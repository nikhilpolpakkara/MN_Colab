ASAP2_VERSION 1 60
/begin PROJECT MSE2_BJ10_0038_00 "MDG1"
/begin HEADER "" VERSION "MSE2_BJ10_0038_00" PROJECT_NO MSE2_BJ10_0038_00 /end HEADER
/begin MODULE DIM ""
/begin MOD_COMMON "" BYTE_ORDER MSB_FIRST ALIGNMENT_BYTE 1 ALIGNMENT_WORD 2 ALIGNMENT_LONG 4 ALIGNMENT_INT64 4 ALIGNMENT_FLOAT32_IEEE 4 ALIGNMENT_FLOAT64_IEEE 4 /end MOD_COMMON
/begin CHARACTERISTIC CWMDFILM "Codeword for MDFILM" VALUE 0x9089532 KwWU8 255.0 dez 0.00 255.0 FORMAT "%5.1" /end CHARACTERISTIC
/begin CHARACTERISTIC CWMDKOL "codeword MDKOL: torque limitation" VALUE 0x9089721 KwWU8 255.0 dez 0.00 255.0 FORMAT "%5.1" /end CHARACTERISTIC
/begin CHARACTERISTIC CWMDLL "codeword MDLL" VALUE 0x9089722 KwWU16 65535.00 OneToOne 0.00 65535.00 FORMAT "%8.2" /end CHARACTERISTIC
/begin CHARACTERISTIC CWMDVERAD "codeword MDVERAD" VALUE 0x9089748 KwWU8 255.0 dez 0.00 255.0 FORMAT "%5.1" /end CHARACTERISTIC
/begin CHARACTERISTIC DDRC_DurDeb.MILLmp_tiOLDebOk_C "debouncing parameter / Duration of healing debouncing for check DFC_MILLmpOL" VALUE 0x908036C Val_Wu16 655350.0 DDRCTime_ms 0.00 655350.0 FORMAT "%8.1" /end CHARACTERISTIC
/begin CHARACTERISTIC DDRC_DurDeb.MILLmp_tiOLDebDef_C "debouncing parameter / Duration of defect debouncing for check DFC_MILLmpOL" VALUE 0x908036E Val_Wu16 655350.0 DDRCTime_ms 0.00 655350.0 FORMAT "%8.1" /end CHARACTERISTIC
/begin CHARACTERISTIC DDRC_DurDeb.MILLmp_tiOTDebOk_C "debouncing parameter / Duration of healing debouncing for check DFC_MILLmpOT" VALUE 0x9080370 Val_Wu16 655350.0 DDRCTime_ms 0.00 655350.0 FORMAT "%8.1" /end CHARACTERISTIC
/begin CHARACTERISTIC DDRC_DurDeb.MILLmp_tiOTDebDef_C "debouncing parameter / Duration of defect debouncing for check DFC_MILLmpOT" VALUE 0x9080372 Val_Wu16 655350.0 DDRCTime_ms 0.00 655350.0 FORMAT "%8.1" /end CHARACTERISTIC
/begin CHARACTERISTIC DDRC_DurDeb.MILLmp_tiSCBDebOk_C "debouncing parameter / Duration of healing debouncing for check DFC_MILLmpSCB" VALUE 0x9080374 Val_Wu16 655350.0 DDRCTime_ms 0.00 655350.0 FORMAT "%8.1" /end CHARACTERISTIC
/begin CHARACTERISTIC DDRC_DurDeb.MILLmp_tiSCBDebDef_C "debouncing parameter / Duration of defect debouncing for check DFC_MILLmpSCB" VALUE 0x9080376 Val_Wu16 655350.0 DDRCTime_ms 0.00 655350.0 FORMAT "%8.1" /end CHARACTERISTIC
/begin CHARACTERISTIC DDRC_DurDeb.MILLmp_tiSCGDebOk_C "debouncing parameter / Duration of healing debouncing for check DFC_MILLmpSCG" VALUE 0x9080378 Val_Wu16 655350.0 DDRCTime_ms 0.00 655350.0 FORMAT "%8.1" /end CHARACTERISTIC
/begin CHARACTERISTIC DDRC_DurDeb.MILLmp_tiSCGDebDef_C "debouncing parameter / Duration of defect debouncing for check DFC_MILLmpSCG" VALUE 0x908037A Val_Wu16 655350.0 DDRCTime_ms 0.00 655350.0 FORMAT "%8.1" /end CHARACTERISTIC
/begin CHARACTERISTIC DDRC_RatDeb.MILLmp_tiOLUDRat_C "Ratioof up-down debouncing / Defect / Heal Ratio for check DFC_MILLmpOL" VALUE 0x9080D61 Val_Wu8 3.00000000000 DDRC_Ratio 1.00000000000 4.00000000000 FORMAT "%13.11" /end CHARACTERISTIC
/begin CHARACTERISTIC DDRC_RatDeb.MILLmp_tiOTUDRat_C "Ratioof up-down debouncing / Defect / Heal Ratio for check DFC_MILLmpOT" VALUE 0x9080D62 Val_Wu8 3.00000000000 DDRC_Ratio 1.00000000000 4.00000000000 FORMAT "%13.11" /end CHARACTERISTIC
/begin CHARACTERISTIC DDRC_RatDeb.MILLmp_tiSCBUDRat_C "Ratioof up-down debouncing / Defect / Heal Ratio for check DFC_MILLmpSCB" VALUE 0x9080D63 Val_Wu8 3.00000000000 DDRC_Ratio 1.00000000000 4.00000000000 FORMAT "%13.11" /end CHARACTERISTIC
/begin CHARACTERISTIC DDRC_RatDeb.MILLmp_tiSCGUDRat_C "Ratioof up-down debouncing / Defect / Heal Ratio for check DFC_MILLmpSCG" VALUE 0x9080D64 Val_Wu8 3.00000000000 DDRC_Ratio 1.00000000000 4.00000000000 FORMAT "%13.11" /end CHARACTERISTIC
/begin CHARACTERISTIC DFC_CtlMsk2.DFC_MILLmpOL_C "Behaviour control mask / Behaviour control masks of check DFC_MILLmpOL" VALUE 0x90803A3 Val_Wu8 255.0 DFES_OneToOne 0.00 255.0 FORMAT "%5.1" /end CHARACTERISTIC
/begin CHARACTERISTIC DFC_CtlMsk2.DFC_MILLmpOT_C "Behaviour control mask / Behaviour control masks of check DFC_MILLmpOT" VALUE 0x90803A4 Val_Wu8 255.0 DFES_OneToOne 0.00 255.0 FORMAT "%5.1" /end CHARACTERISTIC
/begin CHARACTERISTIC DFC_CtlMsk2.DFC_MILLmpSCB_C "Behaviour control mask / Behaviour control masks of check DFC_MILLmpSCB" VALUE 0x90803A5 Val_Wu8 255.0 DFES_OneToOne 0.00 255.0 FORMAT "%5.1" /end CHARACTERISTIC
/begin CHARACTERISTIC DFC_CtlMsk2.DFC_MILLmpSCG_C "Behaviour control mask / Behaviour control masks of check DFC_MILLmpSCG" VALUE 0x90803A6 Val_Wu8 255.0 DFES_OneToOne 0.00 255.0 FORMAT "%5.1" /end CHARACTERISTIC
/begin CHARACTERISTIC DFC_DisblMsk2.DFC_MILLmpOL_C "disable mask / Disable masks of check DFC_MILLmpOL" VALUE 0x9080D73 Val_Wu8 255.0 DFES_OneToOne 0.00 255.0 FORMAT "%5.1" /end CHARACTERISTIC
/begin CHARACTERISTIC DFC_DisblMsk2.DFC_MILLmpOT_C "disable mask / Disable masks of check DFC_MILLmpOT" VALUE 0x9080D74 Val_Wu8 255.0 DFES_OneToOne 0.00 255.0 FORMAT "%5.1" /end CHARACTERISTIC
/begin CHARACTERISTIC DFC_DisblMsk2.DFC_MILLmpSCB_C "disable mask / Disable masks of check DFC_MILLmpSCB" VALUE 0x9080D75 Val_Wu8 255.0 DFES_OneToOne 0.00 255.0 FORMAT "%5.1" /end CHARACTERISTIC
/begin CHARACTERISTIC DFC_DisblMsk2.DFC_MILLmpSCG_C "disable mask / Disable masks of check DFC_MILLmpSCG" VALUE 0x9080D76 Val_Wu8 255.0 DFES_OneToOne 0.00 255.0 FORMAT "%5.1" /end CHARACTERISTIC
/begin CHARACTERISTIC DMAD "maximum adaptable change of resistant torque during one idle cycle" VALUE 0x908974A KwWS16 49.99695 rel_sw_b100 0.00 49.99695 FORMAT "%8.5" EXTENDED_LIMITS -100.0000 99.99695 /end CHARACTERISTIC
/begin CHARACTERISTIC DMADMX "upper limit for torque adaptation" VALUE 0x908974C KwWS16 49.99695 rel_sw_b100 0.00 49.99695 FORMAT "%8.5" EXTENDED_LIMITS -100.0000 99.99695 /end CHARACTERISTIC
/begin CHARACTERISTIC DMIDP "Delta torque for recognition of dashpot" VALUE 0x9089534 KwWU16 99.99847 rel_uw_b100 0.00 99.99847 FORMAT "%8.5" /end CHARACTERISTIC
/begin CHARACTERISTIC DMIZWHY "Delta torque as hysteresis for ignition release" VALUE 0x9089536 KwWU16 99.99847 rel_uw_b100 0.00 99.99847 FORMAT "%8.5" /end CHARACTERISTIC
/begin CHARACTERISTIC DMIZWMK "Delta torque for ignition release" CURVE 0x9089538 KlAxU8SstxS16WU16_Static 99.99847 rel_uw_b100 0.00 99.99847 FORMAT "%8.5"
 /begin AXIS_DESCR STD_AXIS mkfanb_w rel_sw_b100 4 -100.0000 99.99695 FORMAT "%8.4" DEPOSIT ABSOLUTE /end AXIS_DESCR
/end CHARACTERISTIC
/begin CHARACTERISTIC DRMISFA "Parameter to calibrate slope of ramp per second to realise desired driver demanded torque without torque jump" VALUE 0x9089720 KwWU8 2540. relgrd_sb_q10 10.00 2550. FORMAT "%5.0" EXTENDED_LIMITS 0.00 2550. /end CHARACTERISTIC
/begin CHARACTERISTIC DZWETA "delta ignition angle from efficiency" CURVE 0x90898EC FklWS8 95.25 zw_sb_q0p75 0.00 95.25 FORMAT "%5.2" EXTENDED_LIMITS -96.00 95.25
 /begin AXIS_DESCR FIX_AXIS etazws rel_ub_b127p5 201 0.00 100.0 FORMAT "%5.1" FIX_AXIS_PAR 0 0 201 /end AXIS_DESCR
/end CHARACTERISTIC
/begin CHARACTERISTIC DZWOLA "Lambda dependency of optimized model reference ignition angle referred to Lambda 1" CURVE 0x9089234 KlAxU8SstxU8WS8_Static 191.3 zw_sb_q0p75 -96.00 95.25 FORMAT "%5.2"
 /begin AXIS_DESCR STD_AXIS lamsol fak_q0p0039_op0p5 10 0.5000 1.496 FORMAT "%5.3" DEPOSIT ABSOLUTE /end AXIS_DESCR
/end CHARACTERISTIC
/begin CHARACTERISTIC ETADZW "spark efficiency depending on delta ignition angle" CURVE 0x9089249 FklWU8 100.0 rel_ub_b127p5 0.00 100.0 FORMAT "%5.1" EXTENDED_LIMITS 0.00 127.5
 /begin AXIS_DESCR FIX_AXIS dzwb zw_sb_q0p75 65 0.00 48.00 FORMAT "%5.2" FIX_AXIS_PAR 0 0 65 /end AXIS_DESCR
/end CHARACTERISTIC
/begin CHARACTERISTIC ETALAM "Lambda effeciency" CURVE 0x908928A KlAxU8SstxU8WU8 127.5 rel_ub_b127p5 0.00 127.5 FORMAT "%5.1"
 /begin AXIS_DESCR STD_AXIS lamsol fak_q0p0039_op0p5 10 0.5000 1.496 FORMAT "%5.3" DEPOSIT ABSOLUTE /end AXIS_DESCR
/end CHARACTERISTIC
/begin CHARACTERISTIC ETAZWMNO "Upper threshold of minimum ignition efficiency at minimum air charge" VALUE 0x908954A KwWU8 0.9961 fak_ub_b1 0.00 0.9961 /end CHARACTERISTIC
/begin CHARACTERISTIC FGMINUWDP "Factor for adjustment of gradient engine torque during zero transit of clutch torque while decreasing torque." CURVE 0x908954C KlAxU8SstxU16WU8_Static 7.938 fak_ub_b8 0.03125 7.969 FORMAT "%5.3" EXTENDED_LIMITS 0.00 7.969
 /begin AXIS_DESCR STD_AXIS wdkfawu_w relDK_uw_b100 3 0.00 100.0000 FORMAT "%8.4" DEPOSIT ABSOLUTE /end AXIS_DESCR
/end CHARACTERISTIC
/begin CHARACTERISTIC FGMINUWLSD "Factor for adjustment of gradient engine torque during zero transit of clutch torque while increasing torque." CURVE 0x9089558 KlAxU8SstxU16WU8_Static 7.938 fak_ub_b8 0.03125 7.969 FORMAT "%5.3" EXTENDED_LIMITS 0.00 7.969
 /begin AXIS_DESCR STD_AXIS wdkfawu_w relDK_uw_b100 3 0.00 100.0000 FORMAT "%8.4" DEPOSIT ABSOLUTE /end AXIS_DESCR
/end CHARACTERISTIC
/begin CHARACTERISTIC FKAXAVKAT "weighting factor for oxygen capacity depending on avkatf" CURVE 0x9088F1C KlAUbSstUbWUb 0.9961 fak_q0p0039 0.00 0.9961 /begin AXIS_DESCR STD_AXIS avkatf fak_ub_b1 4 0.00 0.9961 DEPOSIT ABSOLUTE /end AXIS_DESCR /end CHARACTERISTIC
/begin CHARACTERISTIC FMINSANG "correction factor for desired indicated engine torque after fuel cut off request based on engine speed gradient" CURVE 0x9089564 KlAxU8SstxS16WU16_Static 1.992188 fak_ub_b2 0.00 1.992188 FORMAT "%8.6" EXTENDED_LIMITS 0.00 511.9922
 /begin AXIS_DESCR STD_AXIS nmotgfil_w nmot_sw_q0p25 2 -8192.000 8191.750 FORMAT "%8.3" DEPOSIT ABSOLUTE /end AXIS_DESCR
/end CHARACTERISTIC
/begin CHARACTERISTIC FTFDPW "Factor for time constant of dashpot filter." CURVE 0x908956E KlAxU8SstxU16WU8_Static 1.984375 fak_ub_b2 0.007812500 1.992188 FORMAT "%8.6" EXTENDED_LIMITS 0.00 1.992188
 /begin AXIS_DESCR STD_AXIS wdkfawu_w relDK_uw_b100 3 0.00 100.0000 FORMAT "%8.4" DEPOSIT ABSOLUTE /end AXIS_DESCR
/end CHARACTERISTIC
/begin CHARACTERISTIC FTFDPWL "Factor for time constant of dashpot filter for mifal_w calculation." CURVE 0x908957A KlAxU8SstxU16WU8_Static 1.992188 fak_ub_b2 0.00 1.992188 FORMAT "%8.6"
 /begin AXIS_DESCR STD_AXIS wdkfawu_w relDK_uw_b100 3 0.00 100.0000 FORMAT "%8.4" DEPOSIT ABSOLUTE /end AXIS_DESCR
/end CHARACTERISTIC
/begin CHARACTERISTIC FTFLSDW "Factor for time constant of LSD filter." CURVE 0x9089586 KlAxU8SstxU16WU8_Static 1.984375 fak_ub_b2 0.007812500 1.992188 FORMAT "%8.6" EXTENDED_LIMITS 0.00 1.992188
 /begin AXIS_DESCR STD_AXIS wdkfawu_w relDK_uw_b100 3 0.00 100.0000 FORMAT "%8.4" DEPOSIT ABSOLUTE /end AXIS_DESCR
/end CHARACTERISTIC
/begin CHARACTERISTIC FTFLSDWL "Factor for time constant of LSD filter for mifal_w calculation." CURVE 0x9089592 KlAxU8SstxU16WU8_Static 1.992188 fak_ub_b2 0.00 1.992188 FORMAT "%8.6"
 /begin AXIS_DESCR STD_AXIS wdkfawu_w relDK_uw_b100 3 0.00 100.0000 FORMAT "%8.4" DEPOSIT ABSOLUTE /end AXIS_DESCR
/end CHARACTERISTIC
/begin CHARACTERISTIC FTVMDWDP "Factor for adjustment of delay time while decreasing torque" CURVE 0x908959E KlAxU8SstxU16WU8_Static 1.984375 fak_ub_b2 0.007812500 1.992188 FORMAT "%8.6" EXTENDED_LIMITS 0.00 1.992188
 /begin AXIS_DESCR STD_AXIS wdkfawu_w relDK_uw_b100 3 0.00 100.0000 FORMAT "%8.4" DEPOSIT ABSOLUTE /end AXIS_DESCR
/end CHARACTERISTIC
/begin CHARACTERISTIC FTVMDWLSD "Factor for adjustment of delay time while increasing torque" CURVE 0x90895AA KlAxU8SstxU16WU8_Static 1.984375 fak_ub_b2 0.007812500 1.992188 FORMAT "%8.6" EXTENDED_LIMITS 0.00 1.992188
 /begin AXIS_DESCR STD_AXIS wdkfawu_w relDK_uw_b100 3 0.00 100.0000 FORMAT "%8.4" DEPOSIT ABSOLUTE /end AXIS_DESCR
/end CHARACTERISTIC
/begin CHARACTERISTIC FURLMION "Conversion factor relative air charge to optimum torque" CURVE 0x90892A0 KlAxU8SstxU16WU16 2.083302 fak_q3p17891Em5 0.00 2.083302 FORMAT "%8.6"
 /begin AXIS_DESCR STD_AXIS nmot_w nmot_uw_q0p25 14 0.00 16383.75 FORMAT "%8.2" DEPOSIT ABSOLUTE /end AXIS_DESCR
/end CHARACTERISTIC
/begin CHARACTERISTIC FURLMIONSOL "MDLL codeword" VALUE 0x9089724 KwWU16 2.083270 fak_q3p17891Em5 0.00003178914 2.083302 FORMAT "%8.6" EXTENDED_LIMITS 0.00 2.083302 /end CHARACTERISTIC
/begin CHARACTERISTIC ILMLKAMN "Threshold for integr. air mass with lambda correction for catalyst purging" VALUE 0x9088F26 KwUw 4660.000 m_q0p1_mg 0.00 4660.000 FORMAT "%8.3" EXTENDED_LIMITS 0.00 6553.500 /end CHARACTERISTIC
/begin CHARACTERISTIC ILMLKAXTK "Threshold of richness area of O2 purging after fuel cat off, funct. of cat-temp" CURVE 0x9088F28 KlAUbSstUbWUw_Static 6553.500 m_q0p1_mg 0.00 6553.500 FORMAT "%8.3"
 /begin AXIS_DESCR STD_AXIS tkihkm temp_ub_q5_o50 4 -50.00 1225. FORMAT "%5.0" DEPOSIT ABSOLUTE /end AXIS_DESCR
/end CHARACTERISTIC
/begin CHARACTERISTIC KFGMINUDP "Gradient of engine torque during zero transit of clutch torque while decreasing torque." MAP 0x90895B6 KfAxU8AyU8SstxU16SstyU16WU16 9999.695 rel_uw_b728 0.1525879 9999.847 FORMAT "%8.3" EXTENDED_LIMITS 0.00 9999.847
 /begin AXIS_DESCR STD_AXIS NO_INPUT_QUANTITY dez 5 0.00 255.0000 FORMAT "%8.4" EXTENDED_LIMITS 0.00 65535.00 DEPOSIT ABSOLUTE /end AXIS_DESCR
 /begin AXIS_DESCR STD_AXIS nmot_w nmot_uw_q0p25 4 0.00 16383.75 FORMAT "%8.2" DEPOSIT ABSOLUTE /end AXIS_DESCR
/end CHARACTERISTIC
/begin CHARACTERISTIC KFGMINULSD "Gradient of engine torque during zero transit of clutch torque while increasing torque." MAP 0x90895F4 KfAxU8AyU8SstxU16SstyU16WU16 9999.695 rel_uw_b728 0.1525879 9999.847 FORMAT "%8.3" EXTENDED_LIMITS 0.00 9999.847
 /begin AXIS_DESCR STD_AXIS NO_INPUT_QUANTITY dez 5 0.00 255.0000 FORMAT "%8.4" EXTENDED_LIMITS 0.00 65535.00 DEPOSIT ABSOLUTE /end AXIS_DESCR
 /begin AXIS_DESCR STD_AXIS nmot_w nmot_uw_q0p25 4 0.00 16383.75 FORMAT "%8.2" DEPOSIT ABSOLUTE /end AXIS_DESCR
/end CHARACTERISTIC
/begin CHARACTERISTIC KFMDS "Map for engine drag torque" MAP 0x908975A KfAxU8AyU8SstxU16SstyU16WU16 39.99939 rel_uw_b40 0.00 39.99939 FORMAT "%8.5"
 /begin AXIS_DESCR STD_AXIS nmot_w nmot_uw_q0p25 25 0.00 16383.75 FORMAT "%8.2" DEPOSIT ABSOLUTE /end AXIS_DESCR
 /begin AXIS_DESCR STD_AXIS dpusms p_ub_q5 6 0.00 327675.0 FORMAT "%8.1" DEPOSIT ABSOLUTE /end AXIS_DESCR
/end CHARACTERISTIC
/begin CHARACTERISTIC KFTFDP "Delay time for driveability filter while decreasing torque." MAP 0x9089632 KfAxU8AyU8SstxU8SstyU16WU8 2.540 t_q0p01 0.01000 2.550 FORMAT "%5.3" EXTENDED_LIMITS 0.00 2.550
 /begin AXIS_DESCR STD_AXIS gangi dez 7 0.00 255.0 FORMAT "%5.1" DEPOSIT ABSOLUTE /end AXIS_DESCR
 /begin AXIS_DESCR STD_AXIS nmot_w nmot_uw_q0p25 4 0.00 16383.75 FORMAT "%8.2" DEPOSIT ABSOLUTE /end AXIS_DESCR
/end CHARACTERISTIC
/begin CHARACTERISTIC KFTFDPL "Time constant for mifal_w calculation while decreasing torque." MAP 0x9089660 KfAxU8AyU8SstxU8SstyU16WU8 2.550 t_q0p01 0.00 2.550 FORMAT "%5.3"
 /begin AXIS_DESCR STD_AXIS gangi dez 5 0.00 255.0 FORMAT "%5.1" DEPOSIT ABSOLUTE /end AXIS_DESCR
 /begin AXIS_DESCR STD_AXIS nmot_w nmot_uw_q0p25 4 0.00 16383.75 FORMAT "%8.2" DEPOSIT ABSOLUTE /end AXIS_DESCR
/end CHARACTERISTIC
/begin CHARACTERISTIC KFTFLSD "Delay time for driveability filter while increasing torque." MAP 0x9089684 KfAxU8AyU8SstxU8SstyU16WU8 2.540 t_q0p01 0.01000 2.550 FORMAT "%5.3" EXTENDED_LIMITS 0.00 2.550
 /begin AXIS_DESCR STD_AXIS gangi dez 7 0.00 255.0 FORMAT "%5.1" DEPOSIT ABSOLUTE /end AXIS_DESCR
 /begin AXIS_DESCR STD_AXIS nmot_w nmot_uw_q0p25 4 0.00 16383.75 FORMAT "%8.2" DEPOSIT ABSOLUTE /end AXIS_DESCR
/end CHARACTERISTIC
/begin CHARACTERISTIC KFTFLSDL "Time constant for mifal_w calculation while increasing torque." MAP 0x90896B2 KfAxU8AyU8SstxU8SstyU16WU8 2.550 t_q0p01 0.00 2.550 FORMAT "%5.3"
 /begin AXIS_DESCR STD_AXIS gangi dez 5 0.00 255.0 FORMAT "%5.1" DEPOSIT ABSOLUTE /end AXIS_DESCR
 /begin AXIS_DESCR STD_AXIS nmot_w nmot_uw_q0p25 4 0.00 16383.75 FORMAT "%8.2" DEPOSIT ABSOLUTE /end AXIS_DESCR
/end CHARACTERISTIC
/begin CHARACTERISTIC KFTVMDLSD "Delay time while increasing torque." MAP 0x90896D6 KfAxU8AyU8SstxU8SstyU16WU8 2.540 t_q0p01 0.01000 2.550 FORMAT "%5.3" EXTENDED_LIMITS 0.00 2.550
 /begin AXIS_DESCR STD_AXIS gangi dez 5 0.00 255.0 FORMAT "%5.1" DEPOSIT ABSOLUTE /end AXIS_DESCR
 /begin AXIS_DESCR STD_AXIS nmot_w nmot_uw_q0p25 4 0.00 16383.75 FORMAT "%8.2" DEPOSIT ABSOLUTE /end AXIS_DESCR
/end CHARACTERISTIC
/begin CHARACTERISTIC KFTVMDP "Delay time while decreasing torque." MAP 0x90896FA KfAxU8AyU8SstxU8SstyU16WU8 2.540 t_q0p01 0.01000 2.550 FORMAT "%5.3" EXTENDED_LIMITS 0.00 2.550
 /begin AXIS_DESCR STD_AXIS gangi dez 5 0.00 255.0 FORMAT "%5.1" DEPOSIT ABSOLUTE /end AXIS_DESCR
 /begin AXIS_DESCR STD_AXIS nmot_w nmot_uw_q0p25 4 0.00 16383.75 FORMAT "%8.2" DEPOSIT ABSOLUTE /end AXIS_DESCR
/end CHARACTERISTIC
/begin CHARACTERISTIC KFZWOP "Optimized model reference ignition angle" MAP 0x90892DA GkfWS8 191.3 zw_sb_q0p75 -96.00 95.25 FORMAT "%5.2"
 /begin AXIS_DESCR COM_AXIS nmotfihy_w nmot_uw_q0p25 30 0.00 16383.75 FORMAT "%8.2" AXIS_PTS_REF SHS30ZUUB /end AXIS_DESCR
 /begin AXIS_DESCR COM_AXIS Ign_ratChrgAirLoc rel_ub_q0p75 20 0.00 191.3 FORMAT "%5.1" AXIS_PTS_REF SRL20ZUUB /end AXIS_DESCR
/end CHARACTERISTIC
/begin CHARACTERISTIC KLNIPDNS "Interpolation factor curve" CURVE 0x9089726 KlAxU8SstxS8WU8_Static 1.000000 fak_ub_b2 0.00 1.000000 FORMAT "%8.6" EXTENDED_LIMITS 0.00 1.992188
 /begin AXIS_DESCR STD_AXIS dns nmotd_sb_q10 8 -1280. 1270. FORMAT "%5.0" DEPOSIT ABSOLUTE /end AXIS_DESCR
/end CHARACTERISTIC
/begin CHARACTERISTIC LAMKAMAX "Max. desired lambda value for catalyst purging open loop" VALUE 0x9088F36 KwUb 0.9961 fak_q0p0039_op0p5 0.5000 1.496 FORMAT "%5.3" /end CHARACTERISTIC
/begin CHARACTERISTIC LAMKAST "Desired lambda value for catalyst purging open loop (characteristic curve by air mass)" CURVE 0x9088F38 KlAUbSstUwWUw 255.9961 fak_q0p0039_op0p5 0.5000000 256.4961 FORMAT "%8.4"
 /begin AXIS_DESCR STD_AXIS ml_w m_uw_b6553p5 4 0.00 6553.500 FORMAT "%8.3" DEPOSIT ABSOLUTE /end AXIS_DESCR
/end CHARACTERISTIC
/begin CHARACTERISTIC MDFILM_tCooltThdDiDrvblty_C "Engine temperature threshold to disable drivability at low coolant temeperatures." VALUE 0x908971E KwWS16 3276.700 Temp_Cels -273.1400 3003.560 FORMAT "%8.3" EXTENDED_LIMITS -3549.940 3003.560 /end CHARACTERISTIC
/begin CHARACTERISTIC MDSH "Part of the resistant torque depending on altitude" CURVE 0x90898C8 KlAxU8SstxU8WS8_Static 24.90 rel_ub_b25 -12.50 12.40 FORMAT "%5.2"
 /begin AXIS_DESCR STD_AXIS fho fak_ub_b4 4 0.00 3.984 FORMAT "%5.3" DEPOSIT ABSOLUTE /end AXIS_DESCR
/end CHARACTERISTIC
/begin CHARACTERISTIC MDSM "temperatuer share of enginie friction torque" CURVE 0x90898D2 KlAxU8SstxS16WU16_Static 6399.902 rel_ub_b25 0.00 6399.902 FORMAT "%8.3"
 /begin AXIS_DESCR STD_AXIS EngDa_tEng Temp_Cels 6 -3549.940 3003.560 FORMAT "%8.3" DEPOSIT ABSOLUTE /end AXIS_DESCR
/end CHARACTERISTIC
/begin CHARACTERISTIC MILLmp_DigOutPar_C.tiBtwTstSCB_C "parameter for power stage diagnostic / Time between tests for SCB error" VALUE 0x908A0EA Kw_Ws16 655350.0 Time_ms -327680.0 327670.0 FORMAT "%8.1" /end CHARACTERISTIC
/begin CHARACTERISTIC MILLmp_DigOutPar_C.tiBtwTstOT_C "parameter for power stage diagnostic / Time between tests for OT error" VALUE 0x908A0EC Kw_Ws16 655.3500 Time_s -327.6800 327.6700 FORMAT "%8.4" /end CHARACTERISTIC
/begin CHARACTERISTIC MILLmp_DigOutPar_C.numTstMax_C "parameter for power stage diagnostic / Maximum number of tests allowed on permanent defect" VALUE 0x908A0EE Kw_Wu16 65535.00 OneToOne 0.00 65535.00 FORMAT "%8.2" /end CHARACTERISTIC
/begin CHARACTERISTIC MILLmp_stMILCfg_CW "configuration parameter for the MIL control" VALUE 0x908A0F4 Val_Wu8 255.0 OneToOne 0.00 255.0 FORMAT "%5.1" /end CHARACTERISTIC
/begin CHARACTERISTIC MILLmp_stPsDiaDisbl_C "Application parameter to disable diagnosis of vehicle MIL lamp power stage" VALUE 0x908A0F0 Val_Wu16 65535.00 OneToOne 0.00 65535.00 FORMAT "%8.2" /end CHARACTERISTIC
/begin CHARACTERISTIC MILLmp_stPsDisbl_C "Application parameter to check if at least one of the conditions is met for disabling MIL lamp" VALUE 0x908A0F2 Val_Wu16 65535.00 OneToOne 0.00 65535.00 FORMAT "%8.2" /end CHARACTERISTIC
/begin CHARACTERISTIC MILLmp_tiAftStrt_C "time for MIL_ON after engine start" VALUE 0x908A0F5 Val_Wu8 254.0 t1sxs_q1 1.000 255.0 FORMAT "%5.1" EXTENDED_LIMITS 0.00 255.0 /end CHARACTERISTIC
/begin CHARACTERISTIC MILLmp_tiRdnBln_C "time for Readiness-Blinking" VALUE 0x908A0F6 Val_Wu8 5.000 t1sxs_q1 5.000 10.00 FORMAT "%5.2" EXTENDED_LIMITS 0.00 255.0 /end CHARACTERISTIC
/begin CHARACTERISTIC MILLmp_tiVisTst_C "time for function test of the MIL" VALUE 0x908A0F7 Val_Wu8 5.000 t1sxs_q1 15.00 20.00 FORMAT "%5.2" EXTENDED_LIMITS 0.00 255.0 /end CHARACTERISTIC
/begin CHARACTERISTIC MisfDet_addrTrgVal_C "Adress for triggervalue" VALUE 0x90828C4 RB_Val_Wu32 4294967295.00 OneToOne 0.00 4294967295.00 FORMAT "%13.2" /end CHARACTERISTIC
/begin CHARACTERISTIC MisfDet_cntrGearChgDly_T "counter for turn off delay for gear change state" CURVE 0x90828EC RB_Curve_S16_U8_Static 255.0 OneToOne 0.00 255.0 FORMAT "%5.1"
 /begin AXIS_DESCR STD_AXIS Epm_nEng EngN 6 -16384.00 16383.50 FORMAT "%8.2" DEPOSIT ABSOLUTE /end AXIS_DESCR
/end CHARACTERISTIC
/begin CHARACTERISTIC MisfDet_cntrIgnBlkStcStrt_C "Delay counter to block statistical function in case of engine start" VALUE 0x9082900 RB_Val_Wu8 255.0 OneToOne 0.00 255.0 FORMAT "%5.1" /end CHARACTERISTIC
/begin CHARACTERISTIC MisfDet_cntrIgnFlreDwn_C "Counter to determine length of flare down phase during engine start" VALUE 0x9082902 RB_Val_Wu16 65535.00 OneToOne 0.00 65535.00 FORMAT "%8.2" /end CHARACTERISTIC
/begin CHARACTERISTIC MisfDet_cntrIgnStrtHld_C "counter for turn off delay for state engine start" VALUE 0x9082904 RB_Val_Wu8 255.0 OneToOne 0.00 255.0 FORMAT "%5.1" /end CHARACTERISTIC
/begin CHARACTERISTIC MisfDet_cylCntrUpdtDn_C "selection of MisfDet_dn sample at S0 or additional interrupt for further processing" VALUE 0x90827CE RB_Val_Wu8 255.0 OneToOne 0.00 255.0 FORMAT "%5.1" /end CHARACTERISTIC
/begin CHARACTERISTIC MisfDet_dlyTiStrt_T "Start delay time, engine temperature dependant" CURVE 0x9082906 RB_Curve_S16_U16_Static 6553.500 t_q0p1 0.00 6553.500 FORMAT "%8.3"
 /begin AXIS_DESCR STD_AXIS MisfDet_tEngStrt Temp_Cels 4 -3549.940 3003.560 FORMAT "%8.3" DEPOSIT ABSOLUTE /end AXIS_DESCR
/end CHARACTERISTIC
/begin CHARACTERISTIC MisfDet_dnCycMaxStc_M "Threshold for the maximum allowed average engine running roughness over one working cycle for the inhibiting condition of misfire statistical function" MAP 0x9082918 RB_Map_S8S16_S16 4095.938 dn_Compu -2048.000 2047.938 FORMAT "%8.3"
 /begin AXIS_DESCR STD_AXIS MisfDet_numGear OneToOne 11 -128.0 127.0 FORMAT "%5.1" DEPOSIT ABSOLUTE /end AXIS_DESCR
 /begin AXIS_DESCR STD_AXIS Epm_nEng EngN 8 -16384.00 16383.50 FORMAT "%8.2" DEPOSIT ABSOLUTE /end AXIS_DESCR
/end CHARACTERISTIC
/begin CHARACTERISTIC MisfDet_dnFilFacMax_C "maximum filter factor for MisfDet_dnFltd" VALUE 0x90827D0 RB_Val_Wu16 0.9999847 fak_uw_b1 0.00 0.9999847 FORMAT "%9.7" /end CHARACTERISTIC
/begin CHARACTERISTIC MisfDet_dnFilFacMin_C "minimum filter factor for MisfDet_dnFltd" VALUE 0x90827D2 RB_Val_Wu16 0.9999847 fak_uw_b1 0.00 0.9999847 FORMAT "%9.7" /end CHARACTERISTIC
/begin CHARACTERISTIC MisfDet_dnFilFacRat_C "percentage of threshold to get maximum filter factor" VALUE 0x90827D4 RB_Val_Wu16 31.99951 fak_uw_b32 0.00 31.99951 FORMAT "%8.5" /end CHARACTERISTIC
/begin CHARACTERISTIC MisfDet_dnFltdAmplThdFacIdle_C "factor on detection trheshold for usage of dnDifXyz at idle" VALUE 0x90827D6 RB_Val_Wu8 0.9961 fak_ub_b1 0.00 0.9961 /end CHARACTERISTIC
/begin CHARACTERISTIC MisfDet_dnFltdAmplThdFac_C "factor on detection trheshold for usage of dnDifXyz" VALUE 0x90827D7 RB_Val_Wu8 0.9961 fak_ub_b1 0.00 0.9961 /end CHARACTERISTIC
/begin CHARACTERISTIC MisfDet_dnFltdInitVal_M "initial value for dnFltd if calculation is stopped" MAP 0x90827D8 RB_Map_U16S16_S16 4095.938 dn_Compu -2048.000 2047.938 FORMAT "%8.3"
 /begin AXIS_DESCR STD_AXIS MisfDet_tqBascSync rel_uw_b100 8 0.00 99.99847 FORMAT "%8.5" DEPOSIT ABSOLUTE /end AXIS_DESCR
 /begin AXIS_DESCR STD_AXIS MisfDet_nEngSync EngN 8 -16384.00 16383.50 FORMAT "%8.2" DEPOSIT ABSOLUTE /end AXIS_DESCR
/end CHARACTERISTIC
/begin CHARACTERISTIC MisfDet_dnQnts_C "quantisation of MisfDet_dn" VALUE 0x908287C RB_Val_Wu8 63.75 fak_ub_b64 0.00 63.75 FORMAT "%5.2" /end CHARACTERISTIC
/begin CHARACTERISTIC MisfDet_dnSynShiftThd_C "Threshold filtered Engine roughness to detect incorrect Engine phase in double ignition mode" VALUE 0x908287E RB_Val_Ws16 4095.938 dn_Compu -2048.000 2047.938 FORMAT "%8.3" /end CHARACTERISTIC
/begin AXIS_PTS MisfDet_dTqThdN_AX "Engine speed axes allowed torque gradient" 0x90829E6 MisfDet_nEngSync RB_Axis_S16 32767.50 EngN 8 -16384.00 16383.50 FORMAT "%8.2" DEPOSIT ABSOLUTE /end AXIS_PTS
/begin AXIS_PTS MisfDet_dTqThdTq_AX "torque axes allowed torque gradient" 0x90829F8 MisfDet_tqBascSync RB_Axis_U16 99.99847 rel_uw_b100 8 0.00 99.99847 FORMAT "%8.5" DEPOSIT ABSOLUTE /end AXIS_PTS
/begin CHARACTERISTIC MisfDet_facEnvPMin_C "Minimal ratio ambient pressure to normal pressure" VALUE 0x9082A0A RB_Val_Wu8 3.984 fak_ub_b4 0.00 3.984 FORMAT "%5.3" /end CHARACTERISTIC
/begin CHARACTERISTIC MisfDet_grdtPedlMax_M "max. gradient of the accelerator pedal position" MAP 0x9082A0C RB_Map_U16S16_S16 3999.939 q0p06104_pc_DIV_s -2000.000 1999.939 FORMAT "%8.3"
 /begin AXIS_DESCR STD_AXIS MisfDet_tqBascSync rel_uw_b100 8 0.00 99.99847 FORMAT "%8.5" DEPOSIT ABSOLUTE /end AXIS_DESCR
 /begin AXIS_DESCR STD_AXIS MisfDet_nEngSync EngN 8 -16384.00 16383.50 FORMAT "%8.2" DEPOSIT ABSOLUTE /end AXIS_DESCR
/end CHARACTERISTIC
/begin CHARACTERISTIC MisfDet_grdtPedlMin_M "min. gradient of the accelerator pedal position" MAP 0x9082AB0 RB_Map_U16S16_S16 3999.939 q0p06104_pc_DIV_s -2000.000 1999.939 FORMAT "%8.3"
 /begin AXIS_DESCR STD_AXIS MisfDet_tqBascSync rel_uw_b100 8 0.00 99.99847 FORMAT "%8.5" DEPOSIT ABSOLUTE /end AXIS_DESCR
 /begin AXIS_DESCR STD_AXIS MisfDet_nEngSync EngN 8 -16384.00 16383.50 FORMAT "%8.2" DEPOSIT ABSOLUTE /end AXIS_DESCR
/end CHARACTERISTIC
/begin CHARACTERISTIC MisfDet_grdtTqMax.Cmn_GM "Maximum allowed torque gradient / all tranmissions" MAP 0x9082C4E RB_MapGroup_S16 3999.939 q0p06104_pc_DIV_s -2000.000 1999.939 FORMAT "%8.3"
 /begin AXIS_DESCR COM_AXIS MisfDet_tqBascSync rel_uw_b100 8 0.00 99.99847 FORMAT "%8.5" AXIS_PTS_REF MisfDet_dTqThdTq_AX /end AXIS_DESCR
 /begin AXIS_DESCR COM_AXIS MisfDet_nEngSync EngN 8 -16384.00 16383.50 FORMAT "%8.2" AXIS_PTS_REF MisfDet_dTqThdN_AX /end AXIS_DESCR
/end CHARACTERISTIC
/begin CHARACTERISTIC MisfDet_grdtTqMin.Cmn_GM "Minimum allowed torque gradient / all tranmissions" MAP 0x9082CCE RB_MapGroup_S16 3999.939 q0p06104_pc_DIV_s -2000.000 1999.939 FORMAT "%8.3"
 /begin AXIS_DESCR COM_AXIS MisfDet_tqBascSync rel_uw_b100 8 0.00 99.99847 FORMAT "%8.5" AXIS_PTS_REF MisfDet_dTqThdTq_AX /end AXIS_DESCR
 /begin AXIS_DESCR COM_AXIS MisfDet_nEngSync EngN 8 -16384.00 16383.50 FORMAT "%8.2" AXIS_PTS_REF MisfDet_dTqThdN_AX /end AXIS_DESCR
/end CHARACTERISTIC
/begin CHARACTERISTIC MisfDet_ignRndMax_C "range of combustions in which one misfire will be generated" VALUE 0x90828C8 RB_Val_Wu16 65535.00 OneToOne 0.00 65535.00 FORMAT "%8.2" /end CHARACTERISTIC
/begin CHARACTERISTIC MisfDet_maskBlkGear_C "Bitmaske mit sperrenden Gangpositionen" VALUE 0x9082B54 RB_Val_Wu16 65535.00 OneToOne 0.00 65535.00 FORMAT "%8.2" /end CHARACTERISTIC
/begin CHARACTERISTIC MisfDet_maskCfgTrg_C "bitmask to configure trigger functionality" VALUE 0x90828CA RB_Val_Wu8 255.0 OneToOne 0.00 255.0 FORMAT "%5.1" /end CHARACTERISTIC
/begin CHARACTERISTIC MisfDet_maskDnFltd.cntrHldN_T "Mask with inhibiting conditions of temporary dN adaption No turn off delay / number ignitions delay, engine speed dependant" CURVE 0x9082D88 RB_Curve_S16_U8_Static 255.0 OneToOne 0.00 255.0 FORMAT "%5.1"
 /begin AXIS_DESCR STD_AXIS Epm_nEng EngN 4 -16384.00 16383.50 FORMAT "%8.2" DEPOSIT ABSOLUTE /end AXIS_DESCR
/end CHARACTERISTIC
/begin CHARACTERISTIC MisfDet_maskDnFltd.cntrHld_C "Mask with inhibiting conditions of temporary dN adaption No turn off delay / number ignitions delay" VALUE 0x9082D96 RB_Val_Wu8 255.0 OneToOne 0.00 255.0 FORMAT "%5.1" /end CHARACTERISTIC
/begin CHARACTERISTIC MisfDet_maskDnFltd.CmbTyp.HldN_C "Mask with inhibiting conditions of temporary dN adaption No turn off delay / mask of selected disabling conditions, engine type specific / bit mask delayed conditions engine speed dependant" VALUE 0x9082D9C RB_Val_Wu32 4294967295.00 OneToOne 0.00 4294967295.00 FORMAT "%13.2" /end CHARACTERISTIC
/begin CHARACTERISTIC MisfDet_maskDnFltd.CmbTyp.Hld_C "Mask with inhibiting conditions of temporary dN adaption No turn off delay / mask of selected disabling conditions, engine type specific / bit mask delayed conditions" VALUE 0x9082DA0 RB_Val_Wu32 4294967295.00 OneToOne 0.00 4294967295.00 FORMAT "%13.2" /end CHARACTERISTIC
/begin CHARACTERISTIC MisfDet_maskDnFltd.CmbTyp.Raw_C "Mask with inhibiting conditions of temporary dN adaption No turn off delay / mask of selected disabling conditions, engine type specific / bit mask not delayed conditions" VALUE 0x9082DA4 RB_Val_Wu32 4294967295.00 OneToOne 0.00 4294967295.00 FORMAT "%13.2" /end CHARACTERISTIC
/begin CHARACTERISTIC MisfDet_maskDnFltd.Cmn.HldN_C "Mask with inhibiting conditions of temporary dN adaption No turn off delay / mask of selected disabling conditions / bit mask delayed conditions engine speed dependant" VALUE 0x9082DAC RB_Val_Wu32 4294967295.00 OneToOne 0.00 4294967295.00 FORMAT "%13.2" /end CHARACTERISTIC
/begin CHARACTERISTIC MisfDet_maskDnFltd.Cmn.Hld_C "Mask with inhibiting conditions of temporary dN adaption No turn off delay / mask of selected disabling conditions / bit mask delayed conditions" VALUE 0x9082DB0 RB_Val_Wu32 4294967295.00 OneToOne 0.00 4294967295.00 FORMAT "%13.2" /end CHARACTERISTIC
/begin CHARACTERISTIC MisfDet_maskDnFltd.Cmn.Raw_C "Mask with inhibiting conditions of temporary dN adaption No turn off delay / mask of selected disabling conditions / bit mask not delayed conditions" VALUE 0x9082DB4 RB_Val_Wu32 4294967295.00 OneToOne 0.00 4294967295.00 FORMAT "%13.2" /end CHARACTERISTIC
/begin CHARACTERISTIC MisfDet_maskMisfGenrCfg_C "bitmask to configure the misfire generator" VALUE 0x90828CB RB_Val_Wu8 255.0 OneToOne 0.00 255.0 FORMAT "%5.1" /end CHARACTERISTIC
/begin CHARACTERISTIC MisfDet_maskStc.cntrHldN_T """Mask with inhibiting conditions of statistical function / number ignitions delay, engine speed dependant" CURVE 0x9082DB8 RB_Curve_S16_U8_Static 255.0 OneToOne 0.00 255.0 FORMAT "%5.1"
 /begin AXIS_DESCR STD_AXIS Epm_nEng EngN 4 -16384.00 16383.50 FORMAT "%8.2" DEPOSIT ABSOLUTE /end AXIS_DESCR
/end CHARACTERISTIC
/begin CHARACTERISTIC MisfDet_maskStc.cntrHld_C """Mask with inhibiting conditions of statistical function / number ignitions delay" VALUE 0x9082DC6 RB_Val_Wu8 255.0 OneToOne 0.00 255.0 FORMAT "%5.1" /end CHARACTERISTIC
/begin CHARACTERISTIC MisfDet_maskStc.CmbTyp.HldN_C """Mask with inhibiting conditions of statistical function / mask of selected disabling conditions, engine type specific / bit mask delayed conditions engine speed dependant" VALUE 0x9082DCC RB_Val_Wu32 4294967295.00 OneToOne 0.00 4294967295.00 FORMAT "%13.2" /end CHARACTERISTIC
/begin CHARACTERISTIC MisfDet_maskStc.CmbTyp.Hld_C """Mask with inhibiting conditions of statistical function / mask of selected disabling conditions, engine type specific / bit mask delayed conditions" VALUE 0x9082DD0 RB_Val_Wu32 4294967295.00 OneToOne 0.00 4294967295.00 FORMAT "%13.2" /end CHARACTERISTIC
/begin CHARACTERISTIC MisfDet_maskStc.CmbTyp.Raw_C """Mask with inhibiting conditions of statistical function / mask of selected disabling conditions, engine type specific / bit mask not delayed conditions" VALUE 0x9082DD4 RB_Val_Wu32 4294967295.00 OneToOne 0.00 4294967295.00 FORMAT "%13.2" /end CHARACTERISTIC
/begin CHARACTERISTIC MisfDet_maskStc.Cmn.HldN_C """Mask with inhibiting conditions of statistical function / mask of selected disabling conditionsmask of selected disabling conditions / bit mask delayed conditions engine speed dependant" VALUE 0x9082DDC RB_Val_Wu32 4294967295.00 OneToOne 0.00 4294967295.00 FORMAT "%13.2" /end CHARACTERISTIC
/begin CHARACTERISTIC MisfDet_maskStc.Cmn.Hld_C """Mask with inhibiting conditions of statistical function / mask of selected disabling conditionsmask of selected disabling conditions / bit mask delayed conditions" VALUE 0x9082DE0 RB_Val_Wu32 4294967295.00 OneToOne 0.00 4294967295.00 FORMAT "%13.2" /end CHARACTERISTIC
/begin CHARACTERISTIC MisfDet_maskStc.Cmn.Raw_C """Mask with inhibiting conditions of statistical function / mask of selected disabling conditionsmask of selected disabling conditions / bit mask not delayed conditions" VALUE 0x9082DE4 RB_Val_Wu32 4294967295.00 OneToOne 0.00 4294967295.00 FORMAT "%13.2" /end CHARACTERISTIC
/begin AXIS_PTS MisfDet_n08TqZero_AX "grouped engine speed axis" 0x9082B56 Epm_nEng RB_Axis_S16 32767.50 EngN 8 -16384.00 16383.50 FORMAT "%8.2" DEPOSIT ABSOLUTE /end AXIS_PTS
/begin CHARACTERISTIC MisfDet_nEngMax.Cmn_GT "Upper limit of allowed engine speed, gear dependant, / all transmission types" CURVE 0x9082D4E RB_CurveGroup_S16 32767.50 EngN -16384.00 16383.50 FORMAT "%8.2"
 /begin AXIS_DESCR COM_AXIS MisfDet_numGear OneToOne 11 -128.0 127.0 FORMAT "%5.1" AXIS_PTS_REF MisfDet_nEngMax_AX /end AXIS_DESCR
/end CHARACTERISTIC
/begin CHARACTERISTIC MisfDet_nEngMaxPedlEvln_C "max. engine speed for evaluation of the gradient of the accelerator pedal position" VALUE 0x9082B68 RB_Val_Ws16 32767.50 EngN -16384.00 16383.50 FORMAT "%8.2" /end CHARACTERISTIC
/begin AXIS_PTS MisfDet_nEngMax_AX "distribution of upper limit of allowed engine speed" 0x9082B6A MisfDet_numGear RB_Axis_S8 255.0 OneToOne 11 -128.0 127.0 FORMAT "%5.1" DEPOSIT ABSOLUTE /end AXIS_PTS
/begin CHARACTERISTIC MisfDet_nEngMin.Cmn_C "Lower limit of allowed engine speed / all transmission types" VALUE 0x9082D64 RB_Val_Ws16 32767.50 EngN -16384.00 16383.50 FORMAT "%8.2" /end CHARACTERISTIC
/begin CHARACTERISTIC MisfDet_nEngMinPedlEvln_C "min. engine speed for evaluation of the gradient of the accelerator pedal position" VALUE 0x9082B76 RB_Val_Ws16 32767.50 EngN -16384.00 16383.50 FORMAT "%8.2" /end CHARACTERISTIC
/begin CHARACTERISTIC MisfDet_nrCmbDiCatHeat_C "number of ignitions for blank-out after a detected misfire under catalyst heat" VALUE 0x9082882 RB_Val_Wu8 255.0 OneToOne 0.00 255.0 FORMAT "%5.1" /end CHARACTERISTIC
/begin CHARACTERISTIC MisfDet_nrCmbDi_M "number of ignitions of suppression after detected misfire" MAP 0x9082884 RB_Map_U16S16_U8 255.0 OneToOne 0.00 255.0 FORMAT "%5.1"
 /begin AXIS_DESCR STD_AXIS MisfDet_tqBascSync rel_uw_b100 4 0.00 99.99847 FORMAT "%8.5" DEPOSIT ABSOLUTE /end AXIS_DESCR
 /begin AXIS_DESCR STD_AXIS MisfDet_nEngSync EngN 8 -16384.00 16383.50 FORMAT "%8.2" DEPOSIT ABSOLUTE /end AXIS_DESCR
/end CHARACTERISTIC
/begin CHARACTERISTIC MisfDet_nrCmbTest_C "duration of test-phase after detected misfire" VALUE 0x90828C0 RB_Val_Wu8 255.0 OneToOne 0.00 255.0 FORMAT "%5.1" /end CHARACTERISTIC
/begin CHARACTERISTIC MisfDet_nSetPLoDiffMax_C "maximum low idle control deviation for detection of open drivetrain" VALUE 0x90827C8 RB_Val_Ws16 32767.50 EngN -16384.00 16383.50 FORMAT "%8.2" /end CHARACTERISTIC
/begin CHARACTERISTIC MisfDet_offsNIdle_C "Offset to idle engine speed to activate zero torque condition" VALUE 0x9082B78 RB_Val_Ws16 32767.50 EngN -16384.00 16383.50 FORMAT "%8.2" /end CHARACTERISTIC
/begin CHARACTERISTIC MisfDet_openPtDlyCntr_C "Debouncing for detection of open drive train" VALUE 0x90827CA RB_Val_Wu8 255.0 OneToOne 0.00 255.0 FORMAT "%5.1" /end CHARACTERISTIC
/begin CHARACTERISTIC MisfDet_stCfgOpenPt_C "configuration switch for detection of open drive train" VALUE 0x90827CB RB_Val_Wu8 255.0 OneToOne 0.00 255.0 FORMAT "%5.1" /end CHARACTERISTIC
/begin CHARACTERISTIC MisfDet_stCmnMiscCfg_C "configuration switch CmnMisc" VALUE 0x90827CC RB_Val_Wu8 255.0 OneToOne 0.00 255.0 FORMAT "%5.1" /end CHARACTERISTIC
/begin CHARACTERISTIC MisfDet_stDnCalcnCfg_C "configuration switch DnCalcn" VALUE 0x9082880 RB_Val_Wu8 255.0 OneToOne 0.00 255.0 FORMAT "%5.1" /end CHARACTERISTIC
/begin CHARACTERISTIC MisfDet_stDnEvlnCfg_C "configuration switch DnEvln" VALUE 0x90828C1 RB_Val_Wu8 255.0 OneToOne 0.00 255.0 FORMAT "%5.1" /end CHARACTERISTIC
/begin CHARACTERISTIC MisfDet_stRelsCdnCfg_C "bit mask for selection of release condition" VALUE 0x9082B7A RB_Val_Wu8 255.0 OneToOne 0.00 255.0 FORMAT "%5.1" /end CHARACTERISTIC
/begin CHARACTERISTIC MisfDet_strtMisfGenr_C "start of misfire generator" VALUE 0x90828CC RB_Val_Wu8 255.0 OneToOne 0.00 255.0 FORMAT "%5.1" /end CHARACTERISTIC
/begin CHARACTERISTIC MisfDet_stTqZeroIdleCfg_C "Configuration of switching from zero torque curve to zero" VALUE 0x9082B7B RB_Val_Wu8 255.0 OneToOne 0.00 255.0 FORMAT "%5.1" /end CHARACTERISTIC
/begin CHARACTERISTIC MisfDet_swtOn_C "Switch to enable misfire detection" VALUE 0x9082B7C RB_Val_Wu8 255.0 OneToOne 0.00 255.0 FORMAT "%5.1" /end CHARACTERISTIC
/begin CHARACTERISTIC MisfDet_tblMisfPat_FM "table for definition of misfire mode and pattern" MAP 0x90828CE RB_FixMap_S16S16_S16 65535.00 OneToOne -32768.00 32767.00 FORMAT "%8.2"
 /begin AXIS_DESCR FIX_AXIS MisfDet_idxMisfPat OneToOne 4 0.00 3.000 FORMAT "%5.3" FIX_AXIS_PAR 0 0 4 /end AXIS_DESCR
 /begin AXIS_DESCR FIX_AXIS MisfDet_idxMisfPat OneToOne 3 0.00 2.000 FORMAT "%5.3" FIX_AXIS_PAR 0 0 3 /end AXIS_DESCR
/end CHARACTERISTIC
/begin CHARACTERISTIC MisfDet_thdNEngStrt_C "Threshold of engine speed to detect engine start" VALUE 0x9082B7E RB_Val_Ws16 32767.50 EngN -16384.00 16383.50 FORMAT "%8.2" /end CHARACTERISTIC
/begin CHARACTERISTIC MisfDet_thdTEngDetnEna_C "Temperature threshold for release of statistics and adaption functions" VALUE 0x9082B80 RB_Val_Ws16 6553.500 Temp_Cels -3549.940 3003.560 FORMAT "%8.3" /end CHARACTERISTIC
/begin CHARACTERISTIC MisfDet_thdTEngDetnStrt_C "Temperature threshold for release of statistics and adaption functions" VALUE 0x9082B82 RB_Val_Ws16 6553.500 Temp_Cels -3549.940 3003.560 FORMAT "%8.3" /end CHARACTERISTIC
/begin CHARACTERISTIC MisfDet_thdTqZeroDrv.Cmn_GT "Threshold zero torque at crankshaft driving state / all transmission types" CURVE 0x9082D66 RB_CurveGroup_U16 99.99847 rel_uw_b100 0.00 99.99847 FORMAT "%8.5"
 /begin AXIS_DESCR COM_AXIS Epm_nEng EngN 8 -16384.00 16383.50 FORMAT "%8.2" AXIS_PTS_REF MisfDet_n08TqZero_AX /end AXIS_DESCR
/end CHARACTERISTIC
/begin CHARACTERISTIC MisfDet_thdTqZeroFlreDwn_C "Threshold zero torque at crankshaft, during flare down phase of engine speed" VALUE 0x9082B84 RB_Val_Wu16 99.99847 rel_uw_b100 0.00 99.99847 FORMAT "%8.5" /end CHARACTERISTIC
/begin CHARACTERISTIC MisfDet_thdTqZeroIdle.Cmn_GT "Threshold zero torque at crankshaft idle state / all transmission types" CURVE 0x9082D76 RB_CurveGroup_U16 99.99847 rel_uw_b100 0.00 99.99847 FORMAT "%8.5"
 /begin AXIS_DESCR COM_AXIS Epm_nEng EngN 8 -16384.00 16383.50 FORMAT "%8.2" AXIS_PTS_REF MisfDet_n08TqZero_AX /end AXIS_DESCR
/end CHARACTERISTIC
/begin CHARACTERISTIC MisfDet_thdTrgVal_C "threshold value for trigger functionality" VALUE 0x90828E8 RB_Val_Wu32 4294967295.00 OneToOne 0.00 4294967295.00 FORMAT "%13.2" /end CHARACTERISTIC
/begin CHARACTERISTIC MisfDet_tqZeroCorrnAlti_M "Map for zero torque correction, engine speed and altitude dependant" MAP 0x9082B86 RB_Map_S16U8_S16 99.99847 rel_uw_b100 -50.00000 49.99847 FORMAT "%8.5"
 /begin AXIS_DESCR STD_AXIS Epm_nEng EngN 5 -16384.00 16383.50 FORMAT "%8.2" DEPOSIT ABSOLUTE /end AXIS_DESCR
 /begin AXIS_DESCR STD_AXIS MisfDet_facEnvP fak_ub_b4 2 0.00 3.984 FORMAT "%5.3" DEPOSIT ABSOLUTE /end AXIS_DESCR
/end CHARACTERISTIC
/begin CHARACTERISTIC MisfDet_tqZeroCorrnTEng_M "Map for zero torque correction, engine speed and engine temperature dependant" MAP 0x9082BAA RB_Map_S16S16_U16 99.99847 rel_uw_b100 0.00 99.99847 FORMAT "%8.5"
 /begin AXIS_DESCR STD_AXIS Epm_nEng EngN 8 -16384.00 16383.50 FORMAT "%8.2" DEPOSIT ABSOLUTE /end AXIS_DESCR
 /begin AXIS_DESCR STD_AXIS MisfDet_tEng Temp_Cels 8 -3549.940 3003.560 FORMAT "%8.3" DEPOSIT ABSOLUTE /end AXIS_DESCR
/end CHARACTERISTIC
/begin AXIS_PTS SHS30ZUUB "datapoint distribution for engine speed. 30 data points" 0x9087790 nmotfihy_w SstAU8SstU16 16383.75 nmot_uw_q0p25 30 0.00 16383.75 FORMAT "%8.2" DEPOSIT ABSOLUTE /end AXIS_PTS
/begin AXIS_PTS SRL20ZUUB "datapoint distributionrelative cylinder charge, 20 datapoints" 0x90877CE Ign_ratChrgAirLoc SstAU8SstU8 191.3 rel_ub_q0p75 20 0.00 191.3 FORMAT "%5.1" DEPOSIT ABSOLUTE /end AXIS_PTS
/begin CHARACTERISTIC TDFRKAD "Control-down time for controlled emptying of the catalyzer" VALUE 0x9088F4A KwUw 1310.6999997 zk20msxs_uw_b1310p72 0.020000305180 1310.7200000 FORMAT "%12.7" /end CHARACTERISTIC
/begin CHARACTERISTIC TMDMADHI "Engine temperature higher threshold to enable adaptation of resistant torque" VALUE 0x908974E KwWS16 6553.500 Temp_Cels -3549.940 3003.560 FORMAT "%8.3" /end CHARACTERISTIC
/begin CHARACTERISTIC TMDMADLO "Engine temperature lower threshold to enable adaptation of resistant torque" VALUE 0x9089750 KwWS16 6553.500 Temp_Cels -3549.940 3003.560 FORMAT "%8.3" /end CHARACTERISTIC
/begin CHARACTERISTIC TMERngMod_ratChrgAirAdpnMax_C "Engine temperature threshold to enable adaptation of resistant torque(MAX)" VALUE 0x9089752 KwWU16 1535.977 rel_uw_q0p0234 0.00 1535.977 FORMAT "%8.3" /end CHARACTERISTIC
/begin CHARACTERISTIC TMERngMod_ratChrgAirAdpnMin_C "Engine temperature threshold to enable adaptation of resistant torque(MIN)" VALUE 0x9089754 KwWU16 1535.977 rel_uw_q0p0234 0.00 1535.977 FORMAT "%8.3" /end CHARACTERISTIC
/begin CHARACTERISTIC TVADFR "delay time release of torque loss adaptation" VALUE 0x9089756 KwWU8 51.00 t_q0p2 0.00 51.00 FORMAT "%5.2" /end CHARACTERISTIC
/begin CHARACTERISTIC TWDMAD "Waiting time to enable adaptation of resistant torque" VALUE 0x9089757 KwWU8 51.00 t_q0p2 0.00 51.00 FORMAT "%5.2" /end CHARACTERISTIC
/begin CHARACTERISTIC TWEMX "Maximum time for cylinder individual resuming of injection after overrun fuel cut-off" VALUE 0x9089746 KwWU8 2.550 t_q0p01 0.00 2.550 FORMAT "%5.3" /end CHARACTERISTIC
/begin CHARACTERISTIC USHKAMXXF "downstream sensor voltage for cancelation of cat oxygen neutralization (LSFX4)" VALUE 0x9088F4C KwUw 327.6750 spg_q0p005 0.00 327.6750 FORMAT "%8.4" /end CHARACTERISTIC
/begin CHARACTERISTIC USVKAMXXF "upstream sensor voltage for detection of lean cond. of cat oxygen neutralization (LSFX4)" VALUE 0x9088F4E KwUw 327.6750 spg_q0p005 0.00 327.6750 FORMAT "%8.4" /end CHARACTERISTIC
/begin CHARACTERISTIC ZKDMAD "time constant for torque adaptation" VALUE 0x9089758 KwWU16 6553.400 t_q0p2 0.2000000 6553.600 FORMAT "%8.3" EXTENDED_LIMITS 0.00 13107.00 /end CHARACTERISTIC
/begin CHARACTERISTIC ZMDNSM "time constant for decay of torque offset after cranking" CURVE 0x9089738 KlAxU8SstxS16WU16_Static 655.3400 t_q0p01 0.01000000 655.3500 FORMAT "%8.4" EXTENDED_LIMITS 0.00 655.3500
 /begin AXIS_DESCR STD_AXIS EngDa_tEng Temp_Cels 3 -3549.940 3003.560 FORMAT "%8.3" DEPOSIT ABSOLUTE /end AXIS_DESCR
/end CHARACTERISTIC
/begin MEASUREMENT B_blrka "Oxygen entry into catalyst to trigger catalyst purge" UBYTE B_TRUE 1 100 0.00 1.00000000000 BIT_MASK 0x1 FORMAT "%13.11" ECU_ADDRESS 0x40008A61 /end MEASUREMENT
/begin MEASUREMENT B_dash "Limitation of negative torque gradient active dashpot" UBYTE B_TRUE 1 100 0.00 1.00000000000 BIT_MASK 0x1 FORMAT "%13.11" ECU_ADDRESS 0x4000878C
 /begin IF_DATA XCPplus 0x0102
  /begin DAQ_EVENT VARIABLE /begin AVAILABLE_EVENT_LIST EVENT 0 EVENT 1 EVENT 2 EVENT 3 /end AVAILABLE_EVENT_LIST /begin DEFAULT_EVENT_LIST EVENT 1 /end DEFAULT_EVENT_LIST /end DAQ_EVENT
 /end IF_DATA
/end MEASUREMENT
/begin MEASUREMENT B_ilmlkat "Condition: valid measurement of oxygen storage" UBYTE B_TRUE 1 100 0.00 1.00000000000 BIT_MASK 0x2 FORMAT "%13.11" ECU_ADDRESS 0x40008A62 /end MEASUREMENT
/begin MEASUREMENT B_ilmlkax "reach integrator area is maximal" UBYTE B_TRUE 1 100 0.00 1.00000000000 BIT_MASK 0x1 FORMAT "%13.11" ECU_ADDRESS 0x40008A5F /end MEASUREMENT
/begin MEASUREMENT B_lrka "condition for neutralization of catalyst oxygen storage" UBYTE B_TRUE 1 100 0.00 1.00000000000 BIT_MASK 0x1 FORMAT "%13.11" ECU_ADDRESS 0x40008A5E /end MEASUREMENT
/begin MEASUREMENT B_madakt "torque loss adaptation activ" UBYTE B_TRUE 1 100 0.00 1.00000000000 BIT_MASK 0x1 FORMAT "%13.11" ECU_ADDRESS 0x4000879B
 /begin IF_DATA XCPplus 0x0102
  /begin DAQ_EVENT VARIABLE /begin AVAILABLE_EVENT_LIST EVENT 0 EVENT 1 EVENT 2 EVENT 3 /end AVAILABLE_EVENT_LIST /begin DEFAULT_EVENT_LIST EVENT 3 /end DEFAULT_EVENT_LIST /end DAQ_EVENT
 /end IF_DATA
/end MEASUREMENT
/begin MEASUREMENT B_madll "condition for torque adaptation loadless" UBYTE B_TRUE 1 100 0.00 1.00000000000 BIT_MASK 0x1 FORMAT "%13.11" ECU_ADDRESS 0x4000879C
 /begin IF_DATA XCPplus 0x0102
  /begin DAQ_EVENT VARIABLE /begin AVAILABLE_EVENT_LIST EVENT 0 EVENT 1 EVENT 2 EVENT 3 /end AVAILABLE_EVENT_LIST /begin DEFAULT_EVENT_LIST EVENT 3 /end DEFAULT_EVENT_LIST /end DAQ_EVENT
 /end IF_DATA
/end MEASUREMENT
/begin MEASUREMENT B_mdein "Condition actions on the torque are active" UBYTE B_TRUE 1 100 0.00 1.00000000000 BIT_MASK 0x1 FORMAT "%13.11" ECU_ADDRESS 0x40008796
 /begin IF_DATA XCPplus 0x0102
  /begin DAQ_EVENT VARIABLE /begin AVAILABLE_EVENT_LIST EVENT 0 EVENT 1 EVENT 2 EVENT 3 /end AVAILABLE_EVENT_LIST /begin DEFAULT_EVENT_LIST EVENT 1 /end DEFAULT_EVENT_LIST /end DAQ_EVENT
 /end IF_DATA
/end MEASUREMENT
/begin MEASUREMENT B_mdene "Condition negative torque intervention active" UBYTE B_TRUE 1 100 0.00 1.00000000000 BIT_MASK 0x1 FORMAT "%13.11" ECU_ADDRESS 0x40008795
 /begin IF_DATA XCPplus 0x0102
  /begin DAQ_EVENT VARIABLE /begin AVAILABLE_EVENT_LIST EVENT 0 EVENT 1 EVENT 2 EVENT 3 /end AVAILABLE_EVENT_LIST /begin DEFAULT_EVENT_LIST EVENT 1 /end DEFAULT_EVENT_LIST /end DAQ_EVENT
 /end IF_DATA
/end MEASUREMENT
/begin MEASUREMENT B_nozwe "condition no intervention of torque-model via ignition angle" UBYTE B_TRUE 1 100 0.00 1.00000000000 BIT_MASK 0x1 FORMAT "%13.11" ECU_ADDRESS 0x40008794
 /begin IF_DATA XCPplus 0x0102
  /begin DAQ_EVENT VARIABLE /begin AVAILABLE_EVENT_LIST EVENT 0 EVENT 1 EVENT 2 EVENT 3 /end AVAILABLE_EVENT_LIST /begin DEFAULT_EVENT_LIST EVENT 0 /end DEFAULT_EVENT_LIST /end DAQ_EVENT
 /end IF_DATA
/end MEASUREMENT
/begin MEASUREMENT B_sa "Fuel cut-off" UBYTE B_TRUE 1 100 0.00 1.00000000000 BIT_MASK 0x1 FORMAT "%13.11" ECU_ADDRESS 0x40008A70
 /begin IF_DATA XCPplus 0x0102
  /begin DAQ_EVENT VARIABLE /begin AVAILABLE_EVENT_LIST EVENT 0 EVENT 1 EVENT 2 EVENT 3 /end AVAILABLE_EVENT_LIST /begin DEFAULT_EVENT_LIST EVENT 1 /end DEFAULT_EVENT_LIST /end DAQ_EVENT
 /end IF_DATA
/end MEASUREMENT
/begin MEASUREMENT B_sablok "condition fuel cut off request (local)" UBYTE B_TRUE 1 100 0.00 1.00000000000 BIT_MASK 0x1 FORMAT "%13.11" ECU_ADDRESS 0x4000878D
 /begin IF_DATA XCPplus 0x0102
  /begin DAQ_EVENT VARIABLE /begin AVAILABLE_EVENT_LIST EVENT 0 EVENT 1 EVENT 2 EVENT 3 /end AVAILABLE_EVENT_LIST /begin DEFAULT_EVENT_LIST EVENT 1 /end DEFAULT_EVENT_LIST /end DAQ_EVENT
 /end IF_DATA
/end MEASUREMENT
/begin MEASUREMENT B_savmd "flag: fuel cut-off prohibition because of torque request" UBYTE B_TRUE 1 100 0.00 1.00000000000 BIT_MASK 0x1 FORMAT "%13.11" ECU_ADDRESS 0x40008793
 /begin IF_DATA XCPplus 0x0102
  /begin DAQ_EVENT VARIABLE /begin AVAILABLE_EVENT_LIST EVENT 0 EVENT 1 EVENT 2 EVENT 3 /end AVAILABLE_EVENT_LIST /begin DEFAULT_EVENT_LIST EVENT 1 /end DEFAULT_EVENT_LIST /end DAQ_EVENT
 /end IF_DATA
/end MEASUREMENT
/begin MEASUREMENT B_sawe "Condition overrun fuel cut-off and resuming injection" UBYTE B_TRUE 1 100 0.00 1.00000000000 BIT_MASK 0x1 FORMAT "%13.11" ECU_ADDRESS 0x40008A6F
 /begin IF_DATA XCPplus 0x0102
  /begin DAQ_EVENT VARIABLE /begin AVAILABLE_EVENT_LIST EVENT 0 EVENT 1 EVENT 2 EVENT 3 /end AVAILABLE_EVENT_LIST /begin DEFAULT_EVENT_LIST EVENT 1 /end DEFAULT_EVENT_LIST /end DAQ_EVENT
 /end IF_DATA
/end MEASUREMENT
/begin MEASUREMENT B_wez "Condition re-injection after fuel cut-off from time synchronous task" UBYTE B_TRUE 1 100 0.00 1.00000000000 BIT_MASK 0x1 FORMAT "%13.11" ECU_ADDRESS 0x40008A6E
 /begin IF_DATA XCPplus 0x0102
  /begin DAQ_EVENT VARIABLE /begin AVAILABLE_EVENT_LIST EVENT 0 EVENT 1 EVENT 2 EVENT 3 /end AVAILABLE_EVENT_LIST /begin DEFAULT_EVENT_LIST EVENT 1 /end DEFAULT_EVENT_LIST /end DAQ_EVENT
 /end IF_DATA
/end MEASUREMENT
/begin MEASUREMENT B_zwf "Condition ignition angle intervention for realization of driver's request" UBYTE B_TRUE 1 100 0.00 1.00000000000 BIT_MASK 0x8 FORMAT "%13.11" ECU_ADDRESS 0x40008797
 /begin IF_DATA XCPplus 0x0102
  /begin DAQ_EVENT VARIABLE /begin AVAILABLE_EVENT_LIST EVENT 0 EVENT 1 EVENT 2 EVENT 3 /end AVAILABLE_EVENT_LIST /begin DEFAULT_EVENT_LIST EVENT 1 /end DEFAULT_EVENT_LIST /end DAQ_EVENT
 /end IF_DATA
/end MEASUREMENT
/begin MEASUREMENT B_zwlwf "Condition ignition angle release by load alteration filter" UBYTE B_TRUE 1 100 0.00 1.00000000000 BIT_MASK 0x1 FORMAT "%13.11" ECU_ADDRESS 0x4000878B
 /begin IF_DATA XCPplus 0x0102
  /begin DAQ_EVENT VARIABLE /begin AVAILABLE_EVENT_LIST EVENT 0 EVENT 1 EVENT 2 EVENT 3 /end AVAILABLE_EVENT_LIST /begin DEFAULT_EVENT_LIST EVENT 1 /end DEFAULT_EVENT_LIST /end DAQ_EVENT
 /end IF_DATA
/end MEASUREMENT
/begin MEASUREMENT B_zwmdlu "Condition ignition angle release due to torque intervention on air path" UBYTE B_TRUE 1 100 0.00 1.00000000000 BIT_MASK 0x1 FORMAT "%13.11" ECU_ADDRESS 0x40008798
 /begin IF_DATA XCPplus 0x0102
  /begin DAQ_EVENT VARIABLE /begin AVAILABLE_EVENT_LIST EVENT 0 EVENT 1 EVENT 2 EVENT 3 /end AVAILABLE_EVENT_LIST /begin DEFAULT_EVENT_LIST EVENT 1 /end DEFAULT_EVENT_LIST /end DAQ_EVENT
 /end IF_DATA
/end MEASUREMENT
/begin MEASUREMENT B_zwvz "condition for ignition angle intervention of torque interface" UBYTE B_TRUE 1 100 0.00 1.00000000000 BIT_MASK 0x1 FORMAT "%13.11" ECU_ADDRESS 0x40008792
 /begin IF_DATA XCPplus 0x0102
  /begin DAQ_EVENT VARIABLE /begin AVAILABLE_EVENT_LIST EVENT 0 EVENT 1 EVENT 2 EVENT 3 /end AVAILABLE_EVENT_LIST /begin DEFAULT_EVENT_LIST EVENT 1 /end DEFAULT_EVENT_LIST /end DAQ_EVENT
 /end IF_DATA
/end MEASUREMENT
/begin MEASUREMENT dmrfnstab_w "resulting torque reserve, possibly weighted by fnstab" UWORD rel_uw_b100 1 100 0.00 99.99847 FORMAT "%8.5" ECU_ADDRESS 0x4000832C
 /begin IF_DATA XCPplus 0x0102
  /begin DAQ_EVENT VARIABLE /begin AVAILABLE_EVENT_LIST EVENT 0 EVENT 1 EVENT 2 EVENT 3 /end AVAILABLE_EVENT_LIST /begin DEFAULT_EVENT_LIST EVENT 1 /end DEFAULT_EVENT_LIST /end DAQ_EVENT
 /end IF_DATA
/end MEASUREMENT
/begin MEASUREMENT dmvadll_w "Delta resistant torque from resistant torque adaptation(B_ll=1)" SWORD rel_sw_b100 1 100 -50.00000 49.99695 FORMAT "%8.5" ECU_ADDRESS 0x4000C6B2
 /begin IF_DATA XCPplus 0x0102
  /begin DAQ_EVENT VARIABLE /begin AVAILABLE_EVENT_LIST EVENT 0 EVENT 1 EVENT 2 EVENT 3 /end AVAILABLE_EVENT_LIST /begin DEFAULT_EVENT_LIST EVENT 3 /end DEFAULT_EVENT_LIST /end DAQ_EVENT
 /end IF_DATA
/end MEASUREMENT
/begin MEASUREMENT dmvad_w "Delta resistant torque from resistant torque adaptation" SWORD rel_sw_b100 1 100 -100.0000 99.99695 FORMAT "%8.4" ECU_ADDRESS 0x4000834A
 /begin IF_DATA XCPplus 0x0102
  /begin DAQ_EVENT VARIABLE /begin AVAILABLE_EVENT_LIST EVENT 0 EVENT 1 EVENT 2 EVENT 3 /end AVAILABLE_EVENT_LIST /begin DEFAULT_EVENT_LIST EVENT 3 /end DEFAULT_EVENT_LIST /end DAQ_EVENT
 /end IF_DATA
/end MEASUREMENT
/begin MEASUREMENT dmvalla_w "Delta torque for adaptation of torque losses without A/C compressor (old value)" SWORD rel_sw_b100 1 100 -50.00000 49.99695 FORMAT "%8.5" ECU_ADDRESS 0x4000834E
 /begin IF_DATA XCPplus 0x0102
  /begin DAQ_EVENT VARIABLE /begin AVAILABLE_EVENT_LIST EVENT 0 EVENT 1 EVENT 2 EVENT 3 /end AVAILABLE_EVENT_LIST /begin DEFAULT_EVENT_LIST EVENT 3 /end DEFAULT_EVENT_LIST /end DAQ_EVENT
 /end IF_DATA
/end MEASUREMENT
/begin MEASUREMENT dpusms "Difference between ambient and manifold pressure for calculation of drag torque" UBYTE p_ub_q5 1 100 0.00 1275. FORMAT "%5.0" ECU_ADDRESS 0x4000879A
 /begin IF_DATA XCPplus 0x0102
  /begin DAQ_EVENT VARIABLE /begin AVAILABLE_EVENT_LIST EVENT 0 EVENT 1 EVENT 2 EVENT 3 /end AVAILABLE_EVENT_LIST /begin DEFAULT_EVENT_LIST EVENT 1 /end DEFAULT_EVENT_LIST /end DAQ_EVENT
 /end IF_DATA
/end MEASUREMENT
/begin MEASUREMENT drmisfa_w "Step size of the delta torque ramp to realise desired driver demanded torque without torque jump" UWORD rel_uw_b100 1 100 0.00 99.99847 FORMAT "%8.5" ECU_ADDRESS 0x40008324
 /begin IF_DATA XCPplus 0x0102
  /begin DAQ_EVENT VARIABLE /begin AVAILABLE_EVENT_LIST EVENT 0 EVENT 1 EVENT 2 EVENT 3 /end AVAILABLE_EVENT_LIST /begin DEFAULT_EVENT_LIST EVENT 1 /end DEFAULT_EVENT_LIST /end DAQ_EVENT
 /end IF_DATA
/end MEASUREMENT
/begin MEASUREMENT dzwb "difference basic ignition angle to optimum ignition angle" UBYTE zw_sb_q0p75 1 100 0.00 191.3 FORMAT "%5.1" ECU_ADDRESS 0x40008A6A
 /begin IF_DATA XCPplus 0x0102
  /begin DAQ_EVENT VARIABLE /begin AVAILABLE_EVENT_LIST EVENT 0 EVENT 1 EVENT 2 EVENT 3 /end AVAILABLE_EVENT_LIST /begin DEFAULT_EVENT_LIST EVENT 0 /end DEFAULT_EVENT_LIST /end DAQ_EVENT
 /end IF_DATA
/end MEASUREMENT
/begin MEASUREMENT dzwi "difference ignition angle (between zwopt and zwout)" UBYTE zw_sb_q0p75 1 100 0.00 191.3 FORMAT "%5.1" ECU_ADDRESS 0x40008A6D
 /begin IF_DATA XCPplus 0x0102
  /begin DAQ_EVENT VARIABLE /begin AVAILABLE_EVENT_LIST EVENT 0 EVENT 1 EVENT 2 EVENT 3 /end AVAILABLE_EVENT_LIST /begin DEFAULT_EVENT_LIST EVENT 1 /end DEFAULT_EVENT_LIST /end DAQ_EVENT
 /end IF_DATA
/end MEASUREMENT
/begin MEASUREMENT dzwol "Lambda-dependent correction of optimized model reference ignition angle" SBYTE zw_sb_q0p75 1 100 -96.00 95.25 FORMAT "%5.2" ECU_ADDRESS 0x40008A69
 /begin IF_DATA XCPplus 0x0102
  /begin DAQ_EVENT VARIABLE /begin AVAILABLE_EVENT_LIST EVENT 0 EVENT 1 EVENT 2 EVENT 3 /end AVAILABLE_EVENT_LIST /begin DEFAULT_EVENT_LIST EVENT 0 /end DEFAULT_EVENT_LIST /end DAQ_EVENT
 /end IF_DATA
/end MEASUREMENT
/begin MEASUREMENT ErrLmp_stMIL "MIL status indicator" UBYTE OneToOne 1 100 0.00 255.0 FORMAT "%5.1" ECU_ADDRESS 0x400063E8
 /begin IF_DATA XCPplus 0x0102
  /begin DAQ_EVENT VARIABLE /begin AVAILABLE_EVENT_LIST EVENT 0 EVENT 1 EVENT 2 EVENT 3 /end AVAILABLE_EVENT_LIST /begin DEFAULT_EVENT_LIST EVENT 2 /end DEFAULT_EVENT_LIST /end DAQ_EVENT
 /end IF_DATA
/end MEASUREMENT
/begin MEASUREMENT etazaist "actual cylinder masking efficiency" UBYTE rel_ub_b127p5 1 100 0.00 100.0 FORMAT "%5.1" ECU_ADDRESS 0x40008A6C
 /begin IF_DATA XCPplus 0x0102
  /begin DAQ_EVENT VARIABLE /begin AVAILABLE_EVENT_LIST EVENT 0 EVENT 1 EVENT 2 EVENT 3 /end AVAILABLE_EVENT_LIST /begin DEFAULT_EVENT_LIST EVENT 1 /end DEFAULT_EVENT_LIST /end DAQ_EVENT
 /end IF_DATA
/end MEASUREMENT
/begin MEASUREMENT etazwb "ignition angle effectiveness of basic ignition angle" UBYTE rel_ub_b127p5 1 100 0.00 100.0 FORMAT "%5.1" ECU_ADDRESS 0x40008A67
 /begin IF_DATA XCPplus 0x0102
  /begin DAQ_EVENT VARIABLE /begin AVAILABLE_EVENT_LIST EVENT 0 EVENT 1 EVENT 2 EVENT 3 /end AVAILABLE_EVENT_LIST /begin DEFAULT_EVENT_LIST EVENT 0 /end DEFAULT_EVENT_LIST /end DAQ_EVENT
 /end IF_DATA
/end MEASUREMENT
/begin MEASUREMENT etazwbm "mean ignition angle effectiveness of basic ignition angle" UBYTE rel_ub_b127p5 1 100 0.00 100.0 FORMAT "%5.1" ECU_ADDRESS 0x40008A66
 /begin IF_DATA XCPplus 0x0102
  /begin DAQ_EVENT VARIABLE /begin AVAILABLE_EVENT_LIST EVENT 0 EVENT 1 EVENT 2 EVENT 3 /end AVAILABLE_EVENT_LIST /begin DEFAULT_EVENT_LIST EVENT 1 /end DEFAULT_EVENT_LIST /end DAQ_EVENT
 /end IF_DATA
/end MEASUREMENT
/begin MEASUREMENT etazwist "actual spark effificiency" UBYTE rel_ub_b127p5 1 100 0.00 100.0 FORMAT "%5.1" ECU_ADDRESS 0x40008A6B
 /begin IF_DATA XCPplus 0x0102
  /begin DAQ_EVENT VARIABLE /begin AVAILABLE_EVENT_LIST EVENT 0 EVENT 1 EVENT 2 EVENT 3 /end AVAILABLE_EVENT_LIST /begin DEFAULT_EVENT_LIST EVENT 1 /end DEFAULT_EVENT_LIST /end DAQ_EVENT
 /end IF_DATA
/end MEASUREMENT
/begin MEASUREMENT etazws "nominal ignition angle efficiency" UBYTE rel_ub_b127p5 1 100 0.00 100.0 FORMAT "%5.1" ECU_ADDRESS 0x40008A75
 /begin IF_DATA XCPplus 0x0102
  /begin DAQ_EVENT VARIABLE /begin AVAILABLE_EVENT_LIST EVENT 0 EVENT 1 EVENT 2 EVENT 3 /end AVAILABLE_EVENT_LIST /begin DEFAULT_EVENT_LIST EVENT 0 /end DEFAULT_EVENT_LIST /end DAQ_EVENT
 /end IF_DATA
/end MEASUREMENT
/begin MEASUREMENT favkatmx "Evaluation factor for oxygen capacity of avkatf" UBYTE fak_q0p0039 1 100 0.00 0.9961 ECU_ADDRESS 0x40008A64 /end MEASUREMENT
/begin MEASUREMENT fminsalok "correction factor for desired indicated engine torque after fule cut off request (local)" UBYTE fak_ub_b2 1 100 0.00 1.992188 FORMAT "%8.6" ECU_ADDRESS 0x4000878E
 /begin IF_DATA XCPplus 0x0102
  /begin DAQ_EVENT VARIABLE /begin AVAILABLE_EVENT_LIST EVENT 0 EVENT 1 EVENT 2 EVENT 3 /end AVAILABLE_EVENT_LIST /begin DEFAULT_EVENT_LIST EVENT 1 /end DEFAULT_EVENT_LIST /end DAQ_EVENT
 /end IF_DATA
/end MEASUREMENT
/begin MEASUREMENT furlmi_w "Conversion factor relative charge air based on torque" UWORD fak_q3p17891Em5 1 100 0.00 2.083302 FORMAT "%8.6" ECU_ADDRESS 0x400086DA
 /begin IF_DATA XCPplus 0x0102
  /begin DAQ_EVENT VARIABLE /begin AVAILABLE_EVENT_LIST EVENT 0 EVENT 1 EVENT 2 EVENT 3 /end AVAILABLE_EVENT_LIST /begin DEFAULT_EVENT_LIST EVENT 1 /end DEFAULT_EVENT_LIST /end DAQ_EVENT
 /end IF_DATA
/end MEASUREMENT
/begin MEASUREMENT gnlwf_w "Torque gradient permitted." UWORD rel_uw_b728 1 100 0.1525879 9999.847 FORMAT "%8.3" ECU_ADDRESS 0x40008312
 /begin IF_DATA XCPplus 0x0102
  /begin DAQ_EVENT VARIABLE /begin AVAILABLE_EVENT_LIST EVENT 0 EVENT 1 EVENT 2 EVENT 3 /end AVAILABLE_EVENT_LIST /begin DEFAULT_EVENT_LIST EVENT 1 /end DEFAULT_EVENT_LIST /end DAQ_EVENT
 /end IF_DATA
/end MEASUREMENT
/begin MEASUREMENT ilmlkax_w "Rich area limit for controlled catalyst purge f(tkatm2), bank 1 |" UWORD m_q0p1_mg 1 100 0.00 6553.500 FORMAT "%8.3" ECU_ADDRESS 0x400086D0 /end MEASUREMENT
/begin MEASUREMENT ilmlka_w "(air mass times delta fr)-integrator for cat oxygen neutralization" UWORD m_q0p1_mg 1 100 0.00 6553.500 FORMAT "%8.3" ECU_ADDRESS 0x400086CE /end MEASUREMENT
/begin MEASUREMENT lamka "Desired lambda for catalyst oxygen purge out" UBYTE fak_q0p0039_op0p5 1 100 0.5000 1.496 FORMAT "%5.3" ECU_ADDRESS 0x40008A60 /end MEASUREMENT
/begin MEASUREMENT lamkaii "lambda setpoint for catalyst deoxidation, valid during init phase" UBYTE fak_q0p0039_op0p5 1 100 0.5000 1.496 FORMAT "%5.3" ECU_ADDRESS 0x40008A63 /end MEASUREMENT
/begin MEASUREMENT mdns_w "torque after start" UWORD rel_uw_b100 1 100 0.00 99.99847 FORMAT "%8.5" ECU_ADDRESS 0x40008340
 /begin IF_DATA XCPplus 0x0102
  /begin DAQ_EVENT VARIABLE /begin AVAILABLE_EVENT_LIST EVENT 0 EVENT 1 EVENT 2 EVENT 3 /end AVAILABLE_EVENT_LIST /begin DEFAULT_EVENT_LIST EVENT 1 /end DEFAULT_EVENT_LIST /end DAQ_EVENT
 /end IF_DATA
/end MEASUREMENT
/begin MEASUREMENT mdsl_w "engine drag torque, slow component" SWORD rel_sw_b100 1 100 -100.0000 99.99695 FORMAT "%8.4" ECU_ADDRESS 0x40008346
 /begin IF_DATA XCPplus 0x0102
  /begin DAQ_EVENT VARIABLE /begin AVAILABLE_EVENT_LIST EVENT 0 EVENT 1 EVENT 2 EVENT 3 /end AVAILABLE_EVENT_LIST /begin DEFAULT_EVENT_LIST EVENT 3 /end DEFAULT_EVENT_LIST /end DAQ_EVENT
 /end IF_DATA
/end MEASUREMENT
/begin MEASUREMENT mdverl_w "Resistant torque of the engine" UWORD rel_uw_b100 1 100 0.00 99.99847 FORMAT "%8.5" ECU_ADDRESS 0x40008344
 /begin IF_DATA XCPplus 0x0102
  /begin DAQ_EVENT VARIABLE /begin AVAILABLE_EVENT_LIST EVENT 0 EVENT 1 EVENT 2 EVENT 3 /end AVAILABLE_EVENT_LIST /begin DEFAULT_EVENT_LIST EVENT 1 /end DEFAULT_EVENT_LIST /end DAQ_EVENT
 /end IF_DATA
/end MEASUREMENT
/begin MEASUREMENT mdvernsol_w "Drag torque loss based on desired engine speed" UWORD rel_uw_b100 1 100 0.00 99.99847 FORMAT "%8.5" ECU_ADDRESS 0x40008342
 /begin IF_DATA XCPplus 0x0102
  /begin DAQ_EVENT VARIABLE /begin AVAILABLE_EVENT_LIST EVENT 0 EVENT 1 EVENT 2 EVENT 3 /end AVAILABLE_EVENT_LIST /begin DEFAULT_EVENT_LIST EVENT 1 /end DEFAULT_EVENT_LIST /end DAQ_EVENT
 /end IF_DATA
/end MEASUREMENT
/begin MEASUREMENT mibas_w "indicated basic torque" UWORD rel_uw_b100 1 100 0.00 99.99847 FORMAT "%8.5" ECU_ADDRESS 0x400086D8
 /begin IF_DATA XCPplus 0x0102
  /begin DAQ_EVENT VARIABLE /begin AVAILABLE_EVENT_LIST EVENT 0 EVENT 1 EVENT 2 EVENT 3 /end AVAILABLE_EVENT_LIST /begin DEFAULT_EVENT_LIST EVENT 1 /end DEFAULT_EVENT_LIST /end DAQ_EVENT
 /end IF_DATA
/end MEASUREMENT
/begin MEASUREMENT mifalr_w "Torque for Torque coordinationation from driver demand , catalyst heating and idle speed torque" UWORD rel_uw_b100 1 100 0.00 99.99847 FORMAT "%8.5" ECU_ADDRESS 0x4000832A
 /begin IF_DATA XCPplus 0x0102
  /begin DAQ_EVENT VARIABLE /begin AVAILABLE_EVENT_LIST EVENT 0 EVENT 1 EVENT 2 EVENT 3 /end AVAILABLE_EVENT_LIST /begin DEFAULT_EVENT_LIST EVENT 1 /end DEFAULT_EVENT_LIST /end DAQ_EVENT
 /end IF_DATA
/end MEASUREMENT
/begin MEASUREMENT mifal_w "Indicated driver's wish torque for torque coordination cylinder filling" UWORD rel_uw_b100 1 100 0.00 99.99847 FORMAT "%8.5" ECU_ADDRESS 0x40008310
 /begin IF_DATA XCPplus 0x0102
  /begin DAQ_EVENT VARIABLE /begin AVAILABLE_EVENT_LIST EVENT 0 EVENT 1 EVENT 2 EVENT 3 /end AVAILABLE_EVENT_LIST /begin DEFAULT_EVENT_LIST EVENT 1 /end DEFAULT_EVENT_LIST /end DAQ_EVENT
 /end IF_DATA
/end MEASUREMENT
/begin MEASUREMENT mifa_w "desired indicated engine torque" UWORD rel_uw_b100 1 100 0.00 99.99847 FORMAT "%8.5" ECU_ADDRESS 0x4000830E
 /begin IF_DATA XCPplus 0x0102
  /begin DAQ_EVENT VARIABLE /begin AVAILABLE_EVENT_LIST EVENT 0 EVENT 1 EVENT 2 EVENT 3 /end AVAILABLE_EVENT_LIST /begin DEFAULT_EVENT_LIST EVENT 1 /end DEFAULT_EVENT_LIST /end DAQ_EVENT
 /end IF_DATA
/end MEASUREMENT
/begin MEASUREMENT migf_w "torque gradient filtered" UWORD rel_uw_b728 1 100 0.00 9999.847 FORMAT "%8.3" ECU_ADDRESS 0x40008316
 /begin IF_DATA XCPplus 0x0102
  /begin DAQ_EVENT VARIABLE /begin AVAILABLE_EVENT_LIST EVENT 0 EVENT 1 EVENT 2 EVENT 3 /end AVAILABLE_EVENT_LIST /begin DEFAULT_EVENT_LIST EVENT 1 /end DEFAULT_EVENT_LIST /end DAQ_EVENT
 /end IF_DATA
/end MEASUREMENT
/begin MEASUREMENT migp_w "torque gradient permitted" UWORD rel_uw_b728 1 100 0.00 9999.847 FORMAT "%8.3" ECU_ADDRESS 0x40008314
 /begin IF_DATA XCPplus 0x0102
  /begin DAQ_EVENT VARIABLE /begin AVAILABLE_EVENT_LIST EVENT 0 EVENT 1 EVENT 2 EVENT 3 /end AVAILABLE_EVENT_LIST /begin DEFAULT_EVENT_LIST EVENT 1 /end DEFAULT_EVENT_LIST /end DAQ_EVENT
 /end IF_DATA
/end MEASUREMENT
/begin MEASUREMENT miist_w "Indicated engine torque high pressure phase (actual value)" UWORD rel_uw_b100 1 100 0.00 99.99847 FORMAT "%8.5" ECU_ADDRESS 0x400086DC
 /begin IF_DATA XCPplus 0x0102
  /begin DAQ_EVENT VARIABLE /begin AVAILABLE_EVENT_LIST EVENT 0 EVENT 1 EVENT 2 EVENT 3 /end AVAILABLE_EVENT_LIST /begin DEFAULT_EVENT_LIST EVENT 1 /end DEFAULT_EVENT_LIST /end DAQ_EVENT
 /end IF_DATA
/end MEASUREMENT
/begin MEASUREMENT milbo_w "Upper limit of indicated torque for air path" UWORD rel_uw_b100 1 100 0.00 99.99847 FORMAT "%8.5" ECU_ADDRESS 0x40008336
 /begin IF_DATA XCPplus 0x0102
  /begin DAQ_EVENT VARIABLE /begin AVAILABLE_EVENT_LIST EVENT 0 EVENT 1 EVENT 2 EVENT 3 /end AVAILABLE_EVENT_LIST /begin DEFAULT_EVENT_LIST EVENT 1 /end DEFAULT_EVENT_LIST /end DAQ_EVENT
 /end IF_DATA
/end MEASUREMENT
/begin MEASUREMENT milbu_w "Lower limit of indicated torque for air path" UWORD rel_uw_b100 1 100 0.00 99.99847 FORMAT "%8.5" ECU_ADDRESS 0x40008334
 /begin IF_DATA XCPplus 0x0102
  /begin DAQ_EVENT VARIABLE /begin AVAILABLE_EVENT_LIST EVENT 0 EVENT 1 EVENT 2 EVENT 3 /end AVAILABLE_EVENT_LIST /begin DEFAULT_EVENT_LIST EVENT 1 /end DEFAULT_EVENT_LIST /end DAQ_EVENT
 /end IF_DATA
/end MEASUREMENT
/begin MEASUREMENT MILLmp_stMIL "MIL status (permanently illuminated, off, blink frequency)" UBYTE OneToOne 1 100 0.00 255.0 FORMAT "%5.1" ECU_ADDRESS 0x400063E7
 /begin IF_DATA XCPplus 0x0102
  /begin DAQ_EVENT VARIABLE /begin AVAILABLE_EVENT_LIST EVENT 0 EVENT 1 EVENT 2 EVENT 3 /end AVAILABLE_EVENT_LIST /begin DEFAULT_EVENT_LIST EVENT 2 /end DEFAULT_EVENT_LIST /end DAQ_EVENT
 /end IF_DATA
/end MEASUREMENT
/begin MEASUREMENT MILLmp_stMILWoTstr "MIL status without tester intervention" UBYTE OneToOne 1 100 0.00 255.0 FORMAT "%5.1" ECU_ADDRESS 0x4000641E
 /begin IF_DATA XCPplus 0x0102
  /begin DAQ_EVENT VARIABLE /begin AVAILABLE_EVENT_LIST EVENT 0 EVENT 1 EVENT 2 EVENT 3 /end AVAILABLE_EVENT_LIST /begin DEFAULT_EVENT_LIST EVENT 3 /end DEFAULT_EVENT_LIST /end DAQ_EVENT
 /end IF_DATA
/end MEASUREMENT
/begin MEASUREMENT MILLmp_stPs "status of the MIL lamp (on, off)" UBYTE OneToOne 1 100 0.00 255.0 BIT_MASK 0x1 FORMAT "%5.1" ECU_ADDRESS 0x400063E6
 /begin IF_DATA XCPplus 0x0102
  /begin DAQ_EVENT VARIABLE /begin AVAILABLE_EVENT_LIST EVENT 0 EVENT 1 EVENT 2 EVENT 3 /end AVAILABLE_EVENT_LIST /begin DEFAULT_EVENT_LIST EVENT 2 /end DEFAULT_EVENT_LIST /end DAQ_EVENT
 /end IF_DATA
/end MEASUREMENT
/begin MEASUREMENT MILLmp_stReqBln "MIL request register for blinking MIL requests" UBYTE MILLmp_ReqVerb 1 100 0.00 255.000000000 FORMAT "%13.9" ECU_ADDRESS 0x4000CB6B
 /begin IF_DATA XCPplus 0x0102
  /begin DAQ_EVENT VARIABLE /begin AVAILABLE_EVENT_LIST EVENT 0 EVENT 1 EVENT 2 EVENT 3 /end AVAILABLE_EVENT_LIST /begin DEFAULT_EVENT_LIST EVENT 3 /end DEFAULT_EVENT_LIST /end DAQ_EVENT
 /end IF_DATA
/end MEASUREMENT
/begin MEASUREMENT MILLmp_stReqOn "MIL request register for continuous MIL requests" UBYTE MILLmp_ReqVerb 1 100 0.00 255.000000000 FORMAT "%13.9" ECU_ADDRESS 0x4000CB6C
 /begin IF_DATA XCPplus 0x0102
  /begin DAQ_EVENT VARIABLE /begin AVAILABLE_EVENT_LIST EVENT 0 EVENT 1 EVENT 2 EVENT 3 /end AVAILABLE_EVENT_LIST /begin DEFAULT_EVENT_LIST EVENT 3 /end DEFAULT_EVENT_LIST /end DAQ_EVENT
 /end IF_DATA
/end MEASUREMENT
/begin MEASUREMENT MILLmp_stSt "state of the MIL's state machine" UBYTE MILLmp_StVerb 1 100 0.00 65.0000000000 FORMAT "%13.10" ECU_ADDRESS 0x4000641C
 /begin IF_DATA XCPplus 0x0102
  /begin DAQ_EVENT VARIABLE /begin AVAILABLE_EVENT_LIST EVENT 0 EVENT 1 EVENT 2 EVENT 3 /end AVAILABLE_EVENT_LIST /begin DEFAULT_EVENT_LIST EVENT 3 /end DEFAULT_EVENT_LIST /end DAQ_EVENT
 /end IF_DATA
/end MEASUREMENT
/begin MEASUREMENT MILLmp_tiRmnBln "remaining time for MIL trigger during MIL_BLINK" UBYTE t50msxs_q0p05 1 100 0.00 12.75 FORMAT "%5.2" ECU_ADDRESS 0x40006627
 /begin IF_DATA XCPplus 0x0102
  /begin DAQ_EVENT VARIABLE /begin AVAILABLE_EVENT_LIST EVENT 0 EVENT 1 EVENT 2 EVENT 3 /end AVAILABLE_EVENT_LIST /begin DEFAULT_EVENT_LIST EVENT 2 /end DEFAULT_EVENT_LIST /end DAQ_EVENT
 /end IF_DATA
/end MEASUREMENT
/begin MEASUREMENT MILLmp_tiRmnSt "remaining state time for states with time trigger" UBYTE t1sxs_q1 1 100 0.00 255.0 FORMAT "%5.1" ECU_ADDRESS 0x4000641D
 /begin IF_DATA XCPplus 0x0102
  /begin DAQ_EVENT VARIABLE /begin AVAILABLE_EVENT_LIST EVENT 0 EVENT 1 EVENT 2 EVENT 3 /end AVAILABLE_EVENT_LIST /begin DEFAULT_EVENT_LIST EVENT 3 /end DEFAULT_EVENT_LIST /end DAQ_EVENT
 /end IF_DATA
/end MEASUREMENT
/begin MEASUREMENT milsol_w "coordinated torque request for charge" UWORD rel_uw_b100 1 100 0.00 99.99847 FORMAT "%8.5" ECU_ADDRESS 0x40008328
 /begin IF_DATA XCPplus 0x0102
  /begin DAQ_EVENT VARIABLE /begin AVAILABLE_EVENT_LIST EVENT 0 EVENT 1 EVENT 2 EVENT 3 /end AVAILABLE_EVENT_LIST /begin DEFAULT_EVENT_LIST EVENT 1 /end DEFAULT_EVENT_LIST /end DAQ_EVENT
 /end IF_DATA
/end MEASUREMENT
/begin MEASUREMENT miopt_w "optimum indicated torque" UWORD rel_uw_b100 1 100 0.00 99.99847 FORMAT "%8.5" ECU_ADDRESS 0x400086D6
 /begin IF_DATA XCPplus 0x0102
  /begin DAQ_EVENT VARIABLE /begin AVAILABLE_EVENT_LIST EVENT 0 EVENT 1 EVENT 2 EVENT 3 /end AVAILABLE_EVENT_LIST /begin DEFAULT_EVENT_LIST EVENT 1 /end DEFAULT_EVENT_LIST /end DAQ_EVENT
 /end IF_DATA
/end MEASUREMENT
/begin MEASUREMENT misfa_w "Indicated desired torque from driver's request" UWORD rel_uw_b100 1 100 0.00 99.99847 FORMAT "%8.5" ECU_ADDRESS 0x40008322
 /begin IF_DATA XCPplus 0x0102
  /begin DAQ_EVENT VARIABLE /begin AVAILABLE_EVENT_LIST EVENT 0 EVENT 1 EVENT 2 EVENT 3 /end AVAILABLE_EVENT_LIST /begin DEFAULT_EVENT_LIST EVENT 1 /end DEFAULT_EVENT_LIST /end DAQ_EVENT
 /end IF_DATA
/end MEASUREMENT
/begin MEASUREMENT MisfDet_cntrGearChgDly "counter for turn off delay for gear change state" UBYTE OneToOne 1 100 0.00 255.0 FORMAT "%5.1" ECU_ADDRESS 0x40007EAA
 /begin IF_DATA XCPplus 0x0102
  /begin DAQ_EVENT VARIABLE /begin AVAILABLE_EVENT_LIST EVENT 0 EVENT 1 EVENT 2 EVENT 3 /end AVAILABLE_EVENT_LIST /begin DEFAULT_EVENT_LIST EVENT 0 /end DEFAULT_EVENT_LIST /end DAQ_EVENT
 /end IF_DATA
/end MEASUREMENT
/begin MEASUREMENT MisfDet_cntrMisf "counter for misfire events" UWORD OneToOne 1 100 0.00 65535.00 FORMAT "%8.2" ECU_ADDRESS 0x40007EB4
 /begin IF_DATA XCPplus 0x0102
  /begin DAQ_EVENT VARIABLE /begin AVAILABLE_EVENT_LIST EVENT 0 EVENT 1 EVENT 2 EVENT 3 /end AVAILABLE_EVENT_LIST /begin DEFAULT_EVENT_LIST EVENT 0 /end DEFAULT_EVENT_LIST /end DAQ_EVENT
 /end IF_DATA
/end MEASUREMENT
/begin MEASUREMENT MisfDet_ctSyn "Synchronous counter, starting with 0 for S0 - only for 1-Cyl projects" UBYTE OneToOne 1 100 0.00 255.0 FORMAT "%5.1" ECU_ADDRESS 0x4000629C
 /begin IF_DATA XCPplus 0x0102
  /begin DAQ_EVENT VARIABLE /begin AVAILABLE_EVENT_LIST EVENT 0 EVENT 1 EVENT 2 EVENT 3 /end AVAILABLE_EVENT_LIST /begin DEFAULT_EVENT_LIST EVENT 0 /end DEFAULT_EVENT_LIST /end DAQ_EVENT
 /end IF_DATA
/end MEASUREMENT
/begin MEASUREMENT MisfDet_cylCntr "cylinder counter misfire detection according to MisfDet_dn (Engine roughness signal)" UBYTE OneToOne 1 100 0.00 255.0 FORMAT "%5.1" ECU_ADDRESS 0x40007F83
 /begin IF_DATA XCPplus 0x0102
  /begin DAQ_EVENT VARIABLE /begin AVAILABLE_EVENT_LIST EVENT 0 EVENT 1 EVENT 2 EVENT 3 /end AVAILABLE_EVENT_LIST /begin DEFAULT_EVENT_LIST EVENT 0 /end DEFAULT_EVENT_LIST /end DAQ_EVENT
 /end IF_DATA
/end MEASUREMENT
/begin MEASUREMENT MisfDet_cylCntrMisfGenr "cylinder counter for misfire generator" UBYTE OneToOne 1 100 0.00 255.0 FORMAT "%5.1" ECU_ADDRESS 0x40007EB3
 /begin IF_DATA XCPplus 0x0102
  /begin DAQ_EVENT VARIABLE /begin AVAILABLE_EVENT_LIST EVENT 0 EVENT 1 EVENT 2 EVENT 3 /end AVAILABLE_EVENT_LIST /begin DEFAULT_EVENT_LIST EVENT 0 /end DEFAULT_EVENT_LIST /end DAQ_EVENT
 /end IF_DATA
/end MEASUREMENT
/begin MEASUREMENT MisfDet_dn "angular acceleration" SWORD dn_Compu 1 100 -2048.000 2047.938 FORMAT "%8.3" ECU_ADDRESS 0x40007FF4
 /begin IF_DATA XCPplus 0x0102
  /begin DAQ_EVENT VARIABLE /begin AVAILABLE_EVENT_LIST EVENT 0 EVENT 1 EVENT 2 EVENT 3 /end AVAILABLE_EVENT_LIST /begin DEFAULT_EVENT_LIST EVENT 0 /end DEFAULT_EVENT_LIST /end DAQ_EVENT
 /end IF_DATA
/end MEASUREMENT
/begin MEASUREMENT MisfDet_dnCyc "Engine speed gradient during one working cycle" SWORD dn_Compu 1 100 -2048.000 2047.938 FORMAT "%8.3" ECU_ADDRESS 0x40007FF2
 /begin IF_DATA XCPplus 0x0102
  /begin DAQ_EVENT VARIABLE /begin AVAILABLE_EVENT_LIST EVENT 0 EVENT 1 EVENT 2 EVENT 3 /end AVAILABLE_EVENT_LIST /begin DEFAULT_EVENT_LIST EVENT 0 /end DEFAULT_EVENT_LIST /end DAQ_EVENT
 /end IF_DATA
/end MEASUREMENT
/begin MEASUREMENT MisfDet_dnCyl "cylinder individual angular acceleration" SWORD dn_Compu 1 100 -2048.000 2047.938 FORMAT "%8.3" ARRAY_SIZE 2 ECU_ADDRESS 0x40007FEE
 /begin IF_DATA XCPplus 0x0102
  /begin DAQ_EVENT VARIABLE /begin AVAILABLE_EVENT_LIST EVENT 0 EVENT 1 EVENT 2 EVENT 3 /end AVAILABLE_EVENT_LIST /begin DEFAULT_EVENT_LIST EVENT 0 /end DEFAULT_EVENT_LIST /end DAQ_EVENT
 /end IF_DATA
/end MEASUREMENT
/begin MEASUREMENT MisfDet_dnDifMin "difference current dn to minimum dnCyl" SWORD dn_Compu 1 100 -2048.000 2047.938 FORMAT "%8.3" ECU_ADDRESS 0x40007FEC
 /begin IF_DATA XCPplus 0x0102
  /begin DAQ_EVENT VARIABLE /begin AVAILABLE_EVENT_LIST EVENT 0 EVENT 1 EVENT 2 EVENT 3 /end AVAILABLE_EVENT_LIST /begin DEFAULT_EVENT_LIST EVENT 0 /end DEFAULT_EVENT_LIST /end DAQ_EVENT
 /end IF_DATA
/end MEASUREMENT
/begin MEASUREMENT MisfDet_dnDifNxt "difference of angular acceleration to the successive cylinder" SWORD dn_Compu 1 100 -2048.000 2047.938 FORMAT "%8.3" ECU_ADDRESS 0x40007FEA
 /begin IF_DATA XCPplus 0x0102
  /begin DAQ_EVENT VARIABLE /begin AVAILABLE_EVENT_LIST EVENT 0 EVENT 1 EVENT 2 EVENT 3 /end AVAILABLE_EVENT_LIST /begin DEFAULT_EVENT_LIST EVENT 0 /end DEFAULT_EVENT_LIST /end DAQ_EVENT
 /end IF_DATA
/end MEASUREMENT
/begin MEASUREMENT MisfDet_dnDly "delay of angular acceleration" UBYTE OneToOne 1 100 0.00 255.0 FORMAT "%5.1" ECU_ADDRESS 0x40007F81
 /begin IF_DATA XCPplus 0x0102
  /begin DAQ_EVENT VARIABLE /begin AVAILABLE_EVENT_LIST EVENT 0 EVENT 1 EVENT 2 EVENT 3 /end AVAILABLE_EVENT_LIST /begin DEFAULT_EVENT_LIST EVENT 0 /end DEFAULT_EVENT_LIST /end DAQ_EVENT
 /end IF_DATA
/end MEASUREMENT
/begin MEASUREMENT MisfDet_dnFilFac "filter factor for MisfDet_dnFltd" UWORD fak_uw_b1 1 100 0.00 0.9999847 FORMAT "%9.7" ARRAY_SIZE 2 ECU_ADDRESS 0x40007FC4
 /begin IF_DATA XCPplus 0x0102
  /begin DAQ_EVENT VARIABLE /begin AVAILABLE_EVENT_LIST EVENT 0 EVENT 1 EVENT 2 EVENT 3 /end AVAILABLE_EVENT_LIST /begin DEFAULT_EVENT_LIST EVENT 0 /end DEFAULT_EVENT_LIST /end DAQ_EVENT
 /end IF_DATA
/end MEASUREMENT
/begin MEASUREMENT MisfDet_dnFltd "filtered angular acceleration of crankshaft" SWORD dn_Compu 1 100 -2048.000 2047.938 FORMAT "%8.3" ECU_ADDRESS 0x40007FE8
 /begin IF_DATA XCPplus 0x0102
  /begin DAQ_EVENT VARIABLE /begin AVAILABLE_EVENT_LIST EVENT 0 EVENT 1 EVENT 2 EVENT 3 /end AVAILABLE_EVENT_LIST /begin DEFAULT_EVENT_LIST EVENT 0 /end DEFAULT_EVENT_LIST /end DAQ_EVENT
 /end IF_DATA
/end MEASUREMENT
/begin MEASUREMENT MisfDet_dnFltdCyl "cylinder individual filtered angular acceleration" SWORD dn_Compu 1 100 -2048.000 2047.938 FORMAT "%8.3" ARRAY_SIZE 2 ECU_ADDRESS 0x40007FE4
 /begin IF_DATA XCPplus 0x0102
  /begin DAQ_EVENT VARIABLE /begin AVAILABLE_EVENT_LIST EVENT 0 EVENT 1 EVENT 2 EVENT 3 /end AVAILABLE_EVENT_LIST /begin DEFAULT_EVENT_LIST EVENT 0 /end DEFAULT_EVENT_LIST /end DAQ_EVENT
 /end IF_DATA
/end MEASUREMENT
/begin MEASUREMENT MisfDet_dnQnts "quantisation of MisfDet_dn" UBYTE fak_ub_b64 1 100 0.00 63.75 FORMAT "%5.2" ECU_ADDRESS 0x40006356 /end MEASUREMENT
/begin MEASUREMENT MisfDet_dnRaw "not corrected angular acceleration" SWORD dn_Compu 1 100 -2048.000 2047.938 FORMAT "%8.3" ECU_ADDRESS 0x40007FE2
 /begin IF_DATA XCPplus 0x0102
  /begin DAQ_EVENT VARIABLE /begin AVAILABLE_EVENT_LIST EVENT 0 EVENT 1 EVENT 2 EVENT 3 /end AVAILABLE_EVENT_LIST /begin DEFAULT_EVENT_LIST EVENT 0 /end DEFAULT_EVENT_LIST /end DAQ_EVENT
 /end IF_DATA
/end MEASUREMENT
/begin MEASUREMENT MisfDet_dnRawAry "array of not corrected angular acceleration (per segment position)" SWORD dn_Compu 1 100 -2048.000 2047.938 FORMAT "%8.3" ARRAY_SIZE 1 ECU_ADDRESS 0x40007FE0
 /begin IF_DATA XCPplus 0x0102
  /begin DAQ_EVENT VARIABLE /begin AVAILABLE_EVENT_LIST EVENT 0 EVENT 1 EVENT 2 EVENT 3 /end AVAILABLE_EVENT_LIST /begin DEFAULT_EVENT_LIST EVENT 0 /end DEFAULT_EVENT_LIST /end DAQ_EVENT
 /end IF_DATA
/end MEASUREMENT
/begin MEASUREMENT MisfDet_dnRawCyl "cylinder individual not corrected angular acceleration" SWORD dn_Compu 1 100 -2048.000 2047.938 FORMAT "%8.3" ARRAY_SIZE 2 ECU_ADDRESS 0x40007FDC
 /begin IF_DATA XCPplus 0x0102
  /begin DAQ_EVENT VARIABLE /begin AVAILABLE_EVENT_LIST EVENT 0 EVENT 1 EVENT 2 EVENT 3 /end AVAILABLE_EVENT_LIST /begin DEFAULT_EVENT_LIST EVENT 0 /end DEFAULT_EVENT_LIST /end DAQ_EVENT
 /end IF_DATA
/end MEASUREMENT
/begin MEASUREMENT MisfDet_dPedlPosn "gradient of the accelerator pedal position" SWORD q0p06104_pc_DIV_s 1 100 -2000.000 1999.939 FORMAT "%8.3" ECU_ADDRESS 0x40007EA8
 /begin IF_DATA XCPplus 0x0102
  /begin DAQ_EVENT VARIABLE /begin AVAILABLE_EVENT_LIST EVENT 0 EVENT 1 EVENT 2 EVENT 3 /end AVAILABLE_EVENT_LIST /begin DEFAULT_EVENT_LIST EVENT 1 /end DEFAULT_EVENT_LIST /end DAQ_EVENT
 /end IF_DATA
/end MEASUREMENT
/begin MEASUREMENT MisfDet_dTq "Gradient of engine torque" SWORD q0p06104_pc_DIV_s 1 100 -2000.000 1999.939 FORMAT "%8.3" ECU_ADDRESS 0x40007EA6
 /begin IF_DATA XCPplus 0x0102
  /begin DAQ_EVENT VARIABLE /begin AVAILABLE_EVENT_LIST EVENT 0 EVENT 1 EVENT 2 EVENT 3 /end AVAILABLE_EVENT_LIST /begin DEFAULT_EVENT_LIST EVENT 1 /end DEFAULT_EVENT_LIST /end DAQ_EVENT
 /end IF_DATA
/end MEASUREMENT
/begin MEASUREMENT MisfDet_facEnvP "Correction factor for zero load depending on ambient pressure" UBYTE fak_ub_b4 1 100 0.00 3.984 FORMAT "%5.3" ECU_ADDRESS 0x40007EA4
 /begin IF_DATA XCPplus 0x0102
  /begin DAQ_EVENT VARIABLE /begin AVAILABLE_EVENT_LIST EVENT 0 EVENT 1 EVENT 2 EVENT 3 /end AVAILABLE_EVENT_LIST /begin DEFAULT_EVENT_LIST EVENT 1 /end DEFAULT_EVENT_LIST /end DAQ_EVENT
 /end IF_DATA
/end MEASUREMENT
/begin MEASUREMENT MisfDet_idxMisfPat "index in misfire pattern table" UBYTE OneToOne 1 100 0.00 255.0 FORMAT "%5.1" ECU_ADDRESS 0x40007EB2
 /begin IF_DATA XCPplus 0x0102
  /begin DAQ_EVENT VARIABLE /begin AVAILABLE_EVENT_LIST EVENT 0 EVENT 1 EVENT 2 EVENT 3 /end AVAILABLE_EVENT_LIST /begin DEFAULT_EVENT_LIST EVENT 0 /end DEFAULT_EVENT_LIST /end DAQ_EVENT
 /end IF_DATA
/end MEASUREMENT
/begin MEASUREMENT MisfDet_ignWaitBtwMisf "number of ignitions between cylinderindividual misfire patterns in single or permanent mode" UWORD OneToOne 1 100 0.00 65535.00 FORMAT "%8.2" ECU_ADDRESS 0x40007EB0
 /begin IF_DATA XCPplus 0x0102
  /begin DAQ_EVENT VARIABLE /begin AVAILABLE_EVENT_LIST EVENT 0 EVENT 1 EVENT 2 EVENT 3 /end AVAILABLE_EVENT_LIST /begin DEFAULT_EVENT_LIST EVENT 0 /end DEFAULT_EVENT_LIST /end DAQ_EVENT
 /end IF_DATA
/end MEASUREMENT
/begin MEASUREMENT MisfDet_ignWaitBtwMisfMod "number of ignitions between misfire modes" UWORD OneToOne 1 100 0.00 65535.00 FORMAT "%8.2" ECU_ADDRESS 0x40007EAE
 /begin IF_DATA XCPplus 0x0102
  /begin DAQ_EVENT VARIABLE /begin AVAILABLE_EVENT_LIST EVENT 0 EVENT 1 EVENT 2 EVENT 3 /end AVAILABLE_EVENT_LIST /begin DEFAULT_EVENT_LIST EVENT 0 /end DEFAULT_EVENT_LIST /end DAQ_EVENT
 /end IF_DATA
/end MEASUREMENT
/begin MEASUREMENT Misfdet_maskDlyBlkDnFltd "Shifiting mask with inhibiting bits for dN calculation" ULONG OneToOne 1 100 0.00 4294967295.00 FORMAT "%13.2" ECU_ADDRESS 0x40007EA0
 /begin IF_DATA XCPplus 0x0102
  /begin DAQ_EVENT VARIABLE /begin AVAILABLE_EVENT_LIST EVENT 0 EVENT 1 EVENT 2 EVENT 3 /end AVAILABLE_EVENT_LIST /begin DEFAULT_EVENT_LIST EVENT 0 /end DEFAULT_EVENT_LIST /end DAQ_EVENT
 /end IF_DATA
/end MEASUREMENT
/begin MEASUREMENT Misfdet_maskDlyBlkStc "Shifiting mask with inhibiting bits for statistical function" ULONG OneToOne 1 100 0.00 4294967295.00 FORMAT "%13.2" ECU_ADDRESS 0x40007E9C
 /begin IF_DATA XCPplus 0x0102
  /begin DAQ_EVENT VARIABLE /begin AVAILABLE_EVENT_LIST EVENT 0 EVENT 1 EVENT 2 EVENT 3 /end AVAILABLE_EVENT_LIST /begin DEFAULT_EVENT_LIST EVENT 0 /end DEFAULT_EVENT_LIST /end DAQ_EVENT
 /end IF_DATA
/end MEASUREMENT
/begin MEASUREMENT MisfDet_maskDnDet "bitmask with cylinders which are detected as misfiring by the Dn-Evaluation procedure" UWORD OneToOne 1 100 0.00 65535.00 FORMAT "%8.2" ECU_ADDRESS 0x40007FC0
 /begin IF_DATA XCPplus 0x0102
  /begin DAQ_EVENT VARIABLE /begin AVAILABLE_EVENT_LIST EVENT 0 EVENT 1 EVENT 2 EVENT 3 /end AVAILABLE_EVENT_LIST /begin DEFAULT_EVENT_LIST EVENT 0 /end DEFAULT_EVENT_LIST /end DAQ_EVENT
 /end IF_DATA
/end MEASUREMENT
/begin MEASUREMENT MisfDet_maskDnFltd.CmbTyp.Hld "Mask with inhibiting conditions of temporary dN adaption No turn off delay / mask of selected disabling conditions, engine type specific / bit mask delayed conditions" ULONG OneToOne 1 100 0.00 4294967295.00 FORMAT "%13.2" ECU_ADDRESS 0x40007E78
 /begin IF_DATA XCPplus 0x0102
  /begin DAQ_EVENT VARIABLE /begin AVAILABLE_EVENT_LIST EVENT 0 EVENT 1 EVENT 2 EVENT 3 /end AVAILABLE_EVENT_LIST /begin DEFAULT_EVENT_LIST EVENT 0 /end DEFAULT_EVENT_LIST /end DAQ_EVENT
 /end IF_DATA
/end MEASUREMENT
/begin MEASUREMENT MisfDet_maskDnFltd.CmbTyp.HldN "Mask with inhibiting conditions of temporary dN adaption No turn off delay / mask of selected disabling conditions, engine type specific / bit mask delayed conditions engine speed dependant" ULONG OneToOne 1 100 0.00 4294967295.00 FORMAT "%13.2" ECU_ADDRESS 0x40007E7C
 /begin IF_DATA XCPplus 0x0102
  /begin DAQ_EVENT VARIABLE /begin AVAILABLE_EVENT_LIST EVENT 0 EVENT 1 EVENT 2 EVENT 3 /end AVAILABLE_EVENT_LIST /begin DEFAULT_EVENT_LIST EVENT 0 /end DEFAULT_EVENT_LIST /end DAQ_EVENT
 /end IF_DATA
/end MEASUREMENT
/begin MEASUREMENT MisfDet_maskDnFltd.CmbTyp.Raw "Mask with inhibiting conditions of temporary dN adaption No turn off delay / mask of selected disabling conditions, engine type specific / bit mask not delayed conditions" ULONG OneToOne 1 100 0.00 4294967295.00 FORMAT "%13.2" ECU_ADDRESS 0x40007E80
 /begin IF_DATA XCPplus 0x0102
  /begin DAQ_EVENT VARIABLE /begin AVAILABLE_EVENT_LIST EVENT 0 EVENT 1 EVENT 2 EVENT 3 /end AVAILABLE_EVENT_LIST /begin DEFAULT_EVENT_LIST EVENT 0 /end DEFAULT_EVENT_LIST /end DAQ_EVENT
 /end IF_DATA
/end MEASUREMENT
/begin MEASUREMENT MisfDet_maskDnFltd.Cmn.Hld "Mask with inhibiting conditions of temporary dN adaption No turn off delay / mask of selected disabling conditions / bit mask delayed conditions" ULONG OneToOne 1 100 0.00 4294967295.00 FORMAT "%13.2" ECU_ADDRESS 0x40007E84 /end MEASUREMENT
/begin MEASUREMENT MisfDet_maskDnFltd.Cmn.HldN "Mask with inhibiting conditions of temporary dN adaption No turn off delay / mask of selected disabling conditions / bit mask delayed conditions engine speed dependant" ULONG OneToOne 1 100 0.00 4294967295.00 FORMAT "%13.2" ECU_ADDRESS 0x40007E88 /end MEASUREMENT
/begin MEASUREMENT MisfDet_maskDnFltd.Cmn.Raw "Mask with inhibiting conditions of temporary dN adaption No turn off delay / mask of selected disabling conditions / bit mask not delayed conditions" ULONG OneToOne 1 100 0.00 4294967295.00 FORMAT "%13.2" ECU_ADDRESS 0x40007E8C /end MEASUREMENT
/begin MEASUREMENT MisfDet_maskDnVld "Validity of engine roughness of the respective segment position" UBYTE OneToOne 1 100 0.00 255.0 FORMAT "%5.1" ECU_ADDRESS 0x40007F80
 /begin IF_DATA XCPplus 0x0102
  /begin DAQ_EVENT VARIABLE /begin AVAILABLE_EVENT_LIST EVENT 0 EVENT 1 EVENT 2 EVENT 3 /end AVAILABLE_EVENT_LIST /begin DEFAULT_EVENT_LIST EVENT 0 /end DEFAULT_EVENT_LIST /end DAQ_EVENT
 /end IF_DATA
/end MEASUREMENT
/begin MEASUREMENT MisfDet_maskMisfSti "flagword for stimulated misfire" UWORD OneToOne 1 100 0.00 65535.00 FORMAT "%8.2" ECU_ADDRESS 0x40007FBE
 /begin IF_DATA XCPplus 0x0102
  /begin DAQ_EVENT VARIABLE /begin AVAILABLE_EVENT_LIST EVENT 0 EVENT 1 EVENT 2 EVENT 3 /end AVAILABLE_EVENT_LIST /begin DEFAULT_EVENT_LIST EVENT 0 /end DEFAULT_EVENT_LIST /end DAQ_EVENT
 /end IF_DATA
/end MEASUREMENT
/begin MEASUREMENT MisfDet_maskMisfStiIgn "flagword for stimulated ignition misfires" UWORD OneToOne 1 100 0.00 65535.00 FORMAT "%8.2" ECU_ADDRESS 0x40007FBC
 /begin IF_DATA XCPplus 0x0102
  /begin DAQ_EVENT VARIABLE /begin AVAILABLE_EVENT_LIST EVENT 0 EVENT 1 EVENT 2 EVENT 3 /end AVAILABLE_EVENT_LIST /begin DEFAULT_EVENT_LIST EVENT 0 /end DEFAULT_EVENT_LIST /end DAQ_EVENT
 /end IF_DATA
/end MEASUREMENT
/begin MEASUREMENT MisfDet_maskMisfStiInj "flagword for stimulated injection misfires" UWORD OneToOne 1 100 0.00 65535.00 FORMAT "%8.2" ECU_ADDRESS 0x40007FBA
 /begin IF_DATA XCPplus 0x0102
  /begin DAQ_EVENT VARIABLE /begin AVAILABLE_EVENT_LIST EVENT 0 EVENT 1 EVENT 2 EVENT 3 /end AVAILABLE_EVENT_LIST /begin DEFAULT_EVENT_LIST EVENT 0 /end DEFAULT_EVENT_LIST /end DAQ_EVENT
 /end IF_DATA
/end MEASUREMENT
/begin MEASUREMENT MisfDet_maskRelsStc "mask with inhibiting conditions of statistical function" ULONG OneToOne 1 100 0.00 4294967295.00 FORMAT "%13.2" ECU_ADDRESS 0x40008004
 /begin IF_DATA XCPplus 0x0102
  /begin DAQ_EVENT VARIABLE /begin AVAILABLE_EVENT_LIST EVENT 0 EVENT 1 EVENT 2 EVENT 3 /end AVAILABLE_EVENT_LIST /begin DEFAULT_EVENT_LIST EVENT 0 /end DEFAULT_EVENT_LIST /end DAQ_EVENT
 /end IF_DATA
/end MEASUREMENT
/begin MEASUREMENT MisfDet_maskRelsStcCmbTyp "mask with inhibiting conditions of statistical function, depending on diesel- or gasoline engine" ULONG OneToOne 1 100 0.00 4294967295.00 FORMAT "%13.2" ECU_ADDRESS 0x40008000
 /begin IF_DATA XCPplus 0x0102
  /begin DAQ_EVENT VARIABLE /begin AVAILABLE_EVENT_LIST EVENT 0 EVENT 1 EVENT 2 EVENT 3 /end AVAILABLE_EVENT_LIST /begin DEFAULT_EVENT_LIST EVENT 0 /end DEFAULT_EVENT_LIST /end DAQ_EVENT
 /end IF_DATA
/end MEASUREMENT
/begin MEASUREMENT MisfDet_maskStc.CmbTyp.Hld """Mask with inhibiting conditions of statistical function / mask of selected disabling conditions, engine type specific / bit mask delayed conditions" ULONG OneToOne 1 100 0.00 4294967295.00 FORMAT "%13.2" ECU_ADDRESS 0x40007E5C
 /begin IF_DATA XCPplus 0x0102
  /begin DAQ_EVENT VARIABLE /begin AVAILABLE_EVENT_LIST EVENT 0 EVENT 1 EVENT 2 EVENT 3 /end AVAILABLE_EVENT_LIST /begin DEFAULT_EVENT_LIST EVENT 0 /end DEFAULT_EVENT_LIST /end DAQ_EVENT
 /end IF_DATA
/end MEASUREMENT
/begin MEASUREMENT MisfDet_maskStc.CmbTyp.HldN """Mask with inhibiting conditions of statistical function / mask of selected disabling conditions, engine type specific / bit mask delayed conditions engine speed dependant" ULONG OneToOne 1 100 0.00 4294967295.00 FORMAT "%13.2" ECU_ADDRESS 0x40007E60
 /begin IF_DATA XCPplus 0x0102
  /begin DAQ_EVENT VARIABLE /begin AVAILABLE_EVENT_LIST EVENT 0 EVENT 1 EVENT 2 EVENT 3 /end AVAILABLE_EVENT_LIST /begin DEFAULT_EVENT_LIST EVENT 0 /end DEFAULT_EVENT_LIST /end DAQ_EVENT
 /end IF_DATA
/end MEASUREMENT
/begin MEASUREMENT MisfDet_maskStc.CmbTyp.Raw """Mask with inhibiting conditions of statistical function / mask of selected disabling conditions, engine type specific / bit mask not delayed conditions" ULONG OneToOne 1 100 0.00 4294967295.00 FORMAT "%13.2" ECU_ADDRESS 0x40007E64
 /begin IF_DATA XCPplus 0x0102
  /begin DAQ_EVENT VARIABLE /begin AVAILABLE_EVENT_LIST EVENT 0 EVENT 1 EVENT 2 EVENT 3 /end AVAILABLE_EVENT_LIST /begin DEFAULT_EVENT_LIST EVENT 0 /end DEFAULT_EVENT_LIST /end DAQ_EVENT
 /end IF_DATA
/end MEASUREMENT
/begin MEASUREMENT MisfDet_maskStc.Cmn.Hld """Mask with inhibiting conditions of statistical function / mask of selected disabling conditionsmask of selected disabling conditions / bit mask delayed conditions" ULONG OneToOne 1 100 0.00 4294967295.00 FORMAT "%13.2" ECU_ADDRESS 0x40007E68 /end MEASUREMENT
/begin MEASUREMENT MisfDet_maskStc.Cmn.HldN """Mask with inhibiting conditions of statistical function / mask of selected disabling conditionsmask of selected disabling conditions / bit mask delayed conditions engine speed dependant" ULONG OneToOne 1 100 0.00 4294967295.00 FORMAT "%13.2" ECU_ADDRESS 0x40007E6C /end MEASUREMENT
/begin MEASUREMENT MisfDet_maskStc.Cmn.Raw """Mask with inhibiting conditions of statistical function / mask of selected disabling conditionsmask of selected disabling conditions / bit mask not delayed conditions" ULONG OneToOne 1 100 0.00 4294967295.00 FORMAT "%13.2" ECU_ADDRESS 0x40007E70 /end MEASUREMENT
/begin MEASUREMENT MisfDet_misfMod "actual misfire mode" SWORD OneToOne 1 100 -32768.00 32767.00 FORMAT "%8.2" ECU_ADDRESS 0x40007EAC
 /begin IF_DATA XCPplus 0x0102
  /begin DAQ_EVENT VARIABLE /begin AVAILABLE_EVENT_LIST EVENT 0 EVENT 1 EVENT 2 EVENT 3 /end AVAILABLE_EVENT_LIST /begin DEFAULT_EVENT_LIST EVENT 0 /end DEFAULT_EVENT_LIST /end DAQ_EVENT
 /end IF_DATA
/end MEASUREMENT
/begin MEASUREMENT MisfDet_nEngSync "engine speed synchronised" SWORD EngN 1 100 -16384.00 16383.50 FORMAT "%8.2" ECU_ADDRESS 0x40007FCC
 /begin IF_DATA XCPplus 0x0102
  /begin DAQ_EVENT VARIABLE /begin AVAILABLE_EVENT_LIST EVENT 0 EVENT 1 EVENT 2 EVENT 3 /end AVAILABLE_EVENT_LIST /begin DEFAULT_EVENT_LIST EVENT 0 /end DEFAULT_EVENT_LIST /end DAQ_EVENT
 /end IF_DATA
/end MEASUREMENT
/begin MEASUREMENT MisfDet_nrCmbDi "Number of ignitions for blank-out after a detecte misfire." UBYTE OneToOne 1 100 0.00 255.0 FORMAT "%5.1" ECU_ADDRESS 0x40007F7D
 /begin IF_DATA XCPplus 0x0102
  /begin DAQ_EVENT VARIABLE /begin AVAILABLE_EVENT_LIST EVENT 0 EVENT 1 EVENT 2 EVENT 3 /end AVAILABLE_EVENT_LIST /begin DEFAULT_EVENT_LIST EVENT 2 /end DEFAULT_EVENT_LIST /end DAQ_EVENT
 /end IF_DATA
/end MEASUREMENT
/begin MEASUREMENT MisfDet_nSetPLoDiff "low idle control deviation" SWORD EngN 1 100 -16384.00 16383.50 FORMAT "%8.2" ECU_ADDRESS 0x40007FCA
 /begin IF_DATA XCPplus 0x0102
  /begin DAQ_EVENT VARIABLE /begin AVAILABLE_EVENT_LIST EVENT 0 EVENT 1 EVENT 2 EVENT 3 /end AVAILABLE_EVENT_LIST /begin DEFAULT_EVENT_LIST EVENT 0 /end DEFAULT_EVENT_LIST /end DAQ_EVENT
 /end IF_DATA
/end MEASUREMENT
/begin MEASUREMENT MisfDet_numGear "Variable to indicate the gear number for MisfDet" SBYTE OneToOne 1 100 -128.0 127.0 FORMAT "%5.1" ECU_ADDRESS 0x40007E98
 /begin IF_DATA XCPplus 0x0102
  /begin DAQ_EVENT VARIABLE /begin AVAILABLE_EVENT_LIST EVENT 0 EVENT 1 EVENT 2 EVENT 3 /end AVAILABLE_EVENT_LIST /begin DEFAULT_EVENT_LIST EVENT 0 /end DEFAULT_EVENT_LIST /end DAQ_EVENT
 /end IF_DATA
/end MEASUREMENT
/begin MEASUREMENT MisfDet_openPtDlyCntr "Debounce counter for detection of open drive train" UBYTE OneToOne 1 100 0.00 255.0 FORMAT "%5.1" ECU_ADDRESS 0x40007F2A
 /begin IF_DATA XCPplus 0x0102
  /begin DAQ_EVENT VARIABLE /begin AVAILABLE_EVENT_LIST EVENT 0 EVENT 1 EVENT 2 EVENT 3 /end AVAILABLE_EVENT_LIST /begin DEFAULT_EVENT_LIST EVENT 0 /end DEFAULT_EVENT_LIST /end DAQ_EVENT
 /end IF_DATA
/end MEASUREMENT
/begin MEASUREMENT MisfDet_phiAbsS0 "Absolute position of S0 referece to TDC" SWORD AngleCrS 1 100 -720.0000 719.9780 FORMAT "%8.4" ECU_ADDRESS 0x40007F28
 /begin IF_DATA XCPplus 0x0102
  /begin DAQ_EVENT VARIABLE /begin AVAILABLE_EVENT_LIST EVENT 0 EVENT 1 EVENT 2 EVENT 3 /end AVAILABLE_EVENT_LIST /begin DEFAULT_EVENT_LIST EVENT 0 /end DEFAULT_EVENT_LIST /end DAQ_EVENT
 /end IF_DATA
/end MEASUREMENT
/begin MEASUREMENT MisfDet_segPosnDn "segment position engine roughness" UBYTE Compu_SegPosnInt_VERB 1 100 0.00 258.000000000 FORMAT "%13.9" ECU_ADDRESS 0x40007F76
 /begin IF_DATA XCPplus 0x0102
  /begin DAQ_EVENT VARIABLE /begin AVAILABLE_EVENT_LIST EVENT 0 EVENT 1 EVENT 2 EVENT 3 /end AVAILABLE_EVENT_LIST /begin DEFAULT_EVENT_LIST EVENT 0 /end DEFAULT_EVENT_LIST /end DAQ_EVENT
 /end IF_DATA
/end MEASUREMENT
/begin MEASUREMENT MisfDet_stAsr "Torque intervention by road handling control" UBYTE B_TRUE 1 100 0.00 1.00000000000 BIT_MASK 0x1 FORMAT "%13.11" ECU_ADDRESS 0x40006413
 /begin IF_DATA XCPplus 0x0102
  /begin DAQ_EVENT VARIABLE /begin AVAILABLE_EVENT_LIST EVENT 0 EVENT 1 EVENT 2 EVENT 3 /end AVAILABLE_EVENT_LIST /begin DEFAULT_EVENT_LIST EVENT 0 /end DEFAULT_EVENT_LIST /end DAQ_EVENT
 /end IF_DATA
/end MEASUREMENT
/begin MEASUREMENT MisfDet_stBlkAftDetn "Suppresion after detected misfire" UBYTE B_TRUE 1 100 0.00 1.00000000000 BIT_MASK 0x1 FORMAT "%13.11" ECU_ADDRESS 0x40006385
 /begin IF_DATA XCPplus 0x0102
  /begin DAQ_EVENT VARIABLE /begin AVAILABLE_EVENT_LIST EVENT 0 EVENT 1 EVENT 2 EVENT 3 /end AVAILABLE_EVENT_LIST /begin DEFAULT_EVENT_LIST EVENT 0 /end DEFAULT_EVENT_LIST /end DAQ_EVENT
 /end IF_DATA
/end MEASUREMENT
/begin MEASUREMENT MisfDet_stBlkAftDetnTest "test phase after detected misfire" UBYTE B_TRUE 1 100 0.00 1.00000000000 BIT_MASK 0x1 FORMAT "%13.11" ECU_ADDRESS 0x40006384
 /begin IF_DATA XCPplus 0x0102
  /begin DAQ_EVENT VARIABLE /begin AVAILABLE_EVENT_LIST EVENT 0 EVENT 1 EVENT 2 EVENT 3 /end AVAILABLE_EVENT_LIST /begin DEFAULT_EVENT_LIST EVENT 0 /end DEFAULT_EVENT_LIST /end DAQ_EVENT
 /end IF_DATA
/end MEASUREMENT
/begin MEASUREMENT MisfDet_stBlkDnFltd "Inhibiting condition for dN calculation" UBYTE B_TRUE 1 100 0.00 1.00000000000 BIT_MASK 0x1 FORMAT "%13.11" ECU_ADDRESS 0x40006383
 /begin IF_DATA XCPplus 0x0102
  /begin DAQ_EVENT VARIABLE /begin AVAILABLE_EVENT_LIST EVENT 0 EVENT 1 EVENT 2 EVENT 3 /end AVAILABLE_EVENT_LIST /begin DEFAULT_EVENT_LIST EVENT 0 /end DEFAULT_EVENT_LIST /end DAQ_EVENT
 /end IF_DATA
/end MEASUREMENT
/begin MEASUREMENT MisfDet_stBlkDnFltdTyp "Inhibiting condition for dN calculation, with and without delay (bit mask)" UBYTE OneToOne 1 100 0.00 255.0 FORMAT "%5.1" ECU_ADDRESS 0x40007E97
 /begin IF_DATA XCPplus 0x0102
  /begin DAQ_EVENT VARIABLE /begin AVAILABLE_EVENT_LIST EVENT 0 EVENT 1 EVENT 2 EVENT 3 /end AVAILABLE_EVENT_LIST /begin DEFAULT_EVENT_LIST EVENT 0 /end DEFAULT_EVENT_LIST /end DAQ_EVENT
 /end IF_DATA
/end MEASUREMENT
/begin MEASUREMENT MisfDet_stBlkStc "Inhibiting condition statistical function" UBYTE B_TRUE 1 100 0.00 1.00000000000 BIT_MASK 0x1 FORMAT "%13.11" ECU_ADDRESS 0x40006382
 /begin IF_DATA XCPplus 0x0102
  /begin DAQ_EVENT VARIABLE /begin AVAILABLE_EVENT_LIST EVENT 0 EVENT 1 EVENT 2 EVENT 3 /end AVAILABLE_EVENT_LIST /begin DEFAULT_EVENT_LIST EVENT 0 /end DEFAULT_EVENT_LIST /end DAQ_EVENT
 /end IF_DATA
/end MEASUREMENT
/begin MEASUREMENT MisfDet_stBlkStcTyp "Inhibiting condition statistical function, with and without delay (bit mask)" UBYTE OneToOne 1 100 0.00 255.0 FORMAT "%5.1" ECU_ADDRESS 0x40007E96
 /begin IF_DATA XCPplus 0x0102
  /begin DAQ_EVENT VARIABLE /begin AVAILABLE_EVENT_LIST EVENT 0 EVENT 1 EVENT 2 EVENT 3 /end AVAILABLE_EVENT_LIST /begin DEFAULT_EVENT_LIST EVENT 0 /end DEFAULT_EVENT_LIST /end DAQ_EVENT
 /end IF_DATA
/end MEASUREMENT
/begin MEASUREMENT MisfDet_stCalcIntrpt "Status flag which is set for Misfire syncro calculations - 1Cyl projects" UBYTE B_TRUE 1 100 0.00 1.00000000000 BIT_MASK 0x1 FORMAT "%13.11" ECU_ADDRESS 0x40006412
 /begin IF_DATA XCPplus 0x0102
  /begin DAQ_EVENT VARIABLE /begin AVAILABLE_EVENT_LIST EVENT 0 EVENT 1 EVENT 2 EVENT 3 /end AVAILABLE_EVENT_LIST /begin DEFAULT_EVENT_LIST EVENT 0 /end DEFAULT_EVENT_LIST /end DAQ_EVENT
 /end IF_DATA
/end MEASUREMENT
/begin MEASUREMENT MisfDet_stCatHeat "Condition catalyst heating for misfire detection" UBYTE B_TRUE 1 100 0.00 1.00000000000 BIT_MASK 0x1 FORMAT "%13.11" ECU_ADDRESS 0x4000640E
 /begin IF_DATA XCPplus 0x0102
  /begin DAQ_EVENT VARIABLE /begin AVAILABLE_EVENT_LIST EVENT 0 EVENT 1 EVENT 2 EVENT 3 /end AVAILABLE_EVENT_LIST /begin DEFAULT_EVENT_LIST EVENT 0 /end DEFAULT_EVENT_LIST /end DAQ_EVENT
 /end IF_DATA
/end MEASUREMENT
/begin MEASUREMENT MisfDet_stClthChng "clutch pedal pressed" UBYTE B_TRUE 1 100 0.00 1.00000000000 BIT_MASK 0x1 FORMAT "%13.11" ECU_ADDRESS 0x40006381
 /begin IF_DATA XCPplus 0x0102
  /begin DAQ_EVENT VARIABLE /begin AVAILABLE_EVENT_LIST EVENT 0 EVENT 1 EVENT 2 EVENT 3 /end AVAILABLE_EVENT_LIST /begin DEFAULT_EVENT_LIST EVENT 0 /end DEFAULT_EVENT_LIST /end DAQ_EVENT
 /end IF_DATA
/end MEASUREMENT
/begin MEASUREMENT MisfDet_stDet "state misfire detected" UBYTE B_TRUE 1 100 0.00 1.00000000000 BIT_MASK 0x1 FORMAT "%13.11" ECU_ADDRESS 0x4000637D
 /begin IF_DATA XCPplus 0x0102
  /begin DAQ_EVENT VARIABLE /begin AVAILABLE_EVENT_LIST EVENT 0 EVENT 1 EVENT 2 EVENT 3 /end AVAILABLE_EVENT_LIST /begin DEFAULT_EVENT_LIST EVENT 0 /end DEFAULT_EVENT_LIST /end DAQ_EVENT
 /end IF_DATA
/end MEASUREMENT
/begin MEASUREMENT MisfDet_stDlyStrtStc "Delay condition after start for releasing statistical function" UBYTE B_TRUE 1 100 0.00 1.00000000000 BIT_MASK 0x1 FORMAT "%13.11" ECU_ADDRESS 0x40006296
 /begin IF_DATA XCPplus 0x0102
  /begin DAQ_EVENT VARIABLE /begin AVAILABLE_EVENT_LIST EVENT 0 EVENT 1 EVENT 2 EVENT 3 /end AVAILABLE_EVENT_LIST /begin DEFAULT_EVENT_LIST EVENT 0 /end DEFAULT_EVENT_LIST /end DAQ_EVENT
 /end IF_DATA
/end MEASUREMENT
/begin MEASUREMENT MisfDet_stDlyTiStrt "state delay time after start is active" UBYTE B_TRUE 1 100 0.00 1.00000000000 BIT_MASK 0x1 FORMAT "%13.11" ECU_ADDRESS 0x4000637C
 /begin IF_DATA XCPplus 0x0102
  /begin DAQ_EVENT VARIABLE /begin AVAILABLE_EVENT_LIST EVENT 0 EVENT 1 EVENT 2 EVENT 3 /end AVAILABLE_EVENT_LIST /begin DEFAULT_EVENT_LIST EVENT 2 /end DEFAULT_EVENT_LIST /end DAQ_EVENT
 /end IF_DATA
/end MEASUREMENT
/begin MEASUREMENT MisfDet_stDnDet "state misfiring thresholds exceeded" UBYTE OneToOne 1 100 0.00 255.0 FORMAT "%5.1" ECU_ADDRESS 0x40007F6F
 /begin IF_DATA XCPplus 0x0102
  /begin DAQ_EVENT VARIABLE /begin AVAILABLE_EVENT_LIST EVENT 0 EVENT 1 EVENT 2 EVENT 3 /end AVAILABLE_EVENT_LIST /begin DEFAULT_EVENT_LIST EVENT 0 /end DEFAULT_EVENT_LIST /end DAQ_EVENT
 /end IF_DATA
/end MEASUREMENT
/begin MEASUREMENT MisfDet_stDnDifSelActv "Usage of MisfDet_dnDifNxt or MisfDet_dnDifMin as filter input possible" UBYTE B_TRUE 1 100 0.00 1.00000000000 BIT_MASK 0x1 FORMAT "%13.11" ECU_ADDRESS 0x4000640D
 /begin IF_DATA XCPplus 0x0102
  /begin DAQ_EVENT VARIABLE /begin AVAILABLE_EVENT_LIST EVENT 0 EVENT 1 EVENT 2 EVENT 3 /end AVAILABLE_EVENT_LIST /begin DEFAULT_EVENT_LIST EVENT 0 /end DEFAULT_EVENT_LIST /end DAQ_EVENT
 /end IF_DATA
/end MEASUREMENT
/begin MEASUREMENT MisfDet_stDnDifSelActvCurr "MisfDet_dnDifNxt or MisfDet_dnDifMin is used as filter input for current sample" UBYTE B_TRUE 1 100 0.00 1.00000000000 BIT_MASK 0x1 FORMAT "%13.11" ECU_ADDRESS 0x4000640C
 /begin IF_DATA XCPplus 0x0102
  /begin DAQ_EVENT VARIABLE /begin AVAILABLE_EVENT_LIST EVENT 0 EVENT 1 EVENT 2 EVENT 3 /end AVAILABLE_EVENT_LIST /begin DEFAULT_EVENT_LIST EVENT 0 /end DEFAULT_EVENT_LIST /end DAQ_EVENT
 /end IF_DATA
/end MEASUREMENT
/begin MEASUREMENT MisfDet_stDnFltdZeroNoSegTiAdpn "state reset correction of dn threshold" UBYTE B_TRUE 1 100 0.00 1.00000000000 BIT_MASK 0x1 FORMAT "%13.11" ECU_ADDRESS 0x40006295
 /begin IF_DATA XCPplus 0x0102
  /begin DAQ_EVENT VARIABLE /begin AVAILABLE_EVENT_LIST EVENT 0 EVENT 1 EVENT 2 EVENT 3 /end AVAILABLE_EVENT_LIST /begin DEFAULT_EVENT_LIST EVENT 0 /end DEFAULT_EVENT_LIST /end DAQ_EVENT
 /end IF_DATA
/end MEASUREMENT
/begin MEASUREMENT MisfDet_stDPedlPosnOutOfRng "Status gradient of the accelerator pedal position is out of the allowed range" UBYTE B_TRUE 1 100 0.00 1.00000000000 BIT_MASK 0x1 FORMAT "%13.11" ECU_ADDRESS 0x4000637F
 /begin IF_DATA XCPplus 0x0102
  /begin DAQ_EVENT VARIABLE /begin AVAILABLE_EVENT_LIST EVENT 0 EVENT 1 EVENT 2 EVENT 3 /end AVAILABLE_EVENT_LIST /begin DEFAULT_EVENT_LIST EVENT 1 /end DEFAULT_EVENT_LIST /end DAQ_EVENT
 /end IF_DATA
/end MEASUREMENT
/begin MEASUREMENT MisfDet_stDTqOutOfRng "state torque gradient out of range" UBYTE B_TRUE 1 100 0.00 1.00000000000 BIT_MASK 0x1 FORMAT "%13.11" ECU_ADDRESS 0x4000637E
 /begin IF_DATA XCPplus 0x0102
  /begin DAQ_EVENT VARIABLE /begin AVAILABLE_EVENT_LIST EVENT 0 EVENT 1 EVENT 2 EVENT 3 /end AVAILABLE_EVENT_LIST /begin DEFAULT_EVENT_LIST EVENT 1 /end DEFAULT_EVENT_LIST /end DAQ_EVENT
 /end IF_DATA
/end MEASUREMENT
/begin MEASUREMENT MisfDet_stEngStrt "state engine is in starting condition" UBYTE B_TRUE 1 100 0.00 1.00000000000 BIT_MASK 0x1 FORMAT "%13.11" ECU_ADDRESS 0x4000637A
 /begin IF_DATA XCPplus 0x0102
  /begin DAQ_EVENT VARIABLE /begin AVAILABLE_EVENT_LIST EVENT 0 EVENT 1 EVENT 2 EVENT 3 /end AVAILABLE_EVENT_LIST /begin DEFAULT_EVENT_LIST EVENT 0 /end DEFAULT_EVENT_LIST /end DAQ_EVENT
 /end IF_DATA
/end MEASUREMENT
/begin MEASUREMENT MisfDet_stFcmClr "falg staus to request the fault memory clear" UBYTE B_TRUE 1 100 0.00 1.00000000000 BIT_MASK 0x1 FORMAT "%13.11" ECU_ADDRESS 0x40006404
 /begin IF_DATA XCPplus 0x0102
  /begin DAQ_EVENT VARIABLE /begin AVAILABLE_EVENT_LIST EVENT 0 EVENT 1 EVENT 2 EVENT 3 /end AVAILABLE_EVENT_LIST /begin DEFAULT_EVENT_LIST EVENT 0 /end DEFAULT_EVENT_LIST /end DAQ_EVENT
 /end IF_DATA
/end MEASUREMENT
/begin MEASUREMENT MisfDet_stFcmClr1000ms "Condition clear fault code memory (for 1000ms process)" UBYTE B_TRUE 1 100 0.00 1.00000000000 BIT_MASK 0x1 FORMAT "%13.11" ECU_ADDRESS 0x40006409
 /begin IF_DATA XCPplus 0x0102
  /begin DAQ_EVENT VARIABLE /begin AVAILABLE_EVENT_LIST EVENT 0 EVENT 1 EVENT 2 EVENT 3 /end AVAILABLE_EVENT_LIST /begin DEFAULT_EVENT_LIST EVENT 3 /end DEFAULT_EVENT_LIST /end DAQ_EVENT
 /end IF_DATA
/end MEASUREMENT
/begin MEASUREMENT MisfDet_stFcmClr100ms "Condition clear fault code memory (for 100ms process)" UBYTE B_TRUE 1 100 0.00 1.00000000000 BIT_MASK 0x1 FORMAT "%13.11" ECU_ADDRESS 0x40006408
 /begin IF_DATA XCPplus 0x0102
  /begin DAQ_EVENT VARIABLE /begin AVAILABLE_EVENT_LIST EVENT 0 EVENT 1 EVENT 2 EVENT 3 /end AVAILABLE_EVENT_LIST /begin DEFAULT_EVENT_LIST EVENT 2 /end DEFAULT_EVENT_LIST /end DAQ_EVENT
 /end IF_DATA
/end MEASUREMENT
/begin MEASUREMENT MisfDet_stFcmClr10ms "Condition clear fault code memory (for 10ms process)" UBYTE B_TRUE 1 100 0.00 1.00000000000 BIT_MASK 0x1 FORMAT "%13.11" ECU_ADDRESS 0x40006407
 /begin IF_DATA XCPplus 0x0102
  /begin DAQ_EVENT VARIABLE /begin AVAILABLE_EVENT_LIST EVENT 0 EVENT 1 EVENT 2 EVENT 3 /end AVAILABLE_EVENT_LIST /begin DEFAULT_EVENT_LIST EVENT 1 /end DEFAULT_EVENT_LIST /end DAQ_EVENT
 /end IF_DATA
/end MEASUREMENT
/begin MEASUREMENT MisfDet_stFcmClr200ms "Condition clear fault code memory (for 200ms process)" UBYTE B_TRUE 1 100 0.00 1.00000000000 BIT_MASK 0x1 FORMAT "%13.11" ECU_ADDRESS 0x40006406
 /begin IF_DATA XCPplus 0x0102
  /begin DAQ_EVENT VARIABLE /begin AVAILABLE_EVENT_LIST EVENT 0 EVENT 1 EVENT 2 EVENT 3 /end AVAILABLE_EVENT_LIST /begin DEFAULT_EVENT_LIST EVENT 3 /end DEFAULT_EVENT_LIST /end DAQ_EVENT
 /end IF_DATA
/end MEASUREMENT
/begin MEASUREMENT MisfDet_stFcmClr20ms "Condition clear fault code memory (for 20ms process)" UBYTE B_TRUE 1 100 0.00 1.00000000000 BIT_MASK 0x1 FORMAT "%13.11" ECU_ADDRESS 0x40006405
 /begin IF_DATA XCPplus 0x0102
  /begin DAQ_EVENT VARIABLE /begin AVAILABLE_EVENT_LIST EVENT 0 EVENT 1 EVENT 2 EVENT 3 /end AVAILABLE_EVENT_LIST /begin DEFAULT_EVENT_LIST EVENT 2 /end DEFAULT_EVENT_LIST /end DAQ_EVENT
 /end IF_DATA
/end MEASUREMENT
/begin MEASUREMENT MisfDet_stFlreDwn "state engine is in flare down condition" UBYTE B_TRUE 1 100 0.00 1.00000000000 BIT_MASK 0x1 FORMAT "%13.11" ECU_ADDRESS 0x40006379
 /begin IF_DATA XCPplus 0x0102
  /begin DAQ_EVENT VARIABLE /begin AVAILABLE_EVENT_LIST EVENT 0 EVENT 1 EVENT 2 EVENT 3 /end AVAILABLE_EVENT_LIST /begin DEFAULT_EVENT_LIST EVENT 0 /end DEFAULT_EVENT_LIST /end DAQ_EVENT
 /end IF_DATA
/end MEASUREMENT
/begin MEASUREMENT MisfDet_stGearChg "State of gear change" UBYTE B_TRUE 1 100 0.00 1.00000000000 BIT_MASK 0x1 FORMAT "%13.11" ECU_ADDRESS 0x40006378
 /begin IF_DATA XCPplus 0x0102
  /begin DAQ_EVENT VARIABLE /begin AVAILABLE_EVENT_LIST EVENT 0 EVENT 1 EVENT 2 EVENT 3 /end AVAILABLE_EVENT_LIST /begin DEFAULT_EVENT_LIST EVENT 0 /end DEFAULT_EVENT_LIST /end DAQ_EVENT
 /end IF_DATA
/end MEASUREMENT
/begin MEASUREMENT MisfDet_stGripChngPt "state grip conditions at clutch has changed" UBYTE B_TRUE 1 100 0.00 1.00000000000 BIT_MASK 0x1 FORMAT "%13.11" ECU_ADDRESS 0x40006377
 /begin IF_DATA XCPplus 0x0102
  /begin DAQ_EVENT VARIABLE /begin AVAILABLE_EVENT_LIST EVENT 0 EVENT 1 EVENT 2 EVENT 3 /end AVAILABLE_EVENT_LIST /begin DEFAULT_EVENT_LIST EVENT 0 /end DEFAULT_EVENT_LIST /end DAQ_EVENT
 /end IF_DATA
/end MEASUREMENT
/begin MEASUREMENT MisfDet_stIdle "engine is in idle state" UBYTE B_TRUE 1 100 0.00 1.00000000000 BIT_MASK 0x1 FORMAT "%13.11" ECU_ADDRESS 0x40006403
 /begin IF_DATA XCPplus 0x0102
  /begin DAQ_EVENT VARIABLE /begin AVAILABLE_EVENT_LIST EVENT 0 EVENT 1 EVENT 2 EVENT 3 /end AVAILABLE_EVENT_LIST /begin DEFAULT_EVENT_LIST EVENT 0 /end DEFAULT_EVENT_LIST /end DAQ_EVENT
 /end IF_DATA
/end MEASUREMENT
/begin MEASUREMENT MisfDet_stIdleChng "engine enters or exits idle state" UBYTE B_TRUE 1 100 0.00 1.00000000000 BIT_MASK 0x1 FORMAT "%13.11" ECU_ADDRESS 0x40006376
 /begin IF_DATA XCPplus 0x0102
  /begin DAQ_EVENT VARIABLE /begin AVAILABLE_EVENT_LIST EVENT 0 EVENT 1 EVENT 2 EVENT 3 /end AVAILABLE_EVENT_LIST /begin DEFAULT_EVENT_LIST EVENT 0 /end DEFAULT_EVENT_LIST /end DAQ_EVENT
 /end IF_DATA
/end MEASUREMENT
/begin MEASUREMENT MisfDet_stIgnIntrpt "real ignition interrupt" UBYTE B_TRUE 1 100 0.00 1.00000000000 BIT_MASK 0x1 FORMAT "%13.11" ECU_ADDRESS 0x40006402
 /begin IF_DATA XCPplus 0x0102
  /begin DAQ_EVENT VARIABLE /begin AVAILABLE_EVENT_LIST EVENT 0 EVENT 1 EVENT 2 EVENT 3 /end AVAILABLE_EVENT_LIST /begin DEFAULT_EVENT_LIST EVENT 0 /end DEFAULT_EVENT_LIST /end DAQ_EVENT
 /end IF_DATA
/end MEASUREMENT
/begin MEASUREMENT MisfDet_stInjLockdOpen "Status injector is locked open" UWORD OneToOne 1 100 0.00 65535.00 FORMAT "%8.2" ECU_ADDRESS 0x40007FB0
 /begin IF_DATA XCPplus 0x0102
  /begin DAQ_EVENT VARIABLE /begin AVAILABLE_EVENT_LIST EVENT 0 EVENT 1 EVENT 2 EVENT 3 /end AVAILABLE_EVENT_LIST /begin DEFAULT_EVENT_LIST EVENT 2 /end DEFAULT_EVENT_LIST /end DAQ_EVENT
 /end IF_DATA
/end MEASUREMENT
/begin MEASUREMENT MisfDet_stMisfGenrEna "state of enabling misfire generator" UBYTE B_TRUE 1 100 0.00 1.00000000000 BIT_MASK 0x1 FORMAT "%13.11" ECU_ADDRESS 0x4000629A
 /begin IF_DATA XCPplus 0x0102
  /begin DAQ_EVENT VARIABLE /begin AVAILABLE_EVENT_LIST EVENT 0 EVENT 1 EVENT 2 EVENT 3 /end AVAILABLE_EVENT_LIST /begin DEFAULT_EVENT_LIST EVENT 0 /end DEFAULT_EVENT_LIST /end DAQ_EVENT
 /end IF_DATA
/end MEASUREMENT
/begin MEASUREMENT MisfDet_stMisfGenrEnaTrg "state of enabling trigger of misfire generator" UBYTE B_TRUE 1 100 0.00 1.00000000000 BIT_MASK 0x1 FORMAT "%13.11" ECU_ADDRESS 0x40006299
 /begin IF_DATA XCPplus 0x0102
  /begin DAQ_EVENT VARIABLE /begin AVAILABLE_EVENT_LIST EVENT 0 EVENT 1 EVENT 2 EVENT 3 /end AVAILABLE_EVENT_LIST /begin DEFAULT_EVENT_LIST EVENT 0 /end DEFAULT_EVENT_LIST /end DAQ_EVENT
 /end IF_DATA
/end MEASUREMENT
/begin MEASUREMENT MisfDet_stMisfGenrRun "state misfire generator running" UBYTE B_TRUE 1 100 0.00 1.00000000000 BIT_MASK 0x1 FORMAT "%13.11" ECU_ADDRESS 0x40006374
 /begin IF_DATA XCPplus 0x0102
  /begin DAQ_EVENT VARIABLE /begin AVAILABLE_EVENT_LIST EVENT 0 EVENT 1 EVENT 2 EVENT 3 /end AVAILABLE_EVENT_LIST /begin DEFAULT_EVENT_LIST EVENT 0 /end DEFAULT_EVENT_LIST /end DAQ_EVENT
 /end IF_DATA
/end MEASUREMENT
/begin MEASUREMENT MisfDet_stMisfGenrRunIgn "misfire generator running via ignition cut off" UBYTE B_TRUE 1 100 0.00 1.00000000000 BIT_MASK 0x1 FORMAT "%13.11" ECU_ADDRESS 0x40006373
 /begin IF_DATA XCPplus 0x0102
  /begin DAQ_EVENT VARIABLE /begin AVAILABLE_EVENT_LIST EVENT 0 EVENT 1 EVENT 2 EVENT 3 /end AVAILABLE_EVENT_LIST /begin DEFAULT_EVENT_LIST EVENT 0 /end DEFAULT_EVENT_LIST /end DAQ_EVENT
 /end IF_DATA
/end MEASUREMENT
/begin MEASUREMENT MisfDet_stMisfModActv "state misfire mode in progress" UBYTE B_TRUE 1 100 0.00 1.00000000000 BIT_MASK 0x1 FORMAT "%13.11" ECU_ADDRESS 0x40006298
 /begin IF_DATA XCPplus 0x0102
  /begin DAQ_EVENT VARIABLE /begin AVAILABLE_EVENT_LIST EVENT 0 EVENT 1 EVENT 2 EVENT 3 /end AVAILABLE_EVENT_LIST /begin DEFAULT_EVENT_LIST EVENT 0 /end DEFAULT_EVENT_LIST /end DAQ_EVENT
 /end IF_DATA
/end MEASUREMENT
/begin MEASUREMENT MisfDet_stMisfSti "cond. for misfire demanded, stimuli signal from software misfiring generator" UBYTE B_TRUE 1 100 0.00 1.00000000000 BIT_MASK 0x1 FORMAT "%13.11" ECU_ADDRESS 0x40006401
 /begin IF_DATA XCPplus 0x0102
  /begin DAQ_EVENT VARIABLE /begin AVAILABLE_EVENT_LIST EVENT 0 EVENT 1 EVENT 2 EVENT 3 /end AVAILABLE_EVENT_LIST /begin DEFAULT_EVENT_LIST EVENT 0 /end DEFAULT_EVENT_LIST /end DAQ_EVENT
 /end IF_DATA
/end MEASUREMENT
/begin MEASUREMENT MisfDet_stMisfStiSync "state misfire was stimulated by misfire generator, synchronised" UBYTE B_TRUE 1 100 0.00 1.00000000000 BIT_MASK 0x1 FORMAT "%13.11" ECU_ADDRESS 0x40006400
 /begin IF_DATA XCPplus 0x0102
  /begin DAQ_EVENT VARIABLE /begin AVAILABLE_EVENT_LIST EVENT 0 EVENT 1 EVENT 2 EVENT 3 /end AVAILABLE_EVENT_LIST /begin DEFAULT_EVENT_LIST EVENT 0 /end DEFAULT_EVENT_LIST /end DAQ_EVENT
 /end IF_DATA
/end MEASUREMENT
/begin MEASUREMENT MisfDet_stMsr "condition MSR" UBYTE B_TRUE 1 100 0.00 1.00000000000 BIT_MASK 0x1 FORMAT "%13.11" ECU_ADDRESS 0x400063FF
 /begin IF_DATA XCPplus 0x0102
  /begin DAQ_EVENT VARIABLE /begin AVAILABLE_EVENT_LIST EVENT 0 EVENT 1 EVENT 2 EVENT 3 /end AVAILABLE_EVENT_LIST /begin DEFAULT_EVENT_LIST EVENT 0 /end DEFAULT_EVENT_LIST /end DAQ_EVENT
 /end IF_DATA
/end MEASUREMENT
/begin MEASUREMENT MisfDet_stNEngOutOfRng "state engine speed out of limits for misfire detection" UBYTE B_TRUE 1 100 0.00 1.00000000000 BIT_MASK 0x1 FORMAT "%13.11" ECU_ADDRESS 0x40006372
 /begin IF_DATA XCPplus 0x0102
  /begin DAQ_EVENT VARIABLE /begin AVAILABLE_EVENT_LIST EVENT 0 EVENT 1 EVENT 2 EVENT 3 /end AVAILABLE_EVENT_LIST /begin DEFAULT_EVENT_LIST EVENT 0 /end DEFAULT_EVENT_LIST /end DAQ_EVENT
 /end IF_DATA
/end MEASUREMENT
/begin MEASUREMENT MisfDet_stNmax "condition engine speed limitation is active" UBYTE B_TRUE 1 100 0.00 1.00000000000 BIT_MASK 0x1 FORMAT "%13.11" ECU_ADDRESS 0x40006371
 /begin IF_DATA XCPplus 0x0102
  /begin DAQ_EVENT VARIABLE /begin AVAILABLE_EVENT_LIST EVENT 0 EVENT 1 EVENT 2 EVENT 3 /end AVAILABLE_EVENT_LIST /begin DEFAULT_EVENT_LIST EVENT 0 /end DEFAULT_EVENT_LIST /end DAQ_EVENT
 /end IF_DATA
/end MEASUREMENT
/begin MEASUREMENT MisfDet_stNoInj "Status no injection" UBYTE B_TRUE 1 100 0.00 1.00000000000 BIT_MASK 0x1 FORMAT "%13.11" ECU_ADDRESS 0x400063FE
 /begin IF_DATA XCPplus 0x0102
  /begin DAQ_EVENT VARIABLE /begin AVAILABLE_EVENT_LIST EVENT 0 EVENT 1 EVENT 2 EVENT 3 /end AVAILABLE_EVENT_LIST /begin DEFAULT_EVENT_LIST EVENT 0 /end DEFAULT_EVENT_LIST /end DAQ_EVENT
 /end IF_DATA
/end MEASUREMENT
/begin MEASUREMENT MisfDet_stNoInjSync "no injection synchronised" UBYTE B_TRUE 1 100 0.00 1.00000000000 BIT_MASK 0x1 FORMAT "%13.11" ECU_ADDRESS 0x400063FD
 /begin IF_DATA XCPplus 0x0102
  /begin DAQ_EVENT VARIABLE /begin AVAILABLE_EVENT_LIST EVENT 0 EVENT 1 EVENT 2 EVENT 3 /end AVAILABLE_EVENT_LIST /begin DEFAULT_EVENT_LIST EVENT 0 /end DEFAULT_EVENT_LIST /end DAQ_EVENT
 /end IF_DATA
/end MEASUREMENT
/begin MEASUREMENT MisfDet_stOpenPt "status drive train open" UBYTE B_TRUE 1 100 0.00 1.00000000000 BIT_MASK 0x1 FORMAT "%13.11" ECU_ADDRESS 0x400063FC
 /begin IF_DATA XCPplus 0x0102
  /begin DAQ_EVENT VARIABLE /begin AVAILABLE_EVENT_LIST EVENT 0 EVENT 1 EVENT 2 EVENT 3 /end AVAILABLE_EVENT_LIST /begin DEFAULT_EVENT_LIST EVENT 0 /end DEFAULT_EVENT_LIST /end DAQ_EVENT
 /end IF_DATA
/end MEASUREMENT
/begin MEASUREMENT MisfDet_stReIni "Condition - ECU is in state Re-Initialization (Used in synchronous task)" UBYTE B_TRUE 1 100 0.00 1.00000000000 BIT_MASK 0x1 FORMAT "%13.11" ECU_ADDRESS 0x400063F8
 /begin IF_DATA XCPplus 0x0102
  /begin DAQ_EVENT VARIABLE /begin AVAILABLE_EVENT_LIST EVENT 0 EVENT 1 EVENT 2 EVENT 3 /end AVAILABLE_EVENT_LIST /begin DEFAULT_EVENT_LIST EVENT 0 /end DEFAULT_EVENT_LIST /end DAQ_EVENT
 /end IF_DATA
/end MEASUREMENT
/begin MEASUREMENT MisfDet_stReIni100ms "Condition ECU is in state ReIni (for 100ms process)" UBYTE B_TRUE 1 100 0.00 1.00000000000 BIT_MASK 0x1 FORMAT "%13.11" ECU_ADDRESS 0x400063FB
 /begin IF_DATA XCPplus 0x0102
  /begin DAQ_EVENT VARIABLE /begin AVAILABLE_EVENT_LIST EVENT 0 EVENT 1 EVENT 2 EVENT 3 /end AVAILABLE_EVENT_LIST /begin DEFAULT_EVENT_LIST EVENT 2 /end DEFAULT_EVENT_LIST /end DAQ_EVENT
 /end IF_DATA
/end MEASUREMENT
/begin MEASUREMENT MisfDet_stReIni200ms "Condition ECU is in state ReIni (for 200ms process)" UBYTE B_TRUE 1 100 0.00 1.00000000000 BIT_MASK 0x1 FORMAT "%13.11" ECU_ADDRESS 0x400063FA
 /begin IF_DATA XCPplus 0x0102
  /begin DAQ_EVENT VARIABLE /begin AVAILABLE_EVENT_LIST EVENT 0 EVENT 1 EVENT 2 EVENT 3 /end AVAILABLE_EVENT_LIST /begin DEFAULT_EVENT_LIST EVENT 3 /end DEFAULT_EVENT_LIST /end DAQ_EVENT
 /end IF_DATA
/end MEASUREMENT
/begin MEASUREMENT MisfDet_stReIni20ms "Condition ECU is in state ReIni (for 20ms process)" UBYTE B_TRUE 1 100 0.00 1.00000000000 BIT_MASK 0x1 FORMAT "%13.11" ECU_ADDRESS 0x400063F9
 /begin IF_DATA XCPplus 0x0102
  /begin DAQ_EVENT VARIABLE /begin AVAILABLE_EVENT_LIST EVENT 0 EVENT 1 EVENT 2 EVENT 3 /end AVAILABLE_EVENT_LIST /begin DEFAULT_EVENT_LIST EVENT 2 /end DEFAULT_EVENT_LIST /end DAQ_EVENT
 /end IF_DATA
/end MEASUREMENT
/begin MEASUREMENT MisfDet_stSecCamsftAftStrt "state 2nd working cycle after start passed" UBYTE B_TRUE 1 100 0.00 1.00000000000 BIT_MASK 0x1 FORMAT "%13.11" ECU_ADDRESS 0x40006297
 /begin IF_DATA XCPplus 0x0102
  /begin DAQ_EVENT VARIABLE /begin AVAILABLE_EVENT_LIST EVENT 0 EVENT 1 EVENT 2 EVENT 3 /end AVAILABLE_EVENT_LIST /begin DEFAULT_EVENT_LIST EVENT 0 /end DEFAULT_EVENT_LIST /end DAQ_EVENT
 /end IF_DATA
/end MEASUREMENT
/begin MEASUREMENT MisfDet_stSetZeroTq "state zero torque threshold is set to zero" UBYTE B_TRUE 1 100 0.00 1.00000000000 BIT_MASK 0x1 FORMAT "%13.11" ECU_ADDRESS 0x40006370
 /begin IF_DATA XCPplus 0x0102
  /begin DAQ_EVENT VARIABLE /begin AVAILABLE_EVENT_LIST EVENT 0 EVENT 1 EVENT 2 EVENT 3 /end AVAILABLE_EVENT_LIST /begin DEFAULT_EVENT_LIST EVENT 1 /end DEFAULT_EVENT_LIST /end DAQ_EVENT
 /end IF_DATA
/end MEASUREMENT
/begin MEASUREMENT MisfDet_stStrtDeb "state engine is in starting conditions, debounced" UBYTE B_TRUE 1 100 0.00 1.00000000000 BIT_MASK 0x1 FORMAT "%13.11" ECU_ADDRESS 0x4000636F
 /begin IF_DATA XCPplus 0x0102
  /begin DAQ_EVENT VARIABLE /begin AVAILABLE_EVENT_LIST EVENT 0 EVENT 1 EVENT 2 EVENT 3 /end AVAILABLE_EVENT_LIST /begin DEFAULT_EVENT_LIST EVENT 0 /end DEFAULT_EVENT_LIST /end DAQ_EVENT
 /end IF_DATA
/end MEASUREMENT
/begin MEASUREMENT MisfDet_stTEngLow "state engine temperature low" UBYTE B_TRUE 1 100 0.00 1.00000000000 BIT_MASK 0x1 FORMAT "%13.11" ECU_ADDRESS 0x4000636E
 /begin IF_DATA XCPplus 0x0102
  /begin DAQ_EVENT VARIABLE /begin AVAILABLE_EVENT_LIST EVENT 0 EVENT 1 EVENT 2 EVENT 3 /end AVAILABLE_EVENT_LIST /begin DEFAULT_EVENT_LIST EVENT 2 /end DEFAULT_EVENT_LIST /end DAQ_EVENT
 /end IF_DATA
/end MEASUREMENT
/begin MEASUREMENT MisfDet_stTqZero "state engine torque is under threshold for zero torque at crankshaft" UBYTE B_TRUE 1 100 0.00 1.00000000000 BIT_MASK 0x1 FORMAT "%13.11" ECU_ADDRESS 0x4000636D
 /begin IF_DATA XCPplus 0x0102
  /begin DAQ_EVENT VARIABLE /begin AVAILABLE_EVENT_LIST EVENT 0 EVENT 1 EVENT 2 EVENT 3 /end AVAILABLE_EVENT_LIST /begin DEFAULT_EVENT_LIST EVENT 0 /end DEFAULT_EVENT_LIST /end DAQ_EVENT
 /end IF_DATA
/end MEASUREMENT
/begin MEASUREMENT MisfDet_tEng "engine temperature for MisfDet" SWORD Temp_Cels 1 100 -3549.940 3003.560 FORMAT "%8.3" ECU_ADDRESS 0x40005D94
 /begin IF_DATA XCPplus 0x0102
  /begin DAQ_EVENT VARIABLE /begin AVAILABLE_EVENT_LIST EVENT 0 EVENT 1 EVENT 2 EVENT 3 /end AVAILABLE_EVENT_LIST /begin DEFAULT_EVENT_LIST EVENT 2 /end DEFAULT_EVENT_LIST /end DAQ_EVENT
 /end IF_DATA
/end MEASUREMENT
/begin MEASUREMENT MisfDet_tEngStrt "Engine temperature at start" SWORD Temp_Cels 1 100 -3549.940 3003.560 FORMAT "%8.3" ECU_ADDRESS 0x40005D92
 /begin IF_DATA XCPplus 0x0102
  /begin DAQ_EVENT VARIABLE /begin AVAILABLE_EVENT_LIST EVENT 0 EVENT 1 EVENT 2 EVENT 3 /end AVAILABLE_EVENT_LIST /begin DEFAULT_EVENT_LIST EVENT 2 /end DEFAULT_EVENT_LIST /end DAQ_EVENT
 /end IF_DATA
/end MEASUREMENT
/begin MEASUREMENT MisfDet_thdTqZero "threshold for zero torque output at crankshaft" UWORD rel_uw_b100 1 100 0.00 99.99847 FORMAT "%8.5" ECU_ADDRESS 0x40007F9A
 /begin IF_DATA XCPplus 0x0102
  /begin DAQ_EVENT VARIABLE /begin AVAILABLE_EVENT_LIST EVENT 0 EVENT 1 EVENT 2 EVENT 3 /end AVAILABLE_EVENT_LIST /begin DEFAULT_EVENT_LIST EVENT 1 /end DEFAULT_EVENT_LIST /end DAQ_EVENT
 /end IF_DATA
/end MEASUREMENT
/begin MEASUREMENT MisfDet_thdTqZeroRaw "threshold for uncorrected zero torque output at crankshaft" UWORD rel_uw_b100 1 100 0.00 99.99847 FORMAT "%8.5" ECU_ADDRESS 0x40007E94
 /begin IF_DATA XCPplus 0x0102
  /begin DAQ_EVENT VARIABLE /begin AVAILABLE_EVENT_LIST EVENT 0 EVENT 1 EVENT 2 EVENT 3 /end AVAILABLE_EVENT_LIST /begin DEFAULT_EVENT_LIST EVENT 1 /end DEFAULT_EVENT_LIST /end DAQ_EVENT
 /end IF_DATA
/end MEASUREMENT
/begin MEASUREMENT MisfDet_tiEngRun "engine running time" UWORD t_q0p1 1 100 0.00 6553.500 FORMAT "%8.3" ECU_ADDRESS 0x40007F98
 /begin IF_DATA XCPplus 0x0102
  /begin DAQ_EVENT VARIABLE /begin AVAILABLE_EVENT_LIST EVENT 0 EVENT 1 EVENT 2 EVENT 3 /end AVAILABLE_EVENT_LIST /begin DEFAULT_EVENT_LIST EVENT 2 /end DEFAULT_EVENT_LIST /end DAQ_EVENT
 /end IF_DATA
/end MEASUREMENT
/begin MEASUREMENT MisfDet_tiEngRunSum "accumulated engine running time" UWORD t_q0p1 1 100 0.00 6553.500 FORMAT "%8.3" ECU_ADDRESS 0x40007F96
 /begin IF_DATA XCPplus 0x0102
  /begin DAQ_EVENT VARIABLE /begin AVAILABLE_EVENT_LIST EVENT 0 EVENT 1 EVENT 2 EVENT 3 /end AVAILABLE_EVENT_LIST /begin DEFAULT_EVENT_LIST EVENT 2 /end DEFAULT_EVENT_LIST /end DAQ_EVENT
 /end IF_DATA
/end MEASUREMENT
/begin MEASUREMENT MisfDet_tqAct "normed engine torque for misfire detection" UWORD rel_uw_b100 1 100 0.00 99.99847 FORMAT "%8.5" ECU_ADDRESS 0x40007F94
 /begin IF_DATA XCPplus 0x0102
  /begin DAQ_EVENT VARIABLE /begin AVAILABLE_EVENT_LIST EVENT 0 EVENT 1 EVENT 2 EVENT 3 /end AVAILABLE_EVENT_LIST /begin DEFAULT_EVENT_LIST EVENT 0 /end DEFAULT_EVENT_LIST /end DAQ_EVENT
 /end IF_DATA
/end MEASUREMENT
/begin MEASUREMENT MisfDet_tqBasc "base torque" UWORD rel_uw_b100 1 100 0.00 99.99847 FORMAT "%8.5" ECU_ADDRESS 0x40007F92
 /begin IF_DATA XCPplus 0x0102
  /begin DAQ_EVENT VARIABLE /begin AVAILABLE_EVENT_LIST EVENT 0 EVENT 1 EVENT 2 EVENT 3 /end AVAILABLE_EVENT_LIST /begin DEFAULT_EVENT_LIST EVENT 0 /end DEFAULT_EVENT_LIST /end DAQ_EVENT
 /end IF_DATA
/end MEASUREMENT
/begin MEASUREMENT MisfDet_tqBascSync "synchronised base torque" UWORD rel_uw_b100 1 100 0.00 99.99847 FORMAT "%8.5" ECU_ADDRESS 0x40007F90
 /begin IF_DATA XCPplus 0x0102
  /begin DAQ_EVENT VARIABLE /begin AVAILABLE_EVENT_LIST EVENT 0 EVENT 1 EVENT 2 EVENT 3 /end AVAILABLE_EVENT_LIST /begin DEFAULT_EVENT_LIST EVENT 0 /end DEFAULT_EVENT_LIST /end DAQ_EVENT
 /end IF_DATA
/end MEASUREMENT
/begin MEASUREMENT MisfDet_tqZeroCorrnAlti "correction value for threshold of zero torque output at crankshaft, altitude dependant" SWORD rel_uw_b100 1 100 -50.00000 49.99847 FORMAT "%8.5" ECU_ADDRESS 0x40007FC8
 /begin IF_DATA XCPplus 0x0102
  /begin DAQ_EVENT VARIABLE /begin AVAILABLE_EVENT_LIST EVENT 0 EVENT 1 EVENT 2 EVENT 3 /end AVAILABLE_EVENT_LIST /begin DEFAULT_EVENT_LIST EVENT 1 /end DEFAULT_EVENT_LIST /end DAQ_EVENT
 /end IF_DATA
/end MEASUREMENT
/begin MEASUREMENT MisfDet_tqZeroCorrnTEng "correction value for threshold of zero torque output at crankshaft, engine temperature dependant" UWORD rel_uw_b100 1 100 0.00 99.99847 FORMAT "%8.5" ECU_ADDRESS 0x40007F8E
 /begin IF_DATA XCPplus 0x0102
  /begin DAQ_EVENT VARIABLE /begin AVAILABLE_EVENT_LIST EVENT 0 EVENT 1 EVENT 2 EVENT 3 /end AVAILABLE_EVENT_LIST /begin DEFAULT_EVENT_LIST EVENT 1 /end DEFAULT_EVENT_LIST /end DAQ_EVENT
 /end IF_DATA
/end MEASUREMENT
/begin MEASUREMENT misllr_w "Stationary torque request by idle speed control (pre-control and I-part)" UWORD rel_uw_b100 1 100 0.00 99.99847 FORMAT "%8.5" ECU_ADDRESS 0x4000833C
 /begin IF_DATA XCPplus 0x0102
  /begin DAQ_EVENT VARIABLE /begin AVAILABLE_EVENT_LIST EVENT 0 EVENT 1 EVENT 2 EVENT 3 /end AVAILABLE_EVENT_LIST /begin DEFAULT_EVENT_LIST EVENT 1 /end DEFAULT_EVENT_LIST /end DAQ_EVENT
 /end IF_DATA
/end MEASUREMENT
/begin MEASUREMENT misol_w "indicated resultant nominal torque" UWORD rel_uw_b100 1 100 0.00 99.99847 FORMAT "%8.5" ECU_ADDRESS 0x40008320
 /begin IF_DATA XCPplus 0x0102
  /begin DAQ_EVENT VARIABLE /begin AVAILABLE_EVENT_LIST EVENT 0 EVENT 1 EVENT 2 EVENT 3 /end AVAILABLE_EVENT_LIST /begin DEFAULT_EVENT_LIST EVENT 1 /end DEFAULT_EVENT_LIST /end DAQ_EVENT
 /end IF_DATA
/end MEASUREMENT
/begin MEASUREMENT miswons_w "Stationary torque request by idle speed control without increased drag torque after start" UWORD rel_uw_b100 1 100 0.00 99.99847 FORMAT "%8.5" ECU_ADDRESS 0x4000833E
 /begin IF_DATA XCPplus 0x0102
  /begin DAQ_EVENT VARIABLE /begin AVAILABLE_EVENT_LIST EVENT 0 EVENT 1 EVENT 2 EVENT 3 /end AVAILABLE_EVENT_LIST /begin DEFAULT_EVENT_LIST EVENT 1 /end DEFAULT_EVENT_LIST /end DAQ_EVENT
 /end IF_DATA
/end MEASUREMENT
/begin MEASUREMENT mivbeg_w "Indicated torque requested by driver before slope limitation" UWORD rel_uw_b100 1 100 0.00 99.99847 FORMAT "%8.5" ECU_ADDRESS 0x4000830C
 /begin IF_DATA XCPplus 0x0102
  /begin DAQ_EVENT VARIABLE /begin AVAILABLE_EVENT_LIST EVENT 0 EVENT 1 EVENT 2 EVENT 3 /end AVAILABLE_EVENT_LIST /begin DEFAULT_EVENT_LIST EVENT 1 /end DEFAULT_EVENT_LIST /end DAQ_EVENT
 /end IF_DATA
/end MEASUREMENT
/begin MEASUREMENT mizbooas_w "Upper limit of indicated torque for ignition path without stalling protection" UWORD rel_uw_b100 1 100 0.00 99.99847 FORMAT "%8.5" ECU_ADDRESS 0x40008332
 /begin IF_DATA XCPplus 0x0102
  /begin DAQ_EVENT VARIABLE /begin AVAILABLE_EVENT_LIST EVENT 0 EVENT 1 EVENT 2 EVENT 3 /end AVAILABLE_EVENT_LIST /begin DEFAULT_EVENT_LIST EVENT 1 /end DEFAULT_EVENT_LIST /end DAQ_EVENT
 /end IF_DATA
/end MEASUREMENT
/begin MEASUREMENT mizbo_w "Upper limit of indicated torque for ignition path" UWORD rel_uw_b100 1 100 0.00 99.99847 FORMAT "%8.5" ECU_ADDRESS 0x40008330
 /begin IF_DATA XCPplus 0x0102
  /begin DAQ_EVENT VARIABLE /begin AVAILABLE_EVENT_LIST EVENT 0 EVENT 1 EVENT 2 EVENT 3 /end AVAILABLE_EVENT_LIST /begin DEFAULT_EVENT_LIST EVENT 1 /end DEFAULT_EVENT_LIST /end DAQ_EVENT
 /end IF_DATA
/end MEASUREMENT
/begin MEASUREMENT mizbu_w "Lower limit of indicated torque for ignition path" UWORD rel_uw_b100 1 100 0.00 99.99847 FORMAT "%8.5" ECU_ADDRESS 0x4000832E
 /begin IF_DATA XCPplus 0x0102
  /begin DAQ_EVENT VARIABLE /begin AVAILABLE_EVENT_LIST EVENT 0 EVENT 1 EVENT 2 EVENT 3 /end AVAILABLE_EVENT_LIST /begin DEFAULT_EVENT_LIST EVENT 1 /end DEFAULT_EVENT_LIST /end DAQ_EVENT
 /end IF_DATA
/end MEASUREMENT
/begin MEASUREMENT mizsoloa_w "Indicated desired torque for calculation of ignition angle, without disturbance control" UWORD rel_uw_b100 1 100 0.00 99.99847 FORMAT "%8.5" ECU_ADDRESS 0x4000831E
 /begin IF_DATA XCPplus 0x0102
  /begin DAQ_EVENT VARIABLE /begin AVAILABLE_EVENT_LIST EVENT 0 EVENT 1 EVENT 2 EVENT 3 /end AVAILABLE_EVENT_LIST /begin DEFAULT_EVENT_LIST EVENT 0 /end DEFAULT_EVENT_LIST /end DAQ_EVENT
 /end IF_DATA
/end MEASUREMENT
/begin MEASUREMENT mizsol_w "indicated resultant nominal torque for ignition angle intervention" UWORD rel_uw_b100 1 100 0.00 99.99847 FORMAT "%8.5" ECU_ADDRESS 0x4000831C
 /begin IF_DATA XCPplus 0x0102
  /begin DAQ_EVENT VARIABLE /begin AVAILABLE_EVENT_LIST EVENT 0 EVENT 1 EVENT 2 EVENT 3 /end AVAILABLE_EVENT_LIST /begin DEFAULT_EVENT_LIST EVENT 0 /end DEFAULT_EVENT_LIST /end DAQ_EVENT
 /end IF_DATA
/end MEASUREMENT
/begin MEASUREMENT mizwlwf_w "Indicated torque for ignition release by driveability filter" UWORD rel_uw_b100 1 100 0.00 99.99847 FORMAT "%8.5" ECU_ADDRESS 0x40008318
 /begin IF_DATA XCPplus 0x0102
  /begin DAQ_EVENT VARIABLE /begin AVAILABLE_EVENT_LIST EVENT 0 EVENT 1 EVENT 2 EVENT 3 /end AVAILABLE_EVENT_LIST /begin DEFAULT_EVENT_LIST EVENT 1 /end DEFAULT_EVENT_LIST /end DAQ_EVENT
 /end IF_DATA
/end MEASUREMENT
/begin MEASUREMENT mizwmn_w "indicated engine torque at the latest spark angle" UWORD rel_uw_b100 1 100 0.00 99.99847 FORMAT "%8.5" ECU_ADDRESS 0x400086D4
 /begin IF_DATA XCPplus 0x0102
  /begin DAQ_EVENT VARIABLE /begin AVAILABLE_EVENT_LIST EVENT 0 EVENT 1 EVENT 2 EVENT 3 /end AVAILABLE_EVENT_LIST /begin DEFAULT_EVENT_LIST EVENT 1 /end DEFAULT_EVENT_LIST /end DAQ_EVENT
 /end IF_DATA
/end MEASUREMENT
/begin MEASUREMENT mkfanb_w "Clutch torque calculated from limited driver's request" SWORD rel_sw_b100 1 100 -100.0000 99.99695 FORMAT "%8.4" ECU_ADDRESS 0x4000831A
 /begin IF_DATA XCPplus 0x0102
  /begin DAQ_EVENT VARIABLE /begin AVAILABLE_EVENT_LIST EVENT 0 EVENT 1 EVENT 2 EVENT 3 /end AVAILABLE_EVENT_LIST /begin DEFAULT_EVENT_LIST EVENT 1 /end DEFAULT_EVENT_LIST /end DAQ_EVENT
 /end IF_DATA
/end MEASUREMENT
/begin MEASUREMENT nstsol_w "Stability factor for the calculaiton of rlminllr_w" UWORD nmot_uw_q0p25 1 100 0.00 16383.75 FORMAT "%8.2" ECU_ADDRESS 0x4000833A
 /begin IF_DATA XCPplus 0x0102
  /begin DAQ_EVENT VARIABLE /begin AVAILABLE_EVENT_LIST EVENT 0 EVENT 1 EVENT 2 EVENT 3 /end AVAILABLE_EVENT_LIST /begin DEFAULT_EVENT_LIST EVENT 1 /end DEFAULT_EVENT_LIST /end DAQ_EVENT
 /end IF_DATA
/end MEASUREMENT
/begin MEASUREMENT redsol "calculated desired cylinder cut-off step" UBYTE dez 1 100 0.00 255.0 FORMAT "%5.1" ECU_ADDRESS 0x40008A71
 /begin IF_DATA XCPplus 0x0102
  /begin DAQ_EVENT VARIABLE /begin AVAILABLE_EVENT_LIST EVENT 0 EVENT 1 EVENT 2 EVENT 3 /end AVAILABLE_EVENT_LIST /begin DEFAULT_EVENT_LIST EVENT 0 /end DEFAULT_EVENT_LIST /end DAQ_EVENT
 /end IF_DATA
/end MEASUREMENT
/begin MEASUREMENT redsolz "Desired cylinder cut-off step from time synchronous task" UBYTE dez 1 100 0.00 255.0 FORMAT "%5.1" ECU_ADDRESS 0x40008A73
 /begin IF_DATA XCPplus 0x0102
  /begin DAQ_EVENT VARIABLE /begin AVAILABLE_EVENT_LIST EVENT 0 EVENT 1 EVENT 2 EVENT 3 /end AVAILABLE_EVENT_LIST /begin DEFAULT_EVENT_LIST EVENT 1 /end DEFAULT_EVENT_LIST /end DAQ_EVENT
 /end IF_DATA
/end MEASUREMENT
/begin MEASUREMENT rlminllr_w "Minimum relative air charge for idle speed control" UWORD rel_q0p02344 1 100 0.00 1535.977 FORMAT "%8.3" ECU_ADDRESS 0x40008338
 /begin IF_DATA XCPplus 0x0102
  /begin DAQ_EVENT VARIABLE /begin AVAILABLE_EVENT_LIST EVENT 0 EVENT 1 EVENT 2 EVENT 3 /end AVAILABLE_EVENT_LIST /begin DEFAULT_EVENT_LIST EVENT 1 /end DEFAULT_EVENT_LIST /end DAQ_EVENT
 /end IF_DATA
/end MEASUREMENT
/begin MEASUREMENT rlsolmd "Desired relative air charge after torque coordination" UBYTE rel_ub_q0p75 1 100 0.00 191.3 FORMAT "%5.1" ECU_ADDRESS 0x40008799
 /begin IF_DATA XCPplus 0x0102
  /begin DAQ_EVENT VARIABLE /begin AVAILABLE_EVENT_LIST EVENT 0 EVENT 1 EVENT 2 EVENT 3 /end AVAILABLE_EVENT_LIST /begin DEFAULT_EVENT_LIST EVENT 1 /end DEFAULT_EVENT_LIST /end DAQ_EVENT
 /end IF_DATA
/end MEASUREMENT
/begin MEASUREMENT rlsolmd_w "Desired value for relative air charge after torque coordination" UWORD rel_q0p02344 1 100 0.00 1535.977 FORMAT "%8.3" ECU_ADDRESS 0x40008326
 /begin IF_DATA XCPplus 0x0102
  /begin DAQ_EVENT VARIABLE /begin AVAILABLE_EVENT_LIST EVENT 0 EVENT 1 EVENT 2 EVENT 3 /end AVAILABLE_EVENT_LIST /begin DEFAULT_EVENT_LIST EVENT 1 /end DEFAULT_EVENT_LIST /end DAQ_EVENT
 /end IF_DATA
/end MEASUREMENT
/begin MEASUREMENT tcllwf "Time constant for mifal_w calculation." UBYTE t_q0p01 1 100 0.00 2.550 FORMAT "%5.3" ECU_ADDRESS 0x40008791
 /begin IF_DATA XCPplus 0x0102
  /begin DAQ_EVENT VARIABLE /begin AVAILABLE_EVENT_LIST EVENT 0 EVENT 1 EVENT 2 EVENT 3 /end AVAILABLE_EVENT_LIST /begin DEFAULT_EVENT_LIST EVENT 1 /end DEFAULT_EVENT_LIST /end DAQ_EVENT
 /end IF_DATA
/end MEASUREMENT
/begin MEASUREMENT tclp "time constant of low pass filter" UBYTE t_q0p01 1 100 0.01000 2.550 FORMAT "%5.3" ECU_ADDRESS 0x40008790
 /begin IF_DATA XCPplus 0x0102
  /begin DAQ_EVENT VARIABLE /begin AVAILABLE_EVENT_LIST EVENT 0 EVENT 1 EVENT 2 EVENT 3 /end AVAILABLE_EVENT_LIST /begin DEFAULT_EVENT_LIST EVENT 1 /end DEFAULT_EVENT_LIST /end DAQ_EVENT
 /end IF_DATA
/end MEASUREMENT
/begin MEASUREMENT tdlwf "Time delay while increasing or decreasing torque." UBYTE t_q0p01 1 100 0.01000 2.550 FORMAT "%5.3" ECU_ADDRESS 0x4000878F
 /begin IF_DATA XCPplus 0x0102
  /begin DAQ_EVENT VARIABLE /begin AVAILABLE_EVENT_LIST EVENT 0 EVENT 1 EVENT 2 EVENT 3 /end AVAILABLE_EVENT_LIST /begin DEFAULT_EVENT_LIST EVENT 1 /end DEFAULT_EVENT_LIST /end DAQ_EVENT
 /end IF_DATA
/end MEASUREMENT
/begin MEASUREMENT TMECmb_nStatyRef "stationary reference speed" UWORD nmot_uw_q0p25 1 100 0.00 16383.75 FORMAT "%8.2" ECU_ADDRESS 0x40008348
 /begin IF_DATA XCPplus 0x0102
  /begin DAQ_EVENT VARIABLE /begin AVAILABLE_EVENT_LIST EVENT 0 EVENT 1 EVENT 2 EVENT 3 /end AVAILABLE_EVENT_LIST /begin DEFAULT_EVENT_LIST EVENT 1 /end DEFAULT_EVENT_LIST /end DAQ_EVENT
 /end IF_DATA
/end MEASUREMENT
/begin MEASUREMENT zwopt "Optimized model reference ignition angle" SBYTE zw_sb_q0p75 1 100 -96.00 95.25 FORMAT "%5.2" ECU_ADDRESS 0x40008A65
 /begin IF_DATA XCPplus 0x0102
  /begin DAQ_EVENT VARIABLE /begin AVAILABLE_EVENT_LIST EVENT 0 EVENT 1 EVENT 2 EVENT 3 /end AVAILABLE_EVENT_LIST /begin DEFAULT_EVENT_LIST EVENT 0 /end DEFAULT_EVENT_LIST /end DAQ_EVENT
 /end IF_DATA
/end MEASUREMENT
/begin MEASUREMENT zwsol "desired ignition angle from torque intervention" SBYTE zw_sb_q0p75 1 100 -96.00 95.25 FORMAT "%5.2" ECU_ADDRESS 0x40008A74
 /begin IF_DATA XCPplus 0x0102
  /begin DAQ_EVENT VARIABLE /begin AVAILABLE_EVENT_LIST EVENT 0 EVENT 1 EVENT 2 EVENT 3 /end AVAILABLE_EVENT_LIST /begin DEFAULT_EVENT_LIST EVENT 0 /end DEFAULT_EVENT_LIST /end DAQ_EVENT
 /end IF_DATA
/end MEASUREMENT
/begin FUNCTION LRKA "9001.2.0  Catalyst purge"
 /begin DEF_CHARACTERISTIC FKAXAVKAT ILMLKAMN ILMLKAXTK LAMKAMAX LAMKAST TDFRKAD USHKAMXXF USVKAMXXF /end DEF_CHARACTERISTIC
 /begin IN_MEASUREMENT avkatf B_bevab B_sa B_sbbhk B_sbbvk B_st lamsol ml_w PrjCon_stLamSensRrCat_b SyC_stSub tkihkm ushkl_w usvkl_w /end IN_MEASUREMENT
 /begin OUT_MEASUREMENT B_ilmlkax B_lrka ilmlkax_w ilmlka_w lamka /end OUT_MEASUREMENT
 /begin LOC_MEASUREMENT B_blrka B_ilmlkat favkatmx lamkaii /end LOC_MEASUREMENT
 FUNCTION_VERSION "9001.2.0" /end FUNCTION
/begin FUNCTION MDBAS "9000.6.0  Basic calculation for torque interface" /begin DEF_CHARACTERISTIC DZWOLA ETADZW ETALAM FURLMION KFZWOP /end DEF_CHARACTERISTIC /begin REF_CHARACTERISTIC SHS30ZUUB SRL20ZUUB /end REF_CHARACTERISTIC
 /begin IN_MEASUREMENT etazwmn Ign_ratChrgAirLoc lamsol nmotfihy_w nmot_w rl rl_w SyC_stSub zwbas zzyl /end IN_MEASUREMENT
 /begin OUT_MEASUREMENT etazwb etazwbm furlmi_w mibas_w miopt_w mizwmn_w zwopt /end OUT_MEASUREMENT
 /begin LOC_MEASUREMENT dzwb dzwol /end LOC_MEASUREMENT
 FUNCTION_VERSION "9000.6.0" /end FUNCTION
/begin FUNCTION MDFILM "9300.4.0  engine desired torque filtering"
 /begin DEF_CHARACTERISTIC CWMDFILM DMIDP DMIZWHY DMIZWMK ETAZWMNO FGMINUWDP FGMINUWLSD FMINSANG FTFDPW FTFDPWL FTFLSDW FTFLSDWL FTVMDWDP FTVMDWLSD KFGMINUDP KFGMINULSD KFTFDP KFTFDPL KFTFLSD KFTFLSDL KFTVMDLSD KFTVMDP MDFILM_tCooltThdDiDrvblty_C /end DEF_CHARACTERISTIC
 /begin IN_MEASUREMENT B_disdpsc2 B_fvoffap B_kuppl B_ll B_sab EngDa_tEng furlmi_w gangi mdverl_w mibas_w misllr_w mizwmn_w mkfanb_w nmotgfil_w nmot_w rlfa_w rlmin_w SyC_stSub wdkfawu_w /end IN_MEASUREMENT
 /begin OUT_MEASUREMENT B_dash B_zwlwf mifal_w mifa_w mivbeg_w /end OUT_MEASUREMENT
 /begin LOC_MEASUREMENT B_sablok fminsalok gnlwf_w migf_w migp_w mizwlwf_w tcllwf tclp tdlwf /end LOC_MEASUREMENT
 FUNCTION_VERSION "9300.4.0" /end FUNCTION
/begin FUNCTION MDIST "9000.2.0  Engine torque calculation" /begin REF_CHARACTERISTIC ETADZW /end REF_CHARACTERISTIC /begin IN_MEASUREMENT miopt_w redist SyC_stSub zwist zwopt /end IN_MEASUREMENT /begin OUT_MEASUREMENT etazaist etazwist miist_w /end OUT_MEASUREMENT /begin LOC_MEASUREMENT dzwi /end LOC_MEASUREMENT FUNCTION_VERSION "9000.2.0" /end FUNCTION
/begin FUNCTION MDKOG "9000.9.0  Coordination torque intervention" /begin DEF_CHARACTERISTIC DRMISFA /end DEF_CHARACTERISTIC
 /begin IN_MEASUREMENT B_dash B_kuppl B_ll B_rlmin B_zwlwf B_zwmdlu dmar_w dmkh_w dmllr_w etazaist etazwb gangi mdverl_w mibas_w mifa_w minmx_w miopt_w misllr_w mivmx_w mizbooas_w mizbo_w mizbu_w mizwmn_w /end IN_MEASUREMENT
 /begin OUT_MEASUREMENT B_mdein B_mdene B_nozwe B_savmd B_zwf B_zwvz misfa_w misol_w mizsoloa_w mizsol_w mkfanb_w /end OUT_MEASUREMENT
 /begin LOC_MEASUREMENT drmisfa_w /end LOC_MEASUREMENT
 FUNCTION_VERSION "9000.9.0" /end FUNCTION
/begin FUNCTION MDKOL "9000.7.0  Coordination torque intervention air path" /begin DEF_CHARACTERISTIC CWMDKOL /end DEF_CHARACTERISTIC
 /begin IN_MEASUREMENT dmllrl_w dmrkh_w dmrllr_w Epm_nEng10ms furlmi_w mifal_w nstat /end IN_MEASUREMENT
 /begin OUT_MEASUREMENT B_zwmdlu mifalr_w milsol_w rlsolmd rlsolmd_w /end OUT_MEASUREMENT
 /begin LOC_MEASUREMENT dmrfnstab_w /end LOC_MEASUREMENT
 FUNCTION_VERSION "9000.7.0" /end FUNCTION
/begin FUNCTION MDKOPA "9000.3.1_386.0.0Coordination of project specific torque requests" /begin OUT_MEASUREMENT milbo_w milbu_w mizbooas_w mizbo_w mizbu_w /end OUT_MEASUREMENT FUNCTION_VERSION "9000.3.1_386.0.0" /end FUNCTION
/begin FUNCTION MDLL "9000.12.0 Desired value by idle speed control for relative air charge" /begin DEF_CHARACTERISTIC CWMDLL FURLMIONSOL KLNIPDNS ZMDNSM /end DEF_CHARACTERISTIC
 /begin IN_MEASUREMENT B_llrein B_ollstoff B_pwtrop dmllri_w dns EngDa_tEng Epm_nEng10ms furlmi_w mdvernsol_w miist_w nsol_w nstat SyC_stSub /end IN_MEASUREMENT
 /begin OUT_MEASUREMENT misllr_w nstsol_w rlminllr_w /end OUT_MEASUREMENT
 /begin LOC_MEASUREMENT mdns_w miswons_w /end LOC_MEASUREMENT
 FUNCTION_VERSION "9000.12.0" /end FUNCTION
/begin FUNCTION MDRED "9000.2.0  Calculation reduction stage from torque demand" /begin DEF_CHARACTERISTIC TWEMX /end DEF_CHARACTERISTIC /begin IN_MEASUREMENT B_llrein B_mdene B_sab B_wesyn misol_w mizwmn_w SyC_stSub /end IN_MEASUREMENT /begin OUT_MEASUREMENT B_sa B_sawe B_wez redsol /end OUT_MEASUREMENT /begin LOC_MEASUREMENT redsolz /end LOC_MEASUREMENT FUNCTION_VERSION "9000.2.0" /end FUNCTION
/begin FUNCTION MDVER "9000.6.0  Loss in engine torque" /begin DEF_CHARACTERISTIC KFMDS MDSH MDSM /end DEF_CHARACTERISTIC
 /begin IN_MEASUREMENT dmvad_w EngDa_tEng fho mdlfs_w nmot_w nstsol_w ps pu SyC_stSub /end IN_MEASUREMENT
 /begin OUT_MEASUREMENT mdverl_w mdvernsol_w /end OUT_MEASUREMENT
 /begin LOC_MEASUREMENT dpusms mdsl_w TMECmb_nStatyRef /end LOC_MEASUREMENT
 FUNCTION_VERSION "9000.6.0" /end FUNCTION
/begin FUNCTION MDVERAD "9000.4.0  Adaptation of torque loss"
 /begin DEF_CHARACTERISTIC CWMDVERAD DMAD DMADMX TMDMADHI TMDMADLO TMERngMod_ratChrgAirAdpnMax_C TMERngMod_ratChrgAirAdpnMin_C TVADFR TWDMAD ZKDMAD /end DEF_CHARACTERISTIC
 /begin IN_MEASUREMENT B_llri B_vllr dmllri_w EngDa_tEng rlsolmd_w rl_w SyC_stSub /end IN_MEASUREMENT
 /begin OUT_MEASUREMENT B_madakt dmvadll_w dmvad_w /end OUT_MEASUREMENT
 /begin LOC_MEASUREMENT B_madll dmvalla_w /end LOC_MEASUREMENT
 FUNCTION_VERSION "9000.4.0" /end FUNCTION
/begin FUNCTION MDZW "9000.1.0  Calculation of torque in nominal ignition timing" /begin DEF_CHARACTERISTIC DZWETA /end DEF_CHARACTERISTIC /begin IN_MEASUREMENT etazaist miopt_w mizsol_w SyC_stSub zwopt /end IN_MEASUREMENT /begin OUT_MEASUREMENT zwsol /end OUT_MEASUREMENT /begin LOC_MEASUREMENT etazws /end LOC_MEASUREMENT FUNCTION_VERSION "9000.1.0" /end FUNCTION
/begin FUNCTION MEDC_Compu_Core_CELPrj "35000.1.0 Computation Methods for core, which are migrated from DS classis" FUNCTION_VERSION "35000.1.0" /end FUNCTION
/begin FUNCTION MEDC_Compu_Custom_CELPrj "35000.0.0 Customer specific computation formulas from Clearcase" FUNCTION_VERSION "35000.0.0" /end FUNCTION
/begin FUNCTION MEDC_Compu_DS_CELPrj "35000.2.0 computation methods of DS from Clearcase" FUNCTION_VERSION "35000.2.0" /end FUNCTION
/begin FUNCTION MEDC_Compu_DS_GS_CELPrj "35000.1.0 computation methods, common used by DS and GS from Clearcase" FUNCTION_VERSION "35000.1.0" /end FUNCTION
/begin FUNCTION MEDC_FixConst_Core_CELPrj "35000.0.0 central system constants of the core from Clearcase" FUNCTION_VERSION "35000.0.0" /end FUNCTION
/begin FUNCTION MEDC_FixConst_Custom_CELPrj "35000.1.0 Customer specific central system constants from Clearcase" FUNCTION_VERSION "35000.1.0" /end FUNCTION
/begin FUNCTION MEDC_FixConst_DS_CELPrj "35000.1.0 DS central system constants from Clearcase" FUNCTION_VERSION "35000.1.0" /end FUNCTION
/begin FUNCTION MEDC_FixConst_DS_GS_CELPrj "35000.1.0 central systemkonstants, common used by DS and GS from Clearcase" FUNCTION_VERSION "35000.1.0" /end FUNCTION
/begin FUNCTION MEDC_MoCompu_CELPrj "1.4.0     Computation formulas for monitoring" FUNCTION_VERSION "1.4.0" /end FUNCTION
/begin FUNCTION MEDC_Models_DS_CELPrj "35000.0.0 models DS from Clearcase" FUNCTION_VERSION "35000.0.0" /end FUNCTION
/begin FUNCTION MEDC_Models_DS_GS_CELPrj "35000.0.0 common models GS and DS from Clearcase" FUNCTION_VERSION "35000.0.0" /end FUNCTION
/begin FUNCTION MEDC_SimpleModels "1.3.0     Simple models for diesel gasoline systems" FUNCTION_VERSION "1.3.0" /end FUNCTION
/begin FUNCTION MILLmp_DD "1.9.0     Device Driver for the MIL Control"
 /begin DEF_CHARACTERISTIC DDRC_DurDeb.MILLmp_tiOLDebOk_C DDRC_DurDeb.MILLmp_tiOLDebDef_C DDRC_DurDeb.MILLmp_tiOTDebOk_C DDRC_DurDeb.MILLmp_tiOTDebDef_C DDRC_DurDeb.MILLmp_tiSCBDebOk_C DDRC_DurDeb.MILLmp_tiSCBDebDef_C DDRC_DurDeb.MILLmp_tiSCGDebOk_C DDRC_DurDeb.MILLmp_tiSCGDebDef_C DDRC_RatDeb.MILLmp_tiOLUDRat_C DDRC_RatDeb.MILLmp_tiOTUDRat_C DDRC_RatDeb.MILLmp_tiSCBUDRat_C DDRC_RatDeb.MILLmp_tiSCGUDRat_C DFC_CtlMsk2.DFC_MILLmpOL_C DFC_CtlMsk2.DFC_MILLmpOT_C DFC_CtlMsk2.DFC_MILLmpSCB_C DFC_CtlMsk2.DFC_MILLmpSCG_C DFC_DisblMsk2.DFC_MILLmpOL_C DFC_DisblMsk2.DFC_MILLmpOT_C DFC_DisblMsk2.DFC_MILLmpSCB_C DFC_DisblMsk2.DFC_MILLmpSCG_C MILLmp_DigOutPar_C.tiBtwTstSCB_C MILLmp_DigOutPar_C.tiBtwTstOT_C MILLmp_DigOutPar_C.numTstMax_C MILLmp_stPsDiaDisbl_C MILLmp_stPsDisbl_C /end DEF_CHARACTERISTIC
 /begin IN_MEASUREMENT DevLib_stPwrStgEnaCond MILLmp_stReqBln MILLmp_stReqOn SyC_stSub /end IN_MEASUREMENT
 /begin OUT_MEASUREMENT ErrLmp_stMIL MILLmp_stMIL MILLmp_stPs /end OUT_MEASUREMENT
 /begin LOC_MEASUREMENT MILLmp_tiRmnBln /end LOC_MEASUREMENT
 FUNCTION_VERSION "1.9.0" /end FUNCTION
/begin FUNCTION MILLmp_VD "1.16.0    Virtual Device for the MIL Control"
 /begin DEF_CHARACTERISTIC MILLmp_stMILCfg_CW MILLmp_tiAftStrt_C MILLmp_tiRdnBln_C MILLmp_tiVisTst_C /end DEF_CHARACTERISTIC
 /begin OUT_MEASUREMENT MILLmp_stReqBln MILLmp_stReqOn /end OUT_MEASUREMENT
 /begin LOC_MEASUREMENT MILLmp_stMILWoTstr MILLmp_stSt MILLmp_tiRmnSt /end LOC_MEASUREMENT
 FUNCTION_VERSION "1.16.0" /end FUNCTION
/begin FUNCTION MisfDet_AdprInp "1.1.0     Input Adapter for Misfire detection" /begin IN_MEASUREMENT B_edk B_kuppl B_sa gangi /end IN_MEASUREMENT FUNCTION_VERSION "1.1.0" /end FUNCTION
/begin FUNCTION MisfDet_CmnMisc "1.40.1    Misfire detection, Common functions and encapsulation of variables"
 /begin DEF_CHARACTERISTIC MisfDet_nSetPLoDiffMax_C MisfDet_openPtDlyCntr_C MisfDet_stCfgOpenPt_C MisfDet_stCmnMiscCfg_C /end DEF_CHARACTERISTIC
 /begin REF_CHARACTERISTIC MisfDet_thdNEngStrt_C /end REF_CHARACTERISTIC
 /begin IN_MEASUREMENT B_kh B_khakt B_ll B_neutgear dns EngDa_tEng EpmSyn_phiInt Epm_nEng injddpfi_flgNoInjReq miist_w MisfDet_dnDly MisfDet_stMisfSti SyC_ctPostDrvLeave SyC_stSub VehV_v /end IN_MEASUREMENT
 /begin OUT_MEASUREMENT MisfDet_nEngSync MisfDet_nSetPLoDiff MisfDet_stAsr MisfDet_stCalcIntrpt MisfDet_stCatHeat MisfDet_stFcmClr MisfDet_stFcmClr1000ms MisfDet_stFcmClr100ms MisfDet_stFcmClr10ms MisfDet_stFcmClr200ms MisfDet_stFcmClr20ms MisfDet_stIdle MisfDet_stIgnIntrpt MisfDet_stInjLockdOpen MisfDet_stMisfStiSync MisfDet_stMsr MisfDet_stNoInj MisfDet_stNoInjSync MisfDet_stOpenPt MisfDet_stReIni MisfDet_stReIni100ms MisfDet_stReIni200ms MisfDet_stReIni20ms MisfDet_tEng MisfDet_tEngStrt MisfDet_tiEngRun MisfDet_tiEngRunSum MisfDet_tqAct MisfDet_tqBasc MisfDet_tqBascSync /end OUT_MEASUREMENT
 /begin LOC_MEASUREMENT MisfDet_ctSyn MisfDet_openPtDlyCntr MisfDet_phiAbsS0 /end LOC_MEASUREMENT
 FUNCTION_VERSION "1.40.1" /end FUNCTION
/begin FUNCTION MisfDet_DnCalcn "1.16.1    Calculation of engine speed deceleration of misfire detection"
 /begin DEF_CHARACTERISTIC MisfDet_cylCntrUpdtDn_C MisfDet_dnFilFacMax_C MisfDet_dnFilFacMin_C MisfDet_dnFilFacRat_C MisfDet_dnFltdAmplThdFacIdle_C MisfDet_dnFltdAmplThdFac_C MisfDet_dnFltdInitVal_M MisfDet_dnQnts_C MisfDet_dnSynShiftThd_C MisfDet_stDnCalcnCfg_C /end DEF_CHARACTERISTIC
 /begin IN_MEASUREMENT EpmSyn_stPhaCorrn Epm_nEng Epm_stOpMode MisfDet_cylCntrSegTi MisfDet_dnThd MisfDet_maskSegPosnDnCalc MisfDet_maskSegTiVld MisfDet_nEngSync MisfDet_nrMisfConsc MisfDet_segPosnSegTi MisfDet_segTi MisfDet_segTiAry MisfDet_segTiDly MisfDet_stBlkDnFltd MisfDet_stCalcIntrpt MisfDet_stIdle MisfDet_stMisfCont MisfDet_stNoInjSync MisfDet_stOpenPt MisfDet_tqBascSync /end IN_MEASUREMENT
 /begin OUT_MEASUREMENT MisfDet_cylCntr MisfDet_dn MisfDet_dnCyc MisfDet_dnCyl MisfDet_dnDifMin MisfDet_dnDifNxt MisfDet_dnDly MisfDet_dnFilFac MisfDet_dnFltd MisfDet_dnFltdCyl MisfDet_dnQnts MisfDet_dnRaw MisfDet_dnRawAry MisfDet_dnRawCyl MisfDet_maskDnVld MisfDet_segPosnDn MisfDet_stDnDifSelActv MisfDet_stDnDifSelActvCurr /end OUT_MEASUREMENT
 FUNCTION_VERSION "1.16.1" /end FUNCTION
/begin FUNCTION MisfDet_DnEvln "1.11.0    Misfire detection, Evaluation of engine speed acceleration"
 /begin DEF_CHARACTERISTIC MisfDet_nrCmbDiCatHeat_C MisfDet_nrCmbDi_M MisfDet_nrCmbTest_C MisfDet_stDnEvlnCfg_C /end DEF_CHARACTERISTIC
 /begin IN_MEASUREMENT MisfDet_cylCntr MisfDet_dn MisfDet_dnFltd MisfDet_dnThd MisfDet_dnThdCont MisfDet_nEngSync MisfDet_stBlkStc MisfDet_stCatHeat MisfDet_stReIni MisfDet_stStrtDeb MisfDet_tqBascSync SyC_stSub /end IN_MEASUREMENT
 /begin OUT_MEASUREMENT MisfDet_maskDnDet MisfDet_nrCmbDi MisfDet_stBlkAftDetn MisfDet_stBlkAftDetnTest MisfDet_stDet MisfDet_stDnDet /end OUT_MEASUREMENT
 FUNCTION_VERSION "1.11.0" /end FUNCTION
/begin FUNCTION MisfDet_GlbDef "100.24.0  MisfDet Global Definitions inside package" FUNCTION_VERSION "100.24.0" /end FUNCTION
/begin FUNCTION MisfDet_Lib "1.6.0     Function library of misfire detection" /begin IN_MEASUREMENT MisfDet_cylCntr /end IN_MEASUREMENT FUNCTION_VERSION "1.6.0" /end FUNCTION
/begin FUNCTION MisfDet_MisfGenr "1.9.2     Misfire detection, Misfire generator"
 /begin DEF_CHARACTERISTIC MisfDet_addrTrgVal_C MisfDet_ignRndMax_C MisfDet_maskCfgTrg_C MisfDet_maskMisfGenrCfg_C MisfDet_strtMisfGenr_C MisfDet_tblMisfPat_FM MisfDet_thdTrgVal_C /end DEF_CHARACTERISTIC
 /begin IN_MEASUREMENT Epm_ctCyl MisfDet_stBlkStc MisfDet_stCatDmg MisfDet_stReIni /end IN_MEASUREMENT
 /begin OUT_MEASUREMENT MisfDet_maskMisfSti MisfDet_maskMisfStiIgn MisfDet_maskMisfStiInj MisfDet_stMisfGenrRun MisfDet_stMisfGenrRunIgn MisfDet_stMisfSti /end OUT_MEASUREMENT
 /begin LOC_MEASUREMENT MisfDet_cntrMisf MisfDet_cylCntrMisfGenr MisfDet_idxMisfPat MisfDet_ignWaitBtwMisf MisfDet_ignWaitBtwMisfMod MisfDet_misfMod MisfDet_stMisfGenrEna MisfDet_stMisfGenrEnaTrg MisfDet_stMisfModActv MisfDet_stSecCamsftAftStrt /end LOC_MEASUREMENT
 FUNCTION_VERSION "1.9.2" /end FUNCTION
/begin FUNCTION MisfDet_RelsCdn "1.45.0    Release of misfire detection"
 /begin DEF_CHARACTERISTIC MisfDet_cntrGearChgDly_T MisfDet_cntrIgnBlkStcStrt_C MisfDet_cntrIgnFlreDwn_C MisfDet_cntrIgnStrtHld_C MisfDet_dlyTiStrt_T MisfDet_dnCycMaxStc_M MisfDet_dTqThdN_AX MisfDet_dTqThdTq_AX MisfDet_facEnvPMin_C MisfDet_grdtPedlMax_M MisfDet_grdtPedlMin_M MisfDet_grdtTqMax.Cmn_GM MisfDet_grdtTqMin.Cmn_GM MisfDet_maskBlkGear_C MisfDet_maskDnFltd.cntrHldN_T MisfDet_maskDnFltd.cntrHld_C MisfDet_maskDnFltd.CmbTyp.HldN_C MisfDet_maskDnFltd.CmbTyp.Hld_C MisfDet_maskDnFltd.CmbTyp.Raw_C MisfDet_maskDnFltd.Cmn.HldN_C MisfDet_maskDnFltd.Cmn.Hld_C MisfDet_maskDnFltd.Cmn.Raw_C MisfDet_maskStc.cntrHldN_T MisfDet_maskStc.cntrHld_C MisfDet_maskStc.CmbTyp.HldN_C MisfDet_maskStc.CmbTyp.Hld_C MisfDet_maskStc.CmbTyp.Raw_C MisfDet_maskStc.Cmn.HldN_C MisfDet_maskStc.Cmn.Hld_C MisfDet_maskStc.Cmn.Raw_C MisfDet_n08TqZero_AX MisfDet_nEngMax.Cmn_GT MisfDet_nEngMaxPedlEvln_C MisfDet_nEngMax_AX MisfDet_nEngMin.Cmn_C MisfDet_nEngMinPedlEvln_C MisfDet_offsNIdle_C MisfDet_stRelsCdnCfg_C MisfDet_stTqZeroIdleCfg_C MisfDet_swtOn_C MisfDet_thdNEngStrt_C MisfDet_thdTEngDetnEna_C MisfDet_thdTEngDetnStrt_C MisfDet_thdTqZeroDrv.Cmn_GT MisfDet_thdTqZeroFlreDwn_C MisfDet_thdTqZeroIdle.Cmn_GT MisfDet_tqZeroCorrnAlti_M MisfDet_tqZeroCorrnTEng_M /end DEF_CHARACTERISTIC
 /begin IN_MEASUREMENT APP_r B_nmax B_zesync Epm_nEng ESC_tiSampling_s gangi IgCtl_flgCoilDiagActv MisfDet_dnCyc MisfDet_dnDly MisfDet_flgRoughRoad MisfDet_nEngSync MisfDet_nSetPLoDiff MisfDet_stAsr MisfDet_stCalcIntrpt MisfDet_stCatHeat MisfDet_stIdle MisfDet_stIgnIntrpt MisfDet_stNoInj MisfDet_stOpenPt MisfDet_stReIni MisfDet_stSegTiVld MisfDet_tEng MisfDet_tEngStrt MisfDet_tiEngRunSum MisfDet_tqAct MisfDet_tqBascSync pu_w SyC_stSub VehV_v zzaehl /end IN_MEASUREMENT
 /begin OUT_MEASUREMENT MisfDet_maskRelsStc MisfDet_maskRelsStcCmbTyp MisfDet_stBlkDnFltd MisfDet_stBlkStc MisfDet_stDTqOutOfRng MisfDet_stIdleChng MisfDet_stNEngOutOfRng MisfDet_stNmax MisfDet_stSetZeroTq MisfDet_stStrtDeb MisfDet_stTqZero MisfDet_thdTqZero MisfDet_tqZeroCorrnAlti MisfDet_tqZeroCorrnTEng /end OUT_MEASUREMENT
 /begin LOC_MEASUREMENT MisfDet_cntrGearChgDly MisfDet_dPedlPosn MisfDet_dTq MisfDet_facEnvP Misfdet_maskDlyBlkDnFltd Misfdet_maskDlyBlkStc MisfDet_maskDnFltd.CmbTyp.Hld MisfDet_maskDnFltd.CmbTyp.HldN MisfDet_maskDnFltd.CmbTyp.Raw MisfDet_maskDnFltd.Cmn.Hld MisfDet_maskDnFltd.Cmn.HldN MisfDet_maskDnFltd.Cmn.Raw MisfDet_maskStc.CmbTyp.Hld MisfDet_maskStc.CmbTyp.HldN MisfDet_maskStc.CmbTyp.Raw MisfDet_maskStc.Cmn.Hld MisfDet_maskStc.Cmn.HldN MisfDet_maskStc.Cmn.Raw MisfDet_numGear MisfDet_stBlkDnFltdTyp MisfDet_stBlkStcTyp MisfDet_stClthChng MisfDet_stDlyStrtStc MisfDet_stDlyTiStrt MisfDet_stDnFltdZeroNoSegTiAdpn MisfDet_stDPedlPosnOutOfRng MisfDet_stEngStrt MisfDet_stFlreDwn MisfDet_stGearChg MisfDet_stGripChngPt MisfDet_stTEngLow MisfDet_thdTqZeroRaw /end LOC_MEASUREMENT
 FUNCTION_VERSION "1.45.0" /end FUNCTION
/begin COMPU_METHOD AngleCrS "" RAT_FUNC "%6.4" "deg CrS" COEFFS 0 45.5111111111 0 0 0 1 /end COMPU_METHOD
/begin COMPU_METHOD B_TRUE "" TAB_VERB "%6.3" "" COMPU_TAB_REF B_TRUE /end COMPU_METHOD
/begin COMPU_VTAB B_TRUE "" TAB_VERB 2 0 "FALSE" 1 "TRUE" /end COMPU_VTAB
/begin COMPU_METHOD Compu_SegPosnInt_VERB "" TAB_VERB "%6.3" "" COMPU_TAB_REF Compu_SegPosnInt_VERB /end COMPU_METHOD
/begin COMPU_VTAB Compu_SegPosnInt_VERB "" TAB_VERB 4 0 "Std" 256 "Altv" 257 "Idle" 258 "PfltRgn" /end COMPU_VTAB
/begin COMPU_METHOD DDRCTime_ms "" RAT_FUNC "%6.1" "ms" COEFFS 0 1 0 0 0 10 /end COMPU_METHOD
/begin COMPU_METHOD DDRC_Ratio "" TAB_VERB "%6.3" "-" COMPU_TAB_REF DDRC_Ratio /end COMPU_METHOD
/begin COMPU_VTAB DDRC_Ratio "" TAB_VERB 4 1 "Ratio1" 2 "Ratio2" 3 "Ratio3" 4 "Ratio4" /end COMPU_VTAB
/begin COMPU_METHOD dez "" RAT_FUNC "%6.2" "" COEFFS 0 1 0 0 0 1 /end COMPU_METHOD
/begin COMPU_METHOD DFES_OneToOne "" RAT_FUNC "%6.2" "-" COEFFS 0 1 0 0 0 1 /end COMPU_METHOD
/begin COMPU_METHOD dn_Compu "" RAT_FUNC "%6.4" "rad/s^2" COEFFS 0 16 0 0 0 1 /end COMPU_METHOD
/begin COMPU_METHOD EngN "" RAT_FUNC "%6.3" "rpm" COEFFS 0 2 0 0 0 1 /end COMPU_METHOD
/begin COMPU_METHOD fak_q0p0039 "" RAT_FUNC "%6.4" "-" COEFFS 0 256 0 0 0 1 /end COMPU_METHOD
/begin COMPU_METHOD fak_q0p0039_op0p5 "" RAT_FUNC "%6.3" "" COEFFS 0 256 -128 0 0 1 /end COMPU_METHOD
/begin COMPU_METHOD fak_q3p17891Em5 "" RAT_FUNC "%7.6" "" COEFFS 0 31457.28 0 0 0 1 /end COMPU_METHOD
/begin COMPU_METHOD fak_ub_b1 "" RAT_FUNC "%6.4" "-" COEFFS 0 256 0 0 0 1 /end COMPU_METHOD
/begin COMPU_METHOD fak_ub_b2 "" RAT_FUNC "%8.5" "-" COEFFS 0 256 0 0 0 2 /end COMPU_METHOD
/begin COMPU_METHOD fak_ub_b4 "" RAT_FUNC "%6.4" "-" COEFFS 0 256 0 0 0 4 /end COMPU_METHOD
/begin COMPU_METHOD fak_ub_b64 "" RAT_FUNC "%6.3" "-" COEFFS 0 256 0 0 0 64 /end COMPU_METHOD
/begin COMPU_METHOD fak_ub_b8 "" RAT_FUNC "%6.4" "-" COEFFS 0 256 0 0 0 8 /end COMPU_METHOD
/begin COMPU_METHOD fak_uw_b1 "" RAT_FUNC "%7.6" "-" COEFFS 0 65536 0 0 0 1 /end COMPU_METHOD
/begin COMPU_METHOD fak_uw_b32 "" RAT_FUNC "%6.5" "-" COEFFS 0 65536 0 0 0 32 /end COMPU_METHOD
/begin COMPU_METHOD MILLmp_ReqVerb "" TAB_VERB "%6.3" "" COMPU_TAB_REF MILLmp_ReqVerb /end COMPU_METHOD
/begin COMPU_VTAB MILLmp_ReqVerb "" TAB_VERB 256 0 "---|---|---|---|---|---|---|---" 1 "---|---|---|---|---|---|---|FES" 2 "---|---|---|---|---|---|DMD|---" 3 "---|---|---|---|---|---|DMD|FES" 4 "---|---|---|---|---|TRA|---|---" 5 "---|---|---|---|---|TRA|---|FES" 6 "---|---|---|---|---|TRA|DMD|---" 7 "---|---|---|---|---|TRA|DMD|FES" 8 "---|---|---|---|ECU1|---|---|---" 9 "---|---|---|---|ECU1|---|---|FES" 10 "---|---|---|---|ECU1|---|DMD|---" 11 "---|---|---|---|ECU1|---|DMD|FES" 12 "---|---|---|---|ECU1|TRA|---|---" 13 "---|---|---|---|ECU1|TRA|---|FES" 14 "---|---|---|---|ECU1|TRA|DMD|---" 15 "---|---|---|---|ECU1|TRA|DMD|FES" 16 "---|---|---|ECU2|---|---|---|---" 17 "---|---|---|ECU2|---|---|---|FES" 18 "---|---|---|ECU2|---|---|DMD|---" 19 "---|---|---|ECU2|---|---|DMD|FES" 20 "---|---|---|ECU2|---|TRA|---|---" 21 "---|---|---|ECU2|---|TRA|---|FES" 22 "---|---|---|ECU2|---|TRA|DMD|---" 23 "---|---|---|ECU2|---|TRA|DMD|FES" 24 "---|---|---|ECU2|ECU1|---|---|---" 25 "---|---|---|ECU2|ECU1|---|---|FES" 26 "---|---|---|ECU2|ECU1|---|DMD|---" 27 "---|---|---|ECU2|ECU1|---|DMD|FES" 28 "---|---|---|ECU2|ECU1|TRA|---|---" 29 "---|---|---|ECU2|ECU1|TRA|---|FES" 30 "---|---|---|ECU2|ECU1|TRA|DMD|---" 31 "---|---|---|ECU2|ECU1|TRA|DMD|FES" 32 "---|---|ECU3|---|---|---|---|---" 33 "---|---|ECU3|---|---|---|---|FES" 34 "---|---|ECU3|---|---|---|DMD|---" 35 "---|---|ECU3|---|---|---|DMD|FES" 36 "---|---|ECU3|---|---|TRA|---|---" 37 "---|---|ECU3|---|---|TRA|---|FES" 38 "---|---|ECU3|---|---|TRA|DMD|---" 39 "---|---|ECU3|---|---|TRA|DMD|FES" 40 "---|---|ECU3|---|ECU1|---|---|---" 41 "---|---|ECU3|---|ECU1|---|---|FES" 42 "---|---|ECU3|---|ECU1|---|DMD|---" 43 "---|---|ECU3|---|ECU1|---|DMD|FES" 44 "---|---|ECU3|---|ECU1|TRA|---|---" 45 "---|---|ECU3|---|ECU1|TRA|---|FES" 46 "---|---|ECU3|---|ECU1|TRA|DMD|---" 47 "---|---|ECU3|---|ECU1|TRA|DMD|FES" 48 "---|---|ECU3|ECU2|---|---|---|---" 49 "---|---|ECU3|ECU2|---|---|---|FES" 50 "---|---|ECU3|ECU2|---|---|DMD|---" 51 "---|---|ECU3|ECU2|---|---|DMD|FES" 52 "---|---|ECU3|ECU2|---|TRA|---|---" 53 "---|---|ECU3|ECU2|---|TRA|---|FES" 54 "---|---|ECU3|ECU2|---|TRA|DMD|---" 55 "---|---|ECU3|ECU2|---|TRA|DMD|FES" 56 "---|---|ECU3|ECU2|ECU1|---|---|---" 57 "---|---|ECU3|ECU2|ECU1|---|---|FES" 58 "---|---|ECU3|ECU2|ECU1|---|DMD|---" 59 "---|---|ECU3|ECU2|ECU1|---|DMD|FES" 60 "---|---|ECU3|ECU2|ECU1|TRA|---|---" 61 "---|---|ECU3|ECU2|ECU1|TRA|---|FES" 62 "---|---|ECU3|ECU2|ECU1|TRA|DMD|---" 63 "---|---|ECU3|ECU2|ECU1|TRA|DMD|FES" 64 "---|ECU4|---|---|---|---|---|---" 65 "---|ECU4|---|---|---|---|---|FES" 66 "---|ECU4|---|---|---|---|DMD|---" 67 "---|ECU4|---|---|---|---|DMD|FES" 68 "---|ECU4|---|---|---|TRA|---|---" 69 "---|ECU4|---|---|---|TRA|---|FES" 70 "---|ECU4|---|---|---|TRA|DMD|---" 71 "---|ECU4|---|---|---|TRA|DMD|FES" 72 "---|ECU4|---|---|ECU1|---|---|---" 73 "---|ECU4|---|---|ECU1|---|---|FES" 74 "---|ECU4|---|---|ECU1|---|DMD|---" 75 "---|ECU4|---|---|ECU1|---|DMD|FES" 76 "---|ECU4|---|---|ECU1|TRA|---|---" 77 "---|ECU4|---|---|ECU1|TRA|---|FES" 78 "---|ECU4|---|---|ECU1|TRA|DMD|---" 79 "---|ECU4|---|---|ECU1|TRA|DMD|FES" 80 "---|ECU4|---|ECU2|---|---|---|---" 81 "---|ECU4|---|ECU2|---|---|---|FES" 82 "---|ECU4|---|ECU2|---|---|DMD|---" 83 "---|ECU4|---|ECU2|---|---|DMD|FES" 84 "---|ECU4|---|ECU2|---|TRA|---|---" 85 "---|ECU4|---|ECU2|---|TRA|---|FES" 86 "---|ECU4|---|ECU2|---|TRA|DMD|---" 87 "---|ECU4|---|ECU2|---|TRA|DMD|FES" 88 "---|ECU4|---|ECU2|ECU1|---|---|---" 89 "---|ECU4|---|ECU2|ECU1|---|---|FES" 90 "---|ECU4|---|ECU2|ECU1|---|DMD|---" 91 "---|ECU4|---|ECU2|ECU1|---|DMD|FES" 92 "---|ECU4|---|ECU2|ECU1|TRA|---|---" 93 "---|ECU4|---|ECU2|ECU1|TRA|---|FES" 94 "---|ECU4|---|ECU2|ECU1|TRA|DMD|---" 95 "---|ECU4|---|ECU2|ECU1|TRA|DMD|FES" 96 "---|ECU4|ECU3|---|---|---|---|---" 97 "---|ECU4|ECU3|---|---|---|---|FES" 98 "---|ECU4|ECU3|---|---|---|DMD|---" 99 "---|ECU4|ECU3|---|---|---|DMD|FES" 100 "---|ECU4|ECU3|---|---|TRA|---|---" 101 "---|ECU4|ECU3|---|---|TRA|---|FES" 102 "---|ECU4|ECU3|---|---|TRA|DMD|---" 103 "---|ECU4|ECU3|---|---|TRA|DMD|FES" 104 "---|ECU4|ECU3|---|ECU1|---|---|---" 105 "---|ECU4|ECU3|---|ECU1|---|---|FES" 106 "---|ECU4|ECU3|---|ECU1|---|DMD|---" 107 "---|ECU4|ECU3|---|ECU1|---|DMD|FES" 108 "---|ECU4|ECU3|---|ECU1|TRA|---|---" 109 "---|ECU4|ECU3|---|ECU1|TRA|---|FES" 110 "---|ECU4|ECU3|---|ECU1|TRA|DMD|---" 111 "---|ECU4|ECU3|---|ECU1|TRA|DMD|FES" 112 "---|ECU4|ECU3|ECU2|---|---|---|---" 113 "---|ECU4|ECU3|ECU2|---|---|---|FES" 114 "---|ECU4|ECU3|ECU2|---|---|DMD|---" 115 "---|ECU4|ECU3|ECU2|---|---|DMD|FES" 116 "---|ECU4|ECU3|ECU2|---|TRA|---|---" 117 "---|ECU4|ECU3|ECU2|---|TRA|---|FES" 118 "---|ECU4|ECU3|ECU2|---|TRA|DMD|---" 119 "---|ECU4|ECU3|ECU2|---|TRA|DMD|FES" 120 "---|ECU4|ECU3|ECU2|ECU1|---|---|---" 121 "---|ECU4|ECU3|ECU2|ECU1|---|---|FES" 122 "---|ECU4|ECU3|ECU2|ECU1|---|DMD|---" 123 "---|ECU4|ECU3|ECU2|ECU1|---|DMD|FES" 124 "---|ECU4|ECU3|ECU2|ECU1|TRA|---|---" 125 "---|ECU4|ECU3|ECU2|ECU1|TRA|---|FES" 126 "---|ECU4|ECU3|ECU2|ECU1|TRA|DMD|---" 127 "---|ECU4|ECU3|ECU2|ECU1|TRA|DMD|FES" 128 "SLV|---|---|---|---|---|---|---" 129 "SLV|---|---|---|---|---|---|FES" 130 "SLV|---|---|---|---|---|DMD|---" 131 "SLV|---|---|---|---|---|DMD|FES" 132 "SLV|---|---|---|---|TRA|---|---" 133 "SLV|---|---|---|---|TRA|---|FES" 134 "SLV|---|---|---|---|TRA|DMD|---" 135 "SLV|---|---|---|---|TRA|DMD|FES" 136 "SLV|---|---|---|ECU1|---|---|---" 137 "SLV|---|---|---|ECU1|---|---|FES" 138 "SLV|---|---|---|ECU1|---|DMD|---" 139 "SLV|---|---|---|ECU1|---|DMD|FES" 140 "SLV|---|---|---|ECU1|TRA|---|---" 141 "SLV|---|---|---|ECU1|TRA|---|FES" 142 "SLV|---|---|---|ECU1|TRA|DMD|---" 143 "SLV|---|---|---|ECU1|TRA|DMD|FES" 144 "SLV|---|---|ECU2|---|---|---|---" 145 "SLV|---|---|ECU2|---|---|---|FES" 146 "SLV|---|---|ECU2|---|---|DMD|---" 147 "SLV|---|---|ECU2|---|---|DMD|FES" 148 "SLV|---|---|ECU2|---|TRA|---|---" 149 "SLV|---|---|ECU2|---|TRA|---|FES" 150 "SLV|---|---|ECU2|---|TRA|DMD|---" 151 "SLV|---|---|ECU2|---|TRA|DMD|FES" 152 "SLV|---|---|ECU2|ECU1|---|---|---" 153 "SLV|---|---|ECU2|ECU1|---|---|FES" 154 "SLV|---|---|ECU2|ECU1|---|DMD|---" 155 "SLV|---|---|ECU2|ECU1|---|DMD|FES" 156 "SLV|---|---|ECU2|ECU1|TRA|---|---" 157 "SLV|---|---|ECU2|ECU1|TRA|---|FES" 158 "SLV|---|---|ECU2|ECU1|TRA|DMD|---" 159 "SLV|---|---|ECU2|ECU1|TRA|DMD|FES" 160 "SLV|---|ECU3|---|---|---|---|---" 161 "SLV|---|ECU3|---|---|---|---|FES" 162 "SLV|---|ECU3|---|---|---|DMD|---" 163 "SLV|---|ECU3|---|---|---|DMD|FES" 164 "SLV|---|ECU3|---|---|TRA|---|---" 165 "SLV|---|ECU3|---|---|TRA|---|FES" 166 "SLV|---|ECU3|---|---|TRA|DMD|---" 167 "SLV|---|ECU3|---|---|TRA|DMD|FES" 168 "SLV|---|ECU3|---|ECU1|---|---|---" 169 "SLV|---|ECU3|---|ECU1|---|---|FES" 170 "SLV|---|ECU3|---|ECU1|---|DMD|---" 171 "SLV|---|ECU3|---|ECU1|---|DMD|FES" 172 "SLV|---|ECU3|---|ECU1|TRA|---|---" 173 "SLV|---|ECU3|---|ECU1|TRA|---|FES" 174 "SLV|---|ECU3|---|ECU1|TRA|DMD|---" 175 "SLV|---|ECU3|---|ECU1|TRA|DMD|FES" 176 "SLV|---|ECU3|ECU2|---|---|---|---" 177 "SLV|---|ECU3|ECU2|---|---|---|FES" 178 "SLV|---|ECU3|ECU2|---|---|DMD|---" 179 "SLV|---|ECU3|ECU2|---|---|DMD|FES" 180 "SLV|---|ECU3|ECU2|---|TRA|---|---" 181 "SLV|---|ECU3|ECU2|---|TRA|---|FES" 182 "SLV|---|ECU3|ECU2|---|TRA|DMD|---" 183 "SLV|---|ECU3|ECU2|---|TRA|DMD|FES" 184 "SLV|---|ECU3|ECU2|ECU1|---|---|---" 185 "SLV|---|ECU3|ECU2|ECU1|---|---|FES" 186 "SLV|---|ECU3|ECU2|ECU1|---|DMD|---" 187 "SLV|---|ECU3|ECU2|ECU1|---|DMD|FES" 188 "SLV|---|ECU3|ECU2|ECU1|TRA|---|---" 189 "SLV|---|ECU3|ECU2|ECU1|TRA|---|FES" 190 "SLV|---|ECU3|ECU2|ECU1|TRA|DMD|---" 191 "SLV|---|ECU3|ECU2|ECU1|TRA|DMD|FES" 192 "SLV|ECU4|---|---|---|---|---|---" 193 "SLV|ECU4|---|---|---|---|---|FES" 194 "SLV|ECU4|---|---|---|---|DMD|---" 195 "SLV|ECU4|---|---|---|---|DMD|FES" 196 "SLV|ECU4|---|---|---|TRA|---|---" 197 "SLV|ECU4|---|---|---|TRA|---|FES" 198 "SLV|ECU4|---|---|---|TRA|DMD|---" 199 "SLV|ECU4|---|---|---|TRA|DMD|FES" 200 "SLV|ECU4|---|---|ECU1|---|---|---" 201 "SLV|ECU4|---|---|ECU1|---|---|FES" 202 "SLV|ECU4|---|---|ECU1|---|DMD|---" 203 "SLV|ECU4|---|---|ECU1|---|DMD|FES" 204 "SLV|ECU4|---|---|ECU1|TRA|---|---" 205 "SLV|ECU4|---|---|ECU1|TRA|---|FES" 206 "SLV|ECU4|---|---|ECU1|TRA|DMD|---" 207 "SLV|ECU4|---|---|ECU1|TRA|DMD|FES" 208 "SLV|ECU4|---|ECU2|---|---|---|---" 209 "SLV|ECU4|---|ECU2|---|---|---|FES" 210 "SLV|ECU4|---|ECU2|---|---|DMD|---" 211 "SLV|ECU4|---|ECU2|---|---|DMD|FES" 212 "SLV|ECU4|---|ECU2|---|TRA|---|---" 213 "SLV|ECU4|---|ECU2|---|TRA|---|FES" 214 "SLV|ECU4|---|ECU2|---|TRA|DMD|---" 215 "SLV|ECU4|---|ECU2|---|TRA|DMD|FES" 216 "SLV|ECU4|---|ECU2|ECU1|---|---|---" 217 "SLV|ECU4|---|ECU2|ECU1|---|---|FES" 218 "SLV|ECU4|---|ECU2|ECU1|---|DMD|---" 219 "SLV|ECU4|---|ECU2|ECU1|---|DMD|FES" 220 "SLV|ECU4|---|ECU2|ECU1|TRA|---|---" 221 "SLV|ECU4|---|ECU2|ECU1|TRA|---|FES" 222 "SLV|ECU4|---|ECU2|ECU1|TRA|DMD|---" 223 "SLV|ECU4|---|ECU2|ECU1|TRA|DMD|FES" 224 "SLV|ECU4|ECU3|---|---|---|---|---" 225 "SLV|ECU4|ECU3|---|---|---|---|FES" 226 "SLV|ECU4|ECU3|---|---|---|DMD|---" 227 "SLV|ECU4|ECU3|---|---|---|DMD|FES" 228 "SLV|ECU4|ECU3|---|---|TRA|---|---" 229 "SLV|ECU4|ECU3|---|---|TRA|---|FES" 230 "SLV|ECU4|ECU3|---|---|TRA|DMD|---" 231 "SLV|ECU4|ECU3|---|---|TRA|DMD|FES" 232 "SLV|ECU4|ECU3|---|ECU1|---|---|---" 233 "SLV|ECU4|ECU3|---|ECU1|---|---|FES" 234 "SLV|ECU4|ECU3|---|ECU1|---|DMD|---" 235 "SLV|ECU4|ECU3|---|ECU1|---|DMD|FES" 236 "SLV|ECU4|ECU3|---|ECU1|TRA|---|---" 237 "SLV|ECU4|ECU3|---|ECU1|TRA|---|FES" 238 "SLV|ECU4|ECU3|---|ECU1|TRA|DMD|---" 239 "SLV|ECU4|ECU3|---|ECU1|TRA|DMD|FES" 240 "SLV|ECU4|ECU3|ECU2|---|---|---|---" 241 "SLV|ECU4|ECU3|ECU2|---|---|---|FES" 242 "SLV|ECU4|ECU3|ECU2|---|---|DMD|---" 243 "SLV|ECU4|ECU3|ECU2|---|---|DMD|FES" 244 "SLV|ECU4|ECU3|ECU2|---|TRA|---|---" 245 "SLV|ECU4|ECU3|ECU2|---|TRA|---|FES" 246 "SLV|ECU4|ECU3|ECU2|---|TRA|DMD|---" 247 "SLV|ECU4|ECU3|ECU2|---|TRA|DMD|FES" 248 "SLV|ECU4|ECU3|ECU2|ECU1|---|---|---" 249 "SLV|ECU4|ECU3|ECU2|ECU1|---|---|FES" 250 "SLV|ECU4|ECU3|ECU2|ECU1|---|DMD|---" 251 "SLV|ECU4|ECU3|ECU2|ECU1|---|DMD|FES" 252 "SLV|ECU4|ECU3|ECU2|ECU1|TRA|---|---" 253 "SLV|ECU4|ECU3|ECU2|ECU1|TRA|---|FES" 254 "SLV|ECU4|ECU3|ECU2|ECU1|TRA|DMD|---" 255 "SLV|ECU4|ECU3|ECU2|ECU1|TRA|DMD|FES" /end COMPU_VTAB
/begin COMPU_METHOD MILLmp_StVerb "" TAB_VERB "%6.3" "" COMPU_TAB_REF MILLmp_StVerb /end COMPU_METHOD
/begin COMPU_VTAB MILLmp_StVerb "" TAB_VERB 6 0 "Init_State" 17 "PreStart_VisTest" 33 "PreStart_RdnBln" 65 "PreStart_WaitForStart" 2 "AfterStart" 4 "Cruising" /end COMPU_VTAB
/begin COMPU_METHOD MISFDET_DNPRECTRL_SC_Compu "" TAB_VERB "%6.3" "" COMPU_TAB_REF MISFDET_DNPRECTRL_SC_Compu /end COMPU_METHOD
/begin COMPU_VTAB MISFDET_DNPRECTRL_SC_Compu "" TAB_VERB 2 0 "no_preCtrl" 1 "wi_preCtrl" /end COMPU_VTAB
/begin COMPU_METHOD MISFDET_DUALINJTEST_SC_Compu "" TAB_VERB "%6.3" "" COMPU_TAB_REF MISFDET_DUALINJTEST_SC_Compu /end COMPU_METHOD
/begin COMPU_VTAB MISFDET_DUALINJTEST_SC_Compu "" TAB_VERB 2 0 "False" 1 "True" /end COMPU_VTAB
/begin COMPU_METHOD MISFDET_FUREACVN_SC_Compu "" TAB_VERB "%6.3" "" COMPU_TAB_REF MISFDET_FUREACVN_SC_Compu /end COMPU_METHOD
/begin COMPU_VTAB MISFDET_FUREACVN_SC_Compu "" TAB_VERB 2 0 "Deactive" 1 "Active" /end COMPU_VTAB
/begin COMPU_METHOD MISFDET_LAMBASDDETN_SC_Compu "" TAB_VERB "%6.3" "" COMPU_TAB_REF MISFDET_LAMBASDDETN_SC_Compu /end COMPU_METHOD
/begin COMPU_VTAB MISFDET_LAMBASDDETN_SC_Compu "" TAB_VERB 2 0 "noLamBasdDetn" 1 "wiLamBasdDetn" /end COMPU_VTAB
/begin COMPU_METHOD MISFDET_NOTEQUIDIGN_SC_Compu "" TAB_VERB "%6.3" "" COMPU_TAB_REF MISFDET_NOTEQUIDIGN_SC_Compu /end COMPU_METHOD
/begin COMPU_VTAB MISFDET_NOTEQUIDIGN_SC_Compu "" TAB_VERB 2 0 "not_supported" 1 "supported" /end COMPU_VTAB
/begin COMPU_METHOD MISFDET_NREOMMASK_SC_Compu "" RAT_FUNC "%6.2" "" COEFFS 0 1 0 0 0 1 /end COMPU_METHOD
/begin COMPU_METHOD MISFDET_NRTRSMTYP_SC_Compu "" TAB_VERB "%6.3" "" COMPU_TAB_REF MISFDET_NRTRSMTYP_SC_Compu /end COMPU_METHOD
/begin COMPU_VTAB MISFDET_NRTRSMTYP_SC_Compu "" TAB_VERB 3 0 "oneTraTyp" 1 "twoTraTyp" 2 "threeTraTyp" /end COMPU_VTAB
/begin COMPU_METHOD MISFDET_PATDETNTOOTHBASD_SC_Compu "" TAB_VERB "%6.3" "" COMPU_TAB_REF MISFDET_PATDETNTOOTHBASD_SC_Compu /end COMPU_METHOD
/begin COMPU_VTAB MISFDET_PATDETNTOOTHBASD_SC_Compu "" TAB_VERB 2 0 "dnBasd" 1 "toothBasd" /end COMPU_VTAB
/begin COMPU_METHOD MISFDET_PATDETN_SC_Compu "" TAB_VERB "%6.3" "" COMPU_TAB_REF MISFDET_PATDETN_SC_Compu /end COMPU_METHOD
/begin COMPU_VTAB MISFDET_PATDETN_SC_Compu "" TAB_VERB 2 0 "Deactive" 1 "Active" /end COMPU_VTAB
/begin COMPU_METHOD MISFDET_REDFCT_SC_Compu "" RAT_FUNC "%6.2" "" COEFFS 0 1 0 0 0 1 /end COMPU_METHOD
/begin COMPU_METHOD MISFDET_ROUGHROADDIAG_SC_Compu "" TAB_VERB "%6.3" "" COMPU_TAB_REF MISFDET_ROUGHROADDIAG_SC_Compu /end COMPU_METHOD
/begin COMPU_VTAB MISFDET_ROUGHROADDIAG_SC_Compu "" TAB_VERB 2 0 "no_diag" 1 "with_diag" /end COMPU_VTAB
/begin COMPU_METHOD MISFDET_ROUGHROADTYP_SC_Compu "" TAB_VERB "%6.3" "" COMPU_TAB_REF MISFDET_ROUGHROADTYP_SC_Compu /end COMPU_METHOD
/begin COMPU_VTAB MISFDET_ROUGHROADTYP_SC_Compu "" TAB_VERB 8 0 "none" 1 "whlSpdDgs" 2 "whlSpd" 3 "engRoughns" 4 "body" 5 "ABS" 6 "whlSpdOrABS" 7 "whlSpd2Whl" /end COMPU_VTAB
/begin COMPU_METHOD MISFDET_SEGPOSNCYL_SC_Compu "" TAB_VERB "%6.3" "" COMPU_TAB_REF MISFDET_SEGPOSNCYL_SC_Compu /end COMPU_METHOD
/begin COMPU_VTAB MISFDET_SEGPOSNCYL_SC_Compu "" TAB_VERB 2 0 "cmn_seg" 1 "cyl_ind_seg" /end COMPU_VTAB
/begin COMPU_METHOD MISFDET_SEGSHIFTGPFRGN_SC_Compu "" TAB_VERB "%6.3" "" COMPU_TAB_REF MISFDET_SEGSHIFTGPFRGN_SC_Compu /end COMPU_METHOD
/begin COMPU_VTAB MISFDET_SEGSHIFTGPFRGN_SC_Compu "" TAB_VERB 2 0 "no_seg_shift_gpfrgn" 1 "seg_shift_gpfrgn" /end COMPU_VTAB
/begin COMPU_METHOD MISFDET_SEGSHIFTIDLE_SC_Compu "" TAB_VERB "%6.3" "" COMPU_TAB_REF MISFDET_SEGSHIFTIDLE_SC_Compu /end COMPU_METHOD
/begin COMPU_VTAB MISFDET_SEGSHIFTIDLE_SC_Compu "" TAB_VERB 2 0 "no_seg_shift_idle" 1 "seg_shift_idle" /end COMPU_VTAB
/begin COMPU_METHOD MISFDET_SEGSHIFT_SC_Compu "" TAB_VERB "%6.3" "" COMPU_TAB_REF MISFDET_SEGSHIFT_SC_Compu /end COMPU_METHOD
/begin COMPU_VTAB MISFDET_SEGSHIFT_SC_Compu "" TAB_VERB 3 0 "no_seg_shift" 1 "two_pos" 2 "mpl_pos" /end COMPU_VTAB
/begin COMPU_METHOD MISFDET_SEGTIADPN_SC_Compu "" TAB_VERB "%6.3" "" COMPU_TAB_REF MISFDET_SEGTIADPN_SC_Compu /end COMPU_METHOD
/begin COMPU_VTAB MISFDET_SEGTIADPN_SC_Compu "" TAB_VERB 3 0 "woAdpn" 1 "wiAdpn" 2 "wiAdpnEnhd" /end COMPU_VTAB
/begin COMPU_METHOD MISFDET_SEGTICALCNTYP_SC_Compu "" TAB_VERB "%6.3" "" COMPU_TAB_REF MISFDET_SEGTICALCNTYP_SC_Compu /end COMPU_METHOD
/begin COMPU_VTAB MISFDET_SEGTICALCNTYP_SC_Compu "" TAB_VERB 2 0 "Std" 1 "ToothTi" /end COMPU_VTAB
/begin COMPU_METHOD MISFDET_SUSPCEMIEXCDC_SC_Compu "" TAB_VERB "%6.3" "" COMPU_TAB_REF MISFDET_SUSPCEMIEXCDC_SC_Compu /end COMPU_METHOD
/begin COMPU_VTAB MISFDET_SUSPCEMIEXCDC_SC_Compu "" TAB_VERB 2 0 "no_supsc_emi" 1 "wi_supsc_emi" /end COMPU_VTAB
/begin COMPU_METHOD MISFDET_TWOWHLIF_SC_Compu "" TAB_VERB "%6.3" "" COMPU_TAB_REF MISFDET_TWOWHLIF_SC_Compu /end COMPU_METHOD
/begin COMPU_VTAB MISFDET_TWOWHLIF_SC_Compu "" TAB_VERB 3 0 "No input interface adaptation" 1 "MSE_PF" 2 "Power Sports PF" /end COMPU_VTAB
/begin COMPU_METHOD MISFDET_TYP_SC_Compu "" TAB_VERB "%6.3" "" COMPU_TAB_REF MISFDET_TYP_SC_Compu /end COMPU_METHOD
/begin COMPU_VTAB MISFDET_TYP_SC_Compu "" TAB_VERB 5 0 "none" 1 "DS_classic" 2 "DS_enhanced" 3 "GS_DMD" 4 "DGS" /end COMPU_VTAB
/begin COMPU_METHOD MISFDET_VAR_SY_Compu "" TAB_VERB "%6.3" "" COMPU_TAB_REF MISFDET_VAR_SY_Compu /end COMPU_METHOD
/begin COMPU_VTAB MISFDET_VAR_SY_Compu "" TAB_VERB 49 1 "DAI" 3 "VWW" 4 "POR" 5 "AUD" 6 "OPE" 9 "FIA" 11 "BMW" 14 "PSA" 15 "REN" 17 "ALF" 18 "SAB" 19 "VOL" 20 "NIS" 21 "GMU" 22 "FOR" 26 "IMJ" 51 "SEA" 53 "CHR" 54 "JAG" 55 "ROL" 69 "FER" 72 "TOY" 112 "BMWMotorradAG" 123 "MIT" 147 "HYU" 159 "HON" 160 "MAZ" 183 "CU" 190 "LRG" 204 "VVW" 214 "AVT" 242 "Iveco" 243 "DMC" 248 "SUZ" 267 "SSANGYONG" 268 "BRP-Rotax" 270 "KEF" 289 "AMG" 308 "TAT" 319 "MVM" 385 "UAES" 386 "Bajaj_Auto_Indien" 425 "Polaris" 590 "Scania" 828 "RBCD" 898 "MFTBC" 999 "ALL" 2887 "Nonox" 9454 "Fuso" /end COMPU_VTAB
/begin COMPU_METHOD MNFLDAIRPADCCBK_SC_Compu "" TAB_VERB "%6.3" "" COMPU_TAB_REF MNFLDAIRPADCCBK_SC_Compu /end COMPU_METHOD
/begin COMPU_VTAB MNFLDAIRPADCCBK_SC_Compu "" TAB_VERB 2 0 "Disable" 1 "Enable" /end COMPU_VTAB
/begin COMPU_METHOD MOCCPU_IT_SY_Compu "" TAB_VERB "%6.3" "" COMPU_TAB_REF MOCCPU_IT_SY_Compu /end COMPU_METHOD
/begin COMPU_VTAB MOCCPU_IT_SY_Compu "" TAB_VERB 7 0 "CHISTE" 1 "FIT" 2 "OTCG" 3 "CHISTEundOTCG" 4 "FITundOTCG" 5 "Lock-Step" 6 "HW_CMPBL_SOLN" /end COMPU_VTAB
/begin COMPU_METHOD MOCFC_GTMCLKMON_SC_Compu "" TAB_VERB "%6.3" "" COMPU_TAB_REF MOCFC_GTMCLKMON_SC_Compu /end COMPU_METHOD
/begin COMPU_VTAB MOCFC_GTMCLKMON_SC_Compu "" TAB_VERB 2 0 "False" 1 "True" /end COMPU_VTAB
/begin COMPU_METHOD MOCFC_GTMCONNTYP_SC_Compu "" TAB_VERB "%6.3" "" COMPU_TAB_REF MOCFC_GTMCONNTYP_SC_Compu /end COMPU_METHOD
/begin COMPU_VTAB MOCFC_GTMCONNTYP_SC_Compu "" TAB_VERB 2 0 "PORT" 1 "AUX_IN" /end COMPU_VTAB
/begin COMPU_METHOD MOCFC_NRCYCBLK_SC_Compu "" RAT_FUNC "%6.2" "" COEFFS 0 1 0 0 0 1 /end COMPU_METHOD
/begin COMPU_METHOD MOCFC_POSTBLDCHKS_SC_Compu "" TAB_VERB "%6.3" "" COMPU_TAB_REF MOCFC_POSTBLDCHKS_SC_Compu /end COMPU_METHOD
/begin COMPU_VTAB MOCFC_POSTBLDCHKS_SC_Compu "" TAB_VERB 2 0 "False" 1 "True" /end COMPU_VTAB
/begin COMPU_METHOD MOCFC_SCCERRREACTN_SC_Compu "" TAB_VERB "%6.3" "" COMPU_TAB_REF MOCFC_SCCERRREACTN_SC_Compu /end COMPU_METHOD
/begin COMPU_VTAB MOCFC_SCCERRREACTN_SC_Compu "" TAB_VERB 2 0 "Disable" 1 "Enable" /end COMPU_VTAB
/begin COMPU_METHOD mOilAsh_g "" RAT_FUNC "%6.4" "g" COEFFS 0 100 0 0 0 1 /end COMPU_METHOD
/begin COMPU_METHOD Molmass "" RAT_FUNC "%6.4" "g/mol" COEFFS 0 100 0 0 0 1 /end COMPU_METHOD
/begin COMPU_METHOD MO_CMNDSLGSLSW_SC_Compu "" TAB_VERB "%6.3" "" COMPU_TAB_REF MO_CMNDSLGSLSW_SC_Compu /end COMPU_METHOD
/begin COMPU_VTAB MO_CMNDSLGSLSW_SC_Compu "" TAB_VERB 2 0 "False" 1 "True" /end COMPU_VTAB
/begin COMPU_METHOD MO_EXTDTSK_SC_Compu "" TAB_VERB "%6.3" "" COMPU_TAB_REF MO_EXTDTSK_SC_Compu /end COMPU_METHOD
/begin COMPU_VTAB MO_EXTDTSK_SC_Compu "" TAB_VERB 4 0 "Disabled" 2 "2ms" 4 "4ms" 5 "5ms" /end COMPU_VTAB
/begin COMPU_METHOD MO_MAXVALINDCR_SC_Compu "" TAB_VERB "%6.3" "" COMPU_TAB_REF MO_MAXVALINDCR_SC_Compu /end COMPU_METHOD
/begin COMPU_VTAB MO_MAXVALINDCR_SC_Compu "" TAB_VERB 2 0 "Disabled" 1 "Enabled" /end COMPU_VTAB
/begin COMPU_METHOD MO_ROM_SY_Compu "" TAB_VERB "%6.3" "" COMPU_TAB_REF MO_ROM_SY_Compu /end COMPU_METHOD
/begin COMPU_VTAB MO_ROM_SY_Compu "" TAB_VERB 2 0 "False" 1 "True" /end COMPU_VTAB
/begin COMPU_METHOD MRLY_DIAG_MECH_SY_Compu "" TAB_VERB "%6.3" "" COMPU_TAB_REF MRLY_DIAG_MECH_SY_Compu /end COMPU_METHOD
/begin COMPU_VTAB MRLY_DIAG_MECH_SY_Compu "" TAB_VERB 2 0 "False" 1 "True" /end COMPU_VTAB
/begin COMPU_METHOD MSEBSW_SC_Compu "" TAB_VERB "%6.3" "" COMPU_TAB_REF MSEBSW_SC_Compu /end COMPU_METHOD
/begin COMPU_VTAB MSEBSW_SC_Compu "" TAB_VERB 2 0 "BSW1409" 1 "BSW1603" /end COMPU_VTAB
/begin COMPU_METHOD MSI_SC_Compu "" TAB_VERB "%6.3" "" COMPU_TAB_REF MSI_SC_Compu /end COMPU_METHOD
/begin COMPU_VTAB MSI_SC_Compu "" TAB_VERB 3 0 "0" 1 "1" 2 "2" /end COMPU_VTAB
/begin COMPU_METHOD MSI_SY_Compu "" TAB_VERB "%6.3" "" COMPU_TAB_REF MSI_SY_Compu /end COMPU_METHOD
/begin COMPU_VTAB MSI_SY_Compu "" TAB_VERB 2 0 "0" 1 "1" /end COMPU_VTAB
/begin COMPU_METHOD MSI_TMPR_SY_Compu "" TAB_VERB "%6.3" "" COMPU_TAB_REF MSI_TMPR_SY_Compu /end COMPU_METHOD
/begin COMPU_VTAB MSI_TMPR_SY_Compu "" TAB_VERB 2 0 "False" 1 "True" /end COMPU_VTAB
/begin COMPU_METHOD mSoot_g "" RAT_FUNC "%6.4" "g" COEFFS 0 100 0 0 0 1 /end COMPU_METHOD
/begin COMPU_METHOD MsPerVol "" RAT_FUNC "%6.5" "g/l" COEFFS 0 1000 0 0 0 1 /end COMPU_METHOD
/begin COMPU_METHOD MsPrTime_mgprsec_q0p1_COMPU "" RAT_FUNC "%6.3" "mg/s" COEFFS 0 10 0 0 0 1 /end COMPU_METHOD
/begin COMPU_METHOD Ms_g_q0p001_COMPU "" RAT_FUNC "%6.5" "g" COEFFS 0 1000 0 0 0 1 /end COMPU_METHOD
/begin COMPU_METHOD Ms_kg_COMPU "" RAT_FUNC "%6.4" "kg" COEFFS 0 100 0 0 0 1 /end COMPU_METHOD
/begin COMPU_METHOD Ms_O2 "" RAT_FUNC "%6.5" "g" COEFFS 0 1000 0 0 0 1 /end COMPU_METHOD
/begin COMPU_METHOD Ms_SOx "" RAT_FUNC "%6.5" "g" COEFFS 0 3278.68852459016 0 0 0 1 /end COMPU_METHOD
/begin COMPU_METHOD Ms_SOxLdTot "" RAT_FUNC "%6.3" "mg" COEFFS 0 2 0 0 0 1 /end COMPU_METHOD
/begin COMPU_METHOD Ms_SOxNOx "" RAT_FUNC "%8.7" "g" COEFFS 0 100000 0 0 0 1 /end COMPU_METHOD
/begin COMPU_METHOD M_NOxLd_LoRes "" RAT_FUNC "%6.4" "g" COEFFS 0 250 0 0 0 1 /end COMPU_METHOD
/begin COMPU_METHOD m_q0p00000339 "" RAT_FUNC "%8.7" "g/s" COEFFS 0 294912 0 0 0 1 /end COMPU_METHOD
/begin COMPU_METHOD m_q0p0031 "" RAT_FUNC "%6.4" "kg/h" COEFFS 0 320 0 0 0 1 /end COMPU_METHOD
/begin COMPU_METHOD m_q0p009766 "" RAT_FUNC "%6.4" "kg/(h*s)" COEFFS 0 65536 0 0 0 640 /end COMPU_METHOD
/begin COMPU_METHOD m_q0p025 "" RAT_FUNC "%6.4" "kg/h" COEFFS 0 1 0 0 0 0.025 /end COMPU_METHOD
/begin COMPU_METHOD m_q0p1_mg "" RAT_FUNC "%6.3" "mg" COEFFS 0 1 0 0 0 0.1 /end COMPU_METHOD
/begin COMPU_METHOD m_uw_b6553p5 "" RAT_FUNC "%6.3" "kg/h" COEFFS 0 1 0 0 0 0.1 /end COMPU_METHOD
/begin COMPU_METHOD NGINJRLYPRSNT_SC_Compu "" TAB_VERB "%6.3" "" COMPU_TAB_REF NGINJRLYPRSNT_SC_Compu /end COMPU_METHOD
/begin COMPU_VTAB NGINJRLYPRSNT_SC_Compu "" TAB_VERB 2 0 "False" 1 "True" /end COMPU_VTAB
/begin COMPU_METHOD nmotd_sb_q10 "" RAT_FUNC "%6.1" "1/min" COEFFS 0 1 0 0 0 10 /end COMPU_METHOD
/begin COMPU_METHOD nmot_sw_q0p25 "" RAT_FUNC "%6.3" "1/min" COEFFS 0 1 0 0 0 0.25 /end COMPU_METHOD
/begin COMPU_METHOD nmot_uw_q0p25 "" RAT_FUNC "%6.3" "1/min" COEFFS 0 1 0 0 0 0.25 /end COMPU_METHOD
/begin COMPU_METHOD NmPerSec "" RAT_FUNC "%6.3" "Nm/s" COEFFS 0 10 0 0 0 1 /end COMPU_METHOD
/begin COMPU_METHOD NOREINI_SC_Compu "" TAB_VERB "%6.3" "" COMPU_TAB_REF NOREINI_SC_Compu /end COMPU_METHOD
/begin COMPU_VTAB NOREINI_SC_Compu "" TAB_VERB 2 0 "Reini" 1 "NoReini" /end COMPU_VTAB
/begin COMPU_METHOD nox "" RAT_FUNC "%6.2" "ppm" COEFFS 0 1 0 0 0 1 /end COMPU_METHOD
/begin COMPU_METHOD NOxFlwEG "" RAT_FUNC "%6.4" "Gram/s" COEFFS 0 40 0 0 0 1 /end COMPU_METHOD
/begin COMPU_METHOD NOxLdPerFl "" RAT_FUNC "%6.5" "1/l" COEFFS 0 8192 0 0 0 1 /end COMPU_METHOD
/begin COMPU_METHOD NOxMassFlw "" RAT_FUNC "%6.5" "mg/s" COEFFS 0 1000 0 0 0 1 /end COMPU_METHOD
/begin COMPU_METHOD NOxMassPerTime "" RAT_FUNC "%6.3" "mg/s" COEFFS 0 10 0 0 0 1 /end COMPU_METHOD
/begin COMPU_METHOD NRDRVMOD_SC_Compu "" RAT_FUNC "%6.2" "" COEFFS 0 1 0 0 0 1 /end COMPU_METHOD
/begin COMPU_METHOD NSCRgn_Time_S "" RAT_FUNC "%6.4" "s" COEFFS 0 100 0 0 0 1 /end COMPU_METHOD
/begin COMPU_METHOD NUMCYLACT_SY_Compu "" TAB_VERB "%6.3" "" COMPU_TAB_REF NUMCYLACT_SY_Compu /end COMPU_METHOD
/begin COMPU_VTAB NUMCYLACT_SY_Compu "" TAB_VERB 11 1 "ONE_CLYL" 2 "TWO_CYL" 3 "THREE_CYL" 4 "FOUR_CYL" 5 "FIVE_CYL" 6 "SIX_CYL" 7 "SEVEN_CYL" 8 "EIGHT_CYL" 10 "TEN_CYL" 12 "TWELVE_CYL" 16 "SIXTEEN_CYL" /end COMPU_VTAB
/begin COMPU_METHOD NUMCYLCAL_SY_Compu "" TAB_VERB "%6.3" "" COMPU_TAB_REF NUMCYLCAL_SY_Compu /end COMPU_METHOD
/begin COMPU_VTAB NUMCYLCAL_SY_Compu "" TAB_VERB 2 0 "FIX" 1 "CAL" /end COMPU_VTAB
/begin COMPU_METHOD NUMCYLMAX_SY_Compu "" TAB_VERB "%6.3" "" COMPU_TAB_REF NUMCYLMAX_SY_Compu /end COMPU_METHOD
/begin COMPU_VTAB NUMCYLMAX_SY_Compu "" TAB_VERB 11 1 "ONE_CLYL" 2 "TWO_CYL" 3 "THREE_CYL" 4 "FOUR_CYL" 5 "FIVE_CYL" 6 "SIX_CYL" 7 "SEVEN_CYL" 8 "EIGHT_CYL" 10 "TEN_CYL" 12 "TWELVE_CYL" 16 "SIXTEEN_CYL" /end COMPU_VTAB
/begin COMPU_METHOD O2 "" RAT_FUNC "%8.7" "-" COEFFS 0 100000 0 0 0 1 /end COMPU_METHOD
/begin COMPU_METHOD O2MassPerTime "" RAT_FUNC "%6.4" "Kg/h" COEFFS 0 100 0 0 0 1 /end COMPU_METHOD
/begin COMPU_METHOD O2MassPerTimeLo "" RAT_FUNC "%6.4" "Kg/h" COEFFS 0 50 0 0 0 1 /end COMPU_METHOD
/begin COMPU_METHOD OBD_PHYSMEDM_SY_Compu "" TAB_VERB "%6.3" "" COMPU_TAB_REF OBD_PHYSMEDM_SY_Compu /end COMPU_METHOD
/begin COMPU_VTAB OBD_PHYSMEDM_SY_Compu "" TAB_VERB 2 0 "OBD_PHYSMEDM_CAN" 1 "OBD_PHYSMEDM_KLINE" /end COMPU_VTAB
/begin COMPU_METHOD OBS_SY_Compu "" TAB_VERB "%6.3" "" COMPU_TAB_REF OBS_SY_Compu /end COMPU_METHOD
/begin COMPU_VTAB OBS_SY_Compu "" TAB_VERB 2 0 "NOOBS" 1 "SMP480" /end COMPU_VTAB
/begin COMPU_METHOD OilMassPerTime "" RAT_FUNC "%7.6" "mg/s" COEFFS 0 10000 0 0 0 1 /end COMPU_METHOD
/begin COMPU_METHOD OilMassPerTimeLo "" RAT_FUNC "%6.4" "mg/s" COEFFS 0 500 0 0 0 1 /end COMPU_METHOD
/begin COMPU_METHOD OilMFl_mgps_q0p1 "" RAT_FUNC "%6.3" "mg/s" COEFFS 0 10 0 0 0 1 /end COMPU_METHOD
/begin COMPU_METHOD OilMsPrc_q0p01 "" RAT_FUNC "%6.4" "%" COEFFS 0 100 0 0 0 1 /end COMPU_METHOD
/begin COMPU_METHOD OilMs_mg "" RAT_FUNC "%6.2" "mg" COEFFS 0 1 0 0 0 1 /end COMPU_METHOD
/begin COMPU_METHOD OilMs_q0p1 "" RAT_FUNC "%6.3" "g" COEFFS 0 10 0 0 0 1 /end COMPU_METHOD
/begin COMPU_METHOD OilMs_q10 "" RAT_FUNC "%6.1" "g" COEFFS 0 0.1 0 0 0 1 /end COMPU_METHOD
/begin COMPU_METHOD OILPPSSWT_PWRSTG_SC_Compu "" TAB_VERB "%6.3" "" COMPU_TAB_REF OILPPSSWT_PWRSTG_SC_Compu /end COMPU_METHOD
/begin COMPU_VTAB OILPPSSWT_PWRSTG_SC_Compu "" TAB_VERB 2 0 "False" 1 "True" /end COMPU_VTAB
/begin COMPU_METHOD OILPPSSWT_SC_Compu "" TAB_VERB "%6.3" "" COMPU_TAB_REF OILPPSSWT_SC_Compu /end COMPU_METHOD
/begin COMPU_VTAB OILPPSSWT_SC_Compu "" TAB_VERB 2 0 "False" 1 "True" /end COMPU_VTAB
/begin COMPU_METHOD Oil_lvl_mm_q0p004 "" RAT_FUNC "%6.4" "mm" COEFFS 0 250 0 0 0 1 /end COMPU_METHOD
/begin COMPU_METHOD OneToOne "" RAT_FUNC "%6.2" "-" COEFFS 0 1 0 0 0 1 /end COMPU_METHOD
/begin COMPU_METHOD PAIRFLTDSPRS_SY_Compu "" TAB_VERB "%6.3" "" COMPU_TAB_REF PAIRFLTDSPRS_SY_Compu /end COMPU_METHOD
/begin COMPU_VTAB PAIRFLTDSPRS_SY_Compu "" TAB_VERB 2 0 "False" 1 "True" /end COMPU_VTAB
/begin COMPU_METHOD PEDLMODSELN_SC_Compu "" TAB_VERB "%6.3" "" COMPU_TAB_REF PEDLMODSELN_SC_Compu /end COMPU_METHOD
/begin COMPU_VTAB PEDLMODSELN_SC_Compu "" TAB_VERB 4 0 "NO_PEDL_MOD" 1 "GEAR_PEDL_MOD" 2 "SIG_PEDL_MOD" 3 "GEAR_SIG_PEDL_MOD" /end COMPU_VTAB
/begin COMPU_METHOD PENVSNSRTYP_SC_Compu "" TAB_VERB "%6.3" "" COMPU_TAB_REF PENVSNSRTYP_SC_Compu /end COMPU_METHOD
/begin COMPU_VTAB PENVSNSRTYP_SC_Compu "" TAB_VERB 3 0 "ANA" 1 "SPI" 2 "CAN" /end COMPU_VTAB
/begin COMPU_METHOD Period "" RAT_FUNC "%6.3" "ms" COEFFS 0 10 0 0 0 1 /end COMPU_METHOD
/begin COMPU_METHOD PERMSPLYSYS_SY_Compu "" TAB_VERB "%6.3" "" COMPU_TAB_REF PERMSPLYSYS_SY_Compu /end COMPU_METHOD
/begin COMPU_VTAB PERMSPLYSYS_SY_Compu "" TAB_VERB 2 0 "non-permanently supplied system" 1 "permanently supplied system" /end COMPU_VTAB
/begin COMPU_METHOD PFltPOpPrcPerSec_COMPU "" RAT_FUNC "%6.3" "%/s" COEFFS 0 10 0 0 0 1 /end COMPU_METHOD
/begin COMPU_METHOD PFLT_ACTV_SC_Compu "" TAB_VERB "%6.3" "" COMPU_TAB_REF PFLT_ACTV_SC_Compu /end COMPU_METHOD
/begin COMPU_VTAB PFLT_ACTV_SC_Compu "" TAB_VERB 2 0 "False" 1 "True" /end COMPU_VTAB
/begin COMPU_METHOD PHYCYLCNTR_SC_Compu "" TAB_VERB "%6.3" "" COMPU_TAB_REF PHYCYLCNTR_SC_Compu /end COMPU_METHOD
/begin COMPU_VTAB PHYCYLCNTR_SC_Compu "" TAB_VERB 2 0 "False" 1 "True" /end COMPU_VTAB
/begin COMPU_METHOD PiIClb_InjMassS32 "" RAT_FUNC "%9.8" "mg/hub" COEFFS 0 6553600 0 0 0 1 /end COMPU_METHOD
/begin COMPU_METHOD PMaxCtlKi "" RAT_FUNC "%6.4" "deg CrS/(bar*s)" COEFFS 0 763.549741510925 0 0 0 1 /end COMPU_METHOD
/begin COMPU_METHOD PMaxCtlKp "" RAT_FUNC "%7.6" "deg CrS/bar" COEFFS 0 11650.8444444416 0 0 0 1 /end COMPU_METHOD
/begin COMPU_METHOD PMaxCtlKp_8 "" RAT_FUNC "%6.5" "deg CrS/bar" COEFFS 0 1456.3555555552 0 0 0 1 /end COMPU_METHOD
/begin COMPU_METHOD PmpQnt "" RAT_FUNC "%6.3" "mm^3/rev" COEFFS 0 10 0 0 0 1 /end COMPU_METHOD
/begin COMPU_METHOD PosMCAirKi "" RAT_FUNC "%6.4" "(mg/str)/(%*s)" COEFFS 0 214.7483648 0 0 0 1 /end COMPU_METHOD
/begin COMPU_METHOD PosMCAirKp "" RAT_FUNC "%6.5" "(mg/str)/%" COEFFS 0 3276.8 0 0 0 1 /end COMPU_METHOD
/begin COMPU_METHOD PosMCAir_AMPC2Rat "" RAT_FUNC "%6.4" "1/mg/str" COEFFS 0 128 0 0 0 1 /end COMPU_METHOD
/begin COMPU_METHOD PosMCKd "" RAT_FUNC "%8.7" "%/AgCA" COEFFS 0 144000.000000035 0 0 0 1 /end COMPU_METHOD
/begin COMPU_METHOD PosMCKd_4 "" RAT_FUNC "%7.6" "%/AgCA" COEFFS 0 36000.0000000088 0 0 0 1 /end COMPU_METHOD
/begin COMPU_METHOD PosMCKi "" RAT_FUNC "%6.5" "%/(AgCA*s)" COEFFS 0 4718.59200000115 0 0 0 1 /end COMPU_METHOD
/begin COMPU_METHOD PosMCKi_2 "" RAT_FUNC "%6.5" "%/(AgCA*s)" COEFFS 0 2359.29600000058 0 0 0 1 /end COMPU_METHOD
/begin COMPU_METHOD PosMCKp "" RAT_FUNC "%7.6" "%/AgCA" COEFFS 0 72000.0000000176 0 0 0 1 /end COMPU_METHOD
/begin COMPU_METHOD PosMCKp_32 "" RAT_FUNC "%6.5" "%/AgCA" COEFFS 0 2250.00000000055 0 0 0 1 /end COMPU_METHOD
/begin COMPU_METHOD POSTDRV_SOFTRST_SY_Compu "" TAB_VERB "%6.3" "" COMPU_TAB_REF POSTDRV_SOFTRST_SY_Compu /end COMPU_METHOD
/begin COMPU_VTAB POSTDRV_SOFTRST_SY_Compu "" TAB_VERB 2 0 "false" 1 "true" /end COMPU_VTAB
/begin COMPU_METHOD POSTDRV_T15RST_SY_Compu "" TAB_VERB "%6.3" "" COMPU_TAB_REF POSTDRV_T15RST_SY_Compu /end COMPU_METHOD
/begin COMPU_VTAB POSTDRV_T15RST_SY_Compu "" TAB_VERB 2 0 "false" 1 "true" /end COMPU_VTAB
/begin COMPU_METHOD Prc_Fact100 "" RAT_FUNC "%6.4" "%" COEFFS 0 100 0 0 0 1 /end COMPU_METHOD
/begin COMPU_METHOD p_ub_q5 "" RAT_FUNC "%6.2" "hPa" COEFFS 0 1 0 0 0 5 /end COMPU_METHOD
/begin COMPU_METHOD q0p06104_pc_DIV_s "" RAT_FUNC "%6.4" "%/s" COEFFS 0 65536 0 0 0 4000 /end COMPU_METHOD
/begin COMPU_METHOD relDK_uw_b100 "" RAT_FUNC "%6.4" "%DK" COEFFS 0 65535 0 0 0 100 /end COMPU_METHOD
/begin COMPU_METHOD relgrd_sb_q10 "" RAT_FUNC "%6.1" "%/s" COEFFS 0 1 0 0 0 10 /end COMPU_METHOD
/begin COMPU_METHOD rel_q0p02344 "" RAT_FUNC "%6.4" "%" COEFFS 0 32 0 0 0 0.75 /end COMPU_METHOD
/begin COMPU_METHOD rel_sw_b100 "" RAT_FUNC "%6.4" "%" COEFFS 0 32768 0 0 0 100 /end COMPU_METHOD
/begin COMPU_METHOD rel_ub_b127p5 "" RAT_FUNC "%6.3" "%" COEFFS 0 2 0 0 0 1 /end COMPU_METHOD
/begin COMPU_METHOD rel_ub_b25 "" RAT_FUNC "%6.3" "%" COEFFS 0 256 0 0 0 25 /end COMPU_METHOD
/begin COMPU_METHOD rel_ub_q0p75 "" RAT_FUNC "%6.3" "%" COEFFS 0 1 0 0 0 0.75 /end COMPU_METHOD
/begin COMPU_METHOD rel_uw_b100 "" RAT_FUNC "%6.4" "%" COEFFS 0 65536 0 0 0 100 /end COMPU_METHOD
/begin COMPU_METHOD rel_uw_b40 "" RAT_FUNC "%6.5" "%" COEFFS 0 65536 0 0 0 40 /end COMPU_METHOD
/begin COMPU_METHOD rel_uw_b728 "" RAT_FUNC "%6.3" "%/s" COEFFS 0 6.5536 0 0 0 1 /end COMPU_METHOD
/begin COMPU_METHOD rel_uw_q0p0234 "" RAT_FUNC "%6.4" "%" COEFFS 0 32 0 0 0 0.75 /end COMPU_METHOD
/begin COMPU_METHOD spg_q0p005 "" RAT_FUNC "%6.4" "V" COEFFS 0 1 0 0 0 0.005 /end COMPU_METHOD
/begin COMPU_METHOD t1sxs_q1 "" RAT_FUNC "%6.2" "s" COEFFS 0 1 0 0 0 1 /end COMPU_METHOD
/begin COMPU_METHOD t50msxs_q0p05 "" RAT_FUNC "%6.4" "s" COEFFS 0 1 0 0 0 0.05 /end COMPU_METHOD
/begin COMPU_METHOD Temp_Cels "" RAT_FUNC "%6.1" "deg C" COEFFS 0 10 2731.4 0 0 1 /end COMPU_METHOD
/begin COMPU_METHOD temp_ub_q5_o50 "" RAT_FUNC "%6.2" "Grad C" COEFFS 0 1 50 0 0 5 /end COMPU_METHOD
/begin COMPU_METHOD Time_ms "" RAT_FUNC "%6.1" "ms" COEFFS 0 0.1 0 0 0 1 /end COMPU_METHOD
/begin COMPU_METHOD Time_s "" RAT_FUNC "%6.4" "s" COEFFS 0 100 0 0 0 1 /end COMPU_METHOD
/begin COMPU_METHOD t_q0p01 "" RAT_FUNC "%6.4" "s" COEFFS 0 100 0 0 0 1 /end COMPU_METHOD
/begin COMPU_METHOD t_q0p1 "" RAT_FUNC "%6.3" "s" COEFFS 0 10 0 0 0 1 /end COMPU_METHOD
/begin COMPU_METHOD t_q0p2 "" RAT_FUNC "%6.3" "s" COEFFS 0 10 0 0 0 2 /end COMPU_METHOD
/begin COMPU_METHOD zk20msxs_uw_b1310p72 "" RAT_FUNC "%6.1" "s" COEFFS 0 0 65536 0 50 0 /end COMPU_METHOD
/begin COMPU_METHOD zw_sb_q0p75 "" RAT_FUNC "%6.3" "Grad KW" COEFFS 0 255 0 0 0 191.25 /end COMPU_METHOD
/begin RECORD_LAYOUT FklWS8 FNC_VALUES 1 SBYTE COLUMN_DIR DIRECT /end RECORD_LAYOUT
/begin RECORD_LAYOUT FklWU8 FNC_VALUES 1 UBYTE COLUMN_DIR DIRECT /end RECORD_LAYOUT
/begin RECORD_LAYOUT GkfWS8 FNC_VALUES 1 SBYTE COLUMN_DIR DIRECT /end RECORD_LAYOUT
/begin RECORD_LAYOUT KfAxU8AyU8SstxU16SstyU16WU16 NO_AXIS_PTS_X 1 UWORD NO_AXIS_PTS_Y 2 UWORD AXIS_PTS_X 3 UWORD INDEX_INCR DIRECT AXIS_PTS_Y 4 UWORD INDEX_INCR DIRECT FNC_VALUES 5 UWORD COLUMN_DIR DIRECT /end RECORD_LAYOUT
/begin RECORD_LAYOUT KfAxU8AyU8SstxU8SstyU16WU8 NO_AXIS_PTS_X 1 UBYTE NO_AXIS_PTS_Y 2 UBYTE AXIS_PTS_X 3 UBYTE INDEX_INCR DIRECT AXIS_PTS_Y 4 UWORD INDEX_INCR DIRECT FNC_VALUES 5 UBYTE COLUMN_DIR DIRECT /end RECORD_LAYOUT
/begin RECORD_LAYOUT KlAUbSstUbWUb NO_AXIS_PTS_X 1 UBYTE AXIS_PTS_X 2 UBYTE INDEX_INCR DIRECT FNC_VALUES 3 UBYTE COLUMN_DIR DIRECT /end RECORD_LAYOUT
/begin RECORD_LAYOUT KlAUbSstUbWUw_Static NO_AXIS_PTS_X 1 UBYTE AXIS_PTS_X 2 UBYTE INDEX_INCR DIRECT FNC_VALUES 3 UWORD COLUMN_DIR DIRECT STATIC_RECORD_LAYOUT /end RECORD_LAYOUT
/begin RECORD_LAYOUT KlAUbSstUwWUw NO_AXIS_PTS_X 1 UWORD AXIS_PTS_X 2 UWORD INDEX_INCR DIRECT FNC_VALUES 3 UWORD COLUMN_DIR DIRECT /end RECORD_LAYOUT
/begin RECORD_LAYOUT KlAxU8SstxS16WU16_Static NO_AXIS_PTS_X 1 UWORD AXIS_PTS_X 2 SWORD INDEX_INCR DIRECT FNC_VALUES 3 UWORD COLUMN_DIR DIRECT STATIC_RECORD_LAYOUT /end RECORD_LAYOUT
/begin RECORD_LAYOUT KlAxU8SstxS8WU8_Static NO_AXIS_PTS_X 1 UBYTE AXIS_PTS_X 2 SBYTE INDEX_INCR DIRECT FNC_VALUES 3 UBYTE COLUMN_DIR DIRECT STATIC_RECORD_LAYOUT /end RECORD_LAYOUT
/begin RECORD_LAYOUT KlAxU8SstxU16WU16 NO_AXIS_PTS_X 1 UWORD AXIS_PTS_X 2 UWORD INDEX_INCR DIRECT FNC_VALUES 3 UWORD COLUMN_DIR DIRECT /end RECORD_LAYOUT
/begin RECORD_LAYOUT KlAxU8SstxU16WU8_Static NO_AXIS_PTS_X 1 UWORD AXIS_PTS_X 2 UWORD INDEX_INCR DIRECT FNC_VALUES 3 UBYTE COLUMN_DIR DIRECT STATIC_RECORD_LAYOUT /end RECORD_LAYOUT
/begin RECORD_LAYOUT KlAxU8SstxU8WS8_Static NO_AXIS_PTS_X 1 UBYTE AXIS_PTS_X 2 UBYTE INDEX_INCR DIRECT FNC_VALUES 3 SBYTE COLUMN_DIR DIRECT STATIC_RECORD_LAYOUT /end RECORD_LAYOUT
/begin RECORD_LAYOUT KlAxU8SstxU8WU8 NO_AXIS_PTS_X 1 UBYTE AXIS_PTS_X 2 UBYTE INDEX_INCR DIRECT FNC_VALUES 3 UBYTE COLUMN_DIR DIRECT /end RECORD_LAYOUT
/begin RECORD_LAYOUT KwUb FNC_VALUES 1 UBYTE COLUMN_DIR DIRECT /end RECORD_LAYOUT
/begin RECORD_LAYOUT KwUw FNC_VALUES 1 UWORD COLUMN_DIR DIRECT /end RECORD_LAYOUT
/begin RECORD_LAYOUT KwWS16 FNC_VALUES 1 SWORD COLUMN_DIR DIRECT /end RECORD_LAYOUT
/begin RECORD_LAYOUT KwWU16 FNC_VALUES 1 UWORD COLUMN_DIR DIRECT /end RECORD_LAYOUT
/begin RECORD_LAYOUT KwWU8 FNC_VALUES 1 UBYTE COLUMN_DIR DIRECT /end RECORD_LAYOUT
/begin RECORD_LAYOUT Kw_Ws16 FNC_VALUES 1 SWORD COLUMN_DIR DIRECT /end RECORD_LAYOUT
/begin RECORD_LAYOUT Kw_Wu16 FNC_VALUES 1 UWORD COLUMN_DIR DIRECT /end RECORD_LAYOUT
/begin RECORD_LAYOUT RB_Axis_S16 NO_AXIS_PTS_X 1 SWORD AXIS_PTS_X 2 SWORD INDEX_INCR DIRECT /end RECORD_LAYOUT
/begin RECORD_LAYOUT RB_Axis_S8 NO_AXIS_PTS_X 1 SBYTE AXIS_PTS_X 2 SBYTE INDEX_INCR DIRECT /end RECORD_LAYOUT
/begin RECORD_LAYOUT RB_Axis_U16 NO_AXIS_PTS_X 1 UWORD AXIS_PTS_X 2 UWORD INDEX_INCR DIRECT /end RECORD_LAYOUT
/begin RECORD_LAYOUT RB_CurveGroup_S16 FNC_VALUES 1 SWORD COLUMN_DIR DIRECT /end RECORD_LAYOUT
/begin RECORD_LAYOUT RB_CurveGroup_U16 FNC_VALUES 1 UWORD COLUMN_DIR DIRECT /end RECORD_LAYOUT
/begin RECORD_LAYOUT RB_Curve_S16_U16_Static NO_AXIS_PTS_X 1 SWORD AXIS_PTS_X 2 SWORD INDEX_INCR DIRECT FNC_VALUES 3 UWORD COLUMN_DIR DIRECT STATIC_RECORD_LAYOUT /end RECORD_LAYOUT
/begin RECORD_LAYOUT RB_Curve_S16_U8_Static NO_AXIS_PTS_X 1 SWORD AXIS_PTS_X 2 SWORD INDEX_INCR DIRECT FNC_VALUES 3 UBYTE COLUMN_DIR DIRECT STATIC_RECORD_LAYOUT /end RECORD_LAYOUT
/begin RECORD_LAYOUT RB_FixMap_S16S16_S16 FNC_VALUES 1 SWORD COLUMN_DIR DIRECT /end RECORD_LAYOUT
/begin RECORD_LAYOUT RB_MapGroup_S16 FNC_VALUES 1 SWORD COLUMN_DIR DIRECT /end RECORD_LAYOUT
/begin RECORD_LAYOUT RB_Map_S16S16_U16 NO_AXIS_PTS_X 1 SWORD NO_AXIS_PTS_Y 2 SWORD AXIS_PTS_X 3 SWORD INDEX_INCR DIRECT AXIS_PTS_Y 4 SWORD INDEX_INCR DIRECT FNC_VALUES 5 UWORD COLUMN_DIR DIRECT /end RECORD_LAYOUT
/begin RECORD_LAYOUT RB_Map_S16U8_S16 NO_AXIS_PTS_X 1 SWORD NO_AXIS_PTS_Y 2 SWORD AXIS_PTS_X 3 SWORD INDEX_INCR DIRECT AXIS_PTS_Y 4 UBYTE INDEX_INCR DIRECT FNC_VALUES 5 SWORD COLUMN_DIR DIRECT /end RECORD_LAYOUT
/begin RECORD_LAYOUT RB_Map_S8S16_S16 NO_AXIS_PTS_X 1 SBYTE NO_AXIS_PTS_Y 2 SBYTE AXIS_PTS_X 3 SBYTE INDEX_INCR DIRECT AXIS_PTS_Y 4 SWORD INDEX_INCR DIRECT FNC_VALUES 5 SWORD ROW_DIR DIRECT /end RECORD_LAYOUT
/begin RECORD_LAYOUT RB_Map_U16S16_S16 NO_AXIS_PTS_X 1 UWORD NO_AXIS_PTS_Y 2 UWORD AXIS_PTS_X 3 UWORD INDEX_INCR DIRECT AXIS_PTS_Y 4 SWORD INDEX_INCR DIRECT FNC_VALUES 5 SWORD COLUMN_DIR DIRECT /end RECORD_LAYOUT
/begin RECORD_LAYOUT RB_Map_U16S16_U8 NO_AXIS_PTS_X 1 UWORD NO_AXIS_PTS_Y 2 UWORD AXIS_PTS_X 3 UWORD INDEX_INCR DIRECT AXIS_PTS_Y 4 SWORD INDEX_INCR DIRECT FNC_VALUES 5 UBYTE COLUMN_DIR DIRECT /end RECORD_LAYOUT
/begin RECORD_LAYOUT RB_Val_Ws16 FNC_VALUES 1 SWORD COLUMN_DIR DIRECT /end RECORD_LAYOUT
/begin RECORD_LAYOUT RB_Val_Wu16 FNC_VALUES 1 UWORD COLUMN_DIR DIRECT /end RECORD_LAYOUT
/begin RECORD_LAYOUT RB_Val_Wu32 FNC_VALUES 1 ULONG COLUMN_DIR DIRECT /end RECORD_LAYOUT
/begin RECORD_LAYOUT RB_Val_Wu8 FNC_VALUES 1 UBYTE COLUMN_DIR DIRECT /end RECORD_LAYOUT
/begin RECORD_LAYOUT SstAU8SstU16 NO_AXIS_PTS_X 1 UWORD AXIS_PTS_X 2 UWORD INDEX_INCR DIRECT /end RECORD_LAYOUT
/begin RECORD_LAYOUT SstAU8SstU8 NO_AXIS_PTS_X 1 UBYTE AXIS_PTS_X 2 UBYTE INDEX_INCR DIRECT /end RECORD_LAYOUT
/begin RECORD_LAYOUT Val_Wu16 FNC_VALUES 1 UWORD COLUMN_DIR DIRECT /end RECORD_LAYOUT
/begin RECORD_LAYOUT Val_Wu8 FNC_VALUES 1 UBYTE COLUMN_DIR DIRECT /end RECORD_LAYOUT
/end MODULE
/end PROJECT
