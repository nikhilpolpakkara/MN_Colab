ASAP2_VERSION 1 60
/begin PROJECT MSE2_BJ10_0038_00 "MDG1"
/begin HEADER "" VERSION "MSE2_BJ10_0038_00" PROJECT_NO MSE2_BJ10_0038_00 /end HEADER
/begin MODULE DIM ""
/begin MOD_COMMON "" BYTE_ORDER MSB_FIRST ALIGNMENT_BYTE 1 ALIGNMENT_WORD 2 ALIGNMENT_LONG 4 ALIGNMENT_INT64 4 ALIGNMENT_FLOAT32_IEEE 4 ALIGNMENT_FLOAT64_IEEE 4 /end MOD_COMMON
/begin CHARACTERISTIC ANZRIBEH "Number of Ri.calculations downstream catalyst" VALUE 0x9085638 KwUb 255.0 dez 0.00 255.0 FORMAT "%5.1" /end CHARACTERISTIC
/begin CHARACTERISTIC ANZRIBEV "Amount of Ri calculation upstream cat" VALUE 0x9085644 KwUb 255.0 dez 0.00 255.0 FORMAT "%5.1" /end CHARACTERISTIC
/begin CHARACTERISTIC ANZRIWZGH "Number of Ri.calculations value too high downstream catalyst" VALUE 0x9085639 KwUb 255.0 dez 0.00 255.0 FORMAT "%5.1" /end CHARACTERISTIC
/begin CHARACTERISTIC ANZRIWZGV "number of Ri calculations value too great upstream Catalyst" VALUE 0x9085645 KwUb 255.0 dez 0.00 255.0 FORMAT "%5.1" /end CHARACTERISTIC
/begin CHARACTERISTIC CWDIANGS "Code word for diagnosis" VALUE 0x9085656 KwWU8 255.0 dez 0.00 255.0 FORMAT "%5.1" /end CHARACTERISTIC
/begin CHARACTERISTIC CWDKPSTG "Codeword to switch between fixed volatge range or delta of learned volatge limit for volatge slope" VALUE 0x90855FE KwWU8 255.0 dez 0.00 255.0 FORMAT "%5.1" /end CHARACTERISTIC
/begin CHARACTERISTIC CWESUK "Code word transient compensation" VALUE 0x908514E KwWU8 255.0 dez 0.00 255.0 FORMAT "%5.1" /end CHARACTERISTIC
/begin CHARACTERISTIC CWGGLS "code word for Ri-evaluation for all sensors (Nernst)" VALUE 0x9085646 KwUb 255.0 dez 0.00 255.0 FORMAT "%5.1" /end CHARACTERISTIC
/begin CHARACTERISTIC CWSDSTACT "Codeword to enable SideStand Switch" VALUE 0x9085657 KwWU8 255.0 dez 0.00 255.0 FORMAT "%5.1" /end CHARACTERISTIC
/begin CHARACTERISTIC CWSTDIEN "Code word used for side stand diagnostic function" VALUE 0x9085658 KwWU8 255.0 dez 0.00 255.0 FORMAT "%5.1" /end CHARACTERISTIC
/begin CHARACTERISTIC CWTFASTC "Code word for stuck-check intake air temperature sensor after air filter" VALUE 0x90817BC RB_Val_Wu8 255.0 OneToOne 0.00 255.0 FORMAT "%5.1" /end CHARACTERISTIC
/begin CHARACTERISTIC DFC_CtlMsk2.DFC_IntkAirTAirFltDsSTC_C "Behaviour control mask / Behaviour control masks of check DFC_IntkAirTAirFltDsSTC" VALUE 0x90803AD Val_Wu8 255.0 DFES_OneToOne 0.00 255.0 FORMAT "%5.1" /end CHARACTERISTIC
/begin CHARACTERISTIC DFC_CtlMsk2.DFC_DKmax_C "Behaviour control mask / Behaviour control masks of check DFC_DKmax" VALUE 0x90803DE Val_Wu8 255.0 DFES_OneToOne 0.00 255.0 FORMAT "%5.1" /end CHARACTERISTIC
/begin CHARACTERISTIC DFC_CtlMsk2.DFC_DKmin_C "Behaviour control mask / Behaviour control masks of check DFC_DKmin" VALUE 0x90803DF Val_Wu8 255.0 DFES_OneToOne 0.00 255.0 FORMAT "%5.1" /end CHARACTERISTIC
/begin CHARACTERISTIC DFC_CtlMsk2.DFC_DSSmax_C "Behaviour control mask / Behaviour control masks of check DFC_DSSmax" VALUE 0x90803E5 Val_Wu8 255.0 DFES_OneToOne 0.00 255.0 FORMAT "%5.1" /end CHARACTERISTIC
/begin CHARACTERISTIC DFC_CtlMsk2.DFC_DSSmin_C "Behaviour control mask / Behaviour control masks of check DFC_DSSmin" VALUE 0x90803E6 Val_Wu8 255.0 DFES_OneToOne 0.00 255.0 FORMAT "%5.1" /end CHARACTERISTIC
/begin CHARACTERISTIC DFC_CtlMsk2.DFC_IntkAirTAirFltDsPRCMax_C "Behaviour control mask / Behaviour control masks of check DFC_IntkAirTAirFltDsPRCMax" VALUE 0x90803FD Val_Wu8 255.0 DFES_OneToOne 0.00 255.0 FORMAT "%5.1" /end CHARACTERISTIC
/begin CHARACTERISTIC DFC_CtlMsk2.DFC_IntkAirTAirFltDsPRCMin_C "Behaviour control mask / Behaviour control masks of check DFC_IntkAirTAirFltDsPRCMin" VALUE 0x90803FE Val_Wu8 255.0 DFES_OneToOne 0.00 255.0 FORMAT "%5.1" /end CHARACTERISTIC
/begin CHARACTERISTIC DFC_CtlMsk2.DFC_IntkAirTAirFltDsSRCMax_C "Behaviour control mask / Behaviour control masks of check DFC_IntkAirTAirFltDsSRCMax" VALUE 0x90803FF Val_Wu8 255.0 DFES_OneToOne 0.00 255.0 FORMAT "%5.1" /end CHARACTERISTIC
/begin CHARACTERISTIC DFC_CtlMsk2.DFC_IntkAirTAirFltDsSRCMin_C "Behaviour control mask / Behaviour control masks of check DFC_IntkAirTAirFltDsSRCMin" VALUE 0x9080400 Val_Wu8 255.0 DFES_OneToOne 0.00 255.0 FORMAT "%5.1" /end CHARACTERISTIC
/begin CHARACTERISTIC DFC_CtlMsk2.DFC_IntkMnfldPNoSyn_C "Behaviour control mask / Behaviour control masks of check DFC_IntkMnfldPNoSyn" VALUE 0x9080401 Val_Wu8 255.0 DFES_OneToOne 0.00 255.0 FORMAT "%5.1" /end CHARACTERISTIC
/begin CHARACTERISTIC DFC_CtlMsk2.DFC_SdSTNpl_C "Behaviour control mask / Behaviour control masks of check DFC_SdSTNpl" VALUE 0x908042C Val_Wu8 255.0 DFES_OneToOne 0.00 255.0 FORMAT "%5.1" /end CHARACTERISTIC
/begin CHARACTERISTIC DFC_CtlMsk2.DFC_SdSTSCB_C "Behaviour control mask / Behaviour control masks of check DFC_SdSTSCB" VALUE 0x908042D Val_Wu8 255.0 DFES_OneToOne 0.00 255.0 FORMAT "%5.1" /end CHARACTERISTIC
/begin CHARACTERISTIC DFC_CtlMsk2.DFC_SdSTSCG_C "Behaviour control mask / Behaviour control masks of check DFC_SdSTSCG" VALUE 0x908042E Val_Wu8 255.0 DFES_OneToOne 0.00 255.0 FORMAT "%5.1" /end CHARACTERISTIC
/begin CHARACTERISTIC DFC_CtlMsk2.DFC_SdSTSOL_C "Behaviour control mask / Behaviour control masks of check DFC_SdSTSOL" VALUE 0x908042F Val_Wu8 255.0 DFES_OneToOne 0.00 255.0 FORMAT "%5.1" /end CHARACTERISTIC
/begin CHARACTERISTIC DFC_DisblMsk2.DFC_IntkAirTAirFltDsSTC_C "disable mask / Disable masks of check DFC_IntkAirTAirFltDsSTC" VALUE 0x9080D7D Val_Wu8 255.0 DFES_OneToOne 0.00 255.0 FORMAT "%5.1" /end CHARACTERISTIC
/begin CHARACTERISTIC DFC_DisblMsk2.DFC_DKmax_C "disable mask / Disable masks of check DFC_DKmax" VALUE 0x9080DAE Val_Wu8 255.0 DFES_OneToOne 0.00 255.0 FORMAT "%5.1" /end CHARACTERISTIC
/begin CHARACTERISTIC DFC_DisblMsk2.DFC_DKmin_C "disable mask / Disable masks of check DFC_DKmin" VALUE 0x9080DAF Val_Wu8 255.0 DFES_OneToOne 0.00 255.0 FORMAT "%5.1" /end CHARACTERISTIC
/begin CHARACTERISTIC DFC_DisblMsk2.DFC_DSSmax_C "disable mask / Disable masks of check DFC_DSSmax" VALUE 0x9080DB5 Val_Wu8 255.0 DFES_OneToOne 0.00 255.0 FORMAT "%5.1" /end CHARACTERISTIC
/begin CHARACTERISTIC DFC_DisblMsk2.DFC_DSSmin_C "disable mask / Disable masks of check DFC_DSSmin" VALUE 0x9080DB6 Val_Wu8 255.0 DFES_OneToOne 0.00 255.0 FORMAT "%5.1" /end CHARACTERISTIC
/begin CHARACTERISTIC DFC_DisblMsk2.DFC_IntkAirTAirFltDsPRCMax_C "disable mask / Disable masks of check DFC_IntkAirTAirFltDsPRCMax" VALUE 0x9080DCD Val_Wu8 255.0 DFES_OneToOne 0.00 255.0 FORMAT "%5.1" /end CHARACTERISTIC
/begin CHARACTERISTIC DFC_DisblMsk2.DFC_IntkAirTAirFltDsPRCMin_C "disable mask / Disable masks of check DFC_IntkAirTAirFltDsPRCMin" VALUE 0x9080DCE Val_Wu8 255.0 DFES_OneToOne 0.00 255.0 FORMAT "%5.1" /end CHARACTERISTIC
/begin CHARACTERISTIC DFC_DisblMsk2.DFC_IntkAirTAirFltDsSRCMax_C "disable mask / Disable masks of check DFC_IntkAirTAirFltDsSRCMax" VALUE 0x9080DCF Val_Wu8 255.0 DFES_OneToOne 0.00 255.0 FORMAT "%5.1" /end CHARACTERISTIC
/begin CHARACTERISTIC DFC_DisblMsk2.DFC_IntkAirTAirFltDsSRCMin_C "disable mask / Disable masks of check DFC_IntkAirTAirFltDsSRCMin" VALUE 0x9080DD0 Val_Wu8 255.0 DFES_OneToOne 0.00 255.0 FORMAT "%5.1" /end CHARACTERISTIC
/begin CHARACTERISTIC DFC_DisblMsk2.DFC_IntkMnfldPNoSyn_C "disable mask / Disable masks of check DFC_IntkMnfldPNoSyn" VALUE 0x9080DD1 Val_Wu8 255.0 DFES_OneToOne 0.00 255.0 FORMAT "%5.1" /end CHARACTERISTIC
/begin CHARACTERISTIC DFC_DisblMsk2.DFC_SdSTNpl_C "disable mask / Disable masks of check DFC_SdSTNpl" VALUE 0x9080DFC Val_Wu8 255.0 DFES_OneToOne 0.00 255.0 FORMAT "%5.1" /end CHARACTERISTIC
/begin CHARACTERISTIC DFC_DisblMsk2.DFC_SdSTSCB_C "disable mask / Disable masks of check DFC_SdSTSCB" VALUE 0x9080DFD Val_Wu8 255.0 DFES_OneToOne 0.00 255.0 FORMAT "%5.1" /end CHARACTERISTIC
/begin CHARACTERISTIC DFC_DisblMsk2.DFC_SdSTSCG_C "disable mask / Disable masks of check DFC_SdSTSCG" VALUE 0x9080DFE Val_Wu8 255.0 DFES_OneToOne 0.00 255.0 FORMAT "%5.1" /end CHARACTERISTIC
/begin CHARACTERISTIC DFC_DisblMsk2.DFC_SdSTSOL_C "disable mask / Disable masks of check DFC_SdSTSOL" VALUE 0x9080DFF Val_Wu8 255.0 DFES_OneToOne 0.00 255.0 FORMAT "%5.1" /end CHARACTERISTIC
/begin CHARACTERISTIC DOLLSABGE "Slope of the gradient limitation in % per 10ms" VALUE 0x9085434 KwWU16 99.99847 rel_uw_b100 0.00 99.99847 FORMAT "%8.5" /end CHARACTERISTIC
/begin CHARACTERISTIC DOLLSABGES "Slope of the gradient limitation in % per 10ms for start" VALUE 0x9085436 KwWU16 99.99847 rel_uw_b100 0.00 99.99847 FORMAT "%8.5" /end CHARACTERISTIC
/begin CHARACTERISTIC DSSGRAD "gradient for manifold pressure sensor" VALUE 0x908562E KwWU16 1023.984 dgrad_uw_q0p015 0.00 1023.984 FORMAT "%8.3" /end CHARACTERISTIC
/begin CHARACTERISTIC DSSOFS "offset for manifold pressure sensor" VALUE 0x9085630 KwWS16 2559.961 p_sw_q0p039 -1280.000 1279.961 FORMAT "%8.3" /end CHARACTERISTIC
/begin CHARACTERISTIC DUSRIHXF "Delta sensor volt. downstream cat betw. new and old value for Ri-measur.(LSFX4)" VALUE 0x908563A KwUw 327.6750 spg_q0p005 0.00 327.6750 FORMAT "%8.4" /end CHARACTERISTIC
/begin CHARACTERISTIC DUSRIVXF "Delta sensor voltage upstream cat between new and old value for Ri measurement (LSF with Pumped Reference)" VALUE 0x9085648 KwUw 327.6750 spg_q0p005 0.00 327.6750 FORMAT "%8.4" /end CHARACTERISTIC
/begin CHARACTERISTIC DUWDKOA "Threshold for throttle valve dynamics to enable upper mechanical limit throttle adaptation" VALUE 0x9085600 KwWU16 79.99878 spg_uw_q0p001222 0.00 79.99878 FORMAT "%8.5" /end CHARACTERISTIC
/begin CHARACTERISTIC DUWDKUA "Threshold for throttle valve dynamics to enable throttle adaptation" VALUE 0x9085602 KwWU16 79.99878 spg_uw_q0p001222 0.00 79.99878 FORMAT "%8.5" /end CHARACTERISTIC
/begin CHARACTERISTIC DWFMN "Min.range for wallwetting" VALUE 0x9085150 KwWS16 6143.906 rel_q0p09375 -3072.000 3071.906 FORMAT "%8.3" /end CHARACTERISTIC
/begin CHARACTERISTIC DWFMX "Max.range for wallwetting" VALUE 0x9085152 KwWS16 6143.906 rel_q0p09375 -3072.000 3071.906 FORMAT "%8.3" /end CHARACTERISTIC
/begin CHARACTERISTIC EpmSyn_agWinLenIntkMnfldP_C "Length of the pressure evaluation window in angle terms" VALUE 0x908A076 Val_Ws16 1439.978 AngleCrS -720.0000 719.9780 FORMAT "%8.4" /end CHARACTERISTIC
/begin CHARACTERISTIC EpmSyn_agWinStrtIntkMnfldP_C "Start angle of the pressure evaluation window from the last gap" VALUE 0x908A078 Val_Ws16 360.0000 AngleCrS 0.00 360.0000 FORMAT "%8.4" EXTENDED_LIMITS -720.0000 719.9780 /end CHARACTERISTIC
/begin CHARACTERISTIC EpmSyn_cntrValChkIntkMnfldP_C "Phase validation counter threshold" VALUE 0x908A07A Val_Wu8 4.000 OneToOne 1.000 5.000 FORMAT "%5.3" EXTENDED_LIMITS 0.00 255.0 /end CHARACTERISTIC
/begin CHARACTERISTIC EpmSyn_ctGap0PosnOffsetIntkMnfldP_C "Calibration to offset the found phase (by 360) in case the MAP sensor is not in the intake of cylinder 0" VALUE 0x908A07B Val_Wu8 1.000 OneToOne 0.00 1.000 FORMAT "%5.3" EXTENDED_LIMITS 0.00 255.0 /end CHARACTERISTIC
/begin CHARACTERISTIC EpmSyn_DeltaDiffIntkMnfldP_C "Minimum plausible pressure difference between two windows pressure differences" VALUE 0x908A07C Val_Wu16 5119.922 p_uw_q0p078 0.00 5119.922 FORMAT "%8.3" /end CHARACTERISTIC
/begin CHARACTERISTIC EpmSyn_dnEngMaxIntkMnfldP_C "Maximum engine speed to enable pressure based Diagnosis" VALUE 0x908A07E Val_Ws16 32767.50 EngN -16384.00 16383.50 FORMAT "%8.2" /end CHARACTERISTIC
/begin CHARACTERISTIC EpmSyn_dwdkIntkMnfldP_C "Upper threshold for throttle change to disable phase search" VALUE 0x908A080 Val_Wu16 1599.976 relDK_q0p02441 0.00 1599.976 FORMAT "%8.3" /end CHARACTERISTIC
/begin CHARACTERISTIC EpmSyn_facAltiCorrnHiMnfldP_CUR "Altitude correction factor for upper gradient threshold" CURVE 0x908A082 RB_Curve_U8_S8_Static 2.000 fak_q0p01 -1.000 1.000 FORMAT "%5.3" EXTENDED_LIMITS -1.280 1.270
 /begin AXIS_DESCR STD_AXIS fho fak_ub_b4 6 0.00 3.984 FORMAT "%5.3" DEPOSIT ABSOLUTE /end AXIS_DESCR
/end CHARACTERISTIC
/begin CHARACTERISTIC EpmSyn_facAltiCorrnLoMnfldP_CUR "Altitude correction factor for lower gradient threshold" CURVE 0x908A08F RB_Curve_U8_S8_Static 2.000 fak_q0p01 -1.000 1.000 FORMAT "%5.3" EXTENDED_LIMITS -1.280 1.270
 /begin AXIS_DESCR STD_AXIS fho fak_ub_b4 6 0.00 3.984 FORMAT "%5.3" DEPOSIT ABSOLUTE /end AXIS_DESCR
/end CHARACTERISTIC
/begin CHARACTERISTIC EpmSyn_facWghIntkMnfldP_C "Weighting factor of manifold pressure based synchronization method" VALUE 0x908A09C Val_Ws16 10.00000 Fact1 0.00 10.00000 FORMAT "%8.5" EXTENDED_LIMITS -256.0000 255.9922 /end CHARACTERISTIC
/begin CHARACTERISTIC EpmSyn_nEngMaxIntkMnfldP_C "Engine speed upper threshold for phase search by manifold pressure evaluation" VALUE 0x908A09E Val_Ws16 6000.000 EngN 0.00 6000.000 FORMAT "%8.3" EXTENDED_LIMITS -16384.00 16383.50 /end CHARACTERISTIC
/begin CHARACTERISTIC EpmSyn_nEngMinIntkMnfldP_C "Engine speed lower threshold for phase search by manifold pressure evaluation" VALUE 0x908A0A0 Val_Ws16 6000.000 EngN 0.00 6000.000 FORMAT "%8.3" EXTENDED_LIMITS -16384.00 16383.50 /end CHARACTERISTIC
/begin CHARACTERISTIC EpmSyn_nrAtmptIntkMnfldP_C "Threshold for number of consecutive failed gradient check attempts to disable phase search" VALUE 0x908A0A2 Val_Wu8 255.0 OneToOne 0.00 255.0 FORMAT "%5.1" /end CHARACTERISTIC
/begin CHARACTERISTIC EpmSyn_nrNoSynMnfldP_C "Maximum number of failed synchronization attempts to report Sync_Fail error to DSM" VALUE 0x908A0A3 Val_Wu8 252.0 OneToOne 3.000 255.0 FORMAT "%5.1" EXTENDED_LIMITS 0.00 255.0 /end CHARACTERISTIC
/begin CHARACTERISTIC EpmSyn_rAgQlIntkMnfldP_CA "Quality factors assigned to the calculated angle distribution" VAL_BLK 0x908A0A4 ValA_Ws16 799.9878 Prc -400.0000 399.9878 FORMAT "%8.4" NUMBER 1 /end CHARACTERISTIC
/begin CHARACTERISTIC EpmSyn_ratPHiIntkMnfldP_MAP "Upper threshold for manifold pressure ratio to determine phase" MAP 0x9081674 RB_Map_S16S16_S16 655.3500 fak_q0p01 -327.6800 327.6700 FORMAT "%8.4"
 /begin AXIS_DESCR STD_AXIS Epm_nEng EngN 8 -16384.00 16383.50 FORMAT "%8.2" DEPOSIT ABSOLUTE /end AXIS_DESCR
 /begin AXIS_DESCR STD_AXIS wdkba_w relDK_q0p02441 8 -800.0000 799.9756 FORMAT "%8.4" DEPOSIT ABSOLUTE /end AXIS_DESCR
/end CHARACTERISTIC
/begin CHARACTERISTIC EpmSyn_ratPLoIntkMnfldP_MAP "Lowerthreshold for manifold pressure ratio to determine phase" MAP 0x9081718 RB_Map_S16S16_S16 655.3500 fak_q0p01 -327.6800 327.6700 FORMAT "%8.4"
 /begin AXIS_DESCR STD_AXIS Epm_nEng EngN 8 -16384.00 16383.50 FORMAT "%8.2" DEPOSIT ABSOLUTE /end AXIS_DESCR
 /begin AXIS_DESCR STD_AXIS wdkba_w relDK_q0p02441 8 -800.0000 799.9756 FORMAT "%8.4" DEPOSIT ABSOLUTE /end AXIS_DESCR
/end CHARACTERISTIC
/begin CHARACTERISTIC EpmSyn_swtIntkMnfldP_C "Used to reinitialise all Statical counter" VALUE 0x908A0A6 Val_Wu8 255.0 OneToOne 0.00 255.0 FORMAT "%5.1" /end CHARACTERISTIC
/begin CHARACTERISTIC EpmSyn_wdkMaxIntkMnfldP_CUR "Maximum throttle angle at current engine speed below which phase search is enabled" CURVE 0x908A0A8 RB_Curve_S16_S16 1599.976 relDK_q0p02441 -800.0000 799.9756 FORMAT "%8.4"
 /begin AXIS_DESCR STD_AXIS Epm_nEng EngN 6 -16384.00 16383.50 FORMAT "%8.2" DEPOSIT ABSOLUTE /end AXIS_DESCR
/end CHARACTERISTIC
/begin CHARACTERISTIC Epm_ctRevCntDiffMin_C "Minimum number of crank revolution to verify the Synchronization." VALUE 0x908A0C8 Val_Wu16 65535.00 OneToOne 0.00 65535.00 FORMAT "%8.2" /end CHARACTERISTIC
/begin CHARACTERISTIC Epm_facSpdFil_C "Calibration factor for the Engine Speed Filtering" VALUE 0x9085414 KwWU16 0.9999847 fak_uw_b1 0.00 0.9999847 FORMAT "%9.7" /end CHARACTERISTIC
/begin CHARACTERISTIC Epm_nHysThd_CUR "Curve for the Engine speed Hysterisis Threshold" CURVE 0x9085416 KlAxU8SstxU16WU16 16383.75 nmot_uw_q0p25 0.00 16383.75 FORMAT "%8.2"
 /begin AXIS_DESCR STD_AXIS nmotfihy_w nmot_uw_q0p25 6 0.00 16383.75 FORMAT "%8.2" DEPOSIT ABSOLUTE /end AXIS_DESCR
/end CHARACTERISTIC
/begin CHARACTERISTIC Epm_numFireSeg_C "physical firing sequence" VAL_BLK 0x908A0C2 ValA_Wu8 0.00 OneToOne 1.000 1.000 FORMAT "%5.3" EXTENDED_LIMITS 0.00 255.0 NUMBER 1 /end CHARACTERISTIC
/begin CHARACTERISTIC Epm_phiGap2Zero_C "angle between crankshaft signal gap and zero of angle system in ECU" VALUE 0x908A0C4 Val_Ws16 719.9780 AngleCrS 0.00 719.9780 FORMAT "%8.4" EXTENDED_LIMITS -720.0000 719.9780 /end CHARACTERISTIC
/begin CHARACTERISTIC Epm_phiTdc1_C "position of first TDC related to zero of angle system" VALUE 0x908A0C6 Val_Ws16 719.9780 AngleCrS 0.00 719.9780 FORMAT "%8.4" EXTENDED_LIMITS -720.0000 719.9780 /end CHARACTERISTIC
/begin CHARACTERISTIC Epm_tiSpd2Zero_C "Timeout until engine speed will be set to zero" VALUE 0x908A0CA Val_Wu16 1000.000 Time_ms 0.00 1000.000 FORMAT "%8.3" EXTENDED_LIMITS 0.00 655350.0 /end CHARACTERISTIC
/begin CHARACTERISTIC Epm_tiSpdGrdAvgFlt_C "Filtertime for PT1-Filtermodule to calculatethe average filtered enginespeed-gradient" VALUE 0x908A0CC Val_Ws32 999.0 TimeDelay_ms 1.0 1000.0 FORMAT "%12.1" EXTENDED_LIMITS 0.0 4294967.3 /end CHARACTERISTIC
/begin CHARACTERISTIC Epm_tiSpdGrdFlt_C "Filtertime for PT1-Filtermodule to calculate filtered enginespeed-gradient" VALUE 0x908A0D0 Val_Ws32 999.0 TimeDelay_ms 1.0 1000.0 FORMAT "%12.1" EXTENDED_LIMITS 0.0 4294967.3 /end CHARACTERISTIC
/begin CHARACTERISTIC ESC_stS1FrstSched_C "angle synchronous scheduling starts always with a S1 Task (calculation of PILOT injections)" VALUE 0x9089F54 Val_Wu8 3.00000000000 ESC_stS1FrstSched_t 0.00 3.00000000000 FORMAT "%13.11" /end CHARACTERISTIC
/begin CHARACTERISTIC FKNMOTLLS "Factor correction for engine speed to predict more stable idle set position" VALUE 0x9085438 KwWU16 3.999939 fak_uw_b4 0.00 3.999939 FORMAT "%8.6" /end CHARACTERISTIC
/begin CHARACTERISTIC FRINOFH "Factor for validation of old Ri-value without filter downstream cat" VALUE 0x908563C KwUb 15.94 fak_ub_b16 0.00 15.94 FORMAT "%5.2" /end CHARACTERISTIC
/begin CHARACTERISTIC FRINOFV "Factor for validation of old Ri-value without filter upstream cat" VALUE 0x908564A KwUb 15.94 fak_ub_b16 0.00 15.94 FORMAT "%5.2" /end CHARACTERISTIC
/begin CHARACTERISTIC FRLMNHO "correction factor rlmin depending on altitude" CURVE 0x908543A KlAxU8SstxU8WU8 1.992188 fak_ub_b2 0.00 1.992188 FORMAT "%8.6"
 /begin AXIS_DESCR STD_AXIS fho fak_ub_b4 5 0.00 3.984 FORMAT "%5.3" DEPOSIT ABSOLUTE /end AXIS_DESCR
/end CHARACTERISTIC
/begin CHARACTERISTIC FTUKG "Factor for calculating the condition transient control activated" VALUE 0x9085154 KwWU8 9.961 temp_q0p039 0.00 9.961 FORMAT "%5.3" /end CHARACTERISTIC
/begin CHARACTERISTIC FUKNSTM "initial value of transient control post-start factor" CURVE 0x9085156 KlAxU8SstxS16WU16_Static 7.999878 fak_uw_b8 0.00 7.999878 FORMAT "%8.6"
 /begin AXIS_DESCR STD_AXIS EngDa_tStrt Temp_Cels 9 -3549.940 3003.560 FORMAT "%8.3" DEPOSIT ABSOLUTE /end AXIS_DESCR
/end CHARACTERISTIC
/begin CHARACTERISTIC FVANST "weighting factor of deceleration during post-cranking" VALUE 0x908517C KwWU8 1.992188 fak_ub_b2 0.00 1.992188 FORMAT "%8.6" /end CHARACTERISTIC
/begin CHARACTERISTIC GGSDST_vVehSpdThd_C "Vehicle Speed threshold above which if side stand is up Injection Ignition will cut off for safety reasons" VALUE 0x908565A KwWU16 511.9922 vfzg_uw_b512 0.00 511.9922 FORMAT "%8.4" /end CHARACTERISTIC
/begin CHARACTERISTIC InjSys_tiDlyIdleEna_C "Delay time after idle to consider filtered value for wall film calculation" VALUE 0x908517D KwWU8 2.550 t_q0p01 0.00 2.550 FORMAT "%5.3" /end CHARACTERISTIC
/begin CHARACTERISTIC IntkAirT_mAirThdAirFltDsSTC_T "Air mass threshold for stuck-check intake air temperature sensor after air filter" CURVE 0x90817BE RB_Curve_S16_U16_Static 23.30133 m_uw_b23p3 0.00 23.30133 FORMAT "%8.5"
 /begin AXIS_DESCR STD_AXIS EngDa_tStrtAirFltDsSTCLoc Temp_Cels 8 -3549.940 3003.560 FORMAT "%8.3" DEPOSIT ABSOLUTE /end AXIS_DESCR
/end CHARACTERISTIC
/begin CHARACTERISTIC IntkAirT_tDiffThdAirFltDsSTC_C "Minimum temperature threshold for stuck-check intake air temperature sensor after air filter" VALUE 0x90817E0 RB_Val_Ws16 6553.500 Temp_Cels -3549.940 3003.560 FORMAT "%8.3" /end CHARACTERISTIC
/begin CHARACTERISTIC IntkAirT_tEngStrtThdAirFltDsSTC_C "Engine start temperature threshold for stuck-check intake air temperature sensor after air filter" VALUE 0x90817E2 RB_Val_Ws16 6553.500 Temp_Cels -3549.940 3003.560 FORMAT "%8.3" /end CHARACTERISTIC
/begin CHARACTERISTIC IntkAirT_tiAirFltDsSRCMaxErr_C "Error debounce time for signal range check max error intake air temperature sensor after air filter" VALUE 0x90817E4 RB_Val_Wu8 25.50 t_q0p1 0.00 25.50 FORMAT "%5.2" /end CHARACTERISTIC
/begin CHARACTERISTIC IntkAirT_tiAirFltDsSRCMaxHeal_C "Healing debounce time for signal range check max error intake air temperature sensor after air filter" VALUE 0x90817E5 RB_Val_Wu8 25.50 t_q0p1 0.00 25.50 FORMAT "%5.2" /end CHARACTERISTIC
/begin CHARACTERISTIC IntkAirT_tiAirFltDsSRCMinErr_C "Error debounce time for signal range check min error intake air temperature sensor after air filter" VALUE 0x90817E6 RB_Val_Wu8 25.50 t_q0p1 0.00 25.50 FORMAT "%5.2" /end CHARACTERISTIC
/begin CHARACTERISTIC IntkAirT_tiAirFltDsSRCMinHeal_C "Healing debounce time for signal range check min error intake air temperature sensor after air filter" VALUE 0x90817E7 RB_Val_Wu8 25.50 t_q0p1 0.00 25.50 FORMAT "%5.2" /end CHARACTERISTIC
/begin CHARACTERISTIC IntkAirT_uRawAirFltDsSRCMax_C "upper threshold sensor voltage for signal-range-check intake air temperature sensor after air filter" VALUE 0x90817E8 RB_Val_Wu16 1279.980 spg_ub_b5 0.00 1279.980 FORMAT "%8.3" /end CHARACTERISTIC
/begin CHARACTERISTIC IntkAirT_uRawAirFltDsSRCMin_C "lower threshold sensor voltage for signal-range-check intake air temperature sensor after air filter" VALUE 0x90817EA RB_Val_Wu16 1279.980 spg_ub_b5 0.00 1279.980 FORMAT "%8.3" /end CHARACTERISTIC
/begin CHARACTERISTIC KFABAK "share factor wall wetting for acceleration enrichment" MAP 0x908517E GkfWU8 0.9961 fak_ub_b1 0.00 0.9961
 /begin AXIS_DESCR COM_AXIS EngDa_tEng Temp_Cels 9 -3549.940 3003.560 FORMAT "%8.3" AXIS_PTS_REF STE09ESUB /end AXIS_DESCR
 /begin AXIS_DESCR COM_AXIS nmot_w nmot_uw_q0p25 10 0.00 16383.75 FORMAT "%8.2" AXIS_PTS_REF SNM10ESUB /end AXIS_DESCR
/end CHARACTERISTIC
/begin CHARACTERISTIC KFAVAK "share factor wall wetting for deceleration enleanment" MAP 0x90851D8 GkfWU8 0.9961 fak_ub_b1 0.00 0.9961
 /begin AXIS_DESCR COM_AXIS EngDa_tEng Temp_Cels 9 -3549.940 3003.560 FORMAT "%8.3" AXIS_PTS_REF STE09ESUB /end AXIS_DESCR
 /begin AXIS_DESCR COM_AXIS nmot_w nmot_uw_q0p25 10 0.00 16383.75 FORMAT "%8.2" AXIS_PTS_REF SNM10ESUB /end AXIS_DESCR
/end CHARACTERISTIC
/begin CHARACTERISTIC KFBAKL "factor accel. enrichment (short- and long-time part)" MAP 0x9085232 GkfWU8 15.94 fak_ub_b16 0.00 15.94 FORMAT "%5.2"
 /begin AXIS_DESCR COM_AXIS EngDa_tEng Temp_Cels 9 -3549.940 3003.560 FORMAT "%8.3" AXIS_PTS_REF STE09ESUB /end AXIS_DESCR
 /begin AXIS_DESCR COM_AXIS nmot_w nmot_uw_q0p25 10 0.00 16383.75 FORMAT "%8.2" AXIS_PTS_REF SNM10ESUB /end AXIS_DESCR
/end CHARACTERISTIC
/begin CHARACTERISTIC KFOLLSTHO "Desired ISA position at start-up - f(high, engine temperature)." MAP 0x9085446 KfAxU8AyU8SstxU16SstyU8WU8 99.61 rel_ub_b100 0.00 99.61 FORMAT "%5.2"
 /begin AXIS_DESCR STD_AXIS EngDa_tEng Temp_Cels 10 -273.1400 3003.560 FORMAT "%8.3" EXTENDED_LIMITS -273.1400 6280.360 DEPOSIT ABSOLUTE /end AXIS_DESCR
 /begin AXIS_DESCR STD_AXIS fho fak_ub_b4 10 0.00 3.984 FORMAT "%5.3" DEPOSIT ABSOLUTE /end AXIS_DESCR
/end CHARACTERISTIC
/begin CHARACTERISTIC KFRLMN "Minimum charge during fuel on" MAP 0x90854CA KfAxU8AyU8SstxU16SstyU16WU16 47.81250 rel_q0p1875 0.00 47.81250 FORMAT "%8.5" EXTENDED_LIMITS 0.00 12287.81
 /begin AXIS_DESCR STD_AXIS nmot_w nmot_uw_q0p25 16 0.00 16383.75 FORMAT "%8.2" DEPOSIT ABSOLUTE /end AXIS_DESCR
 /begin AXIS_DESCR STD_AXIS EngDa_tEng Temp_Cels 6 -273.1400 3003.560 FORMAT "%8.3" EXTENDED_LIMITS -273.1400 6280.360 DEPOSIT ABSOLUTE /end AXIS_DESCR
/end CHARACTERISTIC
/begin CHARACTERISTIC KFVAKL "factor decel. enleanment (short- and long-time part)" MAP 0x908528C GkfWU8 15.94 fak_ub_b16 0.00 15.94 FORMAT "%5.2"
 /begin AXIS_DESCR COM_AXIS EngDa_tEng Temp_Cels 9 -3549.940 3003.560 FORMAT "%8.3" AXIS_PTS_REF STE09ESUB /end AXIS_DESCR
 /begin AXIS_DESCR COM_AXIS nmot_w nmot_uw_q0p25 10 0.00 16383.75 FORMAT "%8.2" AXIS_PTS_REF SNM10ESUB /end AXIS_DESCR
/end CHARACTERISTIC
/begin CHARACTERISTIC KLOLLSOFMQ "Delta ISA position depending on the leakage air during start (modified range)." CURVE 0x90855BA KlAxU8SstxS16WS16 199.9969 rel_sw_b100 -100.0000 99.99695 FORMAT "%8.4"
 /begin AXIS_DESCR STD_AXIS ofmsdkq_w m_sw_q0p01 4 -327.6800 327.6700 FORMAT "%8.4" DEPOSIT ABSOLUTE /end AXIS_DESCR
/end CHARACTERISTIC
/begin CHARACTERISTIC KLOLLSTOFF "Curve to switch torque dependent opening of orifice at start based on tmot." CURVE 0x90855CC KlAxU8SstxS16WU16_Static 6553.500 t100msxs_uw_b6553p5 0.00 6553.500 FORMAT "%8.3"
 /begin AXIS_DESCR STD_AXIS EngDa_tEng Temp_Cels 6 -3549.940 3003.560 FORMAT "%8.3" DEPOSIT ABSOLUTE /end AXIS_DESCR
/end CHARACTERISTIC
/begin CHARACTERISTIC KLRKBAUM "rk-threshold for acceleration enrichment display" CURVE 0x90852E6 KlAxU8SstxS16WS16 3071.953 rel_sw_q0p0468 -1536.000 1535.953 FORMAT "%8.3"
 /begin AXIS_DESCR STD_AXIS EngDa_tEng Temp_Cels 4 -3549.940 3003.560 FORMAT "%8.3" DEPOSIT ABSOLUTE /end AXIS_DESCR
/end CHARACTERISTIC
/begin CHARACTERISTIC KLRKVAUM "rk-threshold for deceleration enleanment display" CURVE 0x90852F8 KlAxU8SstxS16WS16 3071.953 rel_sw_q0p0468 -1536.000 1535.953 FORMAT "%8.3"
 /begin AXIS_DESCR STD_AXIS EngDa_tEng Temp_Cels 4 -3549.940 3003.560 FORMAT "%8.3" DEPOSIT ABSOLUTE /end AXIS_DESCR
/end CHARACTERISTIC
/begin CHARACTERISTIC LLSNLN "Desired ISA opening in post drive" CURVE 0x90855E6 KlAxU8SstxU16WU8_Static 99.61 rel_ub_b100 0.00 99.61 FORMAT "%5.2"
 /begin AXIS_DESCR STD_AXIS nmot_w nmot_uw_q0p25 3 0.00 16383.75 FORMAT "%8.2" DEPOSIT ABSOLUTE /end AXIS_DESCR
/end CHARACTERISTIC
/begin CHARACTERISTIC LLS_ATS_ID_ATS.LimitTypeMsk_C "Actuator test LLS_ATS_ID_ATS / Tester demand monitoring enable mask for actuators" VALUE 0x9089EB0 Val_Wu8 255.0 OneToOne 0.00 255.0 FORMAT "%5.1" /end CHARACTERISTIC
/begin CHARACTERISTIC LLS_ATS_ID_ATS.CnvNorm_C "Actuator test LLS_ATS_ID_ATS / Conversion norm used for conversion to/from internal scaling" VALUE 0x9089EB1 Val_Wu8 255.0 OneToOne 0.00 255.0 FORMAT "%5.1" /end CHARACTERISTIC
/begin CHARACTERISTIC LLS_ATS_ID_ATS.LowLim_C "Actuator test LLS_ATS_ID_ATS / Lower limit for monitoring" VALUE 0x9089EB2 Val_Wu16 799.9878 Prc 0.00 799.9878 FORMAT "%8.4" /end CHARACTERISTIC
/begin CHARACTERISTIC LLS_ATS_ID_ATS.UpLim_C "Actuator test LLS_ATS_ID_ATS / Upper limit for monitoring" VALUE 0x9089EB4 Val_Wu16 799.9878 Prc 0.00 799.9878 FORMAT "%8.4" /end CHARACTERISTIC
/begin CHARACTERISTIC LLS_ATS_ID_ATS.CnvFac_C "Actuator test LLS_ATS_ID_ATS / Factor used for conversion to/from internal scaling" VALUE 0x9089EB8 Val_Ws32 4294967295.00 OneToOne -2147483648.00 2147483647.00 FORMAT "%13.2" /end CHARACTERISTIC
/begin CHARACTERISTIC LLS_ATS_ID_ATS.CnvOfs_C "Actuator test LLS_ATS_ID_ATS / Offset used for conversion to/from internal scaling" VALUE 0x9089EBC Val_Ws16 65535.00 OneToOne -32768.00 32767.00 FORMAT "%8.2" /end CHARACTERISTIC
/begin CHARACTERISTIC LLS_ATS_ID_ATS.DfltVal_C "Actuator test LLS_ATS_ID_ATS / Default value for standbytest" VALUE 0x9089EBE Val_Wu16 65535.00 OneToOne 0.00 65535.00 FORMAT "%8.2" /end CHARACTERISTIC
/begin CHARACTERISTIC NMOTLLSOFS "speed offset for engine speed to predict more stable idle set position calc." VALUE 0x90855F2 KwWU16 16383.75 nmot_uw_q0p25 0.00 16383.75 FORMAT "%8.2" /end CHARACTERISTIC
/begin CHARACTERISTIC NMOTWF "Threshold for idle speed fluctuations" VALUE 0x908530A KwWU16 16383.75 nmot_uw_q0p25 0.00 16383.75 FORMAT "%8.2" /end CHARACTERISTIC
/begin CHARACTERISTIC OLLSAPP "target air system actuator position for application" VALUE 0x90855F4 KwWU16 99.99847 rel_uw_b100 0.00 99.99847 FORMAT "%8.5" /end CHARACTERISTIC
/begin CHARACTERISTIC OLLSSBGMNHY "Min Hysteresis value for target position of idle speed actuator" VALUE 0x90855F6 KwWU16 99.99847 rel_uw_b100 0.00 99.99847 FORMAT "%8.5" /end CHARACTERISTIC
/begin CHARACTERISTIC OLLSSBGMXHY "Max Hysteresis value for target position of idle speed actuator" VALUE 0x90855F8 KwWU16 99.99847 rel_uw_b100 0.00 99.99847 FORMAT "%8.5" /end CHARACTERISTIC
/begin CHARACTERISTIC OLLSSMN "lower limitation of ISA position" VALUE 0x90855FA KwWU16 99.99847 rel_uw_b100 0.00 99.99847 FORMAT "%8.5" /end CHARACTERISTIC
/begin CHARACTERISTIC OLLSSMX "upper limitation of ISA position" VALUE 0x90855FC KwWU16 99.99847 rel_uw_b100 0.00 99.99847 FORMAT "%8.5" /end CHARACTERISTIC
/begin CHARACTERISTIC PSZYLCNT "Number of main synchros in a working cycle" VALUE 0x9085632 KwWU8 255.0 dez 0.00 255.0 FORMAT "%5.1" /end CHARACTERISTIC
/begin CHARACTERISTIC RBEL "On-load resistance for pump current generation" VALUE 0x908564C KwUw 131070.0 r_uw_q2 0.00 131070.0 FORMAT "%8.1" /end CHARACTERISTIC
/begin CHARACTERISTIC RINHMX "Limit internal resistance Ri of the Nernst sensor downstream cat to max. value" VALUE 0x908563E KwUw 131070.0 r_uw_q2 0.00 131070.0 FORMAT "%8.1" /end CHARACTERISTIC
/begin CHARACTERISTIC RINVMX "Internal resistor Ri of nernst sensor upstr. cat limited to maximal value" VALUE 0x908564E KwUw 131070.0 r_uw_q2 0.00 131070.0 FORMAT "%8.1" /end CHARACTERISTIC
/begin CHARACTERISTIC RKSP "Resistance between congruent voltage and sensor signal" VALUE 0x9085650 KwUw 131070.0 r_uw_q2 0.00 131070.0 FORMAT "%8.1" /end CHARACTERISTIC
/begin CHARACTERISTIC RKUKGMNT "min. threshold to define rkukg window" VALUE 0x908530C KwWS16 3071.953 rel_sw_q0p0468 -1536.000 1535.953 FORMAT "%8.3" /end CHARACTERISTIC
/begin CHARACTERISTIC RKUKGMXT "max. threshold to define rkukg window" VALUE 0x908530E KwWS16 3071.953 rel_sw_q0p0468 -1536.000 1535.953 FORMAT "%8.3" /end CHARACTERISTIC
/begin CHARACTERISTIC SDACTMAX "Maximum sensor voltage for side stand to be active" VALUE 0x908565C KwWU16 319.9951 spg_uw_q0p00488 0.00 319.9951 FORMAT "%8.4" /end CHARACTERISTIC
/begin CHARACTERISTIC SDACTMIN "Minimum sensor voltage for side stand to be active" VALUE 0x908565E KwWU16 319.9951 spg_uw_q0p00488 0.00 319.9951 FORMAT "%8.4" /end CHARACTERISTIC
/begin CHARACTERISTIC SDEBACT "Debounce time parameter for side stand to be active" VALUE 0x9085660 KwWU8 5.100 t_q0p02 0.00 5.100 FORMAT "%5.3" /end CHARACTERISTIC
/begin CHARACTERISTIC SDEBDAIG "Debounce time for diagnosis of side stand fault" VALUE 0x9085661 KwWU8 25.50 t_q0p1 0.00 25.50 FORMAT "%5.2" /end CHARACTERISTIC
/begin CHARACTERISTIC SDINACTMAX "Maximum sensor voltage for side stand to be inactive" VALUE 0x9085662 KwWU16 319.9951 spg_uw_q0p00488 0.00 319.9951 FORMAT "%8.4" /end CHARACTERISTIC
/begin CHARACTERISTIC SDINACTMIN "Minimum sensor voltage for side stand to be inactive" VALUE 0x9085664 KwWU16 319.9951 spg_uw_q0p00488 0.00 319.9951 FORMAT "%8.4" /end CHARACTERISTIC
/begin CHARACTERISTIC SDOPNSNMAX "Maximum sensor voltage for open sensor condition" VALUE 0x9085666 KwWU16 319.9951 spg_uw_q0p00488 0.00 319.9951 FORMAT "%8.4" /end CHARACTERISTIC
/begin CHARACTERISTIC SDOPNSNMIN "Minimum sensor voltage for open sensor condition" VALUE 0x9085668 KwWU16 319.9951 spg_uw_q0p00488 0.00 319.9951 FORMAT "%8.4" /end CHARACTERISTIC
/begin CHARACTERISTIC SDSHBATMAX "Maximum sensor voltage for short circuit to battery" VALUE 0x908566A KwWU16 319.9951 spg_uw_q0p00488 0.00 319.9951 FORMAT "%8.4" /end CHARACTERISTIC
/begin CHARACTERISTIC SDSHBATMIN "Minimum sensor voltage for short circuit to battery" VALUE 0x908566C KwWU16 319.9951 spg_uw_q0p00488 0.00 319.9951 FORMAT "%8.4" /end CHARACTERISTIC
/begin CHARACTERISTIC SDSHGNDMAX "Maximum sensor voltage for short circuit to ground" VALUE 0x908566E KwWU16 319.9951 spg_uw_q0p00488 0.00 319.9951 FORMAT "%8.4" /end CHARACTERISTIC
/begin CHARACTERISTIC SDSHGNDMIN "Minimum sensor voltage for short circuit for ground" VALUE 0x9085670 KwWU16 319.9951 spg_uw_q0p00488 0.00 319.9951 FORMAT "%8.4" /end CHARACTERISTIC
/begin AXIS_PTS SNM10ESUB "Base point distribution of engine speed" 0x9085310 nmot_w SstAU8SstU16 16383.75 nmot_uw_q0p25 10 0.00 16383.75 FORMAT "%8.2" DEPOSIT ABSOLUTE /end AXIS_PTS
/begin AXIS_PTS STE09ESUB "Base point distribution of engine temperature, 9 base pts." 0x9085326 EngDa_tEng SstAU8SstS16 6553.500 Temp_Cels 9 -3549.940 3003.560 FORMAT "%8.3" DEPOSIT ABSOLUTE /end AXIS_PTS
/begin CHARACTERISTIC TADE "substitute value air temperature in case of fault" VALUE 0x90817EC RB_Val_Ws16 6553.500 Temp_Cels -3549.940 3003.560 FORMAT "%8.3" /end CHARACTERISTIC
/begin CHARACTERISTIC TANSELI "intake air temperature calculation, inverse function" CURVE 0x90817EE RB_Curve_U16_S16_Static 6553.500 Temp_Cels -3549.940 3003.560 FORMAT "%8.3"
 /begin AXIS_DESCR STD_AXIS wtans_ggtfaloc spg_ub_b5 20 0.00 1279.980 FORMAT "%8.3" DEPOSIT ABSOLUTE /end AXIS_DESCR
/end CHARACTERISTIC
/begin CHARACTERISTIC TANSMN "intake air temperature limit (for post-start torque increase)" VALUE 0x9081840 RB_Val_Ws16 6553.500 Temp_Cels -3549.940 3003.560 FORMAT "%8.3" /end CHARACTERISTIC
/begin CHARACTERISTIC TANSMX "Threshold for diagnosis of max error of intake air temperature" VALUE 0x9081842 RB_Val_Ws16 6553.500 Temp_Cels -3549.940 3003.560 FORMAT "%8.3" /end CHARACTERISTIC
/begin CHARACTERISTIC TDDK "debouncing time for DKG (side load signal) failure detection" VALUE 0x9085604 KwWU8 25.50 t_q0p1 0.00 25.50 FORMAT "%5.2" /end CHARACTERISTIC
/begin CHARACTERISTIC TDDSR "dechatter time for manifold pressure sensor fault recognization" VALUE 0x9085633 KwWU8 25.50 t100msxs_ub_b25p5 0.00 25.50 FORMAT "%5.2" /end CHARACTERISTIC
/begin CHARACTERISTIC TDELTFA "Debouncing time for enabling the electrical diagnosis of the intake air temperature sensor" VALUE 0x9081844 RB_Val_Wu8 25.50 t_q0p1 0.00 25.50 FORMAT "%5.2" /end CHARACTERISTIC
/begin CHARACTERISTIC TDELTFAK "Debouncing time for enabling the electrical diagnosis of the intake air temperature sensor (cold)" VALUE 0x9081846 RB_Val_Wu16 6553.500 t100msxs_uw_b6553p5 0.00 6553.500 FORMAT "%8.3" /end CHARACTERISTIC
/begin CHARACTERISTIC TDTANSHL "Time delay for healing of sensor error of intake air temperature sensor" VALUE 0x9081848 RB_Val_Wu8 25.50 t_q0p1 0.00 25.50 FORMAT "%5.2" /end CHARACTERISTIC
/begin CHARACTERISTIC TDTANSKHL "Time delay for healing of sensor error of intake air temperature sensor" VALUE 0x908184A RB_Val_Wu16 6553.500 t100msxs_uw_b6553p5 0.00 6553.500 FORMAT "%8.3" /end CHARACTERISTIC
/begin CHARACTERISTIC TDTNSEDTA "Time delay after end of start for Intake Air temperature sensor diagnosis" VALUE 0x908184C RB_Val_Wu8 25.50 t_q0p1 0.00 25.50 FORMAT "%5.2" /end CHARACTERISTIC
/begin CHARACTERISTIC ThrVlv_voltDeltaLowrLimLrngEna_C "Delta voltage threshold added to the previously learnt lower mechanical value to enable the learning" VALUE 0x9085606 KwWU16 79.99878 spg_uw_q0p001222 0.00 79.99878 FORMAT "%8.5" /end CHARACTERISTIC
/begin CHARACTERISTIC TNSUUK "disabling time of transient control during post-cranking" VALUE 0x908533A KwWU16 6553.500 t_q0p1 0.00 6553.500 FORMAT "%8.3" /end CHARACTERISTIC
/begin CHARACTERISTIC TRIAKTH "Time needed for Ri-calculation up to date downstream catalyst" VALUE 0x9085640 KwUw 3276.750 t50msxs_q0p05 0.00 3276.750 FORMAT "%8.3" /end CHARACTERISTIC
/begin CHARACTERISTIC TRIAKTVXF "Time for Ri calculation actuel pre cat for LSF with Pumped Reference" VALUE 0x9085652 KwUb 12.75 t50msxs_q0p05 0.00 12.75 FORMAT "%5.2" /end CHARACTERISTIC
/begin CHARACTERISTIC UADPSMN "minimum input voltage for pressure sensor diagnosis" VALUE 0x9085634 KwWU16 319.9951 spg_uw_q0p00488 0.00 319.9951 FORMAT "%8.4" /end CHARACTERISTIC
/begin CHARACTERISTIC UADPSMX "maximum input voltage for pressure sensor diagnosis" VALUE 0x9085636 KwWU16 319.9951 spg_uw_q0p00488 0.00 319.9951 FORMAT "%8.4" /end CHARACTERISTIC
/begin CHARACTERISTIC UDKPNHUB "Rated travel of the throttle valve" VALUE 0x9085608 KwWU16 79.99878 spg_uw_q0p001222 0.00 79.99878 FORMAT "%8.5" /end CHARACTERISTIC
/begin CHARACTERISTIC UWDKDO "Upper voltage threshold for throttle failure detection" VALUE 0x908560A KwWU16 79.99878 spg_uw_q0p001222 0.00 79.99878 FORMAT "%8.5" /end CHARACTERISTIC
/begin CHARACTERISTIC UWDKDU "Lower voltage threshold for throttle failure detection" VALUE 0x908560C KwWU16 79.99878 spg_uw_q0p001222 0.00 79.99878 FORMAT "%8.5" /end CHARACTERISTIC
/begin CHARACTERISTIC UWDKOAMN "lower tolerance value for throttle upper mechanical limit adaptation" VALUE 0x908560E KwWU16 79.99878 spg_uw_q0p001222 0.00 79.99878 FORMAT "%8.5" /end CHARACTERISTIC
/begin CHARACTERISTIC UWDKOAMX "max tolerance value for throttle upper mechanical limit adaptation" VALUE 0x9085610 KwWU16 79.99878 spg_uw_q0p001222 0.00 79.99878 FORMAT "%8.5" /end CHARACTERISTIC
/begin CHARACTERISTIC UWDKUAMN "min tolerance value for throttle lower mechanical limit adaptation" VALUE 0x9085612 KwWU16 79.99878 spg_uw_q0p001222 0.00 79.99878 FORMAT "%8.5" /end CHARACTERISTIC
/begin CHARACTERISTIC UWDKUAMX "max tolerance value for throttle lower mechanical limit adaptation" VALUE 0x9085614 KwWU16 79.99878 spg_uw_q0p001222 0.00 79.99878 FORMAT "%8.5" /end CHARACTERISTIC
/begin CHARACTERISTIC WDKBASLN "Throttle valve angle threshold for idle detection" CURVE 0x9085616 KlAxU8SstxU16WU16 100.0000 relDK_uw_b100 0.00 100.0000 FORMAT "%8.4"
 /begin AXIS_DESCR STD_AXIS nmot_w nmot_uw_q0p25 4 0.00 16383.75 FORMAT "%8.2" DEPOSIT ABSOLUTE /end AXIS_DESCR
/end CHARACTERISTIC
/begin CHARACTERISTIC WDKSLNHY "Throttle valve angle hysteresis for idle detection" VALUE 0x9085628 KwWU16 100.0000 relDK_uw_b100 0.00 100.0000 FORMAT "%8.4" /end CHARACTERISTIC
/begin CHARACTERISTIC WFRL "fuel wall hang.up" CURVE 0x908533C KlAxU8SstxU16WU16 6143.906 q0p09375_Perc 0.00 6143.906 FORMAT "%8.3"
 /begin AXIS_DESCR STD_AXIS rlp_w rel_uw_q0p0234 17 0.00 1535.977 FORMAT "%8.3" DEPOSIT ABSOLUTE /end AXIS_DESCR
/end CHARACTERISTIC
/begin CHARACTERISTIC WFRLLL "fuel wall hang up during idle speed" CURVE 0x9085382 KlAxU8SstxU16WU16 6143.906 q0p09375_Perc 0.00 6143.906 FORMAT "%8.3"
 /begin AXIS_DESCR STD_AXIS rlp_w rel_uw_q0p0234 8 0.00 1535.977 FORMAT "%8.3" DEPOSIT ABSOLUTE /end AXIS_DESCR
/end CHARACTERISTIC
/begin CHARACTERISTIC ZBAKM "reduction factor K-memory (tmot) for accel. enrichment" CURVE 0x90853A4 GklWU8 0.9961 fak_q0p0039 0.00 0.9961
 /begin AXIS_DESCR COM_AXIS EngDa_tEng Temp_Cels 9 -3549.940 3003.560 FORMAT "%8.3" AXIS_PTS_REF STE09ESUB /end AXIS_DESCR
/end CHARACTERISTIC
/begin CHARACTERISTIC ZBALM "reduction factor L-memory (tmot) for accel. enrichment" CURVE 0x90853AD GklWU8 0.1245 fak_ub_b0p125 0.00 0.1245 FORMAT "%6.4"
 /begin AXIS_DESCR COM_AXIS EngDa_tEng Temp_Cels 9 -3549.940 3003.560 FORMAT "%8.3" AXIS_PTS_REF STE09ESUB /end AXIS_DESCR
/end CHARACTERISTIC
/begin CHARACTERISTIC ZFRIH "Attenuation factor for the internal resistance Ri Nernst filter downstream cat" VALUE 0x9085642 KwUw 0.9999847 fak_uw_b1 0.00 0.9999847 FORMAT "%9.7" /end CHARACTERISTIC
/begin CHARACTERISTIC ZFRIV "Reduction factor for internal resistor Ri-Nernst filter pre cat" VALUE 0x9085654 KwUw 0.9999847 fak_uw_b1 0.00 0.9999847 FORMAT "%9.7" /end CHARACTERISTIC
/begin CHARACTERISTIC ZFTANS "time-constant for low pass filter of intake air temperature" VALUE 0x908184E RB_Val_Wu16 6553.4999985 zk100msxs_uw_b6553p6 0.10000152590 6553.6000000 FORMAT "%12.7" /end CHARACTERISTIC
/begin CHARACTERISTIC ZKTMOT "Time constant temperature impact tmot on HDEV temperature" CURVE 0x90853B6 KlAxU8SstxS16WU16_Static 0.9999847 fak_uw_b1 0.00 0.9999847 FORMAT "%9.7"
 /begin AXIS_DESCR STD_AXIS EngDa_tEng Temp_Cels 8 -3549.940 3003.560 FORMAT "%8.3" DEPOSIT ABSOLUTE /end AXIS_DESCR
/end CHARACTERISTIC
/begin CHARACTERISTIC ZKUWDKAL "Slow time constant for throttle poti voltage lower limit adaptation" VALUE 0x908562A KwWU16 6553.4999985 zk100msxs_uw_b655 0.10000152590 6553.6000000 FORMAT "%12.7" /end CHARACTERISTIC
/begin CHARACTERISTIC ZKUWDKAS "Fast time constant for throttle poti voltage lower limit adaptation" VALUE 0x908562C KwWU16 6553.4999985 zk100msxs_uw_b655 0.10000152590 6553.6000000 FORMAT "%12.7" /end CHARACTERISTIC
/begin CHARACTERISTIC ZNGFIL "time constant for engine gradient filter" VALUE 0x9085430 KwSl 4294967.3 TimeDelay_ms 0.0 4294967.3 FORMAT "%12.1" /end CHARACTERISTIC
/begin CHARACTERISTIC ZUKNSTM "time constant of transient control post cranking factor dependent on engine temperature" CURVE 0x90853D8 KlAxU8SstxS16WU16_Static 6553.4999985 zk100msxs_uw_b6553 0.10000152590 6553.6000000 FORMAT "%12.7"
 /begin AXIS_DESCR STD_AXIS EngDa_tStrt Temp_Cels 9 -3549.940 3003.560 FORMAT "%8.3" DEPOSIT ABSOLUTE /end AXIS_DESCR
/end CHARACTERISTIC
/begin CHARACTERISTIC ZVAKM "reduction factor K-memory (tmot) for decel. enleanment" CURVE 0x90853FE GklWU8 0.9961 fak_q0p0039 0.00 0.9961
 /begin AXIS_DESCR COM_AXIS EngDa_tEng Temp_Cels 9 -3549.940 3003.560 FORMAT "%8.3" AXIS_PTS_REF STE09ESUB /end AXIS_DESCR
/end CHARACTERISTIC
/begin CHARACTERISTIC ZVALM "reduction factor L-memory (tmot) for decel. enleanment" CURVE 0x9085407 GklWU8 0.1245 fak_ub_b0p125 0.00 0.1245 FORMAT "%6.4"
 /begin AXIS_DESCR COM_AXIS EngDa_tEng Temp_Cels 9 -3549.940 3003.560 FORMAT "%8.3" AXIS_PTS_REF STE09ESUB /end AXIS_DESCR
/end CHARACTERISTIC
/*********** End of merged MEASUREMENT blocks ***********/
/begin MEASUREMENT abak "share factor wall wetting for acceleration enrichment" UBYTE fak_ub_b1 1 100 0.00 0.9961 ECU_ADDRESS 0x4000895E
 /begin IF_DATA XCPplus 0x0102
  /begin DAQ_EVENT VARIABLE /begin AVAILABLE_EVENT_LIST EVENT 0 EVENT 1 EVENT 2 EVENT 3 /end AVAILABLE_EVENT_LIST /begin DEFAULT_EVENT_LIST EVENT 1 /end DEFAULT_EVENT_LIST /end DAQ_EVENT
 /end IF_DATA
/end MEASUREMENT
/begin MEASUREMENT avak "share factor wall wetting for deceleration enleanment" UBYTE fak_ub_b1 1 100 0.00 0.9961 ECU_ADDRESS 0x4000895F
 /begin IF_DATA XCPplus 0x0102
  /begin DAQ_EVENT VARIABLE /begin AVAILABLE_EVENT_LIST EVENT 0 EVENT 1 EVENT 2 EVENT 3 /end AVAILABLE_EVENT_LIST /begin DEFAULT_EVENT_LIST EVENT 1 /end DEFAULT_EVENT_LIST /end DAQ_EVENT
 /end IF_DATA
/end MEASUREMENT
/begin MEASUREMENT BIDev_flgSidstSt "Status flag for side stand" UBYTE B_TRUE 1 100 0.00 1.00000000000 BIT_MASK 0x1 FORMAT "%13.11" ECU_ADDRESS 0x4000876D
 /begin IF_DATA XCPplus 0x0102
  /begin DAQ_EVENT VARIABLE /begin AVAILABLE_EVENT_LIST EVENT 0 EVENT 1 EVENT 2 EVENT 3 /end AVAILABLE_EVENT_LIST /begin DEFAULT_EVENT_LIST EVENT 2 /end DEFAULT_EVENT_LIST /end DAQ_EVENT
 /end IF_DATA
/end MEASUREMENT
/begin MEASUREMENT BIDev_tiSdstAct "Debounce time parameter for side stand to be active" UBYTE t_q0p02 1 100 0.00 5.100 FORMAT "%5.3" ECU_ADDRESS 0x40008770
 /begin IF_DATA XCPplus 0x0102
  /begin DAQ_EVENT VARIABLE /begin AVAILABLE_EVENT_LIST EVENT 0 EVENT 1 EVENT 2 EVENT 3 /end AVAILABLE_EVENT_LIST /begin DEFAULT_EVENT_LIST EVENT 2 /end DEFAULT_EVENT_LIST /end DAQ_EVENT
 /end IF_DATA
/end MEASUREMENT
/begin MEASUREMENT BIDev_tiSidstSt "Debounce time parameter for side stand to be active" UBYTE t_q0p02 1 100 0.00 5.100 FORMAT "%5.3" ECU_ADDRESS 0x4000876F
 /begin IF_DATA XCPplus 0x0102
  /begin DAQ_EVENT VARIABLE /begin AVAILABLE_EVENT_LIST EVENT 0 EVENT 1 EVENT 2 EVENT 3 /end AVAILABLE_EVENT_LIST /begin DEFAULT_EVENT_LIST EVENT 2 /end DEFAULT_EVENT_LIST /end DAQ_EVENT
 /end IF_DATA
/end MEASUREMENT
/begin MEASUREMENT bmlosctr_w "counter (word) re-synchronizations due to a loss of the reference gap" UWORD dez 1 100 0.00 65535.00 FORMAT "%8.2" ECU_ADDRESS 0x4000C6CC
 /begin IF_DATA XCPplus 0x0102
  /begin DAQ_EVENT VARIABLE /begin AVAILABLE_EVENT_LIST EVENT 0 EVENT 1 EVENT 2 EVENT 3 /end AVAILABLE_EVENT_LIST /begin DEFAULT_EVENT_LIST EVENT 1 /end DEFAULT_EVENT_LIST /end DAQ_EVENT
 /end IF_DATA
/end MEASUREMENT
/begin MEASUREMENT B_bag "Condition large accel. enrichment" UBYTE B_TRUE 1 100 0.00 1.00000000000 BIT_MASK 0x1 FORMAT "%13.11" ECU_ADDRESS 0x40008955
 /begin IF_DATA XCPplus 0x0102
  /begin DAQ_EVENT VARIABLE /begin AVAILABLE_EVENT_LIST EVENT 0 EVENT 1 EVENT 2 EVENT 3 /end AVAILABLE_EVENT_LIST /begin DEFAULT_EVENT_LIST EVENT 0 /end DEFAULT_EVENT_LIST /end DAQ_EVENT
 /end IF_DATA
/end MEASUREMENT
/begin MEASUREMENT B_bagtemp "Temporary Condition large accel. enrichment" UBYTE B_TRUE 1 100 0.00 1.00000000000 BIT_MASK 0x1 FORMAT "%13.11" ECU_ADDRESS 0x4000895C
 /begin IF_DATA XCPplus 0x0102
  /begin DAQ_EVENT VARIABLE /begin AVAILABLE_EVENT_LIST EVENT 0 EVENT 1 EVENT 2 EVENT 3 /end AVAILABLE_EVENT_LIST /begin DEFAULT_EVENT_LIST EVENT 0 /end DEFAULT_EVENT_LIST /end DAQ_EVENT
 /end IF_DATA
/end MEASUREMENT
/begin MEASUREMENT B_bm "condition reference mark detected" UBYTE B_TRUE 1 100 0.00 1.00000000000 BIT_MASK 0x1 FORMAT "%13.11" ECU_ADDRESS 0x40008945
 /begin IF_DATA XCPplus 0x0102
  /begin DAQ_EVENT VARIABLE /begin AVAILABLE_EVENT_LIST EVENT 0 EVENT 1 EVENT 2 EVENT 3 /end AVAILABLE_EVENT_LIST /begin DEFAULT_EVENT_LIST EVENT 1 /end DEFAULT_EVENT_LIST /end DAQ_EVENT
 /end IF_DATA
/end MEASUREMENT
/begin MEASUREMENT B_dopzue "Condition double ignition output" UBYTE B_TRUE 1 100 0.00 1.00000000000 BIT_MASK 0x1 FORMAT "%13.11" ECU_ADDRESS 0x40008944
 /begin IF_DATA XCPplus 0x0102
  /begin DAQ_EVENT VARIABLE /begin AVAILABLE_EVENT_LIST EVENT 0 EVENT 1 EVENT 2 EVENT 3 /end AVAILABLE_EVENT_LIST /begin DEFAULT_EVENT_LIST EVENT 2 /end DEFAULT_EVENT_LIST /end DAQ_EVENT
 /end IF_DATA
/end MEASUREMENT
/begin MEASUREMENT B_edk "Error condition: throttle position sensor" UBYTE B_TRUE 1 100 0.00 1.00000000000 BIT_MASK 0x1 FORMAT "%13.11" ECU_ADDRESS 0x40008973
 /begin IF_DATA XCPplus 0x0102
  /begin DAQ_EVENT VARIABLE /begin AVAILABLE_EVENT_LIST EVENT 0 EVENT 1 EVENT 2 EVENT 3 /end AVAILABLE_EVENT_LIST /begin DEFAULT_EVENT_LIST EVENT 1 /end DEFAULT_EVENT_LIST /end DAQ_EVENT
 /end IF_DATA
/end MEASUREMENT
/begin MEASUREMENT B_engmvdb "Condition of crank teeth debouncing is active" UBYTE B_TRUE 1 100 0.00 1.00000000000 BIT_MASK 0x1 FORMAT "%13.11" ECU_ADDRESS 0x40008943
 /begin IF_DATA XCPplus 0x0102
  /begin DAQ_EVENT VARIABLE /begin AVAILABLE_EVENT_LIST EVENT 0 EVENT 1 EVENT 2 EVENT 3 /end AVAILABLE_EVENT_LIST /begin DEFAULT_EVENT_LIST EVENT 1 /end DEFAULT_EVENT_LIST /end DAQ_EVENT
 /end IF_DATA
/end MEASUREMENT
/begin MEASUREMENT B_enrinh "Condition enable for Ri-Nernst with filter post cat" UBYTE B_TRUE 1 100 0.00 1.00000000000 BIT_MASK 0x1 FORMAT "%13.11" ECU_ADDRESS 0x40008985 /end MEASUREMENT
/begin MEASUREMENT B_enrinv "Condition enable for Ri-Nernst wit filter pre cat" UBYTE B_TRUE 1 100 0.00 1.00000000000 BIT_MASK 0x1 FORMAT "%13.11" ECU_ADDRESS 0x40008997 /end MEASUREMENT
/begin MEASUREMENT B_erinofh "Condition enable for Ri-Nernst without filter post cat" UBYTE B_TRUE 1 100 0.00 1.00000000000 BIT_MASK 0x2 FORMAT "%13.11" ECU_ADDRESS 0x40008985 /end MEASUREMENT
/begin MEASUREMENT B_erinofv "Condition enable for Ri-Nernst without filter pre cat" UBYTE B_TRUE 1 100 0.00 1.00000000000 BIT_MASK 0x1 FORMAT "%13.11" ECU_ADDRESS 0x40008996 /end MEASUREMENT
/begin MEASUREMENT B_etans "condition Error temperature sensor tans" UBYTE B_TRUE 1 100 0.00 1.00000000000 BIT_MASK 0x1 FORMAT "%13.11" ECU_ADDRESS 0x4000C6F3
 /begin IF_DATA XCPplus 0x0102
  /begin DAQ_EVENT VARIABLE /begin AVAILABLE_EVENT_LIST EVENT 0 EVENT 1 EVENT 2 EVENT 3 /end AVAILABLE_EVENT_LIST /begin DEFAULT_EVENT_LIST EVENT 2 /end DEFAULT_EVENT_LIST /end DAQ_EVENT
 /end IF_DATA
/end MEASUREMENT
/begin MEASUREMENT B_etmot_ggtfaloc "Condition error cooling wter temperature sesnor(local variable)" UBYTE B_TRUE 1 100 0.00 1.00000000000 BIT_MASK 0x1 FORMAT "%13.11" ECU_ADDRESS 0x4000871F
 /begin IF_DATA XCPplus 0x0102
  /begin DAQ_EVENT VARIABLE /begin AVAILABLE_EVENT_LIST EVENT 0 EVENT 1 EVENT 2 EVENT 3 /end AVAILABLE_EVENT_LIST /begin DEFAULT_EVENT_LIST EVENT 2 /end DEFAULT_EVENT_LIST /end DAQ_EVENT
 /end IF_DATA
/end MEASUREMENT
/begin MEASUREMENT B_fbm "condition reference mark error => at least 1 tooth too few/many" UBYTE B_TRUE 1 100 0.00 1.00000000000 BIT_MASK 0x1 FORMAT "%13.11" ECU_ADDRESS 0x40008942
 /begin IF_DATA XCPplus 0x0102
  /begin DAQ_EVENT VARIABLE /begin AVAILABLE_EVENT_LIST EVENT 0 EVENT 1 EVENT 2 EVENT 3 /end AVAILABLE_EVENT_LIST /begin DEFAULT_EVENT_LIST EVENT 1 /end DEFAULT_EVENT_LIST /end DAQ_EVENT
 /end IF_DATA
/end MEASUREMENT
/begin MEASUREMENT B_flgGGTFADSMClr "GGTFA:DSM clear flag" UBYTE B_TRUE 1 100 0.00 1.00000000000 BIT_MASK 0x1 FORMAT "%13.11" ECU_ADDRESS 0x400062A6
 /begin IF_DATA XCPplus 0x0102
  /begin DAQ_EVENT VARIABLE /begin AVAILABLE_EVENT_LIST EVENT 0 EVENT 1 EVENT 2 EVENT 3 /end AVAILABLE_EVENT_LIST /begin DEFAULT_EVENT_LIST EVENT 2 /end DEFAULT_EVENT_LIST /end DAQ_EVENT
 /end IF_DATA
/end MEASUREMENT
/begin MEASUREMENT B_ll "Idle speed from driver's sight" UBYTE B_TRUE 1 100 0.00 1.00000000000 BIT_MASK 0x1 FORMAT "%13.11" ECU_ADDRESS 0x40008972
 /begin IF_DATA XCPplus 0x0102
  /begin DAQ_EVENT VARIABLE /begin AVAILABLE_EVENT_LIST EVENT 0 EVENT 1 EVENT 2 EVENT 3 /end AVAILABLE_EVENT_LIST /begin DEFAULT_EVENT_LIST EVENT 1 /end DEFAULT_EVENT_LIST /end DAQ_EVENT
 /end IF_DATA
/end MEASUREMENT
/begin MEASUREMENT B_llLoc "Idle speed active local" UBYTE B_TRUE 1 100 0.00 1.00000000000 BIT_MASK 0x1 FORMAT "%13.11" ECU_ADDRESS 0x40008960
 /begin IF_DATA XCPplus 0x0102
  /begin DAQ_EVENT VARIABLE /begin AVAILABLE_EVENT_LIST EVENT 0 EVENT 1 EVENT 2 EVENT 3 /end AVAILABLE_EVENT_LIST /begin DEFAULT_EVENT_LIST EVENT 0 /end DEFAULT_EVENT_LIST /end DAQ_EVENT
 /end IF_DATA
/end MEASUREMENT
/begin MEASUREMENT B_llspmn "condition ISA falls under the minimal position" UBYTE B_TRUE 1 100 0.00 1.00000000000 BIT_MASK 0x1 FORMAT "%13.11" ECU_ADDRESS 0x40008969
 /begin IF_DATA XCPplus 0x0102
  /begin DAQ_EVENT VARIABLE /begin AVAILABLE_EVENT_LIST EVENT 0 EVENT 1 EVENT 2 EVENT 3 /end AVAILABLE_EVENT_LIST /begin DEFAULT_EVENT_LIST EVENT 1 /end DEFAULT_EVENT_LIST /end DAQ_EVENT
 /end IF_DATA
/end MEASUREMENT
/begin MEASUREMENT B_llspmx "condition ISA passes the maximum position" UBYTE B_TRUE 1 100 0.00 1.00000000000 BIT_MASK 0x1 FORMAT "%13.11" ECU_ADDRESS 0x40008968
 /begin IF_DATA XCPplus 0x0102
  /begin DAQ_EVENT VARIABLE /begin AVAILABLE_EVENT_LIST EVENT 0 EVENT 1 EVENT 2 EVENT 3 /end AVAILABLE_EVENT_LIST /begin DEFAULT_EVENT_LIST EVENT 1 /end DEFAULT_EVENT_LIST /end DAQ_EVENT
 /end IF_DATA
/end MEASUREMENT
/begin MEASUREMENT B_mndk "Error type: short circuit to ground throttle potentiometer" UBYTE B_TRUE 1 100 0.00 1.00000000000 BIT_MASK 0x1 FORMAT "%13.11" ECU_ADDRESS 0x40008971
 /begin IF_DATA XCPplus 0x0102
  /begin DAQ_EVENT VARIABLE /begin AVAILABLE_EVENT_LIST EVENT 0 EVENT 1 EVENT 2 EVENT 3 /end AVAILABLE_EVENT_LIST /begin DEFAULT_EVENT_LIST EVENT 1 /end DEFAULT_EVENT_LIST /end DAQ_EVENT
 /end IF_DATA
/end MEASUREMENT
/begin MEASUREMENT B_mndss "Condition: temporary info. of min-error manifold pressure sensor" UBYTE B_TRUE 1 100 0.00 1.00000000000 BIT_MASK 0x1 FORMAT "%13.11" ECU_ADDRESS 0x40008982
 /begin IF_DATA XCPplus 0x0102
  /begin DAQ_EVENT VARIABLE /begin AVAILABLE_EVENT_LIST EVENT 0 EVENT 1 EVENT 2 EVENT 3 /end AVAILABLE_EVENT_LIST /begin DEFAULT_EVENT_LIST EVENT 0 /end DEFAULT_EVENT_LIST /end DAQ_EVENT
 /end IF_DATA
/end MEASUREMENT
/begin MEASUREMENT B_motstop "Condition to abort injection and ignition for a definite time" UBYTE B_TRUE 1 100 0.00 1.00000000000 BIT_MASK 0x1 FORMAT "%13.11" ECU_ADDRESS 0x40008941
 /begin IF_DATA XCPplus 0x0102
  /begin DAQ_EVENT VARIABLE /begin AVAILABLE_EVENT_LIST EVENT 0 EVENT 1 EVENT 2 EVENT 3 /end AVAILABLE_EVENT_LIST /begin DEFAULT_EVENT_LIST EVENT 1 /end DEFAULT_EVENT_LIST /end DAQ_EVENT
 /end IF_DATA
/end MEASUREMENT
/begin MEASUREMENT B_mxdk "error type: short circuit to Ubat throttle potentiometer" UBYTE B_TRUE 1 100 0.00 1.00000000000 BIT_MASK 0x1 FORMAT "%13.11" ECU_ADDRESS 0x40008970
 /begin IF_DATA XCPplus 0x0102
  /begin DAQ_EVENT VARIABLE /begin AVAILABLE_EVENT_LIST EVENT 0 EVENT 1 EVENT 2 EVENT 3 /end AVAILABLE_EVENT_LIST /begin DEFAULT_EVENT_LIST EVENT 1 /end DEFAULT_EVENT_LIST /end DAQ_EVENT
 /end IF_DATA
/end MEASUREMENT
/begin MEASUREMENT B_mxdss "Condition: temporary info. of max-error manifold pressure sensor" UBYTE B_TRUE 1 100 0.00 1.00000000000 BIT_MASK 0x1 FORMAT "%13.11" ECU_ADDRESS 0x40008981
 /begin IF_DATA XCPplus 0x0102
  /begin DAQ_EVENT VARIABLE /begin AVAILABLE_EVENT_LIST EVENT 0 EVENT 1 EVENT 2 EVENT 3 /end AVAILABLE_EVENT_LIST /begin DEFAULT_EVENT_LIST EVENT 0 /end DEFAULT_EVENT_LIST /end DAQ_EVENT
 /end IF_DATA
/end MEASUREMENT
/begin MEASUREMENT B_nldg "Condition crankshaft sensor limphome function is active" UBYTE B_TRUE 1 100 0.00 1.00000000000 BIT_MASK 0x1 FORMAT "%13.11" ECU_ADDRESS 0x40008940
 /begin IF_DATA XCPplus 0x0102
  /begin DAQ_EVENT VARIABLE /begin AVAILABLE_EVENT_LIST EVENT 0 EVENT 1 EVENT 2 EVENT 3 /end AVAILABLE_EVENT_LIST /begin DEFAULT_EVENT_LIST EVENT 2 /end DEFAULT_EVENT_LIST /end DAQ_EVENT
 /end IF_DATA
/end MEASUREMENT
/begin MEASUREMENT B_nllsst "Condition: selection of predictive method engine speed for desired bypass air control" UBYTE B_TRUE 1 100 0.00 1.00000000000 BIT_MASK 0x1 FORMAT "%13.11" ECU_ADDRESS 0x4000896B
 /begin IF_DATA XCPplus 0x0102
  /begin DAQ_EVENT VARIABLE /begin AVAILABLE_EVENT_LIST EVENT 0 EVENT 1 EVENT 2 EVENT 3 /end AVAILABLE_EVENT_LIST /begin DEFAULT_EVENT_LIST EVENT 1 /end DEFAULT_EVENT_LIST /end DAQ_EVENT
 /end IF_DATA
/end MEASUREMENT
/begin MEASUREMENT B_nlph "condition no signal from the phase sensors" UBYTE B_TRUE 1 100 0.00 1.00000000000 BIT_MASK 0x1 FORMAT "%13.11" ECU_ADDRESS 0x4000893F
 /begin IF_DATA XCPplus 0x0102
  /begin DAQ_EVENT VARIABLE /begin AVAILABLE_EVENT_LIST EVENT 0 EVENT 1 EVENT 2 EVENT 3 /end AVAILABLE_EVENT_LIST /begin DEFAULT_EVENT_LIST EVENT 2 /end DEFAULT_EVENT_LIST /end DAQ_EVENT
 /end IF_DATA
/end MEASUREMENT
/begin MEASUREMENT B_nlphwe "Request for one injection at TDC to detect a back blow of air in the rail" UBYTE B_TRUE 1 100 0.00 1.00000000000 BIT_MASK 0x1 FORMAT "%13.11" ECU_ADDRESS 0x4000893E /end MEASUREMENT
/begin MEASUREMENT B_nmin "condition lower speed: n < NMIN" UBYTE B_TRUE 1 100 0.00 1.00000000000 BIT_MASK 0x1 FORMAT "%13.11" ECU_ADDRESS 0x4000893D
 /begin IF_DATA XCPplus 0x0102
  /begin DAQ_EVENT VARIABLE /begin AVAILABLE_EVENT_LIST EVENT 0 EVENT 1 EVENT 2 EVENT 3 /end AVAILABLE_EVENT_LIST /begin DEFAULT_EVENT_LIST EVENT 0 /end DEFAULT_EVENT_LIST /end DAQ_EVENT
 /end IF_DATA
/end MEASUREMENT
/begin MEASUREMENT B_nmot "condition engine speed: n > NMIN" UBYTE B_TRUE 1 100 0.00 1.00000000000 BIT_MASK 0x1 FORMAT "%13.11" ECU_ADDRESS 0x4000893C
 /begin IF_DATA XCPplus 0x0102
  /begin DAQ_EVENT VARIABLE /begin AVAILABLE_EVENT_LIST EVENT 0 EVENT 1 EVENT 2 EVENT 3 /end AVAILABLE_EVENT_LIST /begin DEFAULT_EVENT_LIST EVENT 0 /end DEFAULT_EVENT_LIST /end DAQ_EVENT
 /end IF_DATA
/end MEASUREMENT
/begin MEASUREMENT B_ollstoff "condition to switch off madp based duty cycle for ISA (ollsst_w)" UBYTE B_TRUE 1 100 0.00 1.00000000000 BIT_MASK 0x1 FORMAT "%13.11" ECU_ADDRESS 0x40008967
 /begin IF_DATA XCPplus 0x0102
  /begin DAQ_EVENT VARIABLE /begin AVAILABLE_EVENT_LIST EVENT 0 EVENT 1 EVENT 2 EVENT 3 /end AVAILABLE_EVENT_LIST /begin DEFAULT_EVENT_LIST EVENT 1 /end DEFAULT_EVENT_LIST /end DAQ_EVENT
 /end IF_DATA
/end MEASUREMENT
/begin MEASUREMENT B_optpherk "condition suitable engine operating state for phase detection" UBYTE B_TRUE 1 100 0.00 1.00000000000 BIT_MASK 0x1 FORMAT "%13.11" ECU_ADDRESS 0x4000893B /end MEASUREMENT
/begin MEASUREMENT B_phsinvst "condition invert phase relation at start" UBYTE B_TRUE 1 100 0.00 1.00000000000 BIT_MASK 0x1 FORMAT "%13.11" ECU_ADDRESS 0x4000893A /end MEASUREMENT
/begin MEASUREMENT B_phsnl "Condition phase search during phase sensor limp-home" UBYTE B_TRUE 1 100 0.00 1.00000000000 BIT_MASK 0x1 FORMAT "%13.11" ECU_ADDRESS 0x40008939 /end MEASUREMENT
/begin MEASUREMENT B_psremn "Condition for electric min error of manifold pressure sensor" UBYTE B_TRUE 1 100 0.00 1.00000000000 BIT_MASK 0x1 FORMAT "%13.11" ECU_ADDRESS 0x40008980
 /begin IF_DATA XCPplus 0x0102
  /begin DAQ_EVENT VARIABLE /begin AVAILABLE_EVENT_LIST EVENT 0 EVENT 1 EVENT 2 EVENT 3 /end AVAILABLE_EVENT_LIST /begin DEFAULT_EVENT_LIST EVENT 0 /end DEFAULT_EVENT_LIST /end DAQ_EVENT
 /end IF_DATA
/end MEASUREMENT
/begin MEASUREMENT B_psremx "Condition for electric max error of manifold pressure sensor" UBYTE B_TRUE 1 100 0.00 1.00000000000 BIT_MASK 0x1 FORMAT "%13.11" ECU_ADDRESS 0x4000897F
 /begin IF_DATA XCPplus 0x0102
  /begin DAQ_EVENT VARIABLE /begin AVAILABLE_EVENT_LIST EVENT 0 EVENT 1 EVENT 2 EVENT 3 /end AVAILABLE_EVENT_LIST /begin DEFAULT_EVENT_LIST EVENT 0 /end DEFAULT_EVENT_LIST /end DAQ_EVENT
 /end IF_DATA
/end MEASUREMENT
/begin MEASUREMENT B_psrrg "Condition intake manifold pressure rawvalue valid" UBYTE B_TRUE 1 100 0.00 1.00000000000 BIT_MASK 0x1 FORMAT "%13.11" ECU_ADDRESS 0x4000897E
 /begin IF_DATA XCPplus 0x0102
  /begin DAQ_EVENT VARIABLE /begin AVAILABLE_EVENT_LIST EVENT 0 EVENT 1 EVENT 2 EVENT 3 /end AVAILABLE_EVENT_LIST /begin DEFAULT_EVENT_LIST EVENT 0 /end DEFAULT_EVENT_LIST /end DAQ_EVENT
 /end IF_DATA
/end MEASUREMENT
/begin MEASUREMENT B_ribeh "Condition calculate internal resistance Ri for sensor downstream catalyst" UBYTE B_TRUE 1 100 0.00 1.00000000000 BIT_MASK 0x4 FORMAT "%13.11" ECU_ADDRESS 0x40008985 /end MEASUREMENT
/begin MEASUREMENT B_ribev "Condition calculate internal resistance Ri for sensor upstream cat" UBYTE B_TRUE 1 100 0.00 1.00000000000 BIT_MASK 0x1 FORMAT "%13.11" ECU_ADDRESS 0x40008995 /end MEASUREMENT
/begin MEASUREMENT B_riibh "Cond. sensor volt. in the permissible range for pumping current downstream cat" UBYTE B_TRUE 1 100 0.00 1.00000000000 BIT_MASK 0x8 FORMAT "%13.11" ECU_ADDRESS 0x40008985 /end MEASUREMENT
/begin MEASUREMENT B_riibv "Cond. sensor volt. in the perm. range for pump. current upstream cat" UBYTE B_TRUE 1 100 0.00 1.00000000000 BIT_MASK 0x1 FORMAT "%13.11" ECU_ADDRESS 0x40008994 /end MEASUREMENT
/begin MEASUREMENT B_rinavgh "Condition: Valid average Internal resistance Ri calculation, after cat" UBYTE B_TRUE 1 100 0.00 1.00000000000 BIT_MASK 0x4 FORMAT "%13.11" ECU_ADDRESS 0x40008984 /end MEASUREMENT
/begin MEASUREMENT B_rinavgv "Condition: Valid average Internal resistance Ri calculation, pre cat" UBYTE B_TRUE 1 100 0.00 1.00000000000 BIT_MASK 0x1 FORMAT "%13.11" ECU_ADDRESS 0x4000898E /end MEASUREMENT
/begin MEASUREMENT B_rinch "do not calculate Ri of sensor after cat" UBYTE B_TRUE 1 100 0.00 1.00000000000 BIT_MASK 0x10 FORMAT "%13.11" ECU_ADDRESS 0x40008985 /end MEASUREMENT
/begin MEASUREMENT B_rincv "do not calculate Ri of sensor before cat" UBYTE B_TRUE 1 100 0.00 1.00000000000 BIT_MASK 0x1 FORMAT "%13.11" ECU_ADDRESS 0x40008993 /end MEASUREMENT
/begin MEASUREMENT B_rinh "Condition internal resistance of Ri-measur. of sensor active downstream cat." UBYTE B_TRUE 1 100 0.00 1.00000000000 BIT_MASK 0x1 FORMAT "%13.11" ECU_ADDRESS 0x40008984 /end MEASUREMENT
/begin MEASUREMENT B_rinv "Condition: Internal resistance Ri of O2 sensor activ,pre cat" UBYTE B_TRUE 1 100 0.00 1.00000000000 BIT_MASK 0x1 FORMAT "%13.11" ECU_ADDRESS 0x4000898D /end MEASUREMENT
/begin MEASUREMENT B_rlmin "Condition rl-desired value same as that of rl-Minimum value" UBYTE B_TRUE 1 100 0.00 1.00000000000 BIT_MASK 0x1 FORMAT "%13.11" ECU_ADDRESS 0x40008966
 /begin IF_DATA XCPplus 0x0102
  /begin DAQ_EVENT VARIABLE /begin AVAILABLE_EVENT_LIST EVENT 0 EVENT 1 EVENT 2 EVENT 3 /end AVAILABLE_EVENT_LIST /begin DEFAULT_EVENT_LIST EVENT 1 /end DEFAULT_EVENT_LIST /end DAQ_EVENT
 /end IF_DATA
/end MEASUREMENT
/begin MEASUREMENT B_sdstact "Condition: Side stand active" UBYTE B_TRUE 1 100 0.00 1.00000000000 BIT_MASK 0x1 FORMAT "%13.11" ECU_ADDRESS 0x40006416
 /begin IF_DATA XCPplus 0x0102
  /begin DAQ_EVENT VARIABLE /begin AVAILABLE_EVENT_LIST EVENT 0 EVENT 1 EVENT 2 EVENT 3 /end AVAILABLE_EVENT_LIST /begin DEFAULT_EVENT_LIST EVENT 2 /end DEFAULT_EVENT_LIST /end DAQ_EVENT
 /end IF_DATA
/end MEASUREMENT
/begin MEASUREMENT B_stprel "Condition for start debouncing of crankshaft signal" UBYTE B_TRUE 1 100 0.00 1.00000000000 BIT_MASK 0x1 FORMAT "%13.11" ECU_ADDRESS 0x40008938
 /begin IF_DATA XCPplus 0x0102
  /begin DAQ_EVENT VARIABLE /begin AVAILABLE_EVENT_LIST EVENT 0 EVENT 1 EVENT 2 EVENT 3 /end AVAILABLE_EVENT_LIST /begin DEFAULT_EVENT_LIST EVENT 1 /end DEFAULT_EVENT_LIST /end DAQ_EVENT
 /end IF_DATA
/end MEASUREMENT
/begin MEASUREMENT B_synnot "Prohibits injection if phase synchronization could not be detected" UBYTE B_TRUE 1 100 0.00 1.00000000000 BIT_MASK 0x1 FORMAT "%13.11" ECU_ADDRESS 0x40008937 /end MEASUREMENT
/begin MEASUREMENT B_synph "condition synchronization phase" UBYTE B_TRUE 1 100 0.00 1.00000000000 BIT_MASK 0x1 FORMAT "%13.11" ECU_ADDRESS 0x40008936
 /begin IF_DATA XCPplus 0x0102
  /begin DAQ_EVENT VARIABLE /begin AVAILABLE_EVENT_LIST EVENT 0 EVENT 1 EVENT 2 EVENT 3 /end AVAILABLE_EVENT_LIST /begin DEFAULT_EVENT_LIST EVENT 0 /end DEFAULT_EVENT_LIST /end DAQ_EVENT
 /end IF_DATA
/end MEASUREMENT
/begin MEASUREMENT B_tanslinmn "intake air temperature, linearised and calculated" UBYTE B_TRUE 1 100 0.00 1.00000000000 BIT_MASK 0x1 FORMAT "%13.11" ECU_ADDRESS 0x4000871E
 /begin IF_DATA XCPplus 0x0102
  /begin DAQ_EVENT VARIABLE /begin AVAILABLE_EVENT_LIST EVENT 0 EVENT 1 EVENT 2 EVENT 3 /end AVAILABLE_EVENT_LIST /begin DEFAULT_EVENT_LIST EVENT 2 /end DEFAULT_EVENT_LIST /end DAQ_EVENT
 /end IF_DATA
/end MEASUREMENT
/begin MEASUREMENT B_tanslinmx "intake air temperature, linearised and calculated" UBYTE B_TRUE 1 100 0.00 1.00000000000 BIT_MASK 0x1 FORMAT "%13.11" ECU_ADDRESS 0x4000871D
 /begin IF_DATA XCPplus 0x0102
  /begin DAQ_EVENT VARIABLE /begin AVAILABLE_EVENT_LIST EVENT 0 EVENT 1 EVENT 2 EVENT 3 /end AVAILABLE_EVENT_LIST /begin DEFAULT_EVENT_LIST EVENT 2 /end DEFAULT_EVENT_LIST /end DAQ_EVENT
 /end IF_DATA
/end MEASUREMENT
/begin MEASUREMENT B_tdtanshlmax "Time delay for healing of sensor error of intake air temperature sensor" UBYTE B_TRUE 1 100 0.00 1.00000000000 BIT_MASK 0x1 FORMAT "%13.11" ECU_ADDRESS 0x4000871C
 /begin IF_DATA XCPplus 0x0102
  /begin DAQ_EVENT VARIABLE /begin AVAILABLE_EVENT_LIST EVENT 0 EVENT 1 EVENT 2 EVENT 3 /end AVAILABLE_EVENT_LIST /begin DEFAULT_EVENT_LIST EVENT 2 /end DEFAULT_EVENT_LIST /end DAQ_EVENT
 /end IF_DATA
/end MEASUREMENT
/begin MEASUREMENT B_tdtanshlmin "Time delay for healing of sensor error of intake air temperature sensor" UBYTE B_TRUE 1 100 0.00 1.00000000000 BIT_MASK 0x1 FORMAT "%13.11" ECU_ADDRESS 0x4000871B
 /begin IF_DATA XCPplus 0x0102
  /begin DAQ_EVENT VARIABLE /begin AVAILABLE_EVENT_LIST EVENT 0 EVENT 1 EVENT 2 EVENT 3 /end AVAILABLE_EVENT_LIST /begin DEFAULT_EVENT_LIST EVENT 2 /end DEFAULT_EVENT_LIST /end DAQ_EVENT
 /end IF_DATA
/end MEASUREMENT
/begin MEASUREMENT B_uk1 "Enable condition for transient control" UBYTE B_TRUE 1 100 0.00 1.00000000000 BIT_MASK 0x1 FORMAT "%13.11" ECU_ADDRESS 0x40008954
 /begin IF_DATA XCPplus 0x0102
  /begin DAQ_EVENT VARIABLE /begin AVAILABLE_EVENT_LIST EVENT 0 EVENT 1 EVENT 2 EVENT 3 /end AVAILABLE_EVENT_LIST /begin DEFAULT_EVENT_LIST EVENT 0 /end DEFAULT_EVENT_LIST /end DAQ_EVENT
 /end IF_DATA
/end MEASUREMENT
/begin MEASUREMENT B_ukg "condition transient control activated" UBYTE B_TRUE 1 100 0.00 1.00000000000 BIT_MASK 0x1 FORMAT "%13.11" ECU_ADDRESS 0x40008953
 /begin IF_DATA XCPplus 0x0102
  /begin DAQ_EVENT VARIABLE /begin AVAILABLE_EVENT_LIST EVENT 0 EVENT 1 EVENT 2 EVENT 3 /end AVAILABLE_EVENT_LIST /begin DEFAULT_EVENT_LIST EVENT 0 /end DEFAULT_EVENT_LIST /end DAQ_EVENT
 /end IF_DATA
/end MEASUREMENT
/begin MEASUREMENT B_ukgi "condition transient control activated(local)" UBYTE B_TRUE 1 100 0.00 1.00000000000 BIT_MASK 0x1 FORMAT "%13.11" ECU_ADDRESS 0x40008952
 /begin IF_DATA XCPplus 0x0102
  /begin DAQ_EVENT VARIABLE /begin AVAILABLE_EVENT_LIST EVENT 0 EVENT 1 EVENT 2 EVENT 3 /end AVAILABLE_EVENT_LIST /begin DEFAULT_EVENT_LIST EVENT 0 /end DEFAULT_EVENT_LIST /end DAQ_EVENT
 /end IF_DATA
/end MEASUREMENT
/begin MEASUREMENT B_umsync "condition new synchronisation after reference mark" UBYTE B_TRUE 1 100 0.00 1.00000000000 BIT_MASK 0x1 FORMAT "%13.11" ECU_ADDRESS 0x40008935
 /begin IF_DATA XCPplus 0x0102
  /begin DAQ_EVENT VARIABLE /begin AVAILABLE_EVENT_LIST EVENT 0 EVENT 1 EVENT 2 EVENT 3 /end AVAILABLE_EVENT_LIST /begin DEFAULT_EVENT_LIST EVENT 0 /end DEFAULT_EVENT_LIST /end DAQ_EVENT
 /end IF_DATA
/end MEASUREMENT
/begin MEASUREMENT B_ushren "enable sensor voltage after cat for calculation of Ri" UBYTE B_TRUE 1 100 0.00 1.00000000000 BIT_MASK 0x2 FORMAT "%13.11" ECU_ADDRESS 0x40008984 /end MEASUREMENT
/begin MEASUREMENT B_usvren "enable sensor voltage before cat for calculation of Ri" UBYTE B_TRUE 1 100 0.00 1.00000000000 BIT_MASK 0x1 FORMAT "%13.11" ECU_ADDRESS 0x4000898C /end MEASUREMENT
/begin MEASUREMENT B_uwdkoaen "Condition enable throttle learning if learnt value in last driving cycle is small" UBYTE B_TRUE 1 100 0.00 1.00000000000 BIT_MASK 0x1 FORMAT "%13.11" ECU_ADDRESS 0x4000896F
 /begin IF_DATA XCPplus 0x0102
  /begin DAQ_EVENT VARIABLE /begin AVAILABLE_EVENT_LIST EVENT 0 EVENT 1 EVENT 2 EVENT 3 /end AVAILABLE_EVENT_LIST /begin DEFAULT_EVENT_LIST EVENT 2 /end DEFAULT_EVENT_LIST /end DAQ_EVENT
 /end IF_DATA
/end MEASUREMENT
/begin MEASUREMENT B_uwdkuaen "Condition enable throttle learning if learnt value in last driving cycle is small" UBYTE B_TRUE 1 100 0.00 1.00000000000 BIT_MASK 0x1 FORMAT "%13.11" ECU_ADDRESS 0x4000896E
 /begin IF_DATA XCPplus 0x0102
  /begin DAQ_EVENT VARIABLE /begin AVAILABLE_EVENT_LIST EVENT 0 EVENT 1 EVENT 2 EVENT 3 /end AVAILABLE_EVENT_LIST /begin DEFAULT_EVENT_LIST EVENT 2 /end DEFAULT_EVENT_LIST /end DAQ_EVENT
 /end IF_DATA
/end MEASUREMENT
/begin MEASUREMENT B_vaau "Condition decel. enleanment for partition of fuel film" UBYTE B_TRUE 1 100 0.00 1.00000000000 BIT_MASK 0x1 FORMAT "%13.11" ECU_ADDRESS 0x40008961
 /begin IF_DATA XCPplus 0x0102
  /begin DAQ_EVENT VARIABLE /begin AVAILABLE_EVENT_LIST EVENT 0 EVENT 1 EVENT 2 EVENT 3 /end AVAILABLE_EVENT_LIST /begin DEFAULT_EVENT_LIST EVENT 0 /end DEFAULT_EVENT_LIST /end DAQ_EVENT
 /end IF_DATA
/end MEASUREMENT
/begin MEASUREMENT B_vag "Condition large deceleration enleanment" UBYTE B_TRUE 1 100 0.00 1.00000000000 BIT_MASK 0x1 FORMAT "%13.11" ECU_ADDRESS 0x40008951
 /begin IF_DATA XCPplus 0x0102
  /begin DAQ_EVENT VARIABLE /begin AVAILABLE_EVENT_LIST EVENT 0 EVENT 1 EVENT 2 EVENT 3 /end AVAILABLE_EVENT_LIST /begin DEFAULT_EVENT_LIST EVENT 0 /end DEFAULT_EVENT_LIST /end DAQ_EVENT
 /end IF_DATA
/end MEASUREMENT
/begin MEASUREMENT B_vagtemp "Temporary condition large deceleration enleanment" UBYTE B_TRUE 1 100 0.00 1.00000000000 BIT_MASK 0x1 FORMAT "%13.11" ECU_ADDRESS 0x4000895D
 /begin IF_DATA XCPplus 0x0102
  /begin DAQ_EVENT VARIABLE /begin AVAILABLE_EVENT_LIST EVENT 0 EVENT 1 EVENT 2 EVENT 3 /end AVAILABLE_EVENT_LIST /begin DEFAULT_EVENT_LIST EVENT 0 /end DEFAULT_EVENT_LIST /end DAQ_EVENT
 /end IF_DATA
/end MEASUREMENT
/begin MEASUREMENT B_vakl "Condition decel. enleanment L- and K-part" UBYTE B_TRUE 1 100 0.00 1.00000000000 BIT_MASK 0x1 FORMAT "%13.11" ECU_ADDRESS 0x40008965
 /begin IF_DATA XCPplus 0x0102
  /begin DAQ_EVENT VARIABLE /begin AVAILABLE_EVENT_LIST EVENT 0 EVENT 1 EVENT 2 EVENT 3 /end AVAILABLE_EVENT_LIST /begin DEFAULT_EVENT_LIST EVENT 0 /end DEFAULT_EVENT_LIST /end DAQ_EVENT
 /end IF_DATA
/end MEASUREMENT
/begin MEASUREMENT B_zkuwdkas "Condition enable for fast throttle lower mechanical limit learning" UBYTE B_TRUE 1 100 0.00 1.00000000000 BIT_MASK 0x1 FORMAT "%13.11" ECU_ADDRESS 0x4000896D /end MEASUREMENT
/begin MEASUREMENT B_zprel "condition tooth debouncing ready" UBYTE B_TRUE 1 100 0.00 1.00000000000 BIT_MASK 0x1 FORMAT "%13.11" ECU_ADDRESS 0x40008934
 /begin IF_DATA XCPplus 0x0102
  /begin DAQ_EVENT VARIABLE /begin AVAILABLE_EVENT_LIST EVENT 0 EVENT 1 EVENT 2 EVENT 3 /end AVAILABLE_EVENT_LIST /begin DEFAULT_EVENT_LIST EVENT 1 /end DEFAULT_EVENT_LIST /end DAQ_EVENT
 /end IF_DATA
/end MEASUREMENT
/begin MEASUREMENT dkpstg_w "slope of throttle potentiometer (% DK / V)" UWORD rel_uw_b40 1 100 0.00 39.99939 FORMAT "%8.5" ECU_ADDRESS 0x40008574
 /begin IF_DATA XCPplus 0x0102
  /begin DAQ_EVENT VARIABLE /begin AVAILABLE_EVENT_LIST EVENT 0 EVENT 1 EVENT 2 EVENT 3 /end AVAILABLE_EVENT_LIST /begin DEFAULT_EVENT_LIST EVENT 2 /end DEFAULT_EVENT_LIST /end DAQ_EVENT
 /end IF_DATA
/end MEASUREMENT
/begin MEASUREMENT dnmot_w "engine speed difference between two following segments" SWORD nmot_sw_q0p25 1 100 -8192.000 8191.750 FORMAT "%8.3" ECU_ADDRESS 0x40008520
 /begin IF_DATA XCPplus 0x0102
  /begin DAQ_EVENT VARIABLE /begin AVAILABLE_EVENT_LIST EVENT 0 EVENT 1 EVENT 2 EVENT 3 /end AVAILABLE_EVENT_LIST /begin DEFAULT_EVENT_LIST EVENT 0 /end DEFAULT_EVENT_LIST /end DAQ_EVENT
 /end IF_DATA
/end MEASUREMENT
/begin MEASUREMENT DT_as32 "Core specific sample time for MDG1 multicore projects." SLONG Per_Dur 1 100 -2147483648.00 2147483647.00 FORMAT "%13.2" ECU_ADDRESS 0x40005198 /end MEASUREMENT
/begin MEASUREMENT DT_as32_s "Core specific sample time in seconds for MDG1 multicore projects." SLONG Time_Dt 1 100 -2147.48364800 2147.48364700 FORMAT "%13.8" ECU_ADDRESS 0x40005194 /end MEASUREMENT
/begin MEASUREMENT dushkr_w "Voltage difference after cat for calculation of Ri" UWORD spg_q0p005 1 100 0.00 327.6750 FORMAT "%8.4" ECU_ADDRESS 0x4000859A /end MEASUREMENT
/begin MEASUREMENT dusvkr_w "Voltage difference before cat for calculation of Ri" UWORD spg_q0p005 1 100 0.00 327.6750 FORMAT "%8.4" ECU_ADDRESS 0x400085B0 /end MEASUREMENT
/begin MEASUREMENT dwdkba_w "gradient of actual throttle blade position" SWORD relDK_q0p02441 1 100 -800.0000 799.9756 FORMAT "%8.4" ECU_ADDRESS 0x40008572
 /begin IF_DATA XCPplus 0x0102
  /begin DAQ_EVENT VARIABLE /begin AVAILABLE_EVENT_LIST EVENT 0 EVENT 1 EVENT 2 EVENT 3 /end AVAILABLE_EVENT_LIST /begin DEFAULT_EVENT_LIST EVENT 0 /end DEFAULT_EVENT_LIST /end DAQ_EVENT
 /end IF_DATA
/end MEASUREMENT
/begin MEASUREMENT dwfk_w "delta wall wetting quantity short term" SWORD rel_q0p09375 1 100 -3072.000 3071.906 FORMAT "%8.3" ECU_ADDRESS 0x4000853E
 /begin IF_DATA XCPplus 0x0102
  /begin DAQ_EVENT VARIABLE /begin AVAILABLE_EVENT_LIST EVENT 0 EVENT 1 EVENT 2 EVENT 3 /end AVAILABLE_EVENT_LIST /begin DEFAULT_EVENT_LIST EVENT 0 /end DEFAULT_EVENT_LIST /end DAQ_EVENT
 /end IF_DATA
/end MEASUREMENT
/begin MEASUREMENT dwfl_w "delta wall wetting quantity long term" SWORD rel_q0p09375 1 100 -3072.000 3071.906 FORMAT "%8.3" ECU_ADDRESS 0x40008542
 /begin IF_DATA XCPplus 0x0102
  /begin DAQ_EVENT VARIABLE /begin AVAILABLE_EVENT_LIST EVENT 0 EVENT 1 EVENT 2 EVENT 3 /end AVAILABLE_EVENT_LIST /begin DEFAULT_EVENT_LIST EVENT 0 /end DEFAULT_EVENT_LIST /end DAQ_EVENT
 /end IF_DATA
/end MEASUREMENT
/begin MEASUREMENT dwf_w "Delta wall hang-up quantity" SWORD rel_q0p09375 1 100 -3072.000 3071.906 FORMAT "%8.3" ECU_ADDRESS 0x40008530
 /begin IF_DATA XCPplus 0x0102
  /begin DAQ_EVENT VARIABLE /begin AVAILABLE_EVENT_LIST EVENT 0 EVENT 1 EVENT 2 EVENT 3 /end AVAILABLE_EVENT_LIST /begin DEFAULT_EVENT_LIST EVENT 0 /end DEFAULT_EVENT_LIST /end DAQ_EVENT
 /end IF_DATA
/end MEASUREMENT
/begin MEASUREMENT EngDa_tStrtAirFltDsSTCLoc "local engine start temperature for intake air temperature sensor after air filter" SWORD Temp_Cels 1 100 -3549.940 3003.560 FORMAT "%8.3" ECU_ADDRESS 0x40005C40
 /begin IF_DATA XCPplus 0x0102
  /begin DAQ_EVENT VARIABLE /begin AVAILABLE_EVENT_LIST EVENT 0 EVENT 1 EVENT 2 EVENT 3 /end AVAILABLE_EVENT_LIST /begin DEFAULT_EVENT_LIST EVENT 2 /end DEFAULT_EVENT_LIST /end DAQ_EVENT
 /end IF_DATA
/end MEASUREMENT
/begin MEASUREMENT EpmSyn_cntrFailrIntkMnfldP "number of consecutive failed gradient check attempts" UBYTE OneToOne 1 100 0.00 255.0 FORMAT "%5.1" ECU_ADDRESS 0x400062AE
 /begin IF_DATA XCPplus 0x0102
  /begin DAQ_EVENT VARIABLE /begin AVAILABLE_EVENT_LIST EVENT 0 EVENT 1 EVENT 2 EVENT 3 /end AVAILABLE_EVENT_LIST /begin DEFAULT_EVENT_LIST EVENT 0 /end DEFAULT_EVENT_LIST /end DAQ_EVENT
 /end IF_DATA
/end MEASUREMENT
/begin MEASUREMENT EpmSyn_cntrValChkIntkMnfldP "Phase validation counter" UBYTE OneToOne 1 100 0.00 255.0 FORMAT "%5.1" ECU_ADDRESS 0x400062AD
 /begin IF_DATA XCPplus 0x0102
  /begin DAQ_EVENT VARIABLE /begin AVAILABLE_EVENT_LIST EVENT 0 EVENT 1 EVENT 2 EVENT 3 /end AVAILABLE_EVENT_LIST /begin DEFAULT_EVENT_LIST EVENT 0 /end DEFAULT_EVENT_LIST /end DAQ_EVENT
 /end IF_DATA
/end MEASUREMENT
/begin MEASUREMENT EpmSyn_nrGrdtChkIntkMnfldP_mp "Total number of gradient checks" UWORD OneToOne 1 100 0.00 65535.00 FORMAT "%8.2" ECU_ADDRESS 0x40009D88
 /begin IF_DATA XCPplus 0x0102
  /begin DAQ_EVENT VARIABLE /begin AVAILABLE_EVENT_LIST EVENT 0 EVENT 1 EVENT 2 EVENT 3 /end AVAILABLE_EVENT_LIST /begin DEFAULT_EVENT_LIST EVENT 0 /end DEFAULT_EVENT_LIST /end DAQ_EVENT
 /end IF_DATA
/end MEASUREMENT
/begin MEASUREMENT EpmSyn_nrGrdtFailIntkMnfldP_mp "Number of attempts without enough gradient" UWORD OneToOne 1 100 0.00 65535.00 FORMAT "%8.2" ECU_ADDRESS 0x40009D86
 /begin IF_DATA XCPplus 0x0102
  /begin DAQ_EVENT VARIABLE /begin AVAILABLE_EVENT_LIST EVENT 0 EVENT 1 EVENT 2 EVENT 3 /end AVAILABLE_EVENT_LIST /begin DEFAULT_EVENT_LIST EVENT 0 /end DEFAULT_EVENT_LIST /end DAQ_EVENT
 /end IF_DATA
/end MEASUREMENT
/begin MEASUREMENT EpmSyn_nrSynFailIntkMnfldP_mp "Total number of failures to achieve synchronisation (Non-Volatile)" UWORD OneToOne 1 100 0.00 65535.00 FORMAT "%8.2" ECU_ADDRESS 0x40009D84
 /begin IF_DATA XCPplus 0x0102
  /begin DAQ_EVENT VARIABLE /begin AVAILABLE_EVENT_LIST EVENT 0 EVENT 1 EVENT 2 EVENT 3 /end AVAILABLE_EVENT_LIST /begin DEFAULT_EVENT_LIST EVENT 0 /end DEFAULT_EVENT_LIST /end DAQ_EVENT
 /end IF_DATA
/end MEASUREMENT
/begin MEASUREMENT EpmSyn_nrSynSucIntkMnfldP_mp "Total number of success to achieve synchronisation (Non-Volatile)" UWORD OneToOne 1 100 0.00 65535.00 FORMAT "%8.2" ECU_ADDRESS 0x40009D82
 /begin IF_DATA XCPplus 0x0102
  /begin DAQ_EVENT VARIABLE /begin AVAILABLE_EVENT_LIST EVENT 0 EVENT 1 EVENT 2 EVENT 3 /end AVAILABLE_EVENT_LIST /begin DEFAULT_EVENT_LIST EVENT 0 /end DEFAULT_EVENT_LIST /end DAQ_EVENT
 /end IF_DATA
/end MEASUREMENT
/begin MEASUREMENT EpmSyn_phiAbsIntkMnfldP_mp "Current absolute engine position" SWORD AngleCrS 1 100 -720.0000 719.9780 FORMAT "%8.4" ARRAY_SIZE 1 ECU_ADDRESS 0x40009D80
 /begin IF_DATA XCPplus 0x0102
  /begin DAQ_EVENT VARIABLE /begin AVAILABLE_EVENT_LIST EVENT 0 EVENT 1 EVENT 2 EVENT 3 /end AVAILABLE_EVENT_LIST /begin DEFAULT_EVENT_LIST EVENT 0 /end DEFAULT_EVENT_LIST /end DAQ_EVENT
 /end IF_DATA
/end MEASUREMENT
/begin MEASUREMENT EpmSyn_phiOffsIntkMnfldP_mp "Synchronization offset angle" SWORD AngleCrS 1 100 -720.0000 719.9780 FORMAT "%8.4" ARRAY_SIZE 1 ECU_ADDRESS 0x40009D7E
 /begin IF_DATA XCPplus 0x0102
  /begin DAQ_EVENT VARIABLE /begin AVAILABLE_EVENT_LIST EVENT 0 EVENT 1 EVENT 2 EVENT 3 /end AVAILABLE_EVENT_LIST /begin DEFAULT_EVENT_LIST EVENT 0 /end DEFAULT_EVENT_LIST /end DAQ_EVENT
 /end IF_DATA
/end MEASUREMENT
/begin MEASUREMENT EpmSyn_pMaxFirstWinIntkMnfldP "Maximum pressure in first evaluation window" UWORD p_uw_q0p078 1 100 0.00 5119.922 FORMAT "%8.3" ECU_ADDRESS 0x40005C58
 /begin IF_DATA XCPplus 0x0102
  /begin DAQ_EVENT VARIABLE /begin AVAILABLE_EVENT_LIST EVENT 0 EVENT 1 EVENT 2 EVENT 3 /end AVAILABLE_EVENT_LIST /begin DEFAULT_EVENT_LIST EVENT 0 /end DEFAULT_EVENT_LIST /end DAQ_EVENT
 /end IF_DATA
/end MEASUREMENT
/begin MEASUREMENT EpmSyn_pMaxSecWinIntkMnfldP "Maximum pressure in second evaluation window" UWORD p_uw_q0p078 1 100 0.00 5119.922 FORMAT "%8.3" ECU_ADDRESS 0x40005C56
 /begin IF_DATA XCPplus 0x0102
  /begin DAQ_EVENT VARIABLE /begin AVAILABLE_EVENT_LIST EVENT 0 EVENT 1 EVENT 2 EVENT 3 /end AVAILABLE_EVENT_LIST /begin DEFAULT_EVENT_LIST EVENT 0 /end DEFAULT_EVENT_LIST /end DAQ_EVENT
 /end IF_DATA
/end MEASUREMENT
/begin MEASUREMENT EpmSyn_pMinFirstWinIntkMnfldP "Minimum pressure in first evaluation window" UWORD p_uw_q0p078 1 100 0.00 5119.922 FORMAT "%8.3" ECU_ADDRESS 0x40005C54
 /begin IF_DATA XCPplus 0x0102
  /begin DAQ_EVENT VARIABLE /begin AVAILABLE_EVENT_LIST EVENT 0 EVENT 1 EVENT 2 EVENT 3 /end AVAILABLE_EVENT_LIST /begin DEFAULT_EVENT_LIST EVENT 0 /end DEFAULT_EVENT_LIST /end DAQ_EVENT
 /end IF_DATA
/end MEASUREMENT
/begin MEASUREMENT EpmSyn_pMinSecWinIntkMnfldP "Minimum pressure in second evaluation window" UWORD p_uw_q0p078 1 100 0.00 5119.922 FORMAT "%8.3" ECU_ADDRESS 0x40005C52
 /begin IF_DATA XCPplus 0x0102
  /begin DAQ_EVENT VARIABLE /begin AVAILABLE_EVENT_LIST EVENT 0 EVENT 1 EVENT 2 EVENT 3 /end AVAILABLE_EVENT_LIST /begin DEFAULT_EVENT_LIST EVENT 0 /end DEFAULT_EVENT_LIST /end DAQ_EVENT
 /end IF_DATA
/end MEASUREMENT
/begin MEASUREMENT EpmSyn_rAgQlIntkMnfldP_mp "Quality factors of calculated angle distribution" SWORD Prc 1 100 -400.0000 399.9878 FORMAT "%8.4" ARRAY_SIZE 1 ECU_ADDRESS 0x40009D7C
 /begin IF_DATA XCPplus 0x0102
  /begin DAQ_EVENT VARIABLE /begin AVAILABLE_EVENT_LIST EVENT 0 EVENT 1 EVENT 2 EVENT 3 /end AVAILABLE_EVENT_LIST /begin DEFAULT_EVENT_LIST EVENT 0 /end DEFAULT_EVENT_LIST /end DAQ_EVENT
 /end IF_DATA
/end MEASUREMENT
/begin MEASUREMENT EpmSyn_ratPIntkMnfldP "Ratio of pressure differences (between maximum and minimum) in the two evaluation windows" UWORD fak_q0p01 1 100 0.00 655.3500 FORMAT "%8.4" ECU_ADDRESS 0x40005C50
 /begin IF_DATA XCPplus 0x0102
  /begin DAQ_EVENT VARIABLE /begin AVAILABLE_EVENT_LIST EVENT 0 EVENT 1 EVENT 2 EVENT 3 /end AVAILABLE_EVENT_LIST /begin DEFAULT_EVENT_LIST EVENT 0 /end DEFAULT_EVENT_LIST /end DAQ_EVENT
 /end IF_DATA
/end MEASUREMENT
/begin MEASUREMENT EpmSyn_stEnablIntkMnfldP "Condition: Egine operating conditions are suitable for phase search by pressure signal evaluation" UBYTE OneToOne 1 100 0.00 255.0 BIT_MASK 0x1 FORMAT "%5.1" ECU_ADDRESS 0x400062AC
 /begin IF_DATA XCPplus 0x0102
  /begin DAQ_EVENT VARIABLE /begin AVAILABLE_EVENT_LIST EVENT 0 EVENT 1 EVENT 2 EVENT 3 /end AVAILABLE_EVENT_LIST /begin DEFAULT_EVENT_LIST EVENT 0 /end DEFAULT_EVENT_LIST /end DAQ_EVENT
 /end IF_DATA
/end MEASUREMENT
/begin MEASUREMENT EpmSyn_stEnaIntkMnfldP_mp "Request from synchronization coordinator to activate phase search" UBYTE OneToOne 1 100 0.00 255.0 BIT_MASK 0x1 FORMAT "%5.1" ECU_ADDRESS 0x40009E1F
 /begin IF_DATA XCPplus 0x0102
  /begin DAQ_EVENT VARIABLE /begin AVAILABLE_EVENT_LIST EVENT 0 EVENT 1 EVENT 2 EVENT 3 /end AVAILABLE_EVENT_LIST /begin DEFAULT_EVENT_LIST EVENT 0 /end DEFAULT_EVENT_LIST /end DAQ_EVENT
 /end IF_DATA
/end MEASUREMENT
/begin MEASUREMENT EpmSyn_stGrdtDetIntkMnfldP "Gradient detected status" UBYTE OneToOne 1 100 0.00 255.0 FORMAT "%5.1" ECU_ADDRESS 0x400063AD
 /begin IF_DATA XCPplus 0x0102
  /begin DAQ_EVENT VARIABLE /begin AVAILABLE_EVENT_LIST EVENT 0 EVENT 1 EVENT 2 EVENT 3 /end AVAILABLE_EVENT_LIST /begin DEFAULT_EVENT_LIST EVENT 0 /end DEFAULT_EVENT_LIST /end DAQ_EVENT
 /end IF_DATA
/end MEASUREMENT
/begin MEASUREMENT EpmSyn_stPCptrActvIntkMnfldP "Status: Manifold pressure sampling active" UBYTE OneToOne 1 100 0.00 255.0 FORMAT "%5.1" ECU_ADDRESS 0x400063AB
 /begin IF_DATA XCPplus 0x0102
  /begin DAQ_EVENT VARIABLE /begin AVAILABLE_EVENT_LIST EVENT 0 EVENT 1 EVENT 2 EVENT 3 /end AVAILABLE_EVENT_LIST /begin DEFAULT_EVENT_LIST EVENT 0 /end DEFAULT_EVENT_LIST /end DAQ_EVENT
 /end IF_DATA
/end MEASUREMENT
/begin MEASUREMENT EpmSyn_stPhDetIntkMnfldP "Condition: Phase search is successful and finished" UBYTE OneToOne 1 100 0.00 255.0 BIT_MASK 0x1 FORMAT "%5.1" ECU_ADDRESS 0x400062AB
 /begin IF_DATA XCPplus 0x0102
  /begin DAQ_EVENT VARIABLE /begin AVAILABLE_EVENT_LIST EVENT 0 EVENT 1 EVENT 2 EVENT 3 /end AVAILABLE_EVENT_LIST /begin DEFAULT_EVENT_LIST EVENT 0 /end DEFAULT_EVENT_LIST /end DAQ_EVENT
 /end IF_DATA
/end MEASUREMENT
/begin MEASUREMENT EpmSyn_stRecalcnIntkMnfldP_mp "Request from synchronization coordinator to re-calculate phase information" UBYTE OneToOne 1 100 0.00 255.0 BIT_MASK 0x1 FORMAT "%5.1" ECU_ADDRESS 0x40009E1E
 /begin IF_DATA XCPplus 0x0102
  /begin DAQ_EVENT VARIABLE /begin AVAILABLE_EVENT_LIST EVENT 0 EVENT 1 EVENT 2 EVENT 3 /end AVAILABLE_EVENT_LIST /begin DEFAULT_EVENT_LIST EVENT 0 /end DEFAULT_EVENT_LIST /end DAQ_EVENT
 /end IF_DATA
/end MEASUREMENT
/begin MEASUREMENT EpmSyn_stSyncIntkMnfldP_mp "Synchronization status" UBYTE EpmSyn_stSync_W 1 100 0.00 5.00000000000 FORMAT "%13.11" ECU_ADDRESS 0x40009E20
 /begin IF_DATA XCPplus 0x0102
  /begin DAQ_EVENT VARIABLE /begin AVAILABLE_EVENT_LIST EVENT 0 EVENT 1 EVENT 2 EVENT 3 /end AVAILABLE_EVENT_LIST /begin DEFAULT_EVENT_LIST EVENT 0 /end DEFAULT_EVENT_LIST /end DAQ_EVENT
 /end IF_DATA
/end MEASUREMENT
/begin MEASUREMENT EpmSyn_stthrchngIntkMnfldP "Condition: Throttle not stable" UBYTE OneToOne 1 100 0.00 255.0 BIT_MASK 0x1 FORMAT "%5.1" ECU_ADDRESS 0x400063A7
 /begin IF_DATA XCPplus 0x0102
  /begin DAQ_EVENT VARIABLE /begin AVAILABLE_EVENT_LIST EVENT 0 EVENT 1 EVENT 2 EVENT 3 /end AVAILABLE_EVENT_LIST /begin DEFAULT_EVENT_LIST EVENT 0 /end DEFAULT_EVENT_LIST /end DAQ_EVENT
 /end IF_DATA
/end MEASUREMENT
/begin MEASUREMENT EpmSyn_stWinGennIntkMnfldP "Status of window generation state machine" UBYTE OneToOne 1 100 0.00 255.0 FORMAT "%5.1" ECU_ADDRESS 0x400063D5
 /begin IF_DATA XCPplus 0x0102
  /begin DAQ_EVENT VARIABLE /begin AVAILABLE_EVENT_LIST EVENT 0 EVENT 1 EVENT 2 EVENT 3 /end AVAILABLE_EVENT_LIST /begin DEFAULT_EVENT_LIST EVENT 0 /end DEFAULT_EVENT_LIST /end DAQ_EVENT
 /end IF_DATA
/end MEASUREMENT
/begin MEASUREMENT Epm_ctCyl "EPM (Engine Position Management) software cylinder counter" UBYTE OneToOne 1 100 0.00 255.0 FORMAT "%5.1" ECU_ADDRESS 0x400063D4
 /begin IF_DATA XCPplus 0x0102
  /begin DAQ_EVENT VARIABLE /begin AVAILABLE_EVENT_LIST EVENT 0 EVENT 1 EVENT 2 EVENT 3 /end AVAILABLE_EVENT_LIST /begin DEFAULT_EVENT_LIST EVENT 0 /end DEFAULT_EVENT_LIST /end DAQ_EVENT
 /end IF_DATA
/end MEASUREMENT
/begin MEASUREMENT Epm_ctRevCntDiff_mp "Engine revolution difference counter" UWORD RevCnt 1 100 0.00 4095.938 FORMAT "%8.3" ECU_ADDRESS 0x40009D7A
 /begin IF_DATA XCPplus 0x0102
  /begin DAQ_EVENT VARIABLE /begin AVAILABLE_EVENT_LIST EVENT 0 EVENT 1 EVENT 2 EVENT 3 /end AVAILABLE_EVENT_LIST /begin DEFAULT_EVENT_LIST EVENT 0 /end DEFAULT_EVENT_LIST /end DAQ_EVENT
 /end IF_DATA
/end MEASUREMENT
/begin MEASUREMENT Epm_ctTDCPhys_mp "EPM cylinder counter, counts in the physical ignition- /injection order" UBYTE OneToOne 1 100 0.00 255.0 FORMAT "%5.1" ECU_ADDRESS 0x40009E1D
 /begin IF_DATA XCPplus 0x0102
  /begin DAQ_EVENT VARIABLE /begin AVAILABLE_EVENT_LIST EVENT 0 EVENT 1 EVENT 2 EVENT 3 /end AVAILABLE_EVENT_LIST /begin DEFAULT_EVENT_LIST EVENT 0 /end DEFAULT_EVENT_LIST /end DAQ_EVENT
 /end IF_DATA
/end MEASUREMENT
/begin MEASUREMENT Epm_dnEng "Enginespeed-gradient calculated over current crankshaft-segment (S0-S0 oder S1-S1)" SWORD EngNGrd 1 100 -16384.00 16383.50 FORMAT "%8.2" ECU_ADDRESS 0x40005DAC
 /begin IF_DATA XCPplus 0x0102
  /begin DAQ_EVENT VARIABLE /begin AVAILABLE_EVENT_LIST EVENT 0 EVENT 1 EVENT 2 EVENT 3 /end AVAILABLE_EVENT_LIST /begin DEFAULT_EVENT_LIST EVENT 0 /end DEFAULT_EVENT_LIST /end DAQ_EVENT
 /end IF_DATA
/end MEASUREMENT
/begin MEASUREMENT Epm_dnEngAry "Array for storing the speed gradient to calculate moving average" SLONG EngNGrd 1 100 -1073741824.00 1073741823.50 FORMAT "%13.2" ARRAY_SIZE 4 ECU_ADDRESS 0x40004760
 /begin IF_DATA XCPplus 0x0102
  /begin DAQ_EVENT VARIABLE /begin AVAILABLE_EVENT_LIST EVENT 0 EVENT 1 EVENT 2 EVENT 3 /end AVAILABLE_EVENT_LIST /begin DEFAULT_EVENT_LIST EVENT 0 /end DEFAULT_EVENT_LIST /end DAQ_EVENT
 /end IF_DATA
/end MEASUREMENT
/begin MEASUREMENT Epm_dnEngAvg "Engine speed gradient calculated over one working cycle" SWORD EngNGrd 1 100 -16384.00 16383.50 FORMAT "%8.2" ECU_ADDRESS 0x40005DAA
 /begin IF_DATA XCPplus 0x0102
  /begin DAQ_EVENT VARIABLE /begin AVAILABLE_EVENT_LIST EVENT 0 EVENT 1 EVENT 2 EVENT 3 /end AVAILABLE_EVENT_LIST /begin DEFAULT_EVENT_LIST EVENT 0 /end DEFAULT_EVENT_LIST /end DAQ_EVENT
 /end IF_DATA
/end MEASUREMENT
/begin MEASUREMENT Epm_dnEngAvgFlt "filtered engine speed gradient averaged over one cycle" SWORD EngNGrd 1 100 -16384.00 16383.50 FORMAT "%8.2" ECU_ADDRESS 0x40005DA8
 /begin IF_DATA XCPplus 0x0102
  /begin DAQ_EVENT VARIABLE /begin AVAILABLE_EVENT_LIST EVENT 0 EVENT 1 EVENT 2 EVENT 3 /end AVAILABLE_EVENT_LIST /begin DEFAULT_EVENT_LIST EVENT 0 /end DEFAULT_EVENT_LIST /end DAQ_EVENT
 /end IF_DATA
/end MEASUREMENT
/begin MEASUREMENT Epm_dnEngExtdRng "Engine speed-gradient extended range calculated over current crankshaft-segment (S0-S0 and Vx-Vx synchro)" SLONG EngNGrd 1 100 -1073741824.00 1073741823.50 FORMAT "%13.2" ECU_ADDRESS 0x400048D4
 /begin IF_DATA XCPplus 0x0102
  /begin DAQ_EVENT VARIABLE /begin AVAILABLE_EVENT_LIST EVENT 0 EVENT 1 EVENT 2 EVENT 3 /end AVAILABLE_EVENT_LIST /begin DEFAULT_EVENT_LIST EVENT 0 /end DEFAULT_EVENT_LIST /end DAQ_EVENT
 /end IF_DATA
/end MEASUREMENT
/begin MEASUREMENT Epm_dnEngFlt "Filtered engine speed gradient calculated over current crankshaft-segment (S0-S0 oder S1-S1)" SWORD EngNGrd 1 100 -16384.00 16383.50 FORMAT "%8.2" ECU_ADDRESS 0x40005DA6
 /begin IF_DATA XCPplus 0x0102
  /begin DAQ_EVENT VARIABLE /begin AVAILABLE_EVENT_LIST EVENT 0 EVENT 1 EVENT 2 EVENT 3 /end AVAILABLE_EVENT_LIST /begin DEFAULT_EVENT_LIST EVENT 0 /end DEFAULT_EVENT_LIST /end DAQ_EVENT
 /end IF_DATA
/end MEASUREMENT
/begin MEASUREMENT Epm_dnEngSma "Simple moving average of speed gradient of last one working cycle." SLONG EngNGrd 1 100 -1073741824.00 1073741823.50 FORMAT "%13.2" ECU_ADDRESS 0x400048D0
 /begin IF_DATA XCPplus 0x0102
  /begin DAQ_EVENT VARIABLE /begin AVAILABLE_EVENT_LIST EVENT 0 EVENT 1 EVENT 2 EVENT 3 /end AVAILABLE_EVENT_LIST /begin DEFAULT_EVENT_LIST EVENT 0 /end DEFAULT_EVENT_LIST /end DAQ_EVENT
 /end IF_DATA
/end MEASUREMENT
/begin MEASUREMENT Epm_idxCntrFirstWcy "Internal index for speed gradient moving average calculation" UBYTE OneToOne 1 100 0.00 255.0 FORMAT "%5.1" ECU_ADDRESS 0x400062A9
 /begin IF_DATA XCPplus 0x0102
  /begin DAQ_EVENT VARIABLE /begin AVAILABLE_EVENT_LIST EVENT 0 EVENT 1 EVENT 2 EVENT 3 /end AVAILABLE_EVENT_LIST /begin DEFAULT_EVENT_LIST EVENT 0 /end DEFAULT_EVENT_LIST /end DAQ_EVENT
 /end IF_DATA
/end MEASUREMENT
/begin MEASUREMENT Epm_idxCntrMax "Internal index for speed gradient moving average calculation" UBYTE OneToOne 1 100 0.00 255.0 FORMAT "%5.1" ECU_ADDRESS 0x400062A8
 /begin IF_DATA XCPplus 0x0102
  /begin DAQ_EVENT VARIABLE /begin AVAILABLE_EVENT_LIST EVENT 0 EVENT 1 EVENT 2 EVENT 3 /end AVAILABLE_EVENT_LIST /begin DEFAULT_EVENT_LIST EVENT 0 /end DEFAULT_EVENT_LIST /end DAQ_EVENT
 /end IF_DATA
/end MEASUREMENT
/begin MEASUREMENT Epm_idxCntrSma "Internal index for speed gradient moving average calculation" UBYTE OneToOne 1 100 0.00 255.0 FORMAT "%5.1" ECU_ADDRESS 0x400062A7
 /begin IF_DATA XCPplus 0x0102
  /begin DAQ_EVENT VARIABLE /begin AVAILABLE_EVENT_LIST EVENT 0 EVENT 1 EVENT 2 EVENT 3 /end AVAILABLE_EVENT_LIST /begin DEFAULT_EVENT_LIST EVENT 0 /end DEFAULT_EVENT_LIST /end DAQ_EVENT
 /end IF_DATA
/end MEASUREMENT
/begin MEASUREMENT Epm_nEng "Average engine speed of one cylinder segment" SWORD EngN 1 100 -16384.00 16383.50 FORMAT "%8.2" ECU_ADDRESS 0x40005DA2
 /begin IF_DATA XCPplus 0x0102
  /begin DAQ_EVENT VARIABLE /begin AVAILABLE_EVENT_LIST EVENT 0 EVENT 1 EVENT 2 EVENT 3 /end AVAILABLE_EVENT_LIST /begin DEFAULT_EVENT_LIST EVENT 0 /end DEFAULT_EVENT_LIST /end DAQ_EVENT
 /end IF_DATA
/end MEASUREMENT
/begin MEASUREMENT Epm_nEng10ms "engine speed calculated in 10ms" SWORD EngN 1 100 -16384.00 16383.50 FORMAT "%8.2" ECU_ADDRESS 0x40005DA4
 /begin IF_DATA XCPplus 0x0102
  /begin DAQ_EVENT VARIABLE /begin AVAILABLE_EVENT_LIST EVENT 0 EVENT 1 EVENT 2 EVENT 3 /end AVAILABLE_EVENT_LIST /begin DEFAULT_EVENT_LIST EVENT 1 /end DEFAULT_EVENT_LIST /end DAQ_EVENT
 /end IF_DATA
/end MEASUREMENT
/begin MEASUREMENT Epm_nEngCurr "engine speed for half cylinder segment" SWORD EngN 1 100 -16384.00 16383.50 FORMAT "%8.2" ECU_ADDRESS 0x40005DA0
 /begin IF_DATA XCPplus 0x0102
  /begin DAQ_EVENT VARIABLE /begin AVAILABLE_EVENT_LIST EVENT 0 EVENT 1 EVENT 2 EVENT 3 /end AVAILABLE_EVENT_LIST /begin DEFAULT_EVENT_LIST EVENT 0 /end DEFAULT_EVENT_LIST /end DAQ_EVENT
 /end IF_DATA
/end MEASUREMENT
/begin MEASUREMENT Epm_nEngDiff "Difference fo enginespeeds calculated over current crankshaft-segment (S0-S0 oder S1-S1)" SWORD EngN 1 100 -16384.00 16383.50 FORMAT "%8.2" ECU_ADDRESS 0x40005C42
 /begin IF_DATA XCPplus 0x0102
  /begin DAQ_EVENT VARIABLE /begin AVAILABLE_EVENT_LIST EVENT 0 EVENT 1 EVENT 2 EVENT 3 /end AVAILABLE_EVENT_LIST /begin DEFAULT_EVENT_LIST EVENT 0 /end DEFAULT_EVENT_LIST /end DAQ_EVENT
 /end IF_DATA
/end MEASUREMENT
/begin MEASUREMENT Epm_nEngInc10ms "One tooth engine speed" SWORD EngN 1 100 -16384.00 16383.50 FORMAT "%8.2" ECU_ADDRESS 0x40005D9E
 /begin IF_DATA XCPplus 0x0102
  /begin DAQ_EVENT VARIABLE /begin AVAILABLE_EVENT_LIST EVENT 0 EVENT 1 EVENT 2 EVENT 3 /end AVAILABLE_EVENT_LIST /begin DEFAULT_EVENT_LIST EVENT 1 /end DEFAULT_EVENT_LIST /end DAQ_EVENT
 /end IF_DATA
/end MEASUREMENT
/begin MEASUREMENT Epm_nEngLRes "engine speed with low resolution" UBYTE EngN_LRes 1 100 0.00 10200. FORMAT "%5.0" ECU_ADDRESS 0x400063D3
 /begin IF_DATA XCPplus 0x0102
  /begin DAQ_EVENT VARIABLE /begin AVAILABLE_EVENT_LIST EVENT 0 EVENT 1 EVENT 2 EVENT 3 /end AVAILABLE_EVENT_LIST /begin DEFAULT_EVENT_LIST EVENT 1 /end DEFAULT_EVENT_LIST /end DAQ_EVENT
 /end IF_DATA
/end MEASUREMENT
/begin MEASUREMENT Epm_nEngOld "Engine speed of last S0 and Virtual Synchros" SWORD EngN 1 100 -16384.00 16383.50 FORMAT "%8.2" ARRAY_SIZE 4 ECU_ADDRESS 0x40005C44
 /begin IF_DATA XCPplus 0x0102
  /begin DAQ_EVENT VARIABLE /begin AVAILABLE_EVENT_LIST EVENT 0 EVENT 1 EVENT 2 EVENT 3 /end AVAILABLE_EVENT_LIST /begin DEFAULT_EVENT_LIST EVENT 0 /end DEFAULT_EVENT_LIST /end DAQ_EVENT
 /end IF_DATA
/end MEASUREMENT
/begin MEASUREMENT Epm_nEngRaw "Raw engine speed for OBD" SWORD EngN 1 100 -16384.00 16383.50 FORMAT "%8.2" ECU_ADDRESS 0x40005D9C
 /begin IF_DATA XCPplus 0x0102
  /begin DAQ_EVENT VARIABLE /begin AVAILABLE_EVENT_LIST EVENT 0 EVENT 1 EVENT 2 EVENT 3 /end AVAILABLE_EVENT_LIST /begin DEFAULT_EVENT_LIST EVENT 3 /end DEFAULT_EVENT_LIST /end DAQ_EVENT
 /end IF_DATA
/end MEASUREMENT
/begin MEASUREMENT Epm_nEngSeg180 "engine speed for 180 degree segment" SWORD EngN 1 100 -16384.00 16383.50 FORMAT "%8.2" ECU_ADDRESS 0x40005D9A
 /begin IF_DATA XCPplus 0x0102
  /begin DAQ_EVENT VARIABLE /begin AVAILABLE_EVENT_LIST EVENT 0 EVENT 1 EVENT 2 EVENT 3 /end AVAILABLE_EVENT_LIST /begin DEFAULT_EVENT_LIST EVENT 0 /end DEFAULT_EVENT_LIST /end DAQ_EVENT
 /end IF_DATA
/end MEASUREMENT
/begin MEASUREMENT Epm_nEngTooth10ms "engine speed from 6 tooth periods, calculated all 10ms" SWORD EngN 1 100 -16384.00 16383.50 FORMAT "%8.2" ECU_ADDRESS 0x40005D98
 /begin IF_DATA XCPplus 0x0102
  /begin DAQ_EVENT VARIABLE /begin AVAILABLE_EVENT_LIST EVENT 0 EVENT 1 EVENT 2 EVENT 3 /end AVAILABLE_EVENT_LIST /begin DEFAULT_EVENT_LIST EVENT 1 /end DEFAULT_EVENT_LIST /end DAQ_EVENT
 /end IF_DATA
/end MEASUREMENT
/begin MEASUREMENT Epm_numCyl "Real number of cylinder" UBYTE OneToOne 1 100 0.00 255.0 FORMAT "%5.1" ECU_ADDRESS 0x400063D2 /end MEASUREMENT
/begin MEASUREMENT Epm_numCylInt "Number of cylinder." UBYTE OneToOne 1 100 0.00 255.0 FORMAT "%5.1" ECU_ADDRESS 0x400062AA /end MEASUREMENT
/begin MEASUREMENT Epm_phiCyl "Absolut angle of the combustion TDCs" SWORD AngleCrS 1 100 -720.0000 719.9780 FORMAT "%8.4" ARRAY_SIZE 1 ECU_ADDRESS 0x40005C4E /end MEASUREMENT
/begin MEASUREMENT Epm_phiDiffTDC "distance between two cylinders" SWORD AngleCrS 1 100 -720.0000 719.9780 FORMAT "%8.4" ECU_ADDRESS 0x40005D96 /end MEASUREMENT
/begin MEASUREMENT Epm_phiIntDelay_mp "angle difference between set and actual position of syncro interrupt" SWORD AngleCrS 1 100 -720.0000 719.9780 FORMAT "%8.4" ECU_ADDRESS 0x40009D78
 /begin IF_DATA XCPplus 0x0102
  /begin DAQ_EVENT VARIABLE /begin AVAILABLE_EVENT_LIST EVENT 0 EVENT 1 EVENT 2 EVENT 3 /end AVAILABLE_EVENT_LIST /begin DEFAULT_EVENT_LIST EVENT 0 /end DEFAULT_EVENT_LIST /end DAQ_EVENT
 /end IF_DATA
/end MEASUREMENT
/begin MEASUREMENT Epm_stOpMode "state of EPM (Engine Position Management) operation mode" UBYTE Epm_stOpMode_State_t 1 100 1.00000000000 60.0000000000 FORMAT "%13.10" ECU_ADDRESS 0x400063D1
 /begin IF_DATA XCPplus 0x0102
  /begin DAQ_EVENT VARIABLE /begin AVAILABLE_EVENT_LIST EVENT 0 EVENT 1 EVENT 2 EVENT 3 /end AVAILABLE_EVENT_LIST /begin DEFAULT_EVENT_LIST EVENT 0 /end DEFAULT_EVENT_LIST /end DAQ_EVENT
 /end IF_DATA
/end MEASUREMENT
/begin MEASUREMENT Epm_stSpd "Selection of engine speed" UBYTE Epm_stSpd_t 1 100 0.00 4.00000000000 FORMAT "%13.11" ECU_ADDRESS 0x400063D0
 /begin IF_DATA XCPplus 0x0102
  /begin DAQ_EVENT VARIABLE /begin AVAILABLE_EVENT_LIST EVENT 0 EVENT 1 EVENT 2 EVENT 3 /end AVAILABLE_EVENT_LIST /begin DEFAULT_EVENT_LIST EVENT 1 /end DEFAULT_EVENT_LIST /end DAQ_EVENT
 /end IF_DATA
/end MEASUREMENT
/begin MEASUREMENT Epm_tiSpd2Zero "Timeout timer until engine speed will set to zero" UWORD Time_ms 1 100 0.00 655350.0 FORMAT "%8.1" ECU_ADDRESS 0x40005C4C
 /begin IF_DATA XCPplus 0x0102
  /begin DAQ_EVENT VARIABLE /begin AVAILABLE_EVENT_LIST EVENT 0 EVENT 1 EVENT 2 EVENT 3 /end AVAILABLE_EVENT_LIST /begin DEFAULT_EVENT_LIST EVENT 1 /end DEFAULT_EVENT_LIST /end DAQ_EVENT
 /end IF_DATA
/end MEASUREMENT
/begin MEASUREMENT ESC_tiSampling "Sampling time" SLONG Per_Dur 1 100 -2147483648.00 2147483647.00 FORMAT "%13.2" ECU_ADDRESS 0x4000475C /end MEASUREMENT
/begin MEASUREMENT ESC_tiSampling_s "Sampling time in Seconds" SLONG Time_Dt 1 100 -2147.48364800 2147.48364700 FORMAT "%13.8" ECU_ADDRESS 0x40004758 /end MEASUREMENT
/begin MEASUREMENT fbakl_w "factor short/long time part of trans.control during acceleration" SWORD fak_sw_b256 1 100 0.00 255.9922 FORMAT "%8.4" ECU_ADDRESS 0x40008536
 /begin IF_DATA XCPplus 0x0102
  /begin DAQ_EVENT VARIABLE /begin AVAILABLE_EVENT_LIST EVENT 0 EVENT 1 EVENT 2 EVENT 3 /end AVAILABLE_EVENT_LIST /begin DEFAULT_EVENT_LIST EVENT 1 /end DEFAULT_EVENT_LIST /end DAQ_EVENT
 /end IF_DATA
/end MEASUREMENT
/begin MEASUREMENT fbans "post cranking factor of transient control during acceleration" UBYTE fak_ub_b8 1 100 0.00 7.969 FORMAT "%5.3" ECU_ADDRESS 0x4000895A
 /begin IF_DATA XCPplus 0x0102
  /begin DAQ_EVENT VARIABLE /begin AVAILABLE_EVENT_LIST EVENT 0 EVENT 1 EVENT 2 EVENT 3 /end AVAILABLE_EVENT_LIST /begin DEFAULT_EVENT_LIST EVENT 2 /end DEFAULT_EVENT_LIST /end DAQ_EVENT
 /end IF_DATA
/end MEASUREMENT
/begin MEASUREMENT fbansini_w "initial value of transient control post cranking factor" UWORD fak_uw_b8 1 100 0.00 7.999878 FORMAT "%8.6" ECU_ADDRESS 0x40008532
 /begin IF_DATA XCPplus 0x0102
  /begin DAQ_EVENT VARIABLE /begin AVAILABLE_EVENT_LIST EVENT 0 EVENT 1 EVENT 2 EVENT 3 /end AVAILABLE_EVENT_LIST /begin DEFAULT_EVENT_LIST EVENT 3 /end DEFAULT_EVENT_LIST /end DAQ_EVENT
 /end IF_DATA
/end MEASUREMENT
/begin MEASUREMENT fukkl_w "factor short/long time part of transient control" SWORD fak_sw_b256 1 100 -256.0000 255.9922 FORMAT "%8.4" ECU_ADDRESS 0x4000854A
 /begin IF_DATA XCPplus 0x0102
  /begin DAQ_EVENT VARIABLE /begin AVAILABLE_EVENT_LIST EVENT 0 EVENT 1 EVENT 2 EVENT 3 /end AVAILABLE_EVENT_LIST /begin DEFAULT_EVENT_LIST EVENT 0 /end DEFAULT_EVENT_LIST /end DAQ_EVENT
 /end IF_DATA
/end MEASUREMENT
/begin MEASUREMENT fvakl_w "factor short/long-time part of trans.control at deceleration" SWORD fak_sw_b256 1 100 0.00 255.9922 FORMAT "%8.4" ECU_ADDRESS 0x40008538
 /begin IF_DATA XCPplus 0x0102
  /begin DAQ_EVENT VARIABLE /begin AVAILABLE_EVENT_LIST EVENT 0 EVENT 1 EVENT 2 EVENT 3 /end AVAILABLE_EVENT_LIST /begin DEFAULT_EVENT_LIST EVENT 1 /end DEFAULT_EVENT_LIST /end DAQ_EVENT
 /end IF_DATA
/end MEASUREMENT
/begin MEASUREMENT fvans "post cranking factor of transient control during deceleration" UBYTE fak_ub_b8 1 100 0.00 7.969 FORMAT "%5.3" ECU_ADDRESS 0x4000895B
 /begin IF_DATA XCPplus 0x0102
  /begin DAQ_EVENT VARIABLE /begin AVAILABLE_EVENT_LIST EVENT 0 EVENT 1 EVENT 2 EVENT 3 /end AVAILABLE_EVENT_LIST /begin DEFAULT_EVENT_LIST EVENT 2 /end DEFAULT_EVENT_LIST /end DAQ_EVENT
 /end IF_DATA
/end MEASUREMENT
/begin MEASUREMENT HEGO_riAvgS1B1_Ary "Array used for averaging internal resistor" UWORD r_uw_q2 1 100 0.00 131070.0 FORMAT "%8.1" ARRAY_SIZE 3 ECU_ADDRESS 0x400085BC /end MEASUREMENT
/begin MEASUREMENT HEGO_riAvgS2B1_Ary "Array used for averaging internal resistor (downstream)" UWORD r_uw_q2 1 100 0.00 131070.0 FORMAT "%8.1" ARRAY_SIZE 3 ECU_ADDRESS 0x400085A6 /end MEASUREMENT
/begin MEASUREMENT IntkAirT_flgAirFltDsSRCMaxErr "flag to indicate SRC Max error for intake air temperature sensor after air filter" UBYTE B_TRUE 1 100 0.00 1.00000000000 BIT_MASK 0x1 FORMAT "%13.11" ECU_ADDRESS 0x4000871A
 /begin IF_DATA XCPplus 0x0102
  /begin DAQ_EVENT VARIABLE /begin AVAILABLE_EVENT_LIST EVENT 0 EVENT 1 EVENT 2 EVENT 3 /end AVAILABLE_EVENT_LIST /begin DEFAULT_EVENT_LIST EVENT 2 /end DEFAULT_EVENT_LIST /end DAQ_EVENT
 /end IF_DATA
/end MEASUREMENT
/begin MEASUREMENT IntkAirT_flgAirFltDsSRCMaxHeal "flag to indicate SRC Max heal for intake air temperature sensor after air filter" UBYTE B_TRUE 1 100 0.00 1.00000000000 BIT_MASK 0x1 FORMAT "%13.11" ECU_ADDRESS 0x40008719
 /begin IF_DATA XCPplus 0x0102
  /begin DAQ_EVENT VARIABLE /begin AVAILABLE_EVENT_LIST EVENT 0 EVENT 1 EVENT 2 EVENT 3 /end AVAILABLE_EVENT_LIST /begin DEFAULT_EVENT_LIST EVENT 2 /end DEFAULT_EVENT_LIST /end DAQ_EVENT
 /end IF_DATA
/end MEASUREMENT
/begin MEASUREMENT IntkAirT_flgAirFltDsSRCMinErr "flag to indicate SRC Min error for intake air temperature sensor after air filter" UBYTE B_TRUE 1 100 0.00 1.00000000000 BIT_MASK 0x1 FORMAT "%13.11" ECU_ADDRESS 0x40008718
 /begin IF_DATA XCPplus 0x0102
  /begin DAQ_EVENT VARIABLE /begin AVAILABLE_EVENT_LIST EVENT 0 EVENT 1 EVENT 2 EVENT 3 /end AVAILABLE_EVENT_LIST /begin DEFAULT_EVENT_LIST EVENT 2 /end DEFAULT_EVENT_LIST /end DAQ_EVENT
 /end IF_DATA
/end MEASUREMENT
/begin MEASUREMENT IntkAirT_flgAirFltDsSRCMinHeal "flag to indicate SRC Min heal for intake air temperature sensor after air filter" UBYTE B_TRUE 1 100 0.00 1.00000000000 BIT_MASK 0x1 FORMAT "%13.11" ECU_ADDRESS 0x40008717
 /begin IF_DATA XCPplus 0x0102
  /begin DAQ_EVENT VARIABLE /begin AVAILABLE_EVENT_LIST EVENT 0 EVENT 1 EVENT 2 EVENT 3 /end AVAILABLE_EVENT_LIST /begin DEFAULT_EVENT_LIST EVENT 2 /end DEFAULT_EVENT_LIST /end DAQ_EVENT
 /end IF_DATA
/end MEASUREMENT
/begin MEASUREMENT IntkAirT_flgAirFltDsSTCEna "flag to indicate stuck-check enable for intake air temperature sensor after air filter" UBYTE B_TRUE 1 100 0.00 1.00000000000 BIT_MASK 0x1 FORMAT "%13.11" ECU_ADDRESS 0x400062A5
 /begin IF_DATA XCPplus 0x0102
  /begin DAQ_EVENT VARIABLE /begin AVAILABLE_EVENT_LIST EVENT 0 EVENT 1 EVENT 2 EVENT 3 /end AVAILABLE_EVENT_LIST /begin DEFAULT_EVENT_LIST EVENT 2 /end DEFAULT_EVENT_LIST /end DAQ_EVENT
 /end IF_DATA
/end MEASUREMENT
/begin MEASUREMENT IntkAirT_flgAirFltDsSTCErr "flag to indicate stuck-check error for intake air temperature sensor after air filter" UBYTE B_TRUE 1 100 0.00 1.00000000000 BIT_MASK 0x1 FORMAT "%13.11" ECU_ADDRESS 0x400062A4
 /begin IF_DATA XCPplus 0x0102
  /begin DAQ_EVENT VARIABLE /begin AVAILABLE_EVENT_LIST EVENT 0 EVENT 1 EVENT 2 EVENT 3 /end AVAILABLE_EVENT_LIST /begin DEFAULT_EVENT_LIST EVENT 2 /end DEFAULT_EVENT_LIST /end DAQ_EVENT
 /end IF_DATA
/end MEASUREMENT
/begin MEASUREMENT IntkAirT_flgAirFltDsSTCHeal "flag to indicate stuck-check heal for intake air temperature sensor after air filter" UBYTE B_TRUE 1 100 0.00 1.00000000000 BIT_MASK 0x1 FORMAT "%13.11" ECU_ADDRESS 0x400062A3
 /begin IF_DATA XCPplus 0x0102
  /begin DAQ_EVENT VARIABLE /begin AVAILABLE_EVENT_LIST EVENT 0 EVENT 1 EVENT 2 EVENT 3 /end AVAILABLE_EVENT_LIST /begin DEFAULT_EVENT_LIST EVENT 2 /end DEFAULT_EVENT_LIST /end DAQ_EVENT
 /end IF_DATA
/end MEASUREMENT
/begin MEASUREMENT IntkAirT_flgAirFltDsSTCRiseNr "flag to indicate stuck-check IUMPR numerator release for intake air temperature sensor after air filter" UBYTE B_TRUE 1 100 0.00 1.00000000000 BIT_MASK 0x1 FORMAT "%13.11" ECU_ADDRESS 0x400062A2
 /begin IF_DATA XCPplus 0x0102
  /begin DAQ_EVENT VARIABLE /begin AVAILABLE_EVENT_LIST EVENT 0 EVENT 1 EVENT 2 EVENT 3 /end AVAILABLE_EVENT_LIST /begin DEFAULT_EVENT_LIST EVENT 2 /end DEFAULT_EVENT_LIST /end DAQ_EVENT
 /end IF_DATA
/end MEASUREMENT
/begin MEASUREMENT IntkAirT_flgEngWrmUpAirFltDsSTC "flag to indicate engine warm-up for stuck-check intake air temperature sensor after air filter" UBYTE B_TRUE 1 100 0.00 1.00000000000 BIT_MASK 0x1 FORMAT "%13.11" ECU_ADDRESS 0x400062A1
 /begin IF_DATA XCPplus 0x0102
  /begin DAQ_EVENT VARIABLE /begin AVAILABLE_EVENT_LIST EVENT 0 EVENT 1 EVENT 2 EVENT 3 /end AVAILABLE_EVENT_LIST /begin DEFAULT_EVENT_LIST EVENT 2 /end DEFAULT_EVENT_LIST /end DAQ_EVENT
 /end IF_DATA
/end MEASUREMENT
/begin MEASUREMENT IntkAirT_mAirIntegAirFltDsSTCloc "local air mass integrator value for stuck-check intake air temperature sensor after air filter" UWORD m_uw_b23p3 1 100 0.00 23.30133 FORMAT "%8.5" ECU_ADDRESS 0x40005C3E
 /begin IF_DATA XCPplus 0x0102
  /begin DAQ_EVENT VARIABLE /begin AVAILABLE_EVENT_LIST EVENT 0 EVENT 1 EVENT 2 EVENT 3 /end AVAILABLE_EVENT_LIST /begin DEFAULT_EVENT_LIST EVENT 2 /end DEFAULT_EVENT_LIST /end DAQ_EVENT
 /end IF_DATA
/end MEASUREMENT
/begin MEASUREMENT IntkAirT_tMaxAirFltDsSTC "maximum temperature in current driving cycle for stuck-check intake air temperature sensor after air filter" SWORD Temp_Cels 1 100 -3549.940 3003.560 FORMAT "%8.3" ECU_ADDRESS 0x40005C3C
 /begin IF_DATA XCPplus 0x0102
  /begin DAQ_EVENT VARIABLE /begin AVAILABLE_EVENT_LIST EVENT 0 EVENT 1 EVENT 2 EVENT 3 /end AVAILABLE_EVENT_LIST /begin DEFAULT_EVENT_LIST EVENT 2 /end DEFAULT_EVENT_LIST /end DAQ_EVENT
 /end IF_DATA
/end MEASUREMENT
/begin MEASUREMENT IntkAirT_tMinAirFltDsSTC "minimum temperature in current driving cycle for stuck-check intake air temperature sensor after air filter" SWORD Temp_Cels 1 100 -3549.940 3003.560 FORMAT "%8.3" ECU_ADDRESS 0x40005C3A
 /begin IF_DATA XCPplus 0x0102
  /begin DAQ_EVENT VARIABLE /begin AVAILABLE_EVENT_LIST EVENT 0 EVENT 1 EVENT 2 EVENT 3 /end AVAILABLE_EVENT_LIST /begin DEFAULT_EVENT_LIST EVENT 2 /end DEFAULT_EVENT_LIST /end DAQ_EVENT
 /end IF_DATA
/end MEASUREMENT
/begin MEASUREMENT msllss_w "desired air mass flow through idle speed actuator (word)" UWORD m_uw_b655p35 1 100 0.00 655.3500 FORMAT "%8.4" ECU_ADDRESS 0x4000855E
 /begin IF_DATA XCPplus 0x0102
  /begin DAQ_EVENT VARIABLE /begin AVAILABLE_EVENT_LIST EVENT 0 EVENT 1 EVENT 2 EVENT 3 /end AVAILABLE_EVENT_LIST /begin DEFAULT_EVENT_LIST EVENT 1 /end DEFAULT_EVENT_LIST /end DAQ_EVENT
 /end IF_DATA
/end MEASUREMENT
/begin MEASUREMENT msndkhfq_w "standard mass flow through throttle valve based on main charge sensor (increased resolution)" UWORD m_uw_b655p35 1 100 0.00 655.3500 FORMAT "%8.4" ECU_ADDRESS 0x40008570
 /begin IF_DATA XCPplus 0x0102
  /begin DAQ_EVENT VARIABLE /begin AVAILABLE_EVENT_LIST EVENT 0 EVENT 1 EVENT 2 EVENT 3 /end AVAILABLE_EVENT_LIST /begin DEFAULT_EVENT_LIST EVENT 0 /end DEFAULT_EVENT_LIST /end DAQ_EVENT
 /end IF_DATA
/end MEASUREMENT
/begin MEASUREMENT nllscorrd_w "Predictive method corrected engine speed for more stable idle set position calc." UWORD nmot_uw_q0p25 1 100 0.00 16383.75 FORMAT "%8.2" ECU_ADDRESS 0x40008562
 /begin IF_DATA XCPplus 0x0102
  /begin DAQ_EVENT VARIABLE /begin AVAILABLE_EVENT_LIST EVENT 0 EVENT 1 EVENT 2 EVENT 3 /end AVAILABLE_EVENT_LIST /begin DEFAULT_EVENT_LIST EVENT 1 /end DEFAULT_EVENT_LIST /end DAQ_EVENT
 /end IF_DATA
/end MEASUREMENT
/begin MEASUREMENT nmot "Low resolution Engine speed" UBYTE nmot_ub_q40 1 100 0.00 10200. FORMAT "%5.0" ECU_ADDRESS 0x4000894F
 /begin IF_DATA XCPplus 0x0102
  /begin DAQ_EVENT VARIABLE /begin AVAILABLE_EVENT_LIST EVENT 0 EVENT 1 EVENT 2 EVENT 3 /end AVAILABLE_EVENT_LIST /begin DEFAULT_EVENT_LIST EVENT 1 /end DEFAULT_EVENT_LIST /end DAQ_EVENT
 /end IF_DATA
/end MEASUREMENT
/begin MEASUREMENT nmotbuf_w "engine speed buffer for a working cycle" UWORD nmot_uw_q0p25 1 100 0.00 16383.75 FORMAT "%8.2" ARRAY_SIZE 4 ECU_ADDRESS 0x40008524
 /begin IF_DATA XCPplus 0x0102
  /begin DAQ_EVENT VARIABLE /begin AVAILABLE_EVENT_LIST EVENT 0 EVENT 1 EVENT 2 EVENT 3 /end AVAILABLE_EVENT_LIST /begin DEFAULT_EVENT_LIST EVENT 0 /end DEFAULT_EVENT_LIST /end DAQ_EVENT
 /end IF_DATA
/end MEASUREMENT
/begin MEASUREMENT nmotfihy_w "filtered and hysterized engine speed" UWORD nmot_uw_q0p25 1 100 0.00 16383.75 FORMAT "%8.2" ECU_ADDRESS 0x40005D84
 /begin IF_DATA XCPplus 0x0102
  /begin DAQ_EVENT VARIABLE /begin AVAILABLE_EVENT_LIST EVENT 0 EVENT 1 EVENT 2 EVENT 3 /end AVAILABLE_EVENT_LIST /begin DEFAULT_EVENT_LIST EVENT 1 /end DEFAULT_EVENT_LIST /end DAQ_EVENT
 /end IF_DATA
/end MEASUREMENT
/begin MEASUREMENT nmotfz_w "update of engine speed in 10ms raster" UWORD nmot_uw_q0p25 1 100 0.00 16383.75 FORMAT "%8.2" ECU_ADDRESS 0x4000855C
 /begin IF_DATA XCPplus 0x0102
  /begin DAQ_EVENT VARIABLE /begin AVAILABLE_EVENT_LIST EVENT 0 EVENT 1 EVENT 2 EVENT 3 /end AVAILABLE_EVENT_LIST /begin DEFAULT_EVENT_LIST EVENT 1 /end DEFAULT_EVENT_LIST /end DAQ_EVENT
 /end IF_DATA
/end MEASUREMENT
/begin MEASUREMENT nmotgas_w "engine speed gradient over a working cycle" SWORD nmot_uw_q0p25 1 100 -8192.000 8191.750 FORMAT "%8.3" ECU_ADDRESS 0x4000851E
 /begin IF_DATA XCPplus 0x0102
  /begin DAQ_EVENT VARIABLE /begin AVAILABLE_EVENT_LIST EVENT 0 EVENT 1 EVENT 2 EVENT 3 /end AVAILABLE_EVENT_LIST /begin DEFAULT_EVENT_LIST EVENT 0 /end DEFAULT_EVENT_LIST /end DAQ_EVENT
 /end IF_DATA
/end MEASUREMENT
/begin MEASUREMENT nmotgfil "filtered engine speed gradient over a working cycle" SBYTE n_q1 1 100 -128.0 127.0 FORMAT "%5.1" ECU_ADDRESS 0x4000894E
 /begin IF_DATA XCPplus 0x0102
  /begin DAQ_EVENT VARIABLE /begin AVAILABLE_EVENT_LIST EVENT 0 EVENT 1 EVENT 2 EVENT 3 /end AVAILABLE_EVENT_LIST /begin DEFAULT_EVENT_LIST EVENT 1 /end DEFAULT_EVENT_LIST /end DAQ_EVENT
 /end IF_DATA
/end MEASUREMENT
/begin MEASUREMENT nmotgfil_w "filtered engine speed gradient over a working cycle" SWORD nmot_sw_q0p25 1 100 -8192.000 8191.750 FORMAT "%8.3" ECU_ADDRESS 0x4000851C
 /begin IF_DATA XCPplus 0x0102
  /begin DAQ_EVENT VARIABLE /begin AVAILABLE_EVENT_LIST EVENT 0 EVENT 1 EVENT 2 EVENT 3 /end AVAILABLE_EVENT_LIST /begin DEFAULT_EVENT_LIST EVENT 1 /end DEFAULT_EVENT_LIST /end DAQ_EVENT
 /end IF_DATA
/end MEASUREMENT
/begin MEASUREMENT nmotHysThd_w "Engine Speed Hysterisis-filter calculation" UWORD nmot_uw_q0p25 1 100 0.00 16383.75 FORMAT "%8.2" ECU_ADDRESS 0x40006012
 /begin IF_DATA XCPplus 0x0102
  /begin DAQ_EVENT VARIABLE /begin AVAILABLE_EVENT_LIST EVENT 0 EVENT 1 EVENT 2 EVENT 3 /end AVAILABLE_EVENT_LIST /begin DEFAULT_EVENT_LIST EVENT 1 /end DEFAULT_EVENT_LIST /end DAQ_EVENT
 /end IF_DATA
/end MEASUREMENT
/begin MEASUREMENT nmotll "engine speed" UBYTE nmot_ub_q10 1 100 0.00 2550. FORMAT "%5.0" ECU_ADDRESS 0x4000894D
 /begin IF_DATA XCPplus 0x0102
  /begin DAQ_EVENT VARIABLE /begin AVAILABLE_EVENT_LIST EVENT 0 EVENT 1 EVENT 2 EVENT 3 /end AVAILABLE_EVENT_LIST /begin DEFAULT_EVENT_LIST EVENT 1 /end DEFAULT_EVENT_LIST /end DAQ_EVENT
 /end IF_DATA
/end MEASUREMENT
/begin MEASUREMENT nmotlls_w "Predictive method engine speed for more stable idle set position calc" UWORD nmot_uw_q0p25 1 100 0.00 16383.75 FORMAT "%8.2" ECU_ADDRESS 0x4000855A
 /begin IF_DATA XCPplus 0x0102
  /begin DAQ_EVENT VARIABLE /begin AVAILABLE_EVENT_LIST EVENT 0 EVENT 1 EVENT 2 EVENT 3 /end AVAILABLE_EVENT_LIST /begin DEFAULT_EVENT_LIST EVENT 1 /end DEFAULT_EVENT_LIST /end DAQ_EVENT
 /end IF_DATA
/end MEASUREMENT
/begin MEASUREMENT nmotst "engine speed for start/stop systems" UBYTE nmot_ub_q10 1 100 0.00 2550. FORMAT "%5.0" ECU_ADDRESS 0x4000894C
 /begin IF_DATA XCPplus 0x0102
  /begin DAQ_EVENT VARIABLE /begin AVAILABLE_EVENT_LIST EVENT 0 EVENT 1 EVENT 2 EVENT 3 /end AVAILABLE_EVENT_LIST /begin DEFAULT_EVENT_LIST EVENT 1 /end DEFAULT_EVENT_LIST /end DAQ_EVENT
 /end IF_DATA
/end MEASUREMENT
/begin MEASUREMENT nmotst1t_w "fast engine speed for SSM2 pre engage" UWORD nmot_uw_q0p25 1 100 0.00 16383.75 FORMAT "%8.2" ECU_ADDRESS 0x4000851A
 /begin IF_DATA XCPplus 0x0102
  /begin DAQ_EVENT VARIABLE /begin AVAILABLE_EVENT_LIST EVENT 0 EVENT 1 EVENT 2 EVENT 3 /end AVAILABLE_EVENT_LIST /begin DEFAULT_EVENT_LIST EVENT 1 /end DEFAULT_EVENT_LIST /end DAQ_EVENT
 /end IF_DATA
/end MEASUREMENT
/begin MEASUREMENT nmotz "Engine speed from tooth period during start" UBYTE nmot_q10 1 100 0.00 2550. FORMAT "%5.0" ECU_ADDRESS 0x4000894B
 /begin IF_DATA XCPplus 0x0102
  /begin DAQ_EVENT VARIABLE /begin AVAILABLE_EVENT_LIST EVENT 0 EVENT 1 EVENT 2 EVENT 3 /end AVAILABLE_EVENT_LIST /begin DEFAULT_EVENT_LIST EVENT 1 /end DEFAULT_EVENT_LIST /end DAQ_EVENT
 /end IF_DATA
/end MEASUREMENT
/begin MEASUREMENT nmot_w "Engine speed" UWORD nmot_uw_q0p25 1 100 0.00 16383.75 FORMAT "%8.2" ECU_ADDRESS 0x40008518
 /begin IF_DATA XCPplus 0x0102
  /begin DAQ_EVENT VARIABLE /begin AVAILABLE_EVENT_LIST EVENT 0 EVENT 1 EVENT 2 EVENT 3 /end AVAILABLE_EVENT_LIST /begin DEFAULT_EVENT_LIST EVENT 0 /end DEFAULT_EVENT_LIST /end DAQ_EVENT
 /end IF_DATA
/end MEASUREMENT
/begin MEASUREMENT ollsms_w "desired duty cycle for idle speed actuator after start" UWORD rel_uw_b100 1 100 0.00 99.99847 FORMAT "%8.5" ECU_ADDRESS 0x40008558
 /begin IF_DATA XCPplus 0x0102
  /begin DAQ_EVENT VARIABLE /begin AVAILABLE_EVENT_LIST EVENT 0 EVENT 1 EVENT 2 EVENT 3 /end AVAILABLE_EVENT_LIST /begin DEFAULT_EVENT_LIST EVENT 1 /end DEFAULT_EVENT_LIST /end DAQ_EVENT
 /end IF_DATA
/end MEASUREMENT
/begin MEASUREMENT ollsramp_w "cumulative of duty cycle for idle speed actuator after limiter" UWORD rel_uw_b100 1 100 0.00 99.99847 FORMAT "%8.5" ECU_ADDRESS 0x40008556
 /begin IF_DATA XCPplus 0x0102
  /begin DAQ_EVENT VARIABLE /begin AVAILABLE_EVENT_LIST EVENT 0 EVENT 1 EVENT 2 EVENT 3 /end AVAILABLE_EVENT_LIST /begin DEFAULT_EVENT_LIST EVENT 1 /end DEFAULT_EVENT_LIST /end DAQ_EVENT
 /end IF_DATA
/end MEASUREMENT
/begin MEASUREMENT ollss "desired duty cycle for idle speed actuator" UBYTE rel_ub_b100 1 100 0.00 99.61 FORMAT "%5.2" ECU_ADDRESS 0x4000896A
 /begin IF_DATA XCPplus 0x0102
  /begin DAQ_EVENT VARIABLE /begin AVAILABLE_EVENT_LIST EVENT 0 EVENT 1 EVENT 2 EVENT 3 /end AVAILABLE_EVENT_LIST /begin DEFAULT_EVENT_LIST EVENT 1 /end DEFAULT_EVENT_LIST /end DAQ_EVENT
 /end IF_DATA
/end MEASUREMENT
/begin MEASUREMENT ollssbg_w "desired duty cycle for idle speed actuator after limitation" UWORD rel_uw_b100 1 100 0.00 99.99847 FORMAT "%8.5" ECU_ADDRESS 0x40008554
 /begin IF_DATA XCPplus 0x0102
  /begin DAQ_EVENT VARIABLE /begin AVAILABLE_EVENT_LIST EVENT 0 EVENT 1 EVENT 2 EVENT 3 /end AVAILABLE_EVENT_LIST /begin DEFAULT_EVENT_LIST EVENT 0 /end DEFAULT_EVENT_LIST /end DAQ_EVENT
 /end IF_DATA
/end MEASUREMENT
/begin MEASUREMENT ollssobg_w "desired duty cycle for idle speed actuator without limitation" UWORD rel_uw_b100 1 100 0.00 99.99847 FORMAT "%8.5" ECU_ADDRESS 0x40008560
 /begin IF_DATA XCPplus 0x0102
  /begin DAQ_EVENT VARIABLE /begin AVAILABLE_EVENT_LIST EVENT 0 EVENT 1 EVENT 2 EVENT 3 /end AVAILABLE_EVENT_LIST /begin DEFAULT_EVENT_LIST EVENT 0 /end DEFAULT_EVENT_LIST /end DAQ_EVENT
 /end IF_DATA
/end MEASUREMENT
/begin MEASUREMENT ollsst_w "desired duty cycle for idle speed actuator during start" UWORD rel_uw_b100 1 100 0.00 99.99847 FORMAT "%8.5" ECU_ADDRESS 0x40008552
 /begin IF_DATA XCPplus 0x0102
  /begin DAQ_EVENT VARIABLE /begin AVAILABLE_EVENT_LIST EVENT 0 EVENT 1 EVENT 2 EVENT 3 /end AVAILABLE_EVENT_LIST /begin DEFAULT_EVENT_LIST EVENT 0 /end DEFAULT_EVENT_LIST /end DAQ_EVENT
 /end IF_DATA
/end MEASUREMENT
/begin MEASUREMENT ollss_w "desired duty cycle for idle speed actuator (word)" UWORD rel_uw_b100 1 100 0.00 99.99847 FORMAT "%8.5" ECU_ADDRESS 0x40008550
 /begin IF_DATA XCPplus 0x0102
  /begin DAQ_EVENT VARIABLE /begin AVAILABLE_EVENT_LIST EVENT 0 EVENT 1 EVENT 2 EVENT 3 /end AVAILABLE_EVENT_LIST /begin DEFAULT_EVENT_LIST EVENT 0 /end DEFAULT_EVENT_LIST /end DAQ_EVENT
 /end IF_DATA
/end MEASUREMENT
/begin MEASUREMENT ollstkl_w "map input for desired duty cycle for idle speed actuator (word)" SWORD rel_sw_b100 1 100 -100.0000 99.99695 FORMAT "%8.4" ECU_ADDRESS 0x40008564 /end MEASUREMENT
/begin MEASUREMENT phiOffsOld "old state of EpmSyn_phiOffs" SWORD AngleCrS 1 100 -720.0000 719.9780 FORMAT "%8.4" ECU_ADDRESS 0x40008522
 /begin IF_DATA XCPplus 0x0102
  /begin DAQ_EVENT VARIABLE /begin AVAILABLE_EVENT_LIST EVENT 0 EVENT 1 EVENT 2 EVENT 3 /end AVAILABLE_EVENT_LIST /begin DEFAULT_EVENT_LIST EVENT 0 /end DEFAULT_EVENT_LIST /end DAQ_EVENT
 /end IF_DATA
/end MEASUREMENT
/begin MEASUREMENT PIntkVUs_pRawFast "unfiltered raw value intake manifold pressure sensor" UWORD p_uw_q0p078 1 100 0.00 5119.922 FORMAT "%8.3" ECU_ADDRESS 0x4000858A
 /begin IF_DATA XCPplus 0x0102
  /begin DAQ_EVENT VARIABLE /begin AVAILABLE_EVENT_LIST EVENT 0 EVENT 1 EVENT 2 EVENT 3 /end AVAILABLE_EVENT_LIST /begin DEFAULT_EVENT_LIST EVENT 1 /end DEFAULT_EVENT_LIST /end DAQ_EVENT
 /end IF_DATA
/end MEASUREMENT
/begin MEASUREMENT PIntkVUs_pSigMax "Maximum pressure sampled during engine start for signal stuck check" UWORD p_uw_q0p039 1 100 0.00 2559.961 FORMAT "%8.3" ECU_ADDRESS 0x40008588
 /begin IF_DATA XCPplus 0x0102
  /begin DAQ_EVENT VARIABLE /begin AVAILABLE_EVENT_LIST EVENT 0 EVENT 1 EVENT 2 EVENT 3 /end AVAILABLE_EVENT_LIST /begin DEFAULT_EVENT_LIST EVENT 0 /end DEFAULT_EVENT_LIST /end DAQ_EVENT
 /end IF_DATA
/end MEASUREMENT
/begin MEASUREMENT PIntkVUs_pSigMin "Minimum pressure sampled during engine start for signal stuck check" UWORD p_uw_q0p039 1 100 0.00 2559.961 FORMAT "%8.3" ECU_ADDRESS 0x40008586
 /begin IF_DATA XCPplus 0x0102
  /begin DAQ_EVENT VARIABLE /begin AVAILABLE_EVENT_LIST EVENT 0 EVENT 1 EVENT 2 EVENT 3 /end AVAILABLE_EVENT_LIST /begin DEFAULT_EVENT_LIST EVENT 0 /end DEFAULT_EVENT_LIST /end DAQ_EVENT
 /end IF_DATA
/end MEASUREMENT
/begin MEASUREMENT PIntkVUs_uSigChkMax "Maximum sensor voltage sampled during engine start for signal stuck check" UWORD spg_uw_q0p00488 1 100 0.00 319.9951 FORMAT "%8.4" ECU_ADDRESS 0x4000858E
 /begin IF_DATA XCPplus 0x0102
  /begin DAQ_EVENT VARIABLE /begin AVAILABLE_EVENT_LIST EVENT 0 EVENT 1 EVENT 2 EVENT 3 /end AVAILABLE_EVENT_LIST /begin DEFAULT_EVENT_LIST EVENT 1 /end DEFAULT_EVENT_LIST /end DAQ_EVENT
 /end IF_DATA
/end MEASUREMENT
/begin MEASUREMENT PIntkVUs_uSigChkMin "Minimum sensor voltage sampled during engine start for signal stuck check" UWORD spg_uw_q0p00488 1 100 0.00 319.9951 FORMAT "%8.4" ECU_ADDRESS 0x40008590
 /begin IF_DATA XCPplus 0x0102
  /begin DAQ_EVENT VARIABLE /begin AVAILABLE_EVENT_LIST EVENT 0 EVENT 1 EVENT 2 EVENT 3 /end AVAILABLE_EVENT_LIST /begin DEFAULT_EVENT_LIST EVENT 1 /end DEFAULT_EVENT_LIST /end DAQ_EVENT
 /end IF_DATA
/end MEASUREMENT
/begin MEASUREMENT psdss_w "Intake manifold pressure measured with pressure sensor at manifold (DS-S)" UWORD p_uw_q0p039 1 100 0.00 2559.961 FORMAT "%8.3" ECU_ADDRESS 0x40008584
 /begin IF_DATA XCPplus 0x0102
  /begin DAQ_EVENT VARIABLE /begin AVAILABLE_EVENT_LIST EVENT 0 EVENT 1 EVENT 2 EVENT 3 /end AVAILABLE_EVENT_LIST /begin DEFAULT_EVENT_LIST EVENT 0 /end DEFAULT_EVENT_LIST /end DAQ_EVENT
 /end IF_DATA
/end MEASUREMENT
/begin MEASUREMENT psrgmin_w "min intake manifold pressure (absolute) measured" UWORD p_uw_q0p039 1 100 0.00 2559.961 FORMAT "%8.3" ECU_ADDRESS 0x40008592
 /begin IF_DATA XCPplus 0x0102
  /begin DAQ_EVENT VARIABLE /begin AVAILABLE_EVENT_LIST EVENT 0 EVENT 1 EVENT 2 EVENT 3 /end AVAILABLE_EVENT_LIST /begin DEFAULT_EVENT_LIST EVENT 0 /end DEFAULT_EVENT_LIST /end DAQ_EVENT
 /end IF_DATA
/end MEASUREMENT
/begin MEASUREMENT psrgwind_w "window based measured manifold pressure centre of segment" UWORD p_uw_q0p039 1 100 0.00 2559.961 FORMAT "%8.3" ECU_ADDRESS 0x40008582
 /begin IF_DATA XCPplus 0x0102
  /begin DAQ_EVENT VARIABLE /begin AVAILABLE_EVENT_LIST EVENT 0 EVENT 1 EVENT 2 EVENT 3 /end AVAILABLE_EVENT_LIST /begin DEFAULT_EVENT_LIST EVENT 0 /end DEFAULT_EVENT_LIST /end DAQ_EVENT
 /end IF_DATA
/end MEASUREMENT
/begin MEASUREMENT rinavgh_w "Averaged Internal resistance (word) Ri Nernst, after cat" UWORD r_uw_q2 1 100 0.00 131070.0 FORMAT "%8.1" ECU_ADDRESS 0x40008598 /end MEASUREMENT
/begin MEASUREMENT rinavgv_w "Averaged Internal resistance (word) Ri Nernst, pre cat" UWORD r_uw_q2 1 100 0.00 131070.0 FORMAT "%8.1" ECU_ADDRESS 0x400085AE /end MEASUREMENT
/begin MEASUREMENT rinh_w "Actual value (word) internal res. Ri-Nernst cell lambda sensor downstream cat" UWORD r_uw_q2 1 100 0.00 131070.0 FORMAT "%8.1" ECU_ADDRESS 0x40008596 /end MEASUREMENT
/begin MEASUREMENT rinofha_w "Internal resistor (word) Ri Nernst (old value) without filter, downstream cat" UWORD r_uw_q2 1 100 0.00 131070.0 FORMAT "%8.1" ECU_ADDRESS 0x400085A2 /end MEASUREMENT
/begin MEASUREMENT rinofhh_w "Internal resistance (word) Ri Nernst without filtering downstream catalyst" UWORD r_uw_q2 1 100 0.00 131070.0 FORMAT "%8.1" ECU_ADDRESS 0x400085A4 /end MEASUREMENT
/begin MEASUREMENT rinofh_w "Internal resistance (word) Ri Nernst without filtering downstream catalyst" UWORD r_uw_q2 1 100 0.00 131070.0 FORMAT "%8.1" ECU_ADDRESS 0x400085A0 /end MEASUREMENT
/begin MEASUREMENT rinofva_w "Internal resistor (word) Ri Nernst (old value) without filter , pre cat" UWORD r_uw_q2 1 100 0.00 131070.0 FORMAT "%8.1" ECU_ADDRESS 0x400085B8 /end MEASUREMENT
/begin MEASUREMENT rinofvv_w "Internal resistance (word) Ri Nernst without filter , pre cat (LSF with Pumped Reference)" UWORD r_uw_q2 1 100 0.00 131070.0 FORMAT "%8.1" ECU_ADDRESS 0x400085BA /end MEASUREMENT
/begin MEASUREMENT rinofv_w "Internal resistor (word) Ri Nernst without filter , pre cat" UWORD r_uw_q2 1 100 0.00 131070.0 FORMAT "%8.1" ECU_ADDRESS 0x400085B6 /end MEASUREMENT
/begin MEASUREMENT rinv_w "Actual value of internal resistance of lambda sensor,pre cat (word)" UWORD r_uw_q2 1 100 0.00 131070.0 FORMAT "%8.1" ECU_ADDRESS 0x400085AC /end MEASUREMENT
/begin MEASUREMENT rkukg_w "rel. fuel mass transition compensation" SWORD rel_sw_q0p0468 1 100 -1536.000 1535.953 FORMAT "%8.3" ECU_ADDRESS 0x4000852E
 /begin IF_DATA XCPplus 0x0102
  /begin DAQ_EVENT VARIABLE /begin AVAILABLE_EVENT_LIST EVENT 0 EVENT 1 EVENT 2 EVENT 3 /end AVAILABLE_EVENT_LIST /begin DEFAULT_EVENT_LIST EVENT 0 /end DEFAULT_EVENT_LIST /end DAQ_EVENT
 /end IF_DATA
/end MEASUREMENT
/begin MEASUREMENT rkukk_w "rk short term part of transient control" SWORD rel_sw_q0p0468 1 100 -1536.000 1535.953 FORMAT "%8.3" ECU_ADDRESS 0x4000852C
 /begin IF_DATA XCPplus 0x0102
  /begin DAQ_EVENT VARIABLE /begin AVAILABLE_EVENT_LIST EVENT 0 EVENT 1 EVENT 2 EVENT 3 /end AVAILABLE_EVENT_LIST /begin DEFAULT_EVENT_LIST EVENT 0 /end DEFAULT_EVENT_LIST /end DAQ_EVENT
 /end IF_DATA
/end MEASUREMENT
/begin MEASUREMENT rkukl_w "rk long term part of transient control" SWORD rel_sw_q0p0468 1 100 -1536.000 1535.953 FORMAT "%8.3" ECU_ADDRESS 0x40008544
 /begin IF_DATA XCPplus 0x0102
  /begin DAQ_EVENT VARIABLE /begin AVAILABLE_EVENT_LIST EVENT 0 EVENT 1 EVENT 2 EVENT 3 /end AVAILABLE_EVENT_LIST /begin DEFAULT_EVENT_LIST EVENT 0 /end DEFAULT_EVENT_LIST /end DAQ_EVENT
 /end IF_DATA
/end MEASUREMENT
/begin MEASUREMENT rkuk_w "relative fuel mass transition compensation without adjustment" SWORD rel_sw_q0p0468 1 100 -1536.000 1535.953 FORMAT "%8.3" ECU_ADDRESS 0x40008548
 /begin IF_DATA XCPplus 0x0102
  /begin DAQ_EVENT VARIABLE /begin AVAILABLE_EVENT_LIST EVENT 0 EVENT 1 EVENT 2 EVENT 3 /end AVAILABLE_EVENT_LIST /begin DEFAULT_EVENT_LIST EVENT 0 /end DEFAULT_EVENT_LIST /end DAQ_EVENT
 /end IF_DATA
/end MEASUREMENT
/begin MEASUREMENT rlmin_w "minimum permissible rl" UWORD rel_uw_q0p0234 1 100 0.00 1535.977 FORMAT "%8.3" ECU_ADDRESS 0x4000854E
 /begin IF_DATA XCPplus 0x0102
  /begin DAQ_EVENT VARIABLE /begin AVAILABLE_EVENT_LIST EVENT 0 EVENT 1 EVENT 2 EVENT 3 /end AVAILABLE_EVENT_LIST /begin DEFAULT_EVENT_LIST EVENT 1 /end DEFAULT_EVENT_LIST /end DAQ_EVENT
 /end IF_DATA
/end MEASUREMENT
/begin MEASUREMENT rlsolnmd_w "Desired normalized air charge after torque coordination" UWORD rel_uw_q0p0234 1 100 0.00 1535.977 FORMAT "%8.3" ECU_ADDRESS 0x4000854C
 /begin IF_DATA XCPplus 0x0102
  /begin DAQ_EVENT VARIABLE /begin AVAILABLE_EVENT_LIST EVENT 0 EVENT 1 EVENT 2 EVENT 3 /end AVAILABLE_EVENT_LIST /begin DEFAULT_EVENT_LIST EVENT 1 /end DEFAULT_EVENT_LIST /end DAQ_EVENT
 /end IF_DATA
/end MEASUREMENT
/begin MEASUREMENT s1fl2p11 "Interface for mode $01+$02 absolute throttle position in % supply voltage" UBYTE dez 1 100 0.00 255.0 FORMAT "%5.1" ARRAY_SIZE 2 ECU_ADDRESS 0x4000897C
 /begin IF_DATA XCPplus 0x0102
  /begin DAQ_EVENT VARIABLE /begin AVAILABLE_EVENT_LIST EVENT 0 EVENT 1 EVENT 2 EVENT 3 /end AVAILABLE_EVENT_LIST /begin DEFAULT_EVENT_LIST EVENT 3 /end DEFAULT_EVENT_LIST /end DAQ_EVENT
 /end IF_DATA
/end MEASUREMENT
/begin MEASUREMENT s1fl2p45 "Interface for mode $01+$02 relative throttle position in % supply voltage above learned lower mech. stop" UBYTE dez 1 100 0.00 255.0 FORMAT "%5.1" ARRAY_SIZE 2 ECU_ADDRESS 0x40008978
 /begin IF_DATA XCPplus 0x0102
  /begin DAQ_EVENT VARIABLE /begin AVAILABLE_EVENT_LIST EVENT 0 EVENT 1 EVENT 2 EVENT 3 /end AVAILABLE_EVENT_LIST /begin DEFAULT_EVENT_LIST EVENT 3 /end DEFAULT_EVENT_LIST /end DAQ_EVENT
 /end IF_DATA
/end MEASUREMENT
/begin MEASUREMENT s1fl3p0c "Interface for mode $01+$02 engine speed PID $0C" UBYTE dez 1 100 0.00 255.0 FORMAT "%5.1" ARRAY_SIZE 3 ECU_ADDRESS 0x40008948
 /begin IF_DATA XCPplus 0x0102
  /begin DAQ_EVENT VARIABLE /begin AVAILABLE_EVENT_LIST EVENT 0 EVENT 1 EVENT 2 EVENT 3 /end AVAILABLE_EVENT_LIST /begin DEFAULT_EVENT_LIST EVENT 3 /end DEFAULT_EVENT_LIST /end DAQ_EVENT
 /end IF_DATA
/end MEASUREMENT
/begin MEASUREMENT sdwfk_w "memory content of the wall wetting difference for short term portion" SWORD rel_q0p09375 1 100 -3072.000 3071.906 FORMAT "%8.3" ECU_ADDRESS 0x40008540
 /begin IF_DATA XCPplus 0x0102
  /begin DAQ_EVENT VARIABLE /begin AVAILABLE_EVENT_LIST EVENT 0 EVENT 1 EVENT 2 EVENT 3 /end AVAILABLE_EVENT_LIST /begin DEFAULT_EVENT_LIST EVENT 0 /end DEFAULT_EVENT_LIST /end DAQ_EVENT
 /end IF_DATA
/end MEASUREMENT
/begin MEASUREMENT sdwfl_w "memory content of the wall wetting difference for long term portion" SWORD rel_q0p09375 1 100 -3072.000 3071.906 FORMAT "%8.3" ECU_ADDRESS 0x40008546
 /begin IF_DATA XCPplus 0x0102
  /begin DAQ_EVENT VARIABLE /begin AVAILABLE_EVENT_LIST EVENT 0 EVENT 1 EVENT 2 EVENT 3 /end AVAILABLE_EVENT_LIST /begin DEFAULT_EVENT_LIST EVENT 0 /end DEFAULT_EVENT_LIST /end DAQ_EVENT
 /end IF_DATA
/end MEASUREMENT
/begin MEASUREMENT SidstSwt_stSidstDiagcErr "Bit message introduction updated just like sdstdiagerr (Side stand error status)" UBYTE B_TRUE 1 100 0.00 1.00000000000 BIT_MASK 0x1 FORMAT "%13.11" ECU_ADDRESS 0x4000876E
 /begin IF_DATA XCPplus 0x0102
  /begin DAQ_EVENT VARIABLE /begin AVAILABLE_EVENT_LIST EVENT 0 EVENT 1 EVENT 2 EVENT 3 /end AVAILABLE_EVENT_LIST /begin DEFAULT_EVENT_LIST EVENT 2 /end DEFAULT_EVENT_LIST /end DAQ_EVENT
 /end IF_DATA
/end MEASUREMENT
/begin MEASUREMENT stSyncOld "old state of Epm_stSync" UBYTE dez 1 100 0.00 255.0 FORMAT "%5.1" ECU_ADDRESS 0x40008950
 /begin IF_DATA XCPplus 0x0102
  /begin DAQ_EVENT VARIABLE /begin AVAILABLE_EVENT_LIST EVENT 0 EVENT 1 EVENT 2 EVENT 3 /end AVAILABLE_EVENT_LIST /begin DEFAULT_EVENT_LIST EVENT 0 /end DEFAULT_EVENT_LIST /end DAQ_EVENT
 /end IF_DATA
/end MEASUREMENT
/begin MEASUREMENT synstate "current mode of synchronization" UBYTE dez 1 100 0.00 255.0 FORMAT "%5.1" ECU_ADDRESS 0x40008947
 /begin IF_DATA XCPplus 0x0102
  /begin DAQ_EVENT VARIABLE /begin AVAILABLE_EVENT_LIST EVENT 0 EVENT 1 EVENT 2 EVENT 3 /end AVAILABLE_EVENT_LIST /begin DEFAULT_EVENT_LIST EVENT 0 /end DEFAULT_EVENT_LIST /end DAQ_EVENT
 /end IF_DATA
/end MEASUREMENT
/begin MEASUREMENT tans "intake air temperature" SWORD Temp_Cels 1 100 -3549.940 3003.560 FORMAT "%8.3" ECU_ADDRESS 0x40008F74
 /begin IF_DATA XCPplus 0x0102
  /begin DAQ_EVENT VARIABLE /begin AVAILABLE_EVENT_LIST EVENT 0 EVENT 1 EVENT 2 EVENT 3 /end AVAILABLE_EVENT_LIST /begin DEFAULT_EVENT_LIST EVENT 2 /end DEFAULT_EVENT_LIST /end DAQ_EVENT
 /end IF_DATA
/end MEASUREMENT
/begin MEASUREMENT tanslin "intake air temperature, linearised and calculated" SWORD Temp_Cels 1 100 -3549.940 3003.560 FORMAT "%8.3" ECU_ADDRESS 0x40008F72
 /begin IF_DATA XCPplus 0x0102
  /begin DAQ_EVENT VARIABLE /begin AVAILABLE_EVENT_LIST EVENT 0 EVENT 1 EVENT 2 EVENT 3 /end AVAILABLE_EVENT_LIST /begin DEFAULT_EVENT_LIST EVENT 2 /end DEFAULT_EVENT_LIST /end DAQ_EVENT
 /end IF_DATA
/end MEASUREMENT
/begin MEASUREMENT ThrVlv_stLrngTstrTrig "Status: learning via tester trigger done" UBYTE B_TRUE 1 100 0.00 1.00000000000 BIT_MASK 0x1 FORMAT "%13.11" ECU_ADDRESS 0x4000896C
 /begin IF_DATA XCPplus 0x0102
  /begin DAQ_EVENT VARIABLE /begin AVAILABLE_EVENT_LIST EVENT 0 EVENT 1 EVENT 2 EVENT 3 /end AVAILABLE_EVENT_LIST /begin DEFAULT_EVENT_LIST EVENT 2 /end DEFAULT_EVENT_LIST /end DAQ_EVENT
 /end IF_DATA
/end MEASUREMENT
/begin MEASUREMENT tseg_l "segment cycle time" ULONG t_q0p0001_ms 1 100 0.00 429496.729500 FORMAT "%13.6" ECU_ADDRESS 0x40008E64
 /begin IF_DATA XCPplus 0x0102
  /begin DAQ_EVENT VARIABLE /begin AVAILABLE_EVENT_LIST EVENT 0 EVENT 1 EVENT 2 EVENT 3 /end AVAILABLE_EVENT_LIST /begin DEFAULT_EVENT_LIST EVENT 0 /end DEFAULT_EVENT_LIST /end DAQ_EVENT
 /end IF_DATA
/end MEASUREMENT
/begin MEASUREMENT udsmn_w "Min pressure sensor voltage for a working cycle" UWORD spg_uw_q0p000076 1 100 0.00 4.999924 FORMAT "%8.6" ECU_ADDRESS 0x40008580
 /begin IF_DATA XCPplus 0x0102
  /begin DAQ_EVENT VARIABLE /begin AVAILABLE_EVENT_LIST EVENT 0 EVENT 1 EVENT 2 EVENT 3 /end AVAILABLE_EVENT_LIST /begin DEFAULT_EVENT_LIST EVENT 0 /end DEFAULT_EVENT_LIST /end DAQ_EVENT
 /end IF_DATA
/end MEASUREMENT
/begin MEASUREMENT udsm_w "Pressure sensor voltage averaged via a segment (word)" UWORD spg_uw_q0p000076 1 100 0.00 4.999924 FORMAT "%8.6" ECU_ADDRESS 0x4000857E
 /begin IF_DATA XCPplus 0x0102
  /begin DAQ_EVENT VARIABLE /begin AVAILABLE_EVENT_LIST EVENT 0 EVENT 1 EVENT 2 EVENT 3 /end AVAILABLE_EVENT_LIST /begin DEFAULT_EVENT_LIST EVENT 0 /end DEFAULT_EVENT_LIST /end DAQ_EVENT
 /end IF_DATA
/end MEASUREMENT
/begin MEASUREMENT udssmn1ms_w "Minimum voltage of DSS sensor signal (in 1ms)" UWORD spg_uw_q0p00488 1 100 0.00 319.9951 FORMAT "%8.4" ECU_ADDRESS 0x4000857C
 /begin IF_DATA XCPplus 0x0102
  /begin DAQ_EVENT VARIABLE /begin AVAILABLE_EVENT_LIST EVENT 0 EVENT 1 EVENT 2 EVENT 3 /end AVAILABLE_EVENT_LIST /begin DEFAULT_EVENT_LIST EVENT 0 /end DEFAULT_EVENT_LIST /end DAQ_EVENT
 /end IF_DATA
/end MEASUREMENT
/begin MEASUREMENT uwdkoa_w "adapted upper mechanical limit value for throttle valve" UWORD spg_uw_q0p001222 1 100 0.00 79.99878 FORMAT "%8.5" ECU_ADDRESS 0x4000C6D0
 /begin IF_DATA XCPplus 0x0102
  /begin DAQ_EVENT VARIABLE /begin AVAILABLE_EVENT_LIST EVENT 0 EVENT 1 EVENT 2 EVENT 3 /end AVAILABLE_EVENT_LIST /begin DEFAULT_EVENT_LIST EVENT 2 /end DEFAULT_EVENT_LIST /end DAQ_EVENT
 /end IF_DATA
/end MEASUREMENT
/begin MEASUREMENT uwdkua_w "adapted lower mechanical limit value for throttle valve" UWORD spg_uw_q0p001222 1 100 0.00 79.99878 FORMAT "%8.5" ECU_ADDRESS 0x4000C6CE
 /begin IF_DATA XCPplus 0x0102
  /begin DAQ_EVENT VARIABLE /begin AVAILABLE_EVENT_LIST EVENT 0 EVENT 1 EVENT 2 EVENT 3 /end AVAILABLE_EVENT_LIST /begin DEFAULT_EVENT_LIST EVENT 2 /end DEFAULT_EVENT_LIST /end DAQ_EVENT
 /end IF_DATA
/end MEASUREMENT
/begin MEASUREMENT uzkw_w "revolution counter crankshaft" UWORD dez 1 100 0.00 65535.00 FORMAT "%8.2" ECU_ADDRESS 0x40008516
 /begin IF_DATA XCPplus 0x0102
  /begin DAQ_EVENT VARIABLE /begin AVAILABLE_EVENT_LIST EVENT 0 EVENT 1 EVENT 2 EVENT 3 /end AVAILABLE_EVENT_LIST /begin DEFAULT_EVENT_LIST EVENT 0 /end DEFAULT_EVENT_LIST /end DAQ_EVENT
 /end IF_DATA
/end MEASUREMENT
/begin MEASUREMENT wdkba "throttle angle referred to lower limit" UBYTE relDK_ub_b100 1 100 0.00 100.0 FORMAT "%5.1" ECU_ADDRESS 0x40008976
 /begin IF_DATA XCPplus 0x0102
  /begin DAQ_EVENT VARIABLE /begin AVAILABLE_EVENT_LIST EVENT 0 EVENT 1 EVENT 2 EVENT 3 /end AVAILABLE_EVENT_LIST /begin DEFAULT_EVENT_LIST EVENT 1 /end DEFAULT_EVENT_LIST /end DAQ_EVENT
 /end IF_DATA
/end MEASUREMENT
/begin MEASUREMENT wdkba_w "throttle angle with respect to lower mechanical stop" SWORD relDK_q0p02441 1 100 -800.0000 799.9756 FORMAT "%8.4" ECU_ADDRESS 0x4000856E
 /begin IF_DATA XCPplus 0x0102
  /begin DAQ_EVENT VARIABLE /begin AVAILABLE_EVENT_LIST EVENT 0 EVENT 1 EVENT 2 EVENT 3 /end AVAILABLE_EVENT_LIST /begin DEFAULT_EVENT_LIST EVENT 1 /end DEFAULT_EVENT_LIST /end DAQ_EVENT
 /end IF_DATA
/end MEASUREMENT
/begin MEASUREMENT wdkfawu "Throttle angle drivers demand" UBYTE relDK_ub_b100 1 100 0.00 100.0 FORMAT "%5.1" ECU_ADDRESS 0x40008975
 /begin IF_DATA XCPplus 0x0102
  /begin DAQ_EVENT VARIABLE /begin AVAILABLE_EVENT_LIST EVENT 0 EVENT 1 EVENT 2 EVENT 3 /end AVAILABLE_EVENT_LIST /begin DEFAULT_EVENT_LIST EVENT 1 /end DEFAULT_EVENT_LIST /end DAQ_EVENT
 /end IF_DATA
/end MEASUREMENT
/begin MEASUREMENT wdkfawu_w "Throttle angle requested by driver" UWORD relDK_uw_b100 1 100 0.00 100.0000 FORMAT "%8.4" ECU_ADDRESS 0x4000856C
 /begin IF_DATA XCPplus 0x0102
  /begin DAQ_EVENT VARIABLE /begin AVAILABLE_EVENT_LIST EVENT 0 EVENT 1 EVENT 2 EVENT 3 /end AVAILABLE_EVENT_LIST /begin DEFAULT_EVENT_LIST EVENT 1 /end DEFAULT_EVENT_LIST /end DAQ_EVENT
 /end IF_DATA
/end MEASUREMENT
/begin MEASUREMENT wdkfuact_w "actual throttle angle requested by driver" UWORD relDK_uw_b100 1 100 0.00 100.0000 FORMAT "%8.4" ECU_ADDRESS 0x4000856A
 /begin IF_DATA XCPplus 0x0102
  /begin DAQ_EVENT VARIABLE /begin AVAILABLE_EVENT_LIST EVENT 0 EVENT 1 EVENT 2 EVENT 3 /end AVAILABLE_EVENT_LIST /begin DEFAULT_EVENT_LIST EVENT 1 /end DEFAULT_EVENT_LIST /end DAQ_EVENT
 /end IF_DATA
/end MEASUREMENT
/begin MEASUREMENT wdkmhf_w "throttle angle calculated based on main charge sensor" UWORD relDK_uw_b100 1 100 0.00 100.0000 FORMAT "%8.4" ECU_ADDRESS 0x40008568
 /begin IF_DATA XCPplus 0x0102
  /begin DAQ_EVENT VARIABLE /begin AVAILABLE_EVENT_LIST EVENT 0 EVENT 1 EVENT 2 EVENT 3 /end AVAILABLE_EVENT_LIST /begin DEFAULT_EVENT_LIST EVENT 1 /end DEFAULT_EVENT_LIST /end DAQ_EVENT
 /end IF_DATA
/end MEASUREMENT
/begin MEASUREMENT wdks "desired throttle angle w.r.t. to lower mechanical stop" UBYTE relDK_ub_b100 1 100 0.00 100.0 FORMAT "%5.1" ECU_ADDRESS 0x40008974
 /begin IF_DATA XCPplus 0x0102
  /begin DAQ_EVENT VARIABLE /begin AVAILABLE_EVENT_LIST EVENT 0 EVENT 1 EVENT 2 EVENT 3 /end AVAILABLE_EVENT_LIST /begin DEFAULT_EVENT_LIST EVENT 1 /end DEFAULT_EVENT_LIST /end DAQ_EVENT
 /end IF_DATA
/end MEASUREMENT
/begin MEASUREMENT wf_w "wall wetting quantity" UWORD q0p09375_Perc 1 100 0.00 6143.906 FORMAT "%8.3" ECU_ADDRESS 0x4000853C
 /begin IF_DATA XCPplus 0x0102
  /begin DAQ_EVENT VARIABLE /begin AVAILABLE_EVENT_LIST EVENT 0 EVENT 1 EVENT 2 EVENT 3 /end AVAILABLE_EVENT_LIST /begin DEFAULT_EVENT_LIST EVENT 0 /end DEFAULT_EVENT_LIST /end DAQ_EVENT
 /end IF_DATA
/end MEASUREMENT
/begin MEASUREMENT wtans_ggtfaloc "ADC-value for intake air temperature tans(local variable)" UWORD spg_ub_b5 1 100 0.00 1279.980 FORMAT "%8.3" ECU_ADDRESS 0x40008F76
 /begin IF_DATA XCPplus 0x0102
  /begin DAQ_EVENT VARIABLE /begin AVAILABLE_EVENT_LIST EVENT 0 EVENT 1 EVENT 2 EVENT 3 /end AVAILABLE_EVENT_LIST /begin DEFAULT_EVENT_LIST EVENT 2 /end DEFAULT_EVENT_LIST /end DAQ_EVENT
 /end IF_DATA
/end MEASUREMENT
/begin MEASUREMENT zbake "reduction factor during acceleration" UBYTE fak_q0p0039 1 100 0.00 0.9961 ECU_ADDRESS 0x40008956
 /begin IF_DATA XCPplus 0x0102
  /begin DAQ_EVENT VARIABLE /begin AVAILABLE_EVENT_LIST EVENT 0 EVENT 1 EVENT 2 EVENT 3 /end AVAILABLE_EVENT_LIST /begin DEFAULT_EVENT_LIST EVENT 3 /end DEFAULT_EVENT_LIST /end DAQ_EVENT
 /end IF_DATA
/end MEASUREMENT
/begin MEASUREMENT zbale "reduction factor during acceleration" UBYTE fak_ub_b0p125 1 100 0.00 0.1245 FORMAT "%6.4" ECU_ADDRESS 0x40008958
 /begin IF_DATA XCPplus 0x0102
  /begin DAQ_EVENT VARIABLE /begin AVAILABLE_EVENT_LIST EVENT 0 EVENT 1 EVENT 2 EVENT 3 /end AVAILABLE_EVENT_LIST /begin DEFAULT_EVENT_LIST EVENT 3 /end DEFAULT_EVENT_LIST /end DAQ_EVENT
 /end IF_DATA
/end MEASUREMENT
/begin MEASUREMENT zktmotval "Filter constant for the wall film calculation engine temperature dependent" UWORD fak_uw_b1 1 100 0.00 0.9999847 FORMAT "%9.7" ECU_ADDRESS 0x4000853A
 /begin IF_DATA XCPplus 0x0102
  /begin DAQ_EVENT VARIABLE /begin AVAILABLE_EVENT_LIST EVENT 0 EVENT 1 EVENT 2 EVENT 3 /end AVAILABLE_EVENT_LIST /begin DEFAULT_EVENT_LIST EVENT 0 /end DEFAULT_EVENT_LIST /end DAQ_EVENT
 /end IF_DATA
/end MEASUREMENT
/begin MEASUREMENT zriberh "Ri-calculation counter after start downstream catalyst" UBYTE dez 1 100 0.00 255.0 FORMAT "%5.1" ECU_ADDRESS 0x40008989 /end MEASUREMENT
/begin MEASUREMENT zriberv "Ri calculation counter after engine start pre cat" UBYTE dez 1 100 0.00 255.0 FORMAT "%5.1" ECU_ADDRESS 0x40008999 /end MEASUREMENT
/begin MEASUREMENT zriwzgh "Counter for high Ri-value downstream main catalyst" UBYTE dez 1 100 0.00 255.0 FORMAT "%5.1" ECU_ADDRESS 0x40008987 /end MEASUREMENT
/begin MEASUREMENT zriwzgv "Counter for high Ri-value upstream catalyst" UBYTE dez 1 100 0.00 255.0 FORMAT "%5.1" ECU_ADDRESS 0x40008998 /end MEASUREMENT
/begin MEASUREMENT zuknstm_w "time constant of transient control post cranking factor dependent on engine temperature" UWORD zk100msxs_uw_b6553 1 100 0.10000152590 6553.6000000 FORMAT "%12.7" ECU_ADDRESS 0x40008534
 /begin IF_DATA XCPplus 0x0102
  /begin DAQ_EVENT VARIABLE /begin AVAILABLE_EVENT_LIST EVENT 0 EVENT 1 EVENT 2 EVENT 3 /end AVAILABLE_EVENT_LIST /begin DEFAULT_EVENT_LIST EVENT 3 /end DEFAULT_EVENT_LIST /end DAQ_EVENT
 /end IF_DATA
/end MEASUREMENT
/begin MEASUREMENT zvake "reduction factor during deceleration enleanment" UBYTE fak_q0p0039 1 100 0.00 0.9961 ECU_ADDRESS 0x40008957
 /begin IF_DATA XCPplus 0x0102
  /begin DAQ_EVENT VARIABLE /begin AVAILABLE_EVENT_LIST EVENT 0 EVENT 1 EVENT 2 EVENT 3 /end AVAILABLE_EVENT_LIST /begin DEFAULT_EVENT_LIST EVENT 3 /end DEFAULT_EVENT_LIST /end DAQ_EVENT
 /end IF_DATA
/end MEASUREMENT
/begin MEASUREMENT zvale "reduction factor during deceleration enleanment" UBYTE fak_ub_b0p125 1 100 0.00 0.1245 FORMAT "%6.4" ECU_ADDRESS 0x40008959
 /begin IF_DATA XCPplus 0x0102
  /begin DAQ_EVENT VARIABLE /begin AVAILABLE_EVENT_LIST EVENT 0 EVENT 1 EVENT 2 EVENT 3 /end AVAILABLE_EVENT_LIST /begin DEFAULT_EVENT_LIST EVENT 3 /end DEFAULT_EVENT_LIST /end DAQ_EVENT
 /end IF_DATA
/end MEASUREMENT
/begin MEASUREMENT zzkwas_w "tooth counter of crankshaft at working cycle" UWORD dez 1 100 0.00 65535.00 FORMAT "%8.2" ECU_ADDRESS 0x40008514
 /begin IF_DATA XCPplus 0x0102
  /begin DAQ_EVENT VARIABLE /begin AVAILABLE_EVENT_LIST EVENT 0 EVENT 1 EVENT 2 EVENT 3 /end AVAILABLE_EVENT_LIST /begin DEFAULT_EVENT_LIST EVENT 1 /end DEFAULT_EVENT_LIST /end DAQ_EVENT
 /end IF_DATA
/end MEASUREMENT
/begin MEASUREMENT zzyl "SW-cylinder counter" UBYTE dez 1 100 0.00 11.00 FORMAT "%5.2" ECU_ADDRESS 0x40008946
 /begin IF_DATA XCPplus 0x0102
  /begin DAQ_EVENT VARIABLE /begin AVAILABLE_EVENT_LIST EVENT 0 EVENT 1 EVENT 2 EVENT 3 /end AVAILABLE_EVENT_LIST /begin DEFAULT_EVENT_LIST EVENT 0 /end DEFAULT_EVENT_LIST /end DAQ_EVENT
 /end IF_DATA
/end MEASUREMENT
/begin MEASUREMENT zzylcnt "internal SW-cylinder counter" UBYTE dez 1 100 0.00 255.0 FORMAT "%5.1" ECU_ADDRESS 0x40008983
 /begin IF_DATA XCPplus 0x0102
  /begin DAQ_EVENT VARIABLE /begin AVAILABLE_EVENT_LIST EVENT 0 EVENT 1 EVENT 2 EVENT 3 /end AVAILABLE_EVENT_LIST /begin DEFAULT_EVENT_LIST EVENT 0 /end DEFAULT_EVENT_LIST /end DAQ_EVENT
 /end IF_DATA
/end MEASUREMENT
/begin FUNCTION EpmSyn_IntkMnfldP "30000.7.0 Synchonization of the engine by the evaluation of the intake manifold pressure"
 /begin DEF_CHARACTERISTIC DFC_CtlMsk2.DFC_IntkMnfldPNoSyn_C DFC_DisblMsk2.DFC_IntkMnfldPNoSyn_C EpmSyn_agWinLenIntkMnfldP_C EpmSyn_agWinStrtIntkMnfldP_C EpmSyn_cntrValChkIntkMnfldP_C EpmSyn_ctGap0PosnOffsetIntkMnfldP_C EpmSyn_DeltaDiffIntkMnfldP_C EpmSyn_dnEngMaxIntkMnfldP_C EpmSyn_dwdkIntkMnfldP_C EpmSyn_facAltiCorrnHiMnfldP_CUR EpmSyn_facAltiCorrnLoMnfldP_CUR EpmSyn_facWghIntkMnfldP_C EpmSyn_nEngMaxIntkMnfldP_C EpmSyn_nEngMinIntkMnfldP_C EpmSyn_nrAtmptIntkMnfldP_C EpmSyn_nrNoSynMnfldP_C EpmSyn_rAgQlIntkMnfldP_CA EpmSyn_ratPHiIntkMnfldP_MAP EpmSyn_ratPLoIntkMnfldP_MAP EpmSyn_swtIntkMnfldP_C EpmSyn_wdkMaxIntkMnfldP_CUR /end DEF_CHARACTERISTIC
 /begin REF_CHARACTERISTIC EpmSeq_swtInt_C Epm_phiGap2Zero_C /end REF_CHARACTERISTIC
 /begin IN_MEASUREMENT B_psrrg EpmCrS_ctInc EpmHCrS_stSigMode EpmSyn_stEnaDblIgn EpmSyn_stSync Epm_dnEng Epm_nEng fho PIntkVUs_pRawFast wdkba_w /end IN_MEASUREMENT
 /begin OUT_MEASUREMENT EpmSyn_stPhDetIntkMnfldP /end OUT_MEASUREMENT
 /begin LOC_MEASUREMENT EpmSyn_cntrFailrIntkMnfldP EpmSyn_cntrValChkIntkMnfldP EpmSyn_nrGrdtChkIntkMnfldP_mp EpmSyn_nrGrdtFailIntkMnfldP_mp EpmSyn_nrSynFailIntkMnfldP_mp EpmSyn_nrSynSucIntkMnfldP_mp EpmSyn_phiAbsIntkMnfldP_mp EpmSyn_phiOffsIntkMnfldP_mp EpmSyn_pMaxFirstWinIntkMnfldP EpmSyn_pMaxSecWinIntkMnfldP EpmSyn_pMinFirstWinIntkMnfldP EpmSyn_pMinSecWinIntkMnfldP EpmSyn_rAgQlIntkMnfldP_mp EpmSyn_ratPIntkMnfldP EpmSyn_stEnablIntkMnfldP EpmSyn_stEnaIntkMnfldP_mp EpmSyn_stGrdtDetIntkMnfldP EpmSyn_stPCptrActvIntkMnfldP EpmSyn_stRecalcnIntkMnfldP_mp EpmSyn_stSyncIntkMnfldP_mp EpmSyn_stthrchngIntkMnfldP EpmSyn_stWinGennIntkMnfldP /end LOC_MEASUREMENT
 FUNCTION_VERSION "30000.7.0" /end FUNCTION
/begin FUNCTION Epm_Ini "30000.3.0 Initialisation of EPM" /begin DEF_CHARACTERISTIC Epm_numFireSeg_C Epm_phiGap2Zero_C Epm_phiTdc1_C /end DEF_CHARACTERISTIC /begin OUT_MEASUREMENT Epm_numCyl Epm_numCylInt Epm_phiCyl Epm_phiDiffTDC /end OUT_MEASUREMENT FUNCTION_VERSION "30000.3.0" /end FUNCTION
/begin FUNCTION Epm_OpMode "30000.3.0 Operation Modes of EPM" /begin DEF_CHARACTERISTIC Epm_ctRevCntDiffMin_C /end DEF_CHARACTERISTIC /begin REF_CHARACTERISTIC Epm_numFireSeg_C /end REF_CHARACTERISTIC
 /begin IN_MEASUREMENT EpmSeq_numInt EpmSeq_phiNxtInt EpmSyn_numIntTyp EpmSyn_phiInt EpmSyn_stPhaCorrn EpmSyn_stSync /end IN_MEASUREMENT
 /begin OUT_MEASUREMENT Epm_ctCyl Epm_stOpMode /end OUT_MEASUREMENT
 /begin LOC_MEASUREMENT Epm_ctRevCntDiff_mp Epm_ctTDCPhys_mp Epm_phiIntDelay_mp /end LOC_MEASUREMENT
 FUNCTION_VERSION "30000.3.0" /end FUNCTION
/begin FUNCTION Epm_Spd "30000.8.0 Calculation of Engine Speed" /begin DEF_CHARACTERISTIC Epm_tiSpd2Zero_C /end DEF_CHARACTERISTIC /begin REF_CHARACTERISTIC EpmCrS_nDiagOff_C /end REF_CHARACTERISTIC
 /begin IN_MEASUREMENT EpmCrS_numIncPerSeg EpmCrS_phiSeg EpmCrS_stSigMode EpmCrS_tiSeg EpmCrS_tiSegCurr EpmCrS_tiSegCurr1 EpmHCrS_stSigMode EpmRRS_stEngStop /end IN_MEASUREMENT
 /begin OUT_MEASUREMENT Epm_nEng Epm_nEng10ms Epm_nEngCurr Epm_nEngInc10ms Epm_nEngLRes Epm_nEngRaw Epm_nEngSeg180 Epm_nEngTooth10ms Epm_stSpd /end OUT_MEASUREMENT
 /begin LOC_MEASUREMENT Epm_tiSpd2Zero /end LOC_MEASUREMENT
 FUNCTION_VERSION "30000.8.0" /end FUNCTION
/begin FUNCTION Epm_SpdGrd "30000.4.0 Calculation of enginespeed gradient" /begin DEF_CHARACTERISTIC Epm_tiSpdGrdAvgFlt_C Epm_tiSpdGrdFlt_C /end DEF_CHARACTERISTIC /begin REF_CHARACTERISTIC EpmSyn_swtCo_C /end REF_CHARACTERISTIC
 /begin IN_MEASUREMENT EpmCrS_tiSeg EpmSeq_numIntTyp EpmSyn_stPhaCorrn Epm_ctSyn Epm_nEng Epm_stSync /end IN_MEASUREMENT
 /begin OUT_MEASUREMENT Epm_dnEng Epm_dnEngAvg Epm_dnEngAvgFlt Epm_dnEngExtdRng Epm_dnEngFlt Epm_dnEngSma Epm_nEngDiff /end OUT_MEASUREMENT
 /begin LOC_MEASUREMENT Epm_dnEngAry Epm_idxCntrFirstWcy Epm_idxCntrMax Epm_idxCntrSma Epm_nEngOld /end LOC_MEASUREMENT
 FUNCTION_VERSION "30000.4.0" /end FUNCTION
/begin FUNCTION Epm_SwAdp "30000.7.0 Adapter for EPM (MEDC17 to MED7/9)" /begin DEF_CHARACTERISTIC Epm_facSpdFil_C Epm_nHysThd_CUR ZNGFIL /end DEF_CHARACTERISTIC /begin REF_CHARACTERISTIC EpmCrS_nMinInc_C /end REF_CHARACTERISTIC
 /begin IN_MEASUREMENT EpmCrS_phiSeg EpmCrS_stSigMode EpmCrS_tiSeg EpmHCrS_stSigMode EpmRRS_bEngSwOff EpmSeq_numIntTyp EpmSyn_phiOffs EpmSyn_stSync Epm_ctCyl Epm_ctSyn Epm_nEng Epm_nEng10ms Epm_nEngDiff Epm_nEngInc10ms Epm_nEngLRes Epm_nEngRaw Epm_nEngTooth10ms Epm_stOpMode Epm_stSpd Epm_stSync /end IN_MEASUREMENT
 /begin OUT_MEASUREMENT bmlosctr_w B_bm B_dopzue B_engmvdb B_fbm B_motstop B_nldg B_nlph B_nlphwe B_nmin B_nmot B_optpherk B_phsinvst B_phsnl B_stprel B_synnot B_synph B_umsync B_zprel dnmot_w nmot nmotbuf_w nmotfihy_w nmotgas_w nmotgfil nmotgfil_w nmotll nmotst nmotst1t_w nmotz nmot_w s1fl3p0c synstate tseg_l uzkw_w zzkwas_w zzyl /end OUT_MEASUREMENT
 /begin LOC_MEASUREMENT nmotHysThd_w phiOffsOld stSyncOld /end LOC_MEASUREMENT
 FUNCTION_VERSION "30000.7.0" /end FUNCTION
/begin FUNCTION ESC_Stack "100.1.0   Functional component to provide sampling time for both time and angle synchronous rasters" /begin IN_MEASUREMENT EpmCrS_tiSeg EpmCrS_tiSegCurr /end IN_MEASUREMENT /begin OUT_MEASUREMENT DT_as32 DT_as32_s ESC_tiSampling ESC_tiSampling_s /end OUT_MEASUREMENT FUNCTION_VERSION "100.1.0" /end FUNCTION
/begin FUNCTION ESC_TaskLink "100.1.0   activation of engine speed synchronous tasks" /begin DEF_CHARACTERISTIC ESC_stS1FrstSched_C /end DEF_CHARACTERISTIC /begin IN_MEASUREMENT EpmSeq_numInt SyC_stSub SyC_tiDrv /end IN_MEASUREMENT FUNCTION_VERSION "100.1.0" /end FUNCTION
/begin FUNCTION ESUK "9000.18.0 Injection: transient compensation"
 /begin DEF_CHARACTERISTIC CWESUK DWFMN DWFMX FTUKG FUKNSTM FVANST InjSys_tiDlyIdleEna_C KFABAK KFAVAK KFBAKL KFVAKL KLRKBAUM KLRKVAUM NMOTWF RKUKGMNT RKUKGMXT SNM10ESUB STE09ESUB TNSUUK WFRL WFRLLL ZBAKM ZBALM ZKTMOT ZUKNSTM ZVAKM ZVALM /end DEF_CHARACTERISTIC
 /begin REF_CHARACTERISTIC VLLR /end REF_CHARACTERISTIC
 /begin IN_MEASUREMENT B_evzaustot B_ll B_neutgear B_stend B_stendes EngDa_tEng EngDa_tStrt nmot_w rlp_w SyC_stSub tlrs tnse_w VehV_v /end IN_MEASUREMENT
 /begin OUT_MEASUREMENT B_bag B_uk1 B_ukg B_ukgi B_vag dwf_w rkukg_w rkukk_w /end OUT_MEASUREMENT
 /begin LOC_MEASUREMENT abak avak B_bagtemp B_llLoc B_vaau B_vagtemp B_vakl dwfk_w dwfl_w fbakl_w fbans fbansini_w fukkl_w fvakl_w fvans rkukl_w rkuk_w sdwfk_w sdwfl_w wf_w zbake zbale zktmotval zuknstm_w zvake zvale /end LOC_MEASUREMENT
 FUNCTION_VERSION "9000.18.0" /end FUNCTION
/begin FUNCTION FUELLS "9500.14.0 Charge intervention via idle speed actuator"
 /begin DEF_CHARACTERISTIC DOLLSABGE DOLLSABGES FKNMOTLLS FRLMNHO KFOLLSTHO KFRLMN KLOLLSOFMQ KLOLLSTOFF LLSNLN LLS_ATS_ID_ATS.LimitTypeMsk_C LLS_ATS_ID_ATS.CnvNorm_C LLS_ATS_ID_ATS.LowLim_C LLS_ATS_ID_ATS.UpLim_C LLS_ATS_ID_ATS.CnvFac_C LLS_ATS_ID_ATS.CnvOfs_C LLS_ATS_ID_ATS.DfltVal_C NMOTLLSOFS OLLSAPP OLLSSBGMNHY OLLSSBGMXHY OLLSSMN OLLSSMX /end DEF_CHARACTERISTIC
 /begin REF_CHARACTERISTIC KFMSOLLS KUMSIRL /end REF_CHARACTERISTIC
 /begin IN_MEASUREMENT B_asvarap B_llrein B_nmot EngDa_tEng fho ftpavd_w nmot_w nstat ofmsdkq_w ofmsnddkq_w rlfawu_w rlsolmd_w SyC_stSub tnse_w /end IN_MEASUREMENT
 /begin OUT_MEASUREMENT B_llspmn B_llspmx B_ollstoff B_rlmin msllss_w nmotfz_w nmotlls_w ollsms_w ollsramp_w ollss ollssbg_w ollsst_w ollss_w rlmin_w rlsolnmd_w /end OUT_MEASUREMENT
 /begin LOC_MEASUREMENT B_nllsst nllscorrd_w ollssobg_w ollstkl_w /end LOC_MEASUREMENT
 FUNCTION_VERSION "9500.14.0" /end FUNCTION
/begin FUNCTION GConf_Sy "PCFG_MSE2_BJ10_38" FUNCTION_VERSION "PCFG_MSE2_BJ10_38" /end FUNCTION
/begin FUNCTION GGDKG "9500.14.0 Sensor signal throttle position"
 /begin DEF_CHARACTERISTIC CWDKPSTG DFC_CtlMsk2.DFC_DKmax_C DFC_CtlMsk2.DFC_DKmin_C DFC_DisblMsk2.DFC_DKmax_C DFC_DisblMsk2.DFC_DKmin_C DUWDKOA DUWDKUA TDDK ThrVlv_voltDeltaLowrLimLrngEna_C UDKPNHUB UWDKDO UWDKDU UWDKOAMN UWDKOAMX UWDKUAMN UWDKUAMX WDKBASLN WDKSLNHY ZKUWDKAL ZKUWDKAS /end DEF_CHARACTERISTIC
 /begin REF_CHARACTERISTIC KFMSWDKQ /end REF_CHARACTERISTIC
 /begin IN_MEASUREMENT ComDia_flgTPSLrnEnbl Eep_EnvRamInvld ftpavd_w msllseff_w nmot_w ofmsnddkq_w rl_w SyC_stSub umsrln_w uwdk_w /end IN_MEASUREMENT
 /begin OUT_MEASUREMENT B_edk B_ll B_mndk B_mxdk B_uwdkoaen B_uwdkuaen B_zkuwdkas dkpstg_w dwdkba_w msndkhfq_w s1fl2p11 s1fl2p45 ThrVlv_stLrngTstrTrig uwdkoa_w uwdkua_w wdkba wdkba_w wdkfawu wdkfawu_w wdkfuact_w wdkmhf_w wdks /end OUT_MEASUREMENT
 FUNCTION_VERSION "9500.14.0" /end FUNCTION
/begin FUNCTION GGDSS "9500.7.0  Sensor value pressure sensor intake manifold pressure"
 /begin DEF_CHARACTERISTIC DFC_CtlMsk2.DFC_DSSmax_C DFC_CtlMsk2.DFC_DSSmin_C DFC_DisblMsk2.DFC_DSSmax_C DFC_DisblMsk2.DFC_DSSmin_C DSSGRAD DSSOFS PSZYLCNT TDDSR UADPSMN UADPSMX /end DEF_CHARACTERISTIC
 /begin IN_MEASUREMENT B_errwind B_syn PIntkVUs_stSigChkFrz SyC_stSub udsswmin_w udss_w /end IN_MEASUREMENT
 /begin OUT_MEASUREMENT B_mndss B_mxdss B_psremn B_psremx B_psrrg PIntkVUs_pRawFast PIntkVUs_pSigMax PIntkVUs_pSigMin psdss_w psrgwind_w udsmn_w udsm_w udssmn1ms_w /end OUT_MEASUREMENT
 /begin LOC_MEASUREMENT PIntkVUs_uSigChkMax PIntkVUs_uSigChkMin psrgmin_w zzylcnt /end LOC_MEASUREMENT
 FUNCTION_VERSION "9500.7.0" /end FUNCTION
/begin FUNCTION GGLSH "9200.5.0  Sensor variable for lambda sensor downstream of catalytic converter" /begin DEF_CHARACTERISTIC ANZRIBEH ANZRIWZGH DUSRIHXF FRINOFH RINHMX TRIAKTH ZFRIH /end DEF_CHARACTERISTIC /begin REF_CHARACTERISTIC CWGGLS RBEL RKSP /end REF_CHARACTERISTIC
 /begin IN_MEASUREMENT B_atmtpk B_hzkfh B_sigflsh B_stendes B_trsah B_ttbmhh B_usrih SyC_stSub ushkpr_w ushkun_w ushkuv_w /end IN_MEASUREMENT
 /begin OUT_MEASUREMENT B_rinavgh B_rinh B_ushren rinavgh_w rinh_w /end OUT_MEASUREMENT
 /begin LOC_MEASUREMENT B_enrinh B_erinofh B_ribeh B_riibh B_rinch dushkr_w HEGO_riAvgS2B1_Ary rinofha_w rinofhh_w rinofh_w zriberh zriwzgh /end LOC_MEASUREMENT
 FUNCTION_VERSION "9200.5.0" /end FUNCTION
/begin FUNCTION GGLSV "9100.14.0 Sensorsignal lambda upstream catalyst"
 /begin DEF_CHARACTERISTIC ANZRIBEV ANZRIWZGV CWGGLS DUSRIVXF FRINOFV RBEL RINVMX RKSP TRIAKTVXF ZFRIV /end DEF_CHARACTERISTIC
 /begin IN_MEASUREMENT B_atmtpa B_hzkfv B_sigflsv B_stendes B_usriv SyC_stSub usvkpr_w usvkun_w usvkuv_w /end IN_MEASUREMENT
 /begin OUT_MEASUREMENT B_rinavgv B_rinv B_usvren rinavgv_w rinv_w /end OUT_MEASUREMENT
 /begin LOC_MEASUREMENT B_enrinv B_erinofv B_ribev B_riibv B_rincv dusvkr_w HEGO_riAvgS1B1_Ary rinofva_w rinofvv_w rinofv_w zriberv zriwzgv /end LOC_MEASUREMENT
 FUNCTION_VERSION "9100.14.0" /end FUNCTION
/begin FUNCTION GGSDST "9000.7.0_386.1.0Side stand switch functionality"
 /begin DEF_CHARACTERISTIC CWDIANGS CWSDSTACT CWSTDIEN DFC_CtlMsk2.DFC_SdSTNpl_C DFC_CtlMsk2.DFC_SdSTSCB_C DFC_CtlMsk2.DFC_SdSTSCG_C DFC_CtlMsk2.DFC_SdSTSOL_C DFC_DisblMsk2.DFC_SdSTNpl_C DFC_DisblMsk2.DFC_SdSTSCB_C DFC_DisblMsk2.DFC_SdSTSCG_C DFC_DisblMsk2.DFC_SdSTSOL_C GGSDST_vVehSpdThd_C SDACTMAX SDACTMIN SDEBACT SDEBDAIG SDINACTMAX SDINACTMIN SDOPNSNMAX SDOPNSNMIN SDSHBATMAX SDSHBATMIN SDSHGNDMAX SDSHGNDMIN /end DEF_CHARACTERISTIC
 /begin IN_MEASUREMENT B_kl15 B_kuppl B_neutgear SyC_stSub usdst_w vfzg_w /end IN_MEASUREMENT
 /begin OUT_MEASUREMENT BIDev_flgSidstSt B_sdstact SidstSwt_stSidstDiagcErr /end OUT_MEASUREMENT
 /begin LOC_MEASUREMENT BIDev_tiSdstAct BIDev_tiSidstSt /end LOC_MEASUREMENT
 FUNCTION_VERSION "9000.7.0_386.1.0" /end FUNCTION
/begin FUNCTION GGTFA "9000.10.0 Signal intake air temperature sensor"
 /begin DEF_CHARACTERISTIC CWTFASTC DFC_CtlMsk2.DFC_IntkAirTAirFltDsSTC_C DFC_CtlMsk2.DFC_IntkAirTAirFltDsPRCMax_C DFC_CtlMsk2.DFC_IntkAirTAirFltDsPRCMin_C DFC_CtlMsk2.DFC_IntkAirTAirFltDsSRCMax_C DFC_CtlMsk2.DFC_IntkAirTAirFltDsSRCMin_C DFC_DisblMsk2.DFC_IntkAirTAirFltDsSTC_C DFC_DisblMsk2.DFC_IntkAirTAirFltDsPRCMax_C DFC_DisblMsk2.DFC_IntkAirTAirFltDsPRCMin_C DFC_DisblMsk2.DFC_IntkAirTAirFltDsSRCMax_C DFC_DisblMsk2.DFC_IntkAirTAirFltDsSRCMin_C IntkAirT_mAirThdAirFltDsSTC_T IntkAirT_tDiffThdAirFltDsSTC_C IntkAirT_tEngStrtThdAirFltDsSTC_C IntkAirT_tiAirFltDsSRCMaxErr_C IntkAirT_tiAirFltDsSRCMaxHeal_C IntkAirT_tiAirFltDsSRCMinErr_C IntkAirT_tiAirFltDsSRCMinHeal_C IntkAirT_uRawAirFltDsSRCMax_C IntkAirT_uRawAirFltDsSRCMin_C TADE TANSELI TANSMN TANSMX TDELTFA TDELTFAK TDTANSHL TDTANSKHL TDTNSEDTA ZFTANS /end DEF_CHARACTERISTIC
 /begin REF_CHARACTERISTIC TMDMN /end REF_CHARACTERISTIC
 /begin IN_MEASUREMENT B_etmot B_stendz EngDa_tEng EngDa_tStrt ml_w SyC_stSub tnse_w wtans /end IN_MEASUREMENT
 /begin OUT_MEASUREMENT B_etans tans tanslin /end OUT_MEASUREMENT
 /begin LOC_MEASUREMENT B_etmot_ggtfaloc B_flgGGTFADSMClr B_tanslinmn B_tanslinmx B_tdtanshlmax B_tdtanshlmin EngDa_tStrtAirFltDsSTCLoc IntkAirT_flgAirFltDsSRCMaxErr IntkAirT_flgAirFltDsSRCMaxHeal IntkAirT_flgAirFltDsSRCMinErr IntkAirT_flgAirFltDsSRCMinHeal IntkAirT_flgAirFltDsSTCEna IntkAirT_flgAirFltDsSTCErr IntkAirT_flgAirFltDsSTCHeal IntkAirT_flgAirFltDsSTCRiseNr IntkAirT_flgEngWrmUpAirFltDsSTC IntkAirT_mAirIntegAirFltDsSTCloc IntkAirT_tMaxAirFltDsSTC IntkAirT_tMinAirFltDsSTC wtans_ggtfaloc /end LOC_MEASUREMENT
 FUNCTION_VERSION "9000.10.0" /end FUNCTION
/begin COMPU_METHOD AngleCrS "" RAT_FUNC "%6.4" "deg CrS" COEFFS 0 45.5111111111 0 0 0 1 /end COMPU_METHOD
/begin COMPU_METHOD B_TRUE "" TAB_VERB "%6.3" "" COMPU_TAB_REF B_TRUE /end COMPU_METHOD
/begin COMPU_VTAB B_TRUE "" TAB_VERB 2 0 "FALSE" 1 "TRUE" /end COMPU_VTAB
/begin COMPU_METHOD dez "" RAT_FUNC "%6.2" "" COEFFS 0 1 0 0 0 1 /end COMPU_METHOD
/begin COMPU_METHOD DFES_OneToOne "" RAT_FUNC "%6.2" "-" COEFFS 0 1 0 0 0 1 /end COMPU_METHOD
/begin COMPU_METHOD dgrad_uw_q0p015 "" RAT_FUNC "%6.4" "hPa/V" COEFFS 0 65536 0 0 0 1024 /end COMPU_METHOD
/begin COMPU_METHOD EngN "" RAT_FUNC "%6.3" "rpm" COEFFS 0 2 0 0 0 1 /end COMPU_METHOD
/begin COMPU_METHOD EngNGrd "" RAT_FUNC "%6.3" "rpm/s" COEFFS 0 2 0 0 0 1 /end COMPU_METHOD
/begin COMPU_METHOD EngN_LRes "" RAT_FUNC "%6.1" "rpm" COEFFS 0 0.025 0 0 0 1 /end COMPU_METHOD
/begin COMPU_METHOD EpmSyn_stSync_W "" TAB_VERB "%6.3" "" COMPU_TAB_REF EpmSyn_stSync_W /end COMPU_METHOD
/begin COMPU_VTAB EpmSyn_stSync_W "" TAB_VERB 6 0 "EPMSYN_NOTACTV" 1 "EPMSYN_ACTV" 2 "EPMSYN_SYNC" 3 "EPMSYN_NOSYNC" 4 "EPMSYN_DBLIGN" 5 "EPMSYN_TSTINJ" /end COMPU_VTAB
/begin COMPU_METHOD Epm_stOpMode_State_t "" TAB_VERB "%6.3" "" COMPU_TAB_REF Epm_stOpMode_State_t /end COMPU_METHOD
/begin COMPU_VTAB Epm_stOpMode_State_t "" TAB_VERB 10 1 "EPM_MODE_WAIT" 5 "EPM_MODE_LOCKRESYNC" 20 "EPM_MODE_ALE" 33 "EPM_MODE_VERIFY" 36 "EPM_MODE_VERIFY_EXT" 38 "EPM_MODE_BACKUP_CAS" 39 "EPM_MODE_DBLIGN" 40 "EPM_MODE_TSTINJ" 48 "EPM_MODE_OK" 60 "EPM_MODE_BACKUP_CRS" /end COMPU_VTAB
/begin COMPU_METHOD Epm_stSpd_t "" TAB_VERB "%6.3" "" COMPU_TAB_REF Epm_stSpd_t /end COMPU_METHOD
/begin COMPU_VTAB Epm_stSpd_t "" TAB_VERB 5 0 "EPM_SPD_CRS" 1 "EPM_SPD_HOLD" 2 "EPM_SPD_ZERO" 3 "EPM_SPD_CAS" 4 "EPM_SPD_BACKUP" /end COMPU_VTAB
/begin COMPU_METHOD ESC_stS1FrstSched_t "" TAB_VERB "%6.3" "" COMPU_TAB_REF ESC_stS1FrstSched_t /end COMPU_METHOD
/begin COMPU_VTAB ESC_stS1FrstSched_t "" TAB_VERB 4 0 "ESC_SX_SCHEDSTRT" 1 "ESC_S1_SCHEDSTRT" 2 "ESC_S0_SCHEDSTRT" 3 "ESC_S1FORCED_SCHEDSTRT" /end COMPU_VTAB
/begin COMPU_METHOD Fact0002 "" RAT_FUNC "%6.5" "-" COEFFS 0 5000 0 0 0 1 /end COMPU_METHOD
/begin COMPU_METHOD Fact1 "" RAT_FUNC "%6.4" "-" COEFFS 0 128 0 0 0 1 /end COMPU_METHOD
/begin COMPU_METHOD Fact10 "" RAT_FUNC "%13.12" "-" COEFFS 0 10000000000 0 0 0 1 /end COMPU_METHOD
/begin COMPU_METHOD Fact1000 "" RAT_FUNC "%6.5" "-" COEFFS 0 1000 0 0 0 1 /end COMPU_METHOD
/begin COMPU_METHOD Fact16384_COMPU "" RAT_FUNC "%7.6" "%/hPa" COEFFS 0 16384 0 0 0 1 /end COMPU_METHOD
/begin COMPU_METHOD Fact255_COMPU "" RAT_FUNC "%6.4" "-" COEFFS 0 255 0 0 0 1 /end COMPU_METHOD
/begin COMPU_METHOD Fact256 "" RAT_FUNC "%6.4" "-" COEFFS 0 256 0 0 0 1 /end COMPU_METHOD
/begin COMPU_METHOD Fact3 "" RAT_FUNC "%6.4" "-" COEFFS 0 100 0 0 0 1 /end COMPU_METHOD
/begin COMPU_METHOD Fact4 "" RAT_FUNC "%6.4" "-" COEFFS 0 20 0 0 0 1 /end COMPU_METHOD
/begin COMPU_METHOD Fact5 "" RAT_FUNC "%6.3" "-" COEFFS 0 2 0 0 0 1 /end COMPU_METHOD
/begin COMPU_METHOD Fact6 "" RAT_FUNC "%6.4" "-" COEFFS 0 500 0 0 0 1 /end COMPU_METHOD
/begin COMPU_METHOD Fact7 "" RAT_FUNC "%10.9" "-" COEFFS 0 10000000 0 0 0 1 /end COMPU_METHOD
/begin COMPU_METHOD Fact8 "" RAT_FUNC "%11.10" "-" COEFFS 0 100000000 0 0 0 1 /end COMPU_METHOD
/begin COMPU_METHOD Fact9 "" RAT_FUNC "%6.5" "-" COEFFS 0 5000 0 0 0 1 /end COMPU_METHOD
/begin COMPU_METHOD FactFine "" RAT_FUNC "%9.8" "-" COEFFS 0 1000000 0 0 0 1 /end COMPU_METHOD
/begin COMPU_METHOD FactLow "" RAT_FUNC "%6.5" "-" COEFFS 0 1024 0 0 0 1 /end COMPU_METHOD
/begin COMPU_METHOD FactLow1 "" RAT_FUNC "%6.4" "-" COEFFS 0 25 0 0 0 1 /end COMPU_METHOD
/begin COMPU_METHOD FactRev "" RAT_FUNC "%6.3" "-" COEFFS 0 10 0 0 0 1 /end COMPU_METHOD
/begin COMPU_METHOD Fact_10000 "" RAT_FUNC "%7.6" "-" COEFFS 0 10000 0 0 0 1 /end COMPU_METHOD
/begin COMPU_METHOD Fact_2pwr11 "" RAT_FUNC "%6.5" "-" COEFFS 0 2048 0 0 0 1 /end COMPU_METHOD
/begin COMPU_METHOD Fact_EGT "" RAT_FUNC "%6.5" "-" COEFFS 0 1000 0 0 0 1 /end COMPU_METHOD
/begin COMPU_METHOD Fact_NSC "" RAT_FUNC "%6.5" "-" COEFFS 0 1000 0 0 0 1 /end COMPU_METHOD
/begin COMPU_METHOD Fact_NSCEff "" RAT_FUNC "%7.6" "-" COEFFS 0 10000 0 0 0 1 /end COMPU_METHOD
/begin COMPU_METHOD Fact_q0p001 "" RAT_FUNC "%6.5" "-" COEFFS 0 1000 0 0 0 1 /end COMPU_METHOD
/begin COMPU_METHOD Fact_q0p1_COMPU "" RAT_FUNC "%6.3" "-" COEFFS 0 10 0 0 0 1 /end COMPU_METHOD
/begin COMPU_METHOD Fact_q6554p0_COMPU "" RAT_FUNC "%7.0" "-" COEFFS 0 0.000152578577967653 0 0 0 1 /end COMPU_METHOD
/begin COMPU_METHOD Fact_SOx1 "" RAT_FUNC "%9.8" "-" COEFFS 0 1000000 0 0 0 1 /end COMPU_METHOD
/begin COMPU_METHOD Fact_VolNSC "" RAT_FUNC "%9.8" "-" COEFFS 0 1000000 0 0 0 1 /end COMPU_METHOD
/begin COMPU_METHOD Fac_q0p0001_COMPU "" RAT_FUNC "%7.6" "-" COEFFS 0 10000 0 0 0 1 /end COMPU_METHOD
/begin COMPU_METHOD fak_q0p0000001 "" RAT_FUNC "%10.9" "-" COEFFS 0 10000000 0 0 0 1 /end COMPU_METHOD
/begin COMPU_METHOD fak_q0p0009766 "" RAT_FUNC "%6.5" "-" COEFFS 0 65536 0 0 0 64 /end COMPU_METHOD
/begin COMPU_METHOD fak_q0p0039 "" RAT_FUNC "%6.4" "-" COEFFS 0 256 0 0 0 1 /end COMPU_METHOD
/begin COMPU_METHOD fak_q0p01 "" RAT_FUNC "%6.4" "" COEFFS 0 100 0 0 0 1 /end COMPU_METHOD
/begin COMPU_METHOD fak_q0p0625 "" RAT_FUNC "%6.4" "-" COEFFS 0 16 0 0 0 1 /end COMPU_METHOD
/begin COMPU_METHOD fak_q0p5 "" RAT_FUNC "%6.3" "-" COEFFS 0 1 0 0 0 0.5 /end COMPU_METHOD
/begin COMPU_METHOD fak_sl_b1 "" RAT_FUNC "%12.11" "-" COEFFS 0 4294967296 0 0 0 2 /end COMPU_METHOD
/begin COMPU_METHOD fak_sw_b256 "" RAT_FUNC "%6.4" "-" COEFFS 0 65536 0 0 0 512 /end COMPU_METHOD
/begin COMPU_METHOD fak_sw_b4 "" RAT_FUNC "%6.5" "-" COEFFS 0 65536 0 0 0 8 /end COMPU_METHOD
/begin COMPU_METHOD fak_ub_b0p125 "" RAT_FUNC "%6.5" "-" COEFFS 0 256 0 0 0 0.125 /end COMPU_METHOD
/begin COMPU_METHOD fak_ub_b1 "" RAT_FUNC "%6.4" "-" COEFFS 0 256 0 0 0 1 /end COMPU_METHOD
/begin COMPU_METHOD fak_ub_b16 "" RAT_FUNC "%6.4" "-" COEFFS 0 256 0 0 0 16 /end COMPU_METHOD
/begin COMPU_METHOD fak_ub_b2 "" RAT_FUNC "%8.5" "-" COEFFS 0 256 0 0 0 2 /end COMPU_METHOD
/begin COMPU_METHOD fak_ub_b4 "" RAT_FUNC "%6.4" "-" COEFFS 0 256 0 0 0 4 /end COMPU_METHOD
/begin COMPU_METHOD fak_ub_b8 "" RAT_FUNC "%6.4" "-" COEFFS 0 256 0 0 0 8 /end COMPU_METHOD
/begin COMPU_METHOD fak_uw_b1 "" RAT_FUNC "%7.6" "-" COEFFS 0 65536 0 0 0 1 /end COMPU_METHOD
/begin COMPU_METHOD fak_uw_b4 "" RAT_FUNC "%7.6" "-" COEFFS 0 65536 0 0 0 4 /end COMPU_METHOD
/begin COMPU_METHOD fak_uw_b8 "" RAT_FUNC "%6.5" "-" COEFFS 0 65536 0 0 0 8 /end COMPU_METHOD
/begin COMPU_METHOD fak_uw_q0p1 "" RAT_FUNC "%6.3" "" COEFFS 0 1 0 0 0 0.1 /end COMPU_METHOD
/begin COMPU_METHOD FDE_SC_Compu "" TAB_VERB "%6.3" "" COMPU_TAB_REF FDE_SC_Compu /end COMPU_METHOD
/begin COMPU_VTAB FDE_SC_Compu "" TAB_VERB 2 0 "False" 1 "True" /end COMPU_VTAB
/begin COMPU_METHOD FFVE100_SC_Compu "" TAB_VERB "%6.3" "" COMPU_TAB_REF FFVE100_SC_Compu /end COMPU_METHOD
/begin COMPU_VTAB FFVE100_SC_Compu "" TAB_VERB 2 0 "False" 1 "True" /end COMPU_VTAB
/begin COMPU_METHOD FIM_SC_Compu "" TAB_VERB "%6.3" "" COMPU_TAB_REF FIM_SC_Compu /end COMPU_METHOD
/begin COMPU_VTAB FIM_SC_Compu "" TAB_VERB 2 0 "False" 1 "True" /end COMPU_VTAB
/begin COMPU_METHOD FlConsum_l "" RAT_FUNC "%6.5" "l" COEFFS 0 1000 0 0 0 1 /end COMPU_METHOD
/begin COMPU_METHOD FlConsum_l_h "" RAT_FUNC "%6.4" "l/h" COEFFS 0 100 0 0 0 1 /end COMPU_METHOD
/begin COMPU_METHOD FlConsum_l_s "" RAT_FUNC "%8.7" "l/s" COEFFS 0 360000 0 0 0 1 /end COMPU_METHOD
/begin COMPU_METHOD FlConsum_ul "" RAT_FUNC "%6.2" "ul" COEFFS 0 1 0 0 0 1 /end COMPU_METHOD
/begin COMPU_METHOD FlConsum_ul_1 "" RAT_FUNC "%6.5" "ul" COEFFS 0 1000 0 0 0 1 /end COMPU_METHOD
/begin COMPU_METHOD FlConsum_ul_High_COMPU "" RAT_FUNC "%6.1" "ul" COEFFS 0 0.05 0 0 0 1 /end COMPU_METHOD
/begin COMPU_METHOD FlCons_lps_q0p0001 "" RAT_FUNC "%7.6" "l/s" COEFFS 0 10000 0 0 0 1 /end COMPU_METHOD
/begin COMPU_METHOD FLEXPSCTRLRNR_SC_Compu "" TAB_VERB "%6.3" "" COMPU_TAB_REF FLEXPSCTRLRNR_SC_Compu /end COMPU_METHOD
/begin COMPU_VTAB FLEXPSCTRLRNR_SC_Compu "" TAB_VERB 2 0 "0" 1 "1" /end COMPU_VTAB
/begin COMPU_METHOD FLMA_MULTIPNTFUGRIDADPN_SC_Compu "" TAB_VERB "%6.3" "" COMPU_TAB_REF FLMA_MULTIPNTFUGRIDADPN_SC_Compu /end COMPU_METHOD
/begin COMPU_VTAB FLMA_MULTIPNTFUGRIDADPN_SC_Compu "" TAB_VERB 2 0 "False" 1 "True" /end COMPU_VTAB
/begin COMPU_METHOD FLMA_RSTADPNVALSNSRERR_SC_Compu "" TAB_VERB "%6.3" "" COMPU_TAB_REF FLMA_RSTADPNVALSNSRERR_SC_Compu /end COMPU_METHOD
/begin COMPU_VTAB FLMA_RSTADPNVALSNSRERR_SC_Compu "" TAB_VERB 2 0 "False" 1 "True" /end COMPU_VTAB
/begin COMPU_METHOD FLMA_VAR_SY_Compu "" TAB_VERB "%6.3" "" COMPU_TAB_REF FLMA_VAR_SY_Compu /end COMPU_METHOD
/begin COMPU_VTAB FLMA_VAR_SY_Compu "" TAB_VERB 46 1 "DAI" 3 "VWW" 4 "POR" 5 "AUD" 6 "OPE" 9 "FIA" 11 "BMW" 14 "PSA" 15 "REN" 17 "ALF" 18 "SAB" 19 "VOL" 20 "NIS" 21 "GMU" 22 "FOR" 26 "IMJ" 38 "UAES" 51 "SEA" 53 "CHR" 54 "JAG" 55 "ROL" 69 "FER" 72 "TOY" 123 "MIT" 147 "HYU" 159 "HON" 160 "MAZ" 183 "CU" 190 "LRG" 204 "VVW" 214 "AVT" 242 "Iveco" 243 "DMC" 248 "SUZ" 267 "SSANGYONG" 270 "KEF" 289 "AMG" 308 "TAT" 319 "MVM" 330 "TVS" 590 "Scania" 828 "RBCD" 900 "KTM" 999 "ALL" 2887 "Nonox" 9454 "Fuso" /end COMPU_VTAB
/begin COMPU_METHOD FLSPLG_FUPMPTYP_SC_Compu "" TAB_VERB "%6.3" "" COMPU_TAB_REF FLSPLG_FUPMPTYP_SC_Compu /end COMPU_METHOD
/begin COMPU_VTAB FLSPLG_FUPMPTYP_SC_Compu "" TAB_VERB 2 0 "EKP_Pump" 1 "Piston_Pump" /end COMPU_VTAB
/begin COMPU_METHOD FLSPLSYSTST_SC_Compu "" TAB_VERB "%6.3" "" COMPU_TAB_REF FLSPLSYSTST_SC_Compu /end COMPU_METHOD
/begin COMPU_VTAB FLSPLSYSTST_SC_Compu "" TAB_VERB 3 0 "0" 1 "1" 2 "2" /end COMPU_VTAB
/begin COMPU_METHOD FlVolFlw_COMPU "" RAT_FUNC "%6.3" "l/h" COEFFS 0 10 0 0 0 1 /end COMPU_METHOD
/begin COMPU_METHOD FLXR_SY_Compu "" TAB_VERB "%6.3" "" COMPU_TAB_REF FLXR_SY_Compu /end COMPU_METHOD
/begin COMPU_VTAB FLXR_SY_Compu "" TAB_VERB 2 0 "FALSE" 1 "TRUE" /end COMPU_VTAB
/begin COMPU_METHOD m_sw_q0p01 "" RAT_FUNC "%6.4" "kg/h" COEFFS 0 100 0 0 0 1 /end COMPU_METHOD
/begin COMPU_METHOD m_uw_b23p3 "" RAT_FUNC "%6.5" "kg" COEFFS 0 2812.5 0 0 0 1 /end COMPU_METHOD
/begin COMPU_METHOD m_uw_b655p35 "" RAT_FUNC "%6.4" "kg/h" COEFFS 0 100 0 0 0 1 /end COMPU_METHOD
/begin COMPU_METHOD nmot_q10 "" RAT_FUNC "%6.1" "1/min" COEFFS 0 1 0 0 0 10 /end COMPU_METHOD
/begin COMPU_METHOD nmot_sw_q0p25 "" RAT_FUNC "%6.3" "1/min" COEFFS 0 1 0 0 0 0.25 /end COMPU_METHOD
/begin COMPU_METHOD nmot_ub_q10 "" RAT_FUNC "%6.1" "1/min" COEFFS 0 1 0 0 0 10 /end COMPU_METHOD
/begin COMPU_METHOD nmot_ub_q40 "" RAT_FUNC "%6.1" "1/min" COEFFS 0 1 0 0 0 40 /end COMPU_METHOD
/begin COMPU_METHOD nmot_uw_q0p25 "" RAT_FUNC "%6.3" "1/min" COEFFS 0 1 0 0 0 0.25 /end COMPU_METHOD
/begin COMPU_METHOD n_q1 "" RAT_FUNC "%6.2" "1/min" COEFFS 0 1 0 0 0 1 /end COMPU_METHOD
/begin COMPU_METHOD OneToOne "" RAT_FUNC "%6.2" "-" COEFFS 0 1 0 0 0 1 /end COMPU_METHOD
/begin COMPU_METHOD Per_Dur "" RAT_FUNC "%6.2" "usec" COEFFS 0 1 0 0 0 1 /end COMPU_METHOD
/begin COMPU_METHOD Prc "" RAT_FUNC "%6.4" "%" COEFFS 0 81.92 0 0 0 1 /end COMPU_METHOD
/begin COMPU_METHOD p_sw_q0p039 "" RAT_FUNC "%6.4" "hPa" COEFFS 0 256 0 0 0 10 /end COMPU_METHOD
/begin COMPU_METHOD p_uw_q0p039 "" RAT_FUNC "%6.4" "hPa" COEFFS 0 256 0 0 0 10 /end COMPU_METHOD
/begin COMPU_METHOD p_uw_q0p078 "" RAT_FUNC "%6.4" "hPa" COEFFS 0 256 0 0 0 20 /end COMPU_METHOD
/begin COMPU_METHOD q0p09375_Perc "" RAT_FUNC "%6.3" "%" COEFFS 0 65536 0 0 0 6144 /end COMPU_METHOD
/begin COMPU_METHOD relDK_q0p02441 "" RAT_FUNC "%6.4" "%DK" COEFFS 0 65536 0 0 0 1600 /end COMPU_METHOD
/begin COMPU_METHOD relDK_ub_b100 "" RAT_FUNC "%6.3" "%DK" COEFFS 0 255 0 0 0 100 /end COMPU_METHOD
/begin COMPU_METHOD relDK_uw_b100 "" RAT_FUNC "%6.4" "%DK" COEFFS 0 65535 0 0 0 100 /end COMPU_METHOD
/begin COMPU_METHOD rel_q0p09375 "" RAT_FUNC "%6.3" "%" COEFFS 0 1 0 0 0 0.09375 /end COMPU_METHOD
/begin COMPU_METHOD rel_q0p1875 "" RAT_FUNC "%6.3" "%" COEFFS 0 1 0 0 0 0.1875 /end COMPU_METHOD
/begin COMPU_METHOD rel_sw_b100 "" RAT_FUNC "%6.4" "%" COEFFS 0 32768 0 0 0 100 /end COMPU_METHOD
/begin COMPU_METHOD rel_sw_q0p0468 "" RAT_FUNC "%6.4" "%" COEFFS 0 65536 0 0 0 3072 /end COMPU_METHOD
/begin COMPU_METHOD rel_ub_b100 "" RAT_FUNC "%6.3" "%" COEFFS 0 256 0 0 0 100 /end COMPU_METHOD
/begin COMPU_METHOD rel_uw_b100 "" RAT_FUNC "%6.4" "%" COEFFS 0 65536 0 0 0 100 /end COMPU_METHOD
/begin COMPU_METHOD rel_uw_b40 "" RAT_FUNC "%6.5" "%" COEFFS 0 65536 0 0 0 40 /end COMPU_METHOD
/begin COMPU_METHOD rel_uw_q0p0234 "" RAT_FUNC "%6.4" "%" COEFFS 0 32 0 0 0 0.75 /end COMPU_METHOD
/begin COMPU_METHOD RevCnt "" RAT_FUNC "%6.4" "-" COEFFS 0 16 0 0 0 1 /end COMPU_METHOD
/begin COMPU_METHOD r_uw_q2 "" RAT_FUNC "%6.2" "Ohm" COEFFS 0 1 0 0 0 2 /end COMPU_METHOD
/begin COMPU_METHOD spg_q0p005 "" RAT_FUNC "%6.4" "V" COEFFS 0 1 0 0 0 0.005 /end COMPU_METHOD
/begin COMPU_METHOD spg_ub_b5 "" RAT_FUNC "%6.4" "V" COEFFS 0 256 0 0 0 5 /end COMPU_METHOD
/begin COMPU_METHOD spg_uw_q0p000076 "" RAT_FUNC "%7.6" "V" COEFFS 0 65536 0 0 0 5 /end COMPU_METHOD
/begin COMPU_METHOD spg_uw_q0p001222 "" RAT_FUNC "%6.4" "V" COEFFS 0 65536 0 0 0 80 /end COMPU_METHOD
/begin COMPU_METHOD spg_uw_q0p00488 "" RAT_FUNC "%6.4" "V" COEFFS 0 1024 0 0 0 5 /end COMPU_METHOD
/begin COMPU_METHOD t100msxs_ub_b25p5 "" RAT_FUNC "%6.3" "s" COEFFS 0 1 0 0 0 0.1 /end COMPU_METHOD
/begin COMPU_METHOD t100msxs_uw_b6553p5 "" RAT_FUNC "%6.3" "s" COEFFS 0 1 0 0 0 0.1 /end COMPU_METHOD
/begin COMPU_METHOD t50msxs_q0p05 "" RAT_FUNC "%6.4" "s" COEFFS 0 1 0 0 0 0.05 /end COMPU_METHOD
/begin COMPU_METHOD Temp_Cels "" RAT_FUNC "%6.1" "deg C" COEFFS 0 10 2731.4 0 0 1 /end COMPU_METHOD
/begin COMPU_METHOD temp_q0p039 "" RAT_FUNC "%6.4" "K/s" COEFFS 0 256 0 0 0 10 /end COMPU_METHOD
/begin COMPU_METHOD TimeDelay_ms "" RAT_FUNC "%13.2" "ms" COEFFS 0 0 1 0 2.3283064365387e-007 0 /end COMPU_METHOD
/begin COMPU_METHOD Time_Dt "" RAT_FUNC "%9.8" "s" COEFFS 0 1000000 0 0 0 1 /end COMPU_METHOD
/begin COMPU_METHOD Time_ms "" RAT_FUNC "%6.1" "ms" COEFFS 0 0.1 0 0 0 1 /end COMPU_METHOD
/begin COMPU_METHOD t_q0p0001_ms "" RAT_FUNC "%7.6" "ms" COEFFS 0 10000 0 0 0 1 /end COMPU_METHOD
/begin COMPU_METHOD t_q0p01 "" RAT_FUNC "%6.4" "s" COEFFS 0 100 0 0 0 1 /end COMPU_METHOD
/begin COMPU_METHOD t_q0p02 "" RAT_FUNC "%6.4" "s" COEFFS 0 100 0 0 0 2 /end COMPU_METHOD
/begin COMPU_METHOD t_q0p1 "" RAT_FUNC "%6.3" "s" COEFFS 0 10 0 0 0 1 /end COMPU_METHOD
/begin COMPU_METHOD vfzg_uw_b512 "" RAT_FUNC "%6.4" "km/h" COEFFS 0 65536 0 0 0 512 /end COMPU_METHOD
/begin COMPU_METHOD zk100msxs_uw_b655 "" RAT_FUNC "%6.1" "s" COEFFS 0 0 65536 0 10 0 /end COMPU_METHOD
/begin COMPU_METHOD zk100msxs_uw_b6553 "" RAT_FUNC "%6.1" "s" COEFFS 0 0 65536 0 10 0 /end COMPU_METHOD
/begin COMPU_METHOD zk100msxs_uw_b6553p6 "" RAT_FUNC "%6.1" "s" COEFFS 0 0 65536 0 10 0 /end COMPU_METHOD
/begin RECORD_LAYOUT GkfWU8 FNC_VALUES 1 UBYTE COLUMN_DIR DIRECT /end RECORD_LAYOUT
/begin RECORD_LAYOUT GklWU8 FNC_VALUES 1 UBYTE COLUMN_DIR DIRECT /end RECORD_LAYOUT
/begin RECORD_LAYOUT KfAxU8AyU8SstxU16SstyU16WU16 NO_AXIS_PTS_X 1 UWORD NO_AXIS_PTS_Y 2 UWORD AXIS_PTS_X 3 UWORD INDEX_INCR DIRECT AXIS_PTS_Y 4 UWORD INDEX_INCR DIRECT FNC_VALUES 5 UWORD COLUMN_DIR DIRECT /end RECORD_LAYOUT
/begin RECORD_LAYOUT KfAxU8AyU8SstxU16SstyU8WU8 NO_AXIS_PTS_X 1 UBYTE NO_AXIS_PTS_Y 2 UBYTE AXIS_PTS_X 3 UWORD INDEX_INCR DIRECT AXIS_PTS_Y 4 UBYTE INDEX_INCR DIRECT FNC_VALUES 5 UBYTE COLUMN_DIR DIRECT /end RECORD_LAYOUT
/begin RECORD_LAYOUT KlAxU8SstxS16WS16 NO_AXIS_PTS_X 1 SWORD AXIS_PTS_X 2 SWORD INDEX_INCR DIRECT FNC_VALUES 3 SWORD COLUMN_DIR DIRECT /end RECORD_LAYOUT
/begin RECORD_LAYOUT KlAxU8SstxS16WU16_Static NO_AXIS_PTS_X 1 UWORD AXIS_PTS_X 2 SWORD INDEX_INCR DIRECT FNC_VALUES 3 UWORD COLUMN_DIR DIRECT STATIC_RECORD_LAYOUT /end RECORD_LAYOUT
/begin RECORD_LAYOUT KlAxU8SstxU16WU16 NO_AXIS_PTS_X 1 UWORD AXIS_PTS_X 2 UWORD INDEX_INCR DIRECT FNC_VALUES 3 UWORD COLUMN_DIR DIRECT /end RECORD_LAYOUT
/begin RECORD_LAYOUT KlAxU8SstxU16WU8_Static NO_AXIS_PTS_X 1 UWORD AXIS_PTS_X 2 UWORD INDEX_INCR DIRECT FNC_VALUES 3 UBYTE COLUMN_DIR DIRECT STATIC_RECORD_LAYOUT /end RECORD_LAYOUT
/begin RECORD_LAYOUT KlAxU8SstxU8WU8 NO_AXIS_PTS_X 1 UBYTE AXIS_PTS_X 2 UBYTE INDEX_INCR DIRECT FNC_VALUES 3 UBYTE COLUMN_DIR DIRECT /end RECORD_LAYOUT
/begin RECORD_LAYOUT KwSl FNC_VALUES 1 SLONG COLUMN_DIR DIRECT /end RECORD_LAYOUT
/begin RECORD_LAYOUT KwUb FNC_VALUES 1 UBYTE COLUMN_DIR DIRECT /end RECORD_LAYOUT
/begin RECORD_LAYOUT KwUw FNC_VALUES 1 UWORD COLUMN_DIR DIRECT /end RECORD_LAYOUT
/begin RECORD_LAYOUT KwWS16 FNC_VALUES 1 SWORD COLUMN_DIR DIRECT /end RECORD_LAYOUT
/begin RECORD_LAYOUT KwWU16 FNC_VALUES 1 UWORD COLUMN_DIR DIRECT /end RECORD_LAYOUT
/begin RECORD_LAYOUT KwWU8 FNC_VALUES 1 UBYTE COLUMN_DIR DIRECT /end RECORD_LAYOUT
/begin RECORD_LAYOUT RB_Curve_S16_S16 NO_AXIS_PTS_X 1 SWORD AXIS_PTS_X 2 SWORD INDEX_INCR DIRECT FNC_VALUES 3 SWORD COLUMN_DIR DIRECT /end RECORD_LAYOUT
/begin RECORD_LAYOUT RB_Curve_S16_U16_Static NO_AXIS_PTS_X 1 SWORD AXIS_PTS_X 2 SWORD INDEX_INCR DIRECT FNC_VALUES 3 UWORD COLUMN_DIR DIRECT STATIC_RECORD_LAYOUT /end RECORD_LAYOUT
/begin RECORD_LAYOUT RB_Curve_U16_S16_Static NO_AXIS_PTS_X 1 UWORD AXIS_PTS_X 2 UWORD INDEX_INCR DIRECT FNC_VALUES 3 SWORD COLUMN_DIR DIRECT STATIC_RECORD_LAYOUT /end RECORD_LAYOUT
/begin RECORD_LAYOUT RB_Curve_U8_S8_Static NO_AXIS_PTS_X 1 UBYTE AXIS_PTS_X 2 UBYTE INDEX_INCR DIRECT FNC_VALUES 3 SBYTE COLUMN_DIR DIRECT STATIC_RECORD_LAYOUT /end RECORD_LAYOUT
/begin RECORD_LAYOUT RB_Map_S16S16_S16 NO_AXIS_PTS_X 1 SWORD NO_AXIS_PTS_Y 2 SWORD AXIS_PTS_X 3 SWORD INDEX_INCR DIRECT AXIS_PTS_Y 4 SWORD INDEX_INCR DIRECT FNC_VALUES 5 SWORD COLUMN_DIR DIRECT /end RECORD_LAYOUT
/begin RECORD_LAYOUT RB_Val_Ws16 FNC_VALUES 1 SWORD COLUMN_DIR DIRECT /end RECORD_LAYOUT
/begin RECORD_LAYOUT RB_Val_Wu16 FNC_VALUES 1 UWORD COLUMN_DIR DIRECT /end RECORD_LAYOUT
/begin RECORD_LAYOUT RB_Val_Wu8 FNC_VALUES 1 UBYTE COLUMN_DIR DIRECT /end RECORD_LAYOUT
/begin RECORD_LAYOUT SstAU8SstS16 NO_AXIS_PTS_X 1 SWORD AXIS_PTS_X 2 SWORD INDEX_INCR DIRECT /end RECORD_LAYOUT
/begin RECORD_LAYOUT SstAU8SstU16 NO_AXIS_PTS_X 1 UWORD AXIS_PTS_X 2 UWORD INDEX_INCR DIRECT /end RECORD_LAYOUT
/begin RECORD_LAYOUT ValA_Ws16 FNC_VALUES 1 SWORD COLUMN_DIR DIRECT /end RECORD_LAYOUT
/begin RECORD_LAYOUT ValA_Wu8 FNC_VALUES 1 UBYTE COLUMN_DIR DIRECT /end RECORD_LAYOUT
/begin RECORD_LAYOUT Val_Ws16 FNC_VALUES 1 SWORD COLUMN_DIR DIRECT /end RECORD_LAYOUT
/begin RECORD_LAYOUT Val_Ws32 FNC_VALUES 1 SLONG COLUMN_DIR DIRECT /end RECORD_LAYOUT
/begin RECORD_LAYOUT Val_Wu16 FNC_VALUES 1 UWORD COLUMN_DIR DIRECT /end RECORD_LAYOUT
/begin RECORD_LAYOUT Val_Wu8 FNC_VALUES 1 UBYTE COLUMN_DIR DIRECT /end RECORD_LAYOUT
/end MODULE
/end PROJECT
