ASAP2_VERSION 1 60
/begin PROJECT MSE2_BJ10_0038_00 "MDG1"
/begin HEADER "" VERSION "MSE2_BJ10_0038_00" PROJECT_NO MSE2_BJ10_0038_00 /end HEADER
/begin MODULE DIM ""
/begin MOD_COMMON "" BYTE_ORDER MSB_FIRST ALIGNMENT_BYTE 1 ALIGNMENT_WORD 2 ALIGNMENT_LONG 4 ALIGNMENT_INT64 4 ALIGNMENT_FLOAT32_IEEE 4 ALIGNMENT_FLOAT64_IEEE 4 /end MOD_COMMON
/begin CHARACTERISTIC ATS_numInjPfiImp_C "Number of the injections for actuator test for PFI" VALUE 0x9087820 KwUw 65535.00 dez 0.00 65535.00 FORMAT "%8.2" /end CHARACTERISTIC
/begin CHARACTERISTIC ATS_tiInjPfiLngth_C "Injection time for actuator test for PFI" VALUE 0x9087824 KwUl 4294967.29500 t_q0p001_ms 0.00 4294967.29500 FORMAT "%13.5" /end CHARACTERISTIC
/begin CHARACTERISTIC ATS_tiInjPfiPer_C "Injection period for actuator test for PFI" VALUE 0x9087828 KwUl 4294967.29500 t_q0p001_ms 0.00 4294967.29500 FORMAT "%13.5" /end CHARACTERISTIC
/begin CHARACTERISTIC BlDev_uBattHdLampMaxThd_C "Maximum threshold for enabling the Headlamp powerstage diagnosis." VALUE 0x90857E6 KwWU8 25.50 spg_q0p1 0.00 25.50 FORMAT "%5.2" /end CHARACTERISTIC
/begin CHARACTERISTIC BlDev_uBattHdLampMinThd_C "Minimum threshold for enabling the Headlamp powerstage diagnosis." VALUE 0x90857E7 KwWU8 25.50 spg_q0p1 0.00 25.50 FORMAT "%5.2" /end CHARACTERISTIC
/begin CHARACTERISTIC CEngDsT_stSwtPlausSTC_C "code word: diagnosis configuration for tmot" VALUE 0x9081850 RB_Val_Wu8 255.0 OneToOne 0.00 255.0 FORMAT "%5.1" /end CHARACTERISTIC
/begin CHARACTERISTIC CEngDsT_swtEnaRamp_C "Switch to enable ramp for Engine coolent temperature sensor" VALUE 0x9081851 RB_Val_Wu8 1.00000000000 B_TRUE 0.00 1.00000000000 FORMAT "%13.11" /end CHARACTERISTIC
/begin CHARACTERISTIC CEngDsT_tDeltaRamp_C "Delta temperature for ramping engine coolent downstream temperature" VALUE 0x9081852 RB_Val_Ws16 6553.500 Temp_Kelv -3276.800 3276.700 FORMAT "%8.3" /end CHARACTERISTIC
/begin CHARACTERISTIC CEngDsT_tDifSTCErrThd_C "Parameter which specifies the threshold for difference between maximum and minimum value of Coolant Temperature sensor to detect stuck error" VALUE 0x9081854 RB_Val_Ws32 429496729.500 TempDiff_Kelv -214748364.800 214748364.700 FORMAT "%13.3" /end CHARACTERISTIC
/begin CHARACTERISTIC CEngDsT_tiEngRunngDebSTC_C "Time parameter to debounce engine running condition" VALUE 0x9081858 RB_Val_Wu16 6553.500 t_q0p1 0.00 6553.500 FORMAT "%8.3" /end CHARACTERISTIC
/begin CHARACTERISTIC CEngDsT_tiSRCMaxErr_C "Error debounce time for signal range check max error engine coolant temperature sensor" VALUE 0x908185A RB_Val_Wu8 25.50 t_q0p1 0.00 25.50 FORMAT "%5.2" /end CHARACTERISTIC
/begin CHARACTERISTIC CEngDsT_tiSRCMaxHeal_C "Heal debounce time for signal range check max error engine coolant temperature sensor" VALUE 0x908185B RB_Val_Wu8 25.50 t_q0p1 0.00 25.50 FORMAT "%5.2" /end CHARACTERISTIC
/begin CHARACTERISTIC CEngDsT_tiSRCMinErr_C "Error debounce time for signal range check min error engine coolant temperature sensor" VALUE 0x908185C RB_Val_Wu8 25.50 t_q0p1 0.00 25.50 FORMAT "%5.2" /end CHARACTERISTIC
/begin CHARACTERISTIC CEngDsT_tiSRCMinHeal_C "Heal debounce time for signal range check min error engine coolant temperature sensor" VALUE 0x908185D RB_Val_Wu8 25.50 t_q0p1 0.00 25.50 FORMAT "%5.2" /end CHARACTERISTIC
/begin CHARACTERISTIC CEngDsT_tSnsrMinSTCErrDetn_C "Temperature threshold parameter above which stuck at high error could be detected for Coolant Temperature sensor" VALUE 0x908185E RB_Val_Ws16 6553.500 Temp_Cels -3549.940 3003.560 FORMAT "%8.3" /end CHARACTERISTIC
/begin CHARACTERISTIC CEngDsT_uRawSRCMax_C "upper threshold sensor voltage for signal-range-check engine coolant temperature sensor" VALUE 0x9081860 RB_Val_Wu16 319.9951 spg_uw_q0p00488 0.00 319.9951 FORMAT "%8.4" /end CHARACTERISTIC
/begin CHARACTERISTIC CEngDsT_uRawSRCMin_C "lower threshold sensor voltage for signal-range-check engine coolant temperature sensor" VALUE 0x9081862 RB_Val_Wu16 319.9951 spg_uw_q0p00488 0.00 319.9951 FORMAT "%8.4" /end CHARACTERISTIC
/begin CHARACTERISTIC CWDISELCN "Codeword for selecting Clutch input (2W Quadri) or Oil pressure Input (3W)" VALUE 0x90857D8 KwWU8 255.0 dez 0.00 255.0 FORMAT "%5.1" /end CHARACTERISTIC
/begin CHARACTERISTIC CWPNSELCN_C "Code word for pin selection for Low battery or side stand indication" VALUE 0x90857D9 KwWU8 255.0 dez 0.00 255.0 FORMAT "%5.1" /end CHARACTERISTIC
/begin CHARACTERISTIC CWPSHdLamp "Codeword for power stage and diagnostics of Headlamp relay" VALUE 0x90857E8 KwWU8 255.0 dez 0.00 255.0 FORMAT "%5.1" /end CHARACTERISTIC
/begin CHARACTERISTIC CWTMOTMODAVL "Code word to select Model value for engine temparture" VALUE 0x9081864 RB_Val_Wu8 1.00000000000 B_TRUE 0.00 1.00000000000 FORMAT "%13.11" /end CHARACTERISTIC
/begin CHARACTERISTIC CWTMOVHSELN "code word to select overheat flag evaluation B_tmovh" VALUE 0x9081865 RB_Val_Wu8 1.00000000000 B_TRUE 0.00 1.00000000000 FORMAT "%13.11" /end CHARACTERISTIC
/begin CHARACTERISTIC CWZUEAB "codeword ignition off" VALUE 0x90877FC KwUb 255.0 OneToOne 0.00 255.0 FORMAT "%5.1" /end CHARACTERISTIC
/begin CHARACTERISTIC CWZWMIN "Codeword to activate FC-interal features(ZWMIN)" VALUE 0x90857EE KwWU8 255.0 dez 0.00 255.0 FORMAT "%5.1" /end CHARACTERISTIC
/begin CHARACTERISTIC DFC_CtlMsk2.DFC_CEngDsTPlausSTC_C "Behaviour control mask / Behaviour control masks of check DFC_CEngDsTPlausSTC" VALUE 0x90803AA Val_Wu8 255.0 DFES_OneToOne 0.00 255.0 FORMAT "%5.1" /end CHARACTERISTIC
/begin CHARACTERISTIC DFC_CtlMsk2.DFC_CEngDsTPhysRngHi_C "Behaviour control mask / Behaviour control masks of check DFC_CEngDsTPhysRngHi" VALUE 0x90803DA Val_Wu8 255.0 DFES_OneToOne 0.00 255.0 FORMAT "%5.1" /end CHARACTERISTIC
/begin CHARACTERISTIC DFC_CtlMsk2.DFC_CEngDsTPhysRngLo_C "Behaviour control mask / Behaviour control masks of check DFC_CEngDsTPhysRngLo" VALUE 0x90803DB Val_Wu8 255.0 DFES_OneToOne 0.00 255.0 FORMAT "%5.1" /end CHARACTERISTIC
/begin CHARACTERISTIC DFC_CtlMsk2.DFC_CEngDsTSRCMax_C "Behaviour control mask / Behaviour control masks of check DFC_CEngDsTSRCMax" VALUE 0x90803DC Val_Wu8 255.0 DFES_OneToOne 0.00 255.0 FORMAT "%5.1" /end CHARACTERISTIC
/begin CHARACTERISTIC DFC_CtlMsk2.DFC_CEngDsTSRCMin_C "Behaviour control mask / Behaviour control masks of check DFC_CEngDsTSRCMin" VALUE 0x90803DD Val_Wu8 255.0 DFES_OneToOne 0.00 255.0 FORMAT "%5.1" /end CHARACTERISTIC
/begin CHARACTERISTIC DFC_CtlMsk2.DFC_HdLampMax_C "Behaviour control mask / Behaviour control masks of check DFC_HdLampMax" VALUE 0x90803F6 Val_Wu8 255.0 DFES_OneToOne 0.00 255.0 FORMAT "%5.1" /end CHARACTERISTIC
/begin CHARACTERISTIC DFC_CtlMsk2.DFC_HdLampMin_C "Behaviour control mask / Behaviour control masks of check DFC_HdLampMin" VALUE 0x90803F7 Val_Wu8 255.0 DFES_OneToOne 0.00 255.0 FORMAT "%5.1" /end CHARACTERISTIC
/begin CHARACTERISTIC DFC_CtlMsk2.DFC_HdLampSig_C "Behaviour control mask / Behaviour control masks of check DFC_HdLampSig" VALUE 0x90803F8 Val_Wu8 255.0 DFES_OneToOne 0.00 255.0 FORMAT "%5.1" /end CHARACTERISTIC
/begin CHARACTERISTIC DFC_CtlMsk2.DFC_IgnCoil1Err_C "Behaviour control mask / Behaviour control masks of check DFC_IgnCoil1Err" VALUE 0x90803F9 Val_Wu8 255.0 DFES_OneToOne 0.00 255.0 FORMAT "%5.1" /end CHARACTERISTIC
/begin CHARACTERISTIC DFC_CtlMsk2.DFC_IgnCoil2Err_C "Behaviour control mask / Behaviour control masks of check DFC_IgnCoil2Err" VALUE 0x90803FA Val_Wu8 255.0 DFES_OneToOne 0.00 255.0 FORMAT "%5.1" /end CHARACTERISTIC
/begin CHARACTERISTIC DFC_CtlMsk2.DFC_IgnIgbtDiagSCG_0_C "Behaviour control mask / Behaviour control masks of check DFC_IgnIgbtDiagSCG_0" VALUE 0x90803FB Val_Wu8 255.0 DFES_OneToOne 0.00 255.0 FORMAT "%5.1" /end CHARACTERISTIC
/begin CHARACTERISTIC DFC_CtlMsk2.DFC_IgnIgbtDiagSCG_1_C "Behaviour control mask / Behaviour control masks of check DFC_IgnIgbtDiagSCG_1" VALUE 0x90803FC Val_Wu8 255.0 DFES_OneToOne 0.00 255.0 FORMAT "%5.1" /end CHARACTERISTIC
/begin CHARACTERISTIC DFC_CtlMsk2.DFC_TMnpl_C "Behaviour control mask / Behaviour control masks of check DFC_TMnpl" VALUE 0x9080433 Val_Wu8 255.0 DFES_OneToOne 0.00 255.0 FORMAT "%5.1" /end CHARACTERISTIC
/begin CHARACTERISTIC DFC_CtlMsk2.DFC_UBmax_C "Behaviour control mask / Behaviour control masks of check DFC_UBmax" VALUE 0x9080434 Val_Wu8 255.0 DFES_OneToOne 0.00 255.0 FORMAT "%5.1" /end CHARACTERISTIC
/begin CHARACTERISTIC DFC_CtlMsk2.DFC_UBmin_C "Behaviour control mask / Behaviour control masks of check DFC_UBmin" VALUE 0x9080435 Val_Wu8 255.0 DFES_OneToOne 0.00 255.0 FORMAT "%5.1" /end CHARACTERISTIC
/begin CHARACTERISTIC DFC_CtlMsk2.DFC_UBnpl_C "Behaviour control mask / Behaviour control masks of check DFC_UBnpl" VALUE 0x9080436 Val_Wu8 255.0 DFES_OneToOne 0.00 255.0 FORMAT "%5.1" /end CHARACTERISTIC
/begin CHARACTERISTIC DFC_DisblMsk2.DFC_CEngDsTPlausSTC_C "disable mask / Disable masks of check DFC_CEngDsTPlausSTC" VALUE 0x9080D7A Val_Wu8 255.0 DFES_OneToOne 0.00 255.0 FORMAT "%5.1" /end CHARACTERISTIC
/begin CHARACTERISTIC DFC_DisblMsk2.DFC_CEngDsTPhysRngHi_C "disable mask / Disable masks of check DFC_CEngDsTPhysRngHi" VALUE 0x9080DAA Val_Wu8 255.0 DFES_OneToOne 0.00 255.0 FORMAT "%5.1" /end CHARACTERISTIC
/begin CHARACTERISTIC DFC_DisblMsk2.DFC_CEngDsTPhysRngLo_C "disable mask / Disable masks of check DFC_CEngDsTPhysRngLo" VALUE 0x9080DAB Val_Wu8 255.0 DFES_OneToOne 0.00 255.0 FORMAT "%5.1" /end CHARACTERISTIC
/begin CHARACTERISTIC DFC_DisblMsk2.DFC_CEngDsTSRCMax_C "disable mask / Disable masks of check DFC_CEngDsTSRCMax" VALUE 0x9080DAC Val_Wu8 255.0 DFES_OneToOne 0.00 255.0 FORMAT "%5.1" /end CHARACTERISTIC
/begin CHARACTERISTIC DFC_DisblMsk2.DFC_CEngDsTSRCMin_C "disable mask / Disable masks of check DFC_CEngDsTSRCMin" VALUE 0x9080DAD Val_Wu8 255.0 DFES_OneToOne 0.00 255.0 FORMAT "%5.1" /end CHARACTERISTIC
/begin CHARACTERISTIC DFC_DisblMsk2.DFC_HdLampMax_C "disable mask / Disable masks of check DFC_HdLampMax" VALUE 0x9080DC6 Val_Wu8 255.0 DFES_OneToOne 0.00 255.0 FORMAT "%5.1" /end CHARACTERISTIC
/begin CHARACTERISTIC DFC_DisblMsk2.DFC_HdLampMin_C "disable mask / Disable masks of check DFC_HdLampMin" VALUE 0x9080DC7 Val_Wu8 255.0 DFES_OneToOne 0.00 255.0 FORMAT "%5.1" /end CHARACTERISTIC
/begin CHARACTERISTIC DFC_DisblMsk2.DFC_HdLampSig_C "disable mask / Disable masks of check DFC_HdLampSig" VALUE 0x9080DC8 Val_Wu8 255.0 DFES_OneToOne 0.00 255.0 FORMAT "%5.1" /end CHARACTERISTIC
/begin CHARACTERISTIC DFC_DisblMsk2.DFC_IgnCoil1Err_C "disable mask / Disable masks of check DFC_IgnCoil1Err" VALUE 0x9080DC9 Val_Wu8 255.0 DFES_OneToOne 0.00 255.0 FORMAT "%5.1" /end CHARACTERISTIC
/begin CHARACTERISTIC DFC_DisblMsk2.DFC_IgnCoil2Err_C "disable mask / Disable masks of check DFC_IgnCoil2Err" VALUE 0x9080DCA Val_Wu8 255.0 DFES_OneToOne 0.00 255.0 FORMAT "%5.1" /end CHARACTERISTIC
/begin CHARACTERISTIC DFC_DisblMsk2.DFC_IgnIgbtDiagSCG_0_C "disable mask / Disable masks of check DFC_IgnIgbtDiagSCG_0" VALUE 0x9080DCB Val_Wu8 255.0 DFES_OneToOne 0.00 255.0 FORMAT "%5.1" /end CHARACTERISTIC
/begin CHARACTERISTIC DFC_DisblMsk2.DFC_IgnIgbtDiagSCG_1_C "disable mask / Disable masks of check DFC_IgnIgbtDiagSCG_1" VALUE 0x9080DCC Val_Wu8 255.0 DFES_OneToOne 0.00 255.0 FORMAT "%5.1" /end CHARACTERISTIC
/begin CHARACTERISTIC DFC_DisblMsk2.DFC_TMnpl_C "disable mask / Disable masks of check DFC_TMnpl" VALUE 0x9080E03 Val_Wu8 255.0 DFES_OneToOne 0.00 255.0 FORMAT "%5.1" /end CHARACTERISTIC
/begin CHARACTERISTIC DFC_DisblMsk2.DFC_UBmax_C "disable mask / Disable masks of check DFC_UBmax" VALUE 0x9080E04 Val_Wu8 255.0 DFES_OneToOne 0.00 255.0 FORMAT "%5.1" /end CHARACTERISTIC
/begin CHARACTERISTIC DFC_DisblMsk2.DFC_UBmin_C "disable mask / Disable masks of check DFC_UBmin" VALUE 0x9080E05 Val_Wu8 255.0 DFES_OneToOne 0.00 255.0 FORMAT "%5.1" /end CHARACTERISTIC
/begin CHARACTERISTIC DFC_DisblMsk2.DFC_UBnpl_C "disable mask / Disable masks of check DFC_UBnpl" VALUE 0x9080E06 Val_Wu8 255.0 DFES_OneToOne 0.00 255.0 FORMAT "%5.1" /end CHARACTERISTIC
/begin CHARACTERISTIC DTMMOD "Delta threshold for temperature difference from sensor and model." VALUE 0x9081866 RB_Val_Ws16 6553.500 Temp_Cels -3549.940 3003.560 FORMAT "%8.3" /end CHARACTERISTIC
/begin CHARACTERISTIC DTMOVH "TMOT hysteresis for overheat protection" VALUE 0x9081868 RB_Val_Ws16 6553.500 Temp_Cels -3549.940 3003.560 FORMAT "%8.3" /end CHARACTERISTIC
/begin CHARACTERISTIC DTMTAMN "Threshold in case of cold temperatures for min error debouncing" VALUE 0x908186A RB_Val_Ws16 6553.500 Temp_Cels -3549.940 3003.560 FORMAT "%8.3" /end CHARACTERISTIC
/begin CHARACTERISTIC DVFZBEG "Delta speed for change limitation" VALUE 0x9085682 KwWU16 511.9922 vfzg_uw_b512 0.00 511.9922 FORMAT "%8.4" /end CHARACTERISTIC
/begin CHARACTERISTIC ENGOFFTIM "Threshold for a valid engine off time to select the Engine temperature model" VALUE 0x908186C RB_Val_Wu16 65535.00 t_q1 0.00 65535.00 FORMAT "%8.2" /end CHARACTERISTIC
/begin CHARACTERISTIC FSZTM "Factor dwell angle correction tmot depending" CURVE 0x90857F0 KlAxU8SstxS16WU16_Static 1.992188 fak_ub_b2 0.00 1.992188 FORMAT "%8.6" EXTENDED_LIMITS 0.00 511.9922
 /begin AXIS_DESCR STD_AXIS EngDa_tEng Temp_Cels 8 -3549.940 3003.560 FORMAT "%8.3" DEPOSIT ABSOLUTE /end AXIS_DESCR
/end CHARACTERISTIC
/begin CHARACTERISTIC FSZTMSL "Factor dwell angle correction tmot depending for slave plug" CURVE 0x9085812 KlAxU8SstxS16WU16_Static 1.992188 fak_ub_b2 0.00 1.992188 FORMAT "%8.6" EXTENDED_LIMITS 0.00 511.9922
 /begin AXIS_DESCR STD_AXIS EngDa_tEng Temp_Cels 8 -3549.940 3003.560 FORMAT "%8.3" DEPOSIT ABSOLUTE /end AXIS_DESCR
/end CHARACTERISTIC
/begin CHARACTERISTIC GGUB_nLowBattEngSpd_C "Engine Speed Threshold for Low Battery Indication" VALUE 0x9085672 KwWU16 16383.75 nmot_uw_q0p25 0.00 16383.75 FORMAT "%8.2" /end CHARACTERISTIC
/begin CHARACTERISTIC GGUB_uLowBattHi_C "Upper Thershold Voltage for Battery Low Indication" VALUE 0x9085674 KwWU8 25.50 spg_q0p1 0.00 25.50 FORMAT "%5.2" /end CHARACTERISTIC
/begin CHARACTERISTIC GGUB_uLowBattLo_C "Lower Theshold Voltage for Battery Low Indiaction" VALUE 0x9085675 KwWU8 25.50 spg_q0p1 0.00 25.50 FORMAT "%5.2" /end CHARACTERISTIC
/begin CHARACTERISTIC HDLAMPVEHVMN "Minimum Vehicle speed for Headlamp relay on" VALUE 0x90857EA KwWS16 327.6700 vel_q0p01 0.00 327.6700 FORMAT "%8.4" EXTENDED_LIMITS -327.6800 327.6700 /end CHARACTERISTIC
/begin CHARACTERISTIC HEGO_duHeatgMapMax_C "Maximum heating voltage offset for map controlled heating" VALUE 0x9085698 KwSw 25.59961 spg_q0p00039 -12.80000 12.79961 FORMAT "%8.5" /end CHARACTERISTIC
/begin CHARACTERISTIC HEGO_duNomHeatrIntglMax_C "Maximum limit for heater voltage difference, I-part" VALUE 0x908569A KwSw 25.59961 spg_q0p00039 -12.80000 12.79961 FORMAT "%8.5" /end CHARACTERISTIC
/begin CHARACTERISTIC HEGO_duNomHeatrIntglMin_C "Minimum limit for heater voltage difference, I-part" VALUE 0x908569C KwSw 25.59961 spg_q0p00039 -12.80000 12.79961 FORMAT "%8.5" /end CHARACTERISTIC
/begin CHARACTERISTIC HEGO_duNomHeatrPropMax_C "Maximum limit for heater voltage difference, P-part" VALUE 0x908569E KwSw 25.59961 spg_q0p00039 -12.80000 12.79961 FORMAT "%8.5" /end CHARACTERISTIC
/begin CHARACTERISTIC HEGO_duNomHeatrPropMin_C "Minimum limit for heater voltage difference, P-part" VALUE 0x90856A0 KwSw 25.59961 spg_q0p00039 -12.80000 12.79961 FORMAT "%8.5" /end CHARACTERISTIC
/begin CHARACTERISTIC HEGO_facHeatgKi_C "I-part gain of closed loop heating control" VALUE 0x90856A2 KwUw 12.79980 q1p953125Em4_V_DIV_s_Ohm 0.00 12.79980 FORMAT "%8.5" /end CHARACTERISTIC
/begin CHARACTERISTIC HEGO_facHeatgKp_T "P-part gain of closed loop heating control" CURVE 0x90856A4 KlAxU8SstxS16WU16_Static 12.79980 q1p953125Em4_V_DIV_Ohm 0.00 12.79980 FORMAT "%8.5"
 /begin AXIS_DESCR STD_AXIS NO_INPUT_QUANTITY r_uw_q2 11 -65536.00 65534.00 FORMAT "%8.2" DEPOSIT ABSOLUTE /end AXIS_DESCR
/end CHARACTERISTIC
/begin CHARACTERISTIC HEGO_flgDynSimnS1_C "Codeword for enabling dynamic simulation of binary sensor 1" VALUE 0x908568A KwWU8 1.00000000000 B_TRUE 0.00 1.00000000000 FORMAT "%13.11" /end CHARACTERISTIC
/begin CHARACTERISTIC HEGO_flgDynSimnS2_C "Codeword for enabling dynamic simulation of binary sensor 2" VALUE 0x908568B KwWU8 1.00000000000 B_TRUE 0.00 1.00000000000 FORMAT "%13.11" /end CHARACTERISTIC
/begin CHARACTERISTIC HEGO_ratHeatgAntiWndUpMax_C "Maximum heating duty ratio for anti wind up" VALUE 0x90856D2 KwUw 2.559961 fak_q3p906Em5 0.00 2.559961 FORMAT "%8.6" /end CHARACTERISTIC
/begin CHARACTERISTIC HEGO_ratHeatgAntiWndUpMin_C "Minimum heating duty ratio for anti wind up" VALUE 0x90856D4 KwUw 2.559961 fak_q3p906Em5 0.00 2.559961 FORMAT "%8.6" /end CHARACTERISTIC
/begin CHARACTERISTIC HEGO_rDbndMax_C "Maximum value for Ri deadband" VALUE 0x90856D6 KwUw 131070.0 r_uw_q2 0.00 131070.0 FORMAT "%8.1" /end CHARACTERISTIC
/begin CHARACTERISTIC HEGO_rDbndMin_C "Minimum value for Ri deadband" VALUE 0x90856D8 KwUw 131070.0 r_uw_q2 0.00 131070.0 FORMAT "%8.1" /end CHARACTERISTIC
/begin CHARACTERISTIC HEGO_rHeatgOffLo_C "Internal resistance threshold for HEGO sensor closed loop heating control shut-off" VALUE 0x90856DA KwUw 131070.0 r_uw_q2 0.00 131070.0 FORMAT "%8.1" /end CHARACTERISTIC
/begin CHARACTERISTIC HEGO_rHeatgOff_C "Internal resistance threshold for HEGO sensor heating shut- off" VALUE 0x90856DC KwUw 131070.0 r_uw_q2 0.00 131070.0 FORMAT "%8.1" /end CHARACTERISTIC
/begin CHARACTERISTIC HEGO_rNom_C "Nominal internal resistance" VALUE 0x90856DE KwUw 131070.0 r_uw_q2 0.00 131070.0 FORMAT "%8.1" /end CHARACTERISTIC
/begin CHARACTERISTIC HEGO_stHeatrCtrl_C "Heater control start flag" VALUE 0x90856E0 KwUb 225.0 dez 0.00 225.0 FORMAT "%5.1" EXTENDED_LIMITS 0.00 255.0 /end CHARACTERISTIC
/begin CHARACTERISTIC HEGO_tEgHeatgEnaMax_C "Maximum exhaust gas temperature for heating of HEGO sensors" VALUE 0x90856E1 KwUb 1275. temp_ub_q5_o50 -50.00 1225. FORMAT "%5.0" /end CHARACTERISTIC
/begin CHARACTERISTIC HEGO_tEgMinHeatrStrt_C "Minimum exhaust gas temperature for heater start" VALUE 0x90856E2 KwUb 1275. temp_ub_q5_o50 -50.00 1225. FORMAT "%5.0" /end CHARACTERISTIC
/begin CHARACTERISTIC HEGO_tiDebHeatgMapClc_C "Debouncing time for activation of closed loop heating control" VALUE 0x90856E4 KwUw 65.53500 t_q0p001 0.00 65.53500 FORMAT "%8.5" /end CHARACTERISTIC
/begin CHARACTERISTIC HEGO_tiDebHeatgMaxHys_C "Debouncing time for maximum heating hysteresis" VALUE 0x90856E6 KwUw 65.53500 t_q0p001 0.00 65.53500 FORMAT "%8.5" /end CHARACTERISTIC
/begin CHARACTERISTIC HEGO_tiDebHeatgMax_C "Debouncing time for maximum heating" VALUE 0x90856E8 KwUw 65.53500 t_q0p001 0.00 65.53500 FORMAT "%8.5" /end CHARACTERISTIC
/begin CHARACTERISTIC HEGO_tiDebHeatrStrtInhb_C "Debouncing time for heater start" VALUE 0x90856EA KwUw 65.53500 t1msxs_b65p535 0.00 65.53500 FORMAT "%8.5" /end CHARACTERISTIC
/begin CHARACTERISTIC HEGO_tiFolwSimn_C "Time constant of the slow transition for symmetric fault" VALUE 0x908568C KwWU16 655.34999985 zk10msxs_uw_b655p36 0.010000152590 655.36000000 FORMAT "%12.8" /end CHARACTERISTIC
/begin CHARACTERISTIC HEGO_tiHldSimn_C "Delay time for the symmetric fault" VALUE 0x908568E KwWU16 655.3500 t_q0p01 0.00 655.3500 FORMAT "%8.4" /end CHARACTERISTIC
/begin CHARACTERISTIC HEGO_uHeatgMaxDeb_C "Maximum heating voltage, debounced" VALUE 0x90856EC KwUw 23.64648 spg_q0p00039 1.953125 25.59961 FORMAT "%8.5" EXTENDED_LIMITS 0.00 25.59961 /end CHARACTERISTIC
/begin CHARACTERISTIC HEGO_uHeatgMax_C "Maximum heating voltage" VALUE 0x90856EE KwUw 23.64648 spg_q0p00039 1.953125 25.59961 FORMAT "%8.5" EXTENDED_LIMITS 0.00 25.59961 /end CHARACTERISTIC
/begin CHARACTERISTIC HEGO_uLimdMaxSimnS1_C "Maximum Simulation Voltage of Sensor1" VALUE 0x9085690 KwWU16 327.6750 spg_q0p005 0.00 327.6750 FORMAT "%8.4" /end CHARACTERISTIC
/begin CHARACTERISTIC HEGO_uLimdMaxSimnS2_C "Maximum Simulation Voltage of Sensor2" VALUE 0x9085692 KwWU16 327.6750 spg_q0p005 0.00 327.6750 FORMAT "%8.4" /end CHARACTERISTIC
/begin CHARACTERISTIC HEGO_uLimdMinSimnS1_C "Minimum Simulation Voltage of Sensor 1" VALUE 0x9085694 KwWU16 327.6750 spg_q0p005 0.00 327.6750 FORMAT "%8.4" /end CHARACTERISTIC
/begin CHARACTERISTIC HEGO_uLimdMinSimnS2_C "Minimum Simulation Voltage of Sensor 2" VALUE 0x9085696 KwWU16 327.6750 spg_q0p005 0.00 327.6750 FORMAT "%8.4" /end CHARACTERISTIC
/begin CHARACTERISTIC I15031_nMaxSrv4_C "Maximum engine speed for Mode$04 Clear Diagnostic Information" VALUE 0x908A0D4 Val_Ws16 10000.00 EngN 0.00 10000.00 FORMAT "%8.2" EXTENDED_LIMITS -16384.00 16383.50 /end CHARACTERISTIC
/begin CHARACTERISTIC I15031_PID1C_C "OBD requirements to which vehicle is designed" VALUE 0x908A0D6 Val_Wu8 41.0000000000 I15031_PID1CVerb 1.00000000000 42.0000000000 FORMAT "%13.10" /end CHARACTERISTIC
/begin CHARACTERISTIC I15031_PID9AA_C "Shows if HybridEV Vehicle State is supported in PID9A" VALUE 0x908A0D7 Val_Wu8 255.0 OneToOne 0.00 255.0 FORMAT "%5.1" /end CHARACTERISTIC
/begin CHARACTERISTIC I15031_srv9PIDTable.PID0_C "Group of configuration for supported PID's / Supported PIDs" VALUE 0x908A0D9 Val_Wu8 255.0 OneToOne 0.00 255.0 FORMAT "%5.1" /end CHARACTERISTIC
/begin CHARACTERISTIC I15031_srv9PIDTable.PID1_C "Group of configuration for supported PID's / Message count for VIN" VALUE 0x908A0DA Val_Wu8 255.0 OneToOne 0.00 255.0 FORMAT "%5.1" /end CHARACTERISTIC
/begin CHARACTERISTIC I15031_srv9PIDTable.PID2_C "Group of configuration for supported PID's / VIN" VALUE 0x908A0DB Val_Wu8 255.0 OneToOne 0.00 255.0 FORMAT "%5.1" /end CHARACTERISTIC
/begin CHARACTERISTIC I15031_srv9PIDTable.PID3_C "Group of configuration for supported PID's / Message count for CID" VALUE 0x908A0DC Val_Wu8 255.0 OneToOne 0.00 255.0 FORMAT "%5.1" /end CHARACTERISTIC
/begin CHARACTERISTIC I15031_srv9PIDTable.PID4_C "Group of configuration for supported PID's / CID" VALUE 0x908A0DD Val_Wu8 255.0 OneToOne 0.00 255.0 FORMAT "%5.1" /end CHARACTERISTIC
/begin CHARACTERISTIC I15031_srv9PIDTable.PID5_C "Group of configuration for supported PID's / Message count for CVN" VALUE 0x908A0DE Val_Wu8 255.0 OneToOne 0.00 255.0 FORMAT "%5.1" /end CHARACTERISTIC
/begin CHARACTERISTIC I15031_srv9PIDTable.PID6_C "Group of configuration for supported PID's / CVN" VALUE 0x908A0DF Val_Wu8 255.0 OneToOne 0.00 255.0 FORMAT "%5.1" /end CHARACTERISTIC
/begin CHARACTERISTIC I15031_srv9PIDTable.PID7_C "Group of configuration for supported PID's / Message count for IUMPR" VALUE 0x908A0E0 Val_Wu8 255.0 OneToOne 0.00 255.0 FORMAT "%5.1" /end CHARACTERISTIC
/begin CHARACTERISTIC I15031_srv9PIDTable.PID8_C "Group of configuration for supported PID's / IUMPR" VALUE 0x908A0E1 Val_Wu8 255.0 OneToOne 0.00 255.0 FORMAT "%5.1" /end CHARACTERISTIC
/begin CHARACTERISTIC I15031_srv9PIDTable.PID9_C "Group of configuration for supported PID's / Message count for ECUNAME" VALUE 0x908A0E2 Val_Wu8 255.0 OneToOne 0.00 255.0 FORMAT "%5.1" /end CHARACTERISTIC
/begin CHARACTERISTIC I15031_srv9PIDTable.PIDA_C "Group of configuration for supported PID's / ECUNAME" VALUE 0x908A0E3 Val_Wu8 255.0 OneToOne 0.00 255.0 FORMAT "%5.1" /end CHARACTERISTIC
/begin CHARACTERISTIC I15031_srv9PIDTable.PIDB_C "Group of configuration for supported PID's / release of tester output of IUMPR (Diesel)" VALUE 0x908A0E4 Val_Wu8 255.0 OneToOne 0.00 255.0 FORMAT "%5.1" /end CHARACTERISTIC
/begin CHARACTERISTIC I15031_srv9PIDTable.PIDF_C "Group of configuration for supported PID's / supported information of infotype F" VALUE 0x908A0E8 Val_Wu8 255.0 OneToOne 0.00 255.0 FORMAT "%5.1" /end CHARACTERISTIC
/begin CHARACTERISTIC I15031_stRfrshCal_C "Start of support calculation for Service0102" VALUE 0x908A0D8 Val_Wu8 1.000 OneToOne 0.00 1.000 FORMAT "%5.3" EXTENDED_LIMITS 0.00 255.0 /end CHARACTERISTIC
/begin CHARACTERISTIC IgCtl_cntrRampInin_C "step width counter for ramping from burning limit to component protection limit" VALUE 0x9085834 KwWU8 255.0 OneToOne 0.00 255.0 FORMAT "%5.1" /end CHARACTERISTIC
/begin CHARACTERISTIC IgCtl_diaRampStep_C "delta IA for ramping from burning limit to component protection limit" VALUE 0x9085835 KwWS8 95.25 zw_sb_q0p75 0.00 95.25 FORMAT "%5.2" EXTENDED_LIMITS -96.00 95.25 /end CHARACTERISTIC
/begin CHARACTERISTIC IgCtl_facAltiThd_C "altitude threshold for enabling coil diagnosis" VALUE 0x9085836 KwWU8 3.984 fak_ub_b4 0.00 3.984 FORMAT "%5.3" /end CHARACTERISTIC
/begin CHARACTERISTIC IgCtl_facIaCorrnStrt_M "factor for ignition angle correction at start based on throttle" MAP 0x9085838 KfAxU8AyU8SstxU8SstyU16WU16 0.9960938 fak_ub_b1 0.00 0.9960938 FORMAT "%9.7" EXTENDED_LIMITS 0.00 255.9961
 /begin AXIS_DESCR STD_AXIS wdkba relDK_ub_b100 8 0.00 100.0 FORMAT "%5.1" DEPOSIT ABSOLUTE /end AXIS_DESCR
 /begin AXIS_DESCR STD_AXIS tmot Temp_Cels 8 -273.1400 3003.560 FORMAT "%8.3" EXTENDED_LIMITS -273.1400 6280.360 DEPOSIT ABSOLUTE /end AXIS_DESCR
/end CHARACTERISTIC
/begin CHARACTERISTIC IgCtl_iaDifThd_C "threshold to enable coil diagnosis dependent on delta ignition angle between coil1 and coil2" VALUE 0x90858D2 KwWS8 191.3 zw_sb_q0p75 -96.00 95.25 FORMAT "%5.2" /end CHARACTERISTIC
/begin CHARACTERISTIC IgCtl_iaMax_C "calibratable max ignition angle output" VALUE 0x90858D3 KwWS8 191.3 zw_sb_q0p75 -96.00 95.25 FORMAT "%5.2" /end CHARACTERISTIC
/begin CHARACTERISTIC IgCtl_iaMin_C "calibratable min ignition angle output" VALUE 0x90858D4 KwWS8 191.3 zw_sb_q0p75 -96.00 95.25 FORMAT "%5.2" /end CHARACTERISTIC
/begin CHARACTERISTIC IgCtl_iaTraEngSpd_M "ignition angle offset for transients in engine speed" MAP 0x90858D6 KfAxU8AyU8SstxS16SstyS16WS16 191.2500 zw_sb_q0p75 -96.00000 95.25000 FORMAT "%8.5" EXTENDED_LIMITS -24576.00 24575.25
 /begin AXIS_DESCR STD_AXIS Epm_nEng EngN 6 -16384.00 16383.50 FORMAT "%8.2" DEPOSIT ABSOLUTE /end AXIS_DESCR
 /begin AXIS_DESCR STD_AXIS Epm_dnEngSma EngNGrd 6 -16384.00 16383.50 FORMAT "%8.2" DEPOSIT ABSOLUTE /end AXIS_DESCR
/end CHARACTERISTIC
/begin CHARACTERISTIC IgCtl_iaTraThrAg_M "ignition angle offset for transients in throttle angle" MAP 0x908593A KfAxU8AyU8SstxS16SstyS16WS16 191.2500 zw_sb_q0p75 -96.00000 95.25000 FORMAT "%8.5" EXTENDED_LIMITS -24576.00 24575.25
 /begin AXIS_DESCR STD_AXIS Epm_nEng EngN 6 -16384.00 16383.50 FORMAT "%8.2" DEPOSIT ABSOLUTE /end AXIS_DESCR
 /begin AXIS_DESCR STD_AXIS dwdkba_w relDK_q0p02441 6 -800.0000 799.9756 FORMAT "%8.4" DEPOSIT ABSOLUTE /end AXIS_DESCR
/end CHARACTERISTIC
/begin CHARACTERISTIC IgCtl_nHiCutOff_C "higher engine speed cutoff of dwell time" VALUE 0x908599E KwWU16 16383.75 nmot_uw_q0p25 0.00 16383.75 FORMAT "%8.2" /end CHARACTERISTIC
/begin CHARACTERISTIC IgCtl_nHiEnaCoilDiag_C "higher threshold for engine speed to enable coil diagnosis" VALUE 0x90859A0 KwWU16 16383.75 nmot_uw_q0p25 0.00 16383.75 FORMAT "%8.2" /end CHARACTERISTIC
/begin CHARACTERISTIC IgCtl_nLoCutOff_C "lower engine speed cutoff of dwell time" VALUE 0x90859A2 KwWU16 16383.75 nmot_uw_q0p25 0.00 16383.75 FORMAT "%8.2" /end CHARACTERISTIC
/begin CHARACTERISTIC IgCtl_nLoEnaCoilDiag_C "lower threshold for engine speed to enable coil diagnosis" VALUE 0x90859A4 KwWU16 16383.75 nmot_uw_q0p25 0.00 16383.75 FORMAT "%8.2" /end CHARACTERISTIC
/begin CHARACTERISTIC IgCtl_nrCoil1DiagErrThd_C "error threshold for coil 1 diagnosis" VALUE 0x90859A6 KwWU8 255.0 OneToOne 0.00 255.0 FORMAT "%5.1" /end CHARACTERISTIC
/begin CHARACTERISTIC IgCtl_nrCoil1DiagTestThd_C "threshold for coil1 to end coil diagnosis under no error conditions" VALUE 0x90859A7 KwWU8 255.0 OneToOne 0.00 255.0 FORMAT "%5.1" /end CHARACTERISTIC
/begin CHARACTERISTIC IgCtl_nrCoil2DiagErrThd_C "error threshold for coil 2 diagnosis" VALUE 0x90859A8 KwWU8 255.0 OneToOne 0.00 255.0 FORMAT "%5.1" /end CHARACTERISTIC
/begin CHARACTERISTIC IgCtl_nrCoil2DiagTestThd_C "threshold for coil2 to end coil diagnosis under no error conditions" VALUE 0x90859A9 KwWU8 255.0 OneToOne 0.00 255.0 FORMAT "%5.1" /end CHARACTERISTIC
/begin CHARACTERISTIC IgCtl_nrCutoffCycDlyThd_C "number of cycles untill cutoff of coil is permissible" VALUE 0x90859AA KwWU16 65535.00 OneToOne 0.00 65535.00 FORMAT "%8.2" /end CHARACTERISTIC
/begin CHARACTERISTIC IgCtl_nrCycDlyThd_C "number of synchros untill cutoff of coil is permissible" VALUE 0x90859AC KwWU16 65535.00 OneToOne 0.00 65535.00 FORMAT "%8.2" /end CHARACTERISTIC
/begin CHARACTERISTIC IgCtl_nrTIaCutOff_T "dwell time cutoff dependent on temperature" CURVE 0x90859AE KlAxU8SstxS16WU16_Static 2.000000 OneToOne 0.00 2.000000 FORMAT "%8.6" EXTENDED_LIMITS 0.00 65535.00
 /begin AXIS_DESCR STD_AXIS tmot Temp_Cels 5 -3549.940 3003.560 FORMAT "%8.3" DEPOSIT ABSOLUTE /end AXIS_DESCR
/end CHARACTERISTIC
/begin CHARACTERISTIC IgCtl_ratHiCutOff_C "higher load cutoff of dwell time" VALUE 0x90859C4 KwWU8 191.3 rel_ub_q0p75 0.00 191.3 FORMAT "%5.1" /end CHARACTERISTIC
/begin CHARACTERISTIC IgCtl_ratHiEnaCoilDiag_C "higher threshold of aircharge for enabling coild diagnosis" VALUE 0x90859C5 KwWU8 191.3 rel_ub_q0p75 0.00 191.3 FORMAT "%5.1" /end CHARACTERISTIC
/begin CHARACTERISTIC IgCtl_ratLoCutOff_C "Lower load cutoff of dwell time" VALUE 0x90859C6 KwWU8 191.3 rel_ub_q0p75 0.00 191.3 FORMAT "%5.1" /end CHARACTERISTIC
/begin CHARACTERISTIC IgCtl_ratLoEnaCoilDiag_C "lower threshold of aircharge for enabling coil diagnosis" VALUE 0x90859C7 KwWU8 191.3 rel_ub_q0p75 0.00 191.3 FORMAT "%5.1" /end CHARACTERISTIC
/begin CHARACTERISTIC IgCtl_stRstCoilDiag_C "reset of coil diagnosis parameters" VALUE 0x90859C8 KwWU8 255.0 OneToOne 0.00 255.0 FORMAT "%5.1" /end CHARACTERISTIC
/begin CHARACTERISTIC IgCtl_tEngCoilDiagThd_C "engine temperature threshold for enabling coil diagnosis" VALUE 0x90859CA KwWS16 6553.500 Temp_Cels -3549.940 3003.560 FORMAT "%8.3" /end CHARACTERISTIC
/begin CHARACTERISTIC IgCtl_tiCoil2ActvDiagDly_C "time delay to enable coil 2 diagnosis after the end of coil1 diagnosis" VALUE 0x90859CC KwWU8 5.100 t_q0p02 0.00 5.100 FORMAT "%5.3" /end CHARACTERISTIC
/begin CHARACTERISTIC IgCtl_tiEnaCoilDiagDly_C "delay time to enable coil diagnosis" VALUE 0x90859CE KwWU16 1310.700 t_q0p02 0.00 1310.700 FORMAT "%8.3" /end CHARACTERISTIC
/begin CHARACTERISTIC IgCtl_tiMaskRelsStcDly "time delay after misfire detection mask release to enable coil diagnosis" VALUE 0x90859D0 KwWU16 1310.700 t_q0p02 0.00 1310.700 FORMAT "%8.3" /end CHARACTERISTIC
/begin CHARACTERISTIC IgCtl_tiTrigCoilCutOffDly_C "time delay post no misfire detection to enable coil diagnosis" VALUE 0x90859D2 KwWU16 1310.700 t_q0p02 0.00 1310.700 FORMAT "%8.3" /end CHARACTERISTIC
/begin CHARACTERISTIC igndd_PercOffsDwlMax_T "Maximum Dwell calibration curve" CURVE 0x90877FD KlAUbSstUbWUb 100.0 rel_ub_b127p5 0.00 100.0 FORMAT "%5.1" EXTENDED_LIMITS 0.00 127.5
 /begin AXIS_DESCR STD_AXIS Epm_nEngLRes EngN_LRes 4 0.00 10200. FORMAT "%5.0" DEPOSIT ABSOLUTE /end AXIS_DESCR
/end CHARACTERISTIC
/begin CHARACTERISTIC igndd_PercOffsDwlMin_T "Miniimum Dwell calibration curve" CURVE 0x9087806 KlAUbSstUbWUb 100.0 rel_ub_b127p5 0.00 100.0 FORMAT "%5.1" EXTENDED_LIMITS 0.00 127.5
 /begin AXIS_DESCR STD_AXIS Epm_nEngLRes EngN_LRes 4 0.00 10200. FORMAT "%5.0" DEPOSIT ABSOLUTE /end AXIS_DESCR
/end CHARACTERISTIC
/begin CHARACTERISTIC IgnH_SelnPinActvLvl_C "Active output state on uC output" VALUE 0x90819B4 RB_Val_Wu8 1.000 OneToOne 0.00 1.000 FORMAT "%5.3" EXTENDED_LIMITS 0.00 255.0 /end CHARACTERISTIC
/begin CHARACTERISTIC Ign_IgbtDiag_iginjlock_C "Set to 1 if ignition and injection must be cut off on fault confirmation" VALUE 0x908780F KwWU8 255.0 OneToOne 0.00 255.0 FORMAT "%5.1" /end CHARACTERISTIC
/begin CHARACTERISTIC Ign_IgbtDiag_num_intDeb_T "Number of times the fault has to occur before registering it as confirmed fault. Internal Debounce curve." CURVE 0x9087810 RB_Curve_U8_U8 254.0 OneToOne 1.000 255.0 FORMAT "%5.1" EXTENDED_LIMITS 0.00 255.0
 /begin AXIS_DESCR STD_AXIS Epm_nEngLRes EngN_LRes 6 0.00 10200. FORMAT "%5.0" DEPOSIT ABSOLUTE /end AXIS_DESCR
/end CHARACTERISTIC
/begin CHARACTERISTIC Ign_IgbtDiag_uBattMin_C "Minimum threshold VBat for ignition Internal IGBT diagnosis enable condition" VALUE 0x908781D KwWU8 25.50 spg_q0p1 0.00 25.50 FORMAT "%5.2" /end CHARACTERISTIC
/begin CHARACTERISTIC INJDDPFI_ONE_MS_TRANSIENT_FEATURE_C "1ms transient compensation feature : Enable and Disable" VALUE 0x908782C KwUb 1.000 dez 0.00 1.000 FORMAT "%5.3" EXTENDED_LIMITS 0.00 255.0 /end CHARACTERISTIC
/begin CHARACTERISTIC KFDTMFC "Characteristic curve for gradient of engine coolant temperature in reference model in case of fuel cut-off" CURVE 0x908186E RB_Curve_S16_S8_Static 0.1868 temp_sb_b0p093 -0.09375 0.09302 FORMAT "%7.5"
 /begin AXIS_DESCR STD_AXIS tmrw Temp_Cels 6 -3549.940 3003.560 FORMAT "%8.3" DEPOSIT ABSOLUTE /end AXIS_DESCR
/end CHARACTERISTIC
/begin CHARACTERISTIC KFDTMTA "char. map for correction gradient of engine coolant temp. at low warming up" MAP 0x9081882 RB_Map_U16S16_S8 0.1868 temp_sb_b0p093 -0.09375 0.09302 FORMAT "%7.5"
 /begin AXIS_DESCR STD_AXIS ml_ggtfmloc m_uw_b6553p5 6 0.00 6553.500 FORMAT "%8.3" DEPOSIT ABSOLUTE /end AXIS_DESCR
 /begin AXIS_DESCR STD_AXIS tans Temp_Cels 6 -3549.940 3003.560 FORMAT "%8.3" DEPOSIT ABSOLUTE /end AXIS_DESCR
/end CHARACTERISTIC
/begin CHARACTERISTIC KFDTMTR "char. map for gradient of engine coolant temperature in reference model" MAP 0x90818C2 RB_Map_U16S16_S8 0.1868 temp_sb_b0p093 -0.09375 0.09302 FORMAT "%7.5"
 /begin AXIS_DESCR STD_AXIS ml_ggtfmloc m_uw_b6553p5 6 0.00 6553.500 FORMAT "%8.3" DEPOSIT ABSOLUTE /end AXIS_DESCR
 /begin AXIS_DESCR STD_AXIS tmrw Temp_Cels 6 -3549.940 3003.560 FORMAT "%8.3" DEPOSIT ABSOLUTE /end AXIS_DESCR
/end CHARACTERISTIC
/begin CHARACTERISTIC KFDZWFL "Delta ignition angle characteristic map incase of full load" MAP 0x90859D4 KfAxU8AyU8SstxU16SstyU16WS16 191.2500 zw_sb_q0p75 -96.00000 95.25000 FORMAT "%8.5" EXTENDED_LIMITS -24576.00 24575.25
 /begin AXIS_DESCR STD_AXIS nmotfihy_w nmot_uw_q0p25 25 0.00 16383.75 FORMAT "%8.2" DEPOSIT ABSOLUTE /end AXIS_DESCR
 /begin AXIS_DESCR STD_AXIS wdkba relDK_ub_b100 16 0.00 100.0000 FORMAT "%8.4" EXTENDED_LIMITS 0.00 25700.00 DEPOSIT ABSOLUTE /end AXIS_DESCR
/end CHARACTERISTIC
/begin CHARACTERISTIC KFDZWKG "Ignition angle correction due to knock limit shift" MAP 0x9085D4A KfAxU8AyU8SstxU16SstyU16WS16 191.2500 zw_sb_q0p75 -96.00000 95.25000 FORMAT "%8.5" EXTENDED_LIMITS -24576.00 24575.25
 /begin AXIS_DESCR STD_AXIS nmotfihy_w nmot_uw_q0p25 12 0.00 16383.75 FORMAT "%8.2" DEPOSIT ABSOLUTE /end AXIS_DESCR
 /begin AXIS_DESCR STD_AXIS Ign_facDesLamLoc fak_q0p0039_op0p5 6 0.5000000 1.496094 FORMAT "%8.6" EXTENDED_LIMITS 0.5000000 256.4961 DEPOSIT ABSOLUTE /end AXIS_DESCR
/end CHARACTERISTIC
/begin CHARACTERISTIC KFDZWSTT "ignition angle correction at start based on throttle" MAP 0x9085E02 KfAxU8AyU8SstxU8SstyU8WS8 191.3 zw_sb_q0p75 -96.00 95.25 FORMAT "%5.2"
 /begin AXIS_DESCR STD_AXIS wdkba relDK_ub_b100 8 0.00 100.0 FORMAT "%5.1" DEPOSIT ABSOLUTE /end AXIS_DESCR
 /begin AXIS_DESCR STD_AXIS fho fak_ub_b4 8 0.00 3.984 FORMAT "%5.3" DEPOSIT ABSOLUTE /end AXIS_DESCR
/end CHARACTERISTIC
/begin CHARACTERISTIC KFHSUVXF "Line of heater voltage setpoint for off time calculation for lambda sensor heating depending on exh. gas temp" MAP 0x90856F0 KfAxUbAyUbSstxUwSstyUwWUw 25.59961 spg_q0p00039 0.00 25.59961 FORMAT "%8.5"
 /begin AXIS_DESCR STD_AXIS ml_w m_uw_b6553p5 8 0.00 6553.500 FORMAT "%8.3" DEPOSIT ABSOLUTE /end AXIS_DESCR
 /begin AXIS_DESCR STD_AXIS taikrmfxf temp_ub_q5_o50 8 -50.00 327625. FORMAT "%5.0" DEPOSIT ABSOLUTE /end AXIS_DESCR
/end CHARACTERISTIC
/begin CHARACTERISTIC KFNRDZWBSL "Basic ignition angle correction map for twin spark system - slave plug" MAP 0x9085E54 KfAxU8AyU8SstxU16SstyU16WS16 191.2500 zw_sb_q0p75 -96.00000 95.25000 FORMAT "%8.5" EXTENDED_LIMITS -24576.00 24575.25
 /begin AXIS_DESCR STD_AXIS nmotfihy_w nmot_uw_q0p25 30 0.00 16383.75 FORMAT "%8.2" DEPOSIT ABSOLUTE /end AXIS_DESCR
 /begin AXIS_DESCR STD_AXIS rl rel_ub_q0p75 20 0.00 191.2500 FORMAT "%8.4" EXTENDED_LIMITS 0.00 49151.25 DEPOSIT ABSOLUTE /end AXIS_DESCR
/end CHARACTERISTIC
/begin CHARACTERISTIC KFSZNUB "Dwell angle characteristic map" MAP 0x908636C KfAxU8AyU8SstxU16SstyU16WU16 65.53500 t1usxms_q0p001 0.00 65.53500 FORMAT "%8.5"
 /begin AXIS_DESCR STD_AXIS ubsq spg_q0p1 8 0.00 25.50000 FORMAT "%8.5" EXTENDED_LIMITS 0.00 6553.500 DEPOSIT ABSOLUTE /end AXIS_DESCR
 /begin AXIS_DESCR STD_AXIS nmotfihy_w nmot_uw_q0p25 14 0.00 16383.75 FORMAT "%8.2" DEPOSIT ABSOLUTE /end AXIS_DESCR
/end CHARACTERISTIC
/begin CHARACTERISTIC KFSZNUBSL "Ignition dwell time for secondary coil" MAP 0x908647C KfAxU8AyU8SstxU16SstyU16WU16 65.53500 t1usxms_q0p001 0.00 65.53500 FORMAT "%8.5"
 /begin AXIS_DESCR STD_AXIS ubsq spg_q0p1 8 0.00 25.50000 FORMAT "%8.5" EXTENDED_LIMITS 0.00 6553.500 DEPOSIT ABSOLUTE /end AXIS_DESCR
 /begin AXIS_DESCR STD_AXIS nmotfihy_w nmot_uw_q0p25 14 0.00 16383.75 FORMAT "%8.2" DEPOSIT ABSOLUTE /end AXIS_DESCR
/end CHARACTERISTIC
/begin CHARACTERISTIC KFZW "Ignition advance-angle characteristik map" MAP 0x908658C GkfWS8 191.3 zw_sb_q0p75 -96.00 95.25 FORMAT "%5.2"
 /begin AXIS_DESCR COM_AXIS nmotfihy_w nmot_uw_q0p25 30 0.00 16383.75 FORMAT "%8.2" AXIS_PTS_REF SHS30ZUUB /end AXIS_DESCR
 /begin AXIS_DESCR COM_AXIS Ign_ratChrgAirLoc rel_ub_q0p75 20 0.00 191.3 FORMAT "%5.1" AXIS_PTS_REF SRL20ZUUB /end AXIS_DESCR
/end CHARACTERISTIC
/begin CHARACTERISTIC KFZWFNRLTA "weighting factor for KFZWTA" MAP 0x90867E4 KfAxU8AyU8SstxU16SstyU16WU16 1.992188 fak_ub_b2 0.00 1.992188 FORMAT "%8.6" EXTENDED_LIMITS 0.00 511.9922
 /begin AXIS_DESCR STD_AXIS nmotfihy_w nmot_uw_q0p25 18 0.00 16383.75 FORMAT "%8.2" DEPOSIT ABSOLUTE /end AXIS_DESCR
 /begin AXIS_DESCR STD_AXIS Ign_ratChrgAirLoc rel_ub_q0p75 8 0.00 191.2500 FORMAT "%8.4" EXTENDED_LIMITS 0.00 49151.25 DEPOSIT ABSOLUTE /end AXIS_DESCR
/end CHARACTERISTIC
/begin CHARACTERISTIC KFZWFNRLTM "weighting factor for KLZWTM" MAP 0x908693C KfAxU8AyU8SstxU16SstyU16WU16 1.992188 fak_ub_b2 0.00 1.992188 FORMAT "%8.6" EXTENDED_LIMITS 0.00 511.9922
 /begin AXIS_DESCR STD_AXIS nmotfihy_w nmot_uw_q0p25 16 0.00 16383.75 FORMAT "%8.2" DEPOSIT ABSOLUTE /end AXIS_DESCR
 /begin AXIS_DESCR STD_AXIS Ign_ratChrgAirLoc rel_ub_q0p75 6 0.00 191.2500 FORMAT "%8.4" EXTENDED_LIMITS 0.00 49151.25 DEPOSIT ABSOLUTE /end AXIS_DESCR
/end CHARACTERISTIC
/begin CHARACTERISTIC KFZWMN "Map for latest ignition angle, describes burning limit." MAP 0x9086A2C GkfWS8 191.3 zw_sb_q0p75 -96.00 95.25 FORMAT "%5.2"
 /begin AXIS_DESCR COM_AXIS nmotfihy_w nmot_uw_q0p25 30 0.00 16383.75 FORMAT "%8.2" AXIS_PTS_REF SHS30ZUUB /end AXIS_DESCR
 /begin AXIS_DESCR COM_AXIS Ign_ratChrgAirLoc rel_ub_q0p75 20 0.00 191.3 FORMAT "%5.1" AXIS_PTS_REF SRL20ZUUB /end AXIS_DESCR
/end CHARACTERISTIC
/begin CHARACTERISTIC KFZWMS "Map for ignition value as latest possible value, describes temperature limit." MAP 0x9086C84 GkfWS8 191.3 zw_sb_q0p75 -96.00 95.25 FORMAT "%5.2"
 /begin AXIS_DESCR COM_AXIS nmotfihy_w nmot_uw_q0p25 30 0.00 16383.75 FORMAT "%8.2" AXIS_PTS_REF SHS30ZUUB /end AXIS_DESCR
 /begin AXIS_DESCR COM_AXIS Ign_ratChrgAirLoc rel_ub_q0p75 20 0.00 191.3 FORMAT "%5.1" AXIS_PTS_REF SRL20ZUUB /end AXIS_DESCR
/end CHARACTERISTIC
/begin CHARACTERISTIC KFZWSL "Delta ignition anlge for slave spark plug" MAP 0x9086EDC KfAxU8AyU8SstxU16SstyU16WS16 191.2500 zw_sb_q0p75 -96.00000 95.25000 FORMAT "%8.5" EXTENDED_LIMITS -24576.00 24575.25
 /begin AXIS_DESCR STD_AXIS nmotfihy_w nmot_uw_q0p25 30 0.00 16383.75 FORMAT "%8.2" DEPOSIT ABSOLUTE /end AXIS_DESCR
 /begin AXIS_DESCR STD_AXIS rl rel_ub_q0p75 20 0.00 191.2500 FORMAT "%8.4" EXTENDED_LIMITS 0.00 49151.25 DEPOSIT ABSOLUTE /end AXIS_DESCR
/end CHARACTERISTIC
/begin CHARACTERISTIC KFZWSTTM "Ignition angle during start" MAP 0x90873F4 KfAxU8AyU8SstxU16SstyU16WS16 191.2500 zw_sw_q0p75 -96.00000 95.25000 FORMAT "%8.5" EXTENDED_LIMITS -24576.00 24575.25
 /begin AXIS_DESCR STD_AXIS nmot_w nmot_uw_q0p25 6 0.00 16383.75 FORMAT "%8.2" DEPOSIT ABSOLUTE /end AXIS_DESCR
 /begin AXIS_DESCR STD_AXIS IGC2W_EngDa_tStrtLoc temp_q1_om30 8 -30.00000 65505.00 FORMAT "%8.2" DEPOSIT ABSOLUTE /end AXIS_DESCR
/end CHARACTERISTIC
/begin CHARACTERISTIC KFZWTA "ignition correction due to tans" MAP 0x9087474 KfAxU8AyU8SstxS16SstyS16WS16 191.2500 zw_q0p75 -96.00000 95.25000 FORMAT "%8.5" EXTENDED_LIMITS -24576.00 24575.25
 /begin AXIS_DESCR STD_AXIS tans Temp_Cels 6 -3549.940 3003.560 FORMAT "%8.3" DEPOSIT ABSOLUTE /end AXIS_DESCR
 /begin AXIS_DESCR STD_AXIS EngDa_tEng Temp_Cels 6 -3549.940 3003.560 FORMAT "%8.3" DEPOSIT ABSOLUTE /end AXIS_DESCR
/end CHARACTERISTIC
/begin CHARACTERISTIC KFZYLZAUS_GM "Bit mask map for ignition cut off by calibration" MAP 0x90874D8 GkfWU8 3.000 OneToOne 0.00 3.000 FORMAT "%5.3" EXTENDED_LIMITS 0.00 255.0
 /begin AXIS_DESCR COM_AXIS nmotfihy_w nmot_uw_q0p25 30 0.00 16383.75 FORMAT "%8.2" AXIS_PTS_REF SHS30ZUUB /end AXIS_DESCR
 /begin AXIS_DESCR COM_AXIS Ign_ratChrgAirLoc rel_ub_q0p75 20 0.00 191.3 FORMAT "%5.1" AXIS_PTS_REF SRL20ZUUB /end AXIS_DESCR
/end CHARACTERISTIC
/begin CHARACTERISTIC KLDTTMRW "Factor for Engine temperature model value based on ambient temperature when a valid engine off time is not available." CURVE 0x9081902 RB_Curve_S16_S16 3.999939 fak_sw_b2 -2.000000 1.999939 FORMAT "%8.6"
 /begin AXIS_DESCR STD_AXIS tans Temp_Cels 4 -3549.940 3003.560 FORMAT "%8.3" DEPOSIT ABSOLUTE /end AXIS_DESCR
/end CHARACTERISTIC
/begin CHARACTERISTIC KLENGOFF "Engine temperature default value from model dependent on engine off time based on the value saved during engine stop or engine stall (tmrwab)" CURVE 0x9081914 RB_Curve_U16_U8_Static 1.992188 fak_ub_b2 0.00 1.992188 FORMAT "%8.6"
 /begin AXIS_DESCR STD_AXIS t_engoff_w t_q1 15 0.00 65535.00 FORMAT "%8.2" DEPOSIT ABSOLUTE /end AXIS_DESCR
/end CHARACTERISTIC
/begin CHARACTERISTIC KLHSUHXF "Line for switch off time of lambda sensor heating post cat dep. on temp (LSF with Pumped Reference)" CURVE 0x9085794 KlAUbSstUbWUw_Static 25.59961 spg_q0p00039 0.00 25.59961 FORMAT "%8.5"
 /begin AXIS_DESCR STD_AXIS tempstspxf temp_ub_q5_o50 4 -50.00 1225. FORMAT "%5.0" DEPOSIT ABSOLUTE /end AXIS_DESCR
/end CHARACTERISTIC
/begin CHARACTERISTIC KLSZMX "Curve for maximum dwell time for coil protection" CURVE 0x9087730 KlAxU8SstxU8WU16_Static 65.53500 txms_uw_q0p001 0.00 65.53500 FORMAT "%8.5"
 /begin AXIS_DESCR STD_AXIS ubsq spg_q0p1 8 0.00 25.50 FORMAT "%5.2" DEPOSIT ABSOLUTE /end AXIS_DESCR
/end CHARACTERISTIC
/begin CHARACTERISTIC KLSZMX1 "Curve for maximum dwell time for coil protection for second coil" CURVE 0x908774A KlAxU8SstxU8WU16_Static 65.53500 txms_uw_q0p001 0.00 65.53500 FORMAT "%8.5"
 /begin AXIS_DESCR STD_AXIS ubsq spg_q0p1 8 0.00 25.50 FORMAT "%5.2" DEPOSIT ABSOLUTE /end AXIS_DESCR
/end CHARACTERISTIC
/begin CHARACTERISTIC KLTDZWBSL "Temperature bsed basic ignition angle correction map for twin spark system - slave plug" CURVE 0x9087764 KlAxU8SstxS16WS16 191.2500 zw_sb_q0p75 -96.00000 95.25000 FORMAT "%8.5" EXTENDED_LIMITS -24576.00 24575.25
 /begin AXIS_DESCR STD_AXIS EngDa_tEng Temp_Cels 4 -3549.940 3003.560 FORMAT "%8.3" DEPOSIT ABSOLUTE /end AXIS_DESCR
/end CHARACTERISTIC
/begin CHARACTERISTIC KLTTAIKRXF "Time constant for taikrm filtering (LSF with Pumped Reference)" CURVE 0x90857A2 KlAUwSstUwWUw 65.53500 t_q0p001 0.00 65.53500 FORMAT "%8.5"
 /begin AXIS_DESCR STD_AXIS ml_w m_uw_b6553p5 4 0.00 6553.500 FORMAT "%8.3" DEPOSIT ABSOLUTE /end AXIS_DESCR
/end CHARACTERISTIC
/begin CHARACTERISTIC KLZWTM "ignition correction due to tmot" CURVE 0x9087776 KlAxU8SstxS16WS16 191.2500 zw_q0p75 -96.00000 95.25000 FORMAT "%8.5" EXTENDED_LIMITS -24576.00 24575.25
 /begin AXIS_DESCR STD_AXIS EngDa_tEng Temp_Cels 6 -3549.940 3003.560 FORMAT "%8.3" DEPOSIT ABSOLUTE /end AXIS_DESCR
/end CHARACTERISTIC
/begin CHARACTERISTIC KUPPINV "Inversion for clutch signal" VALUE 0x90857DA KwWU8 255.0 dez 0.00 255.0 FORMAT "%5.1" /end CHARACTERISTIC
/begin CHARACTERISTIC NEUTGEARACTMAX "Max. voltage limit for Neutral switch functionality to be active" VALUE 0x90857DC KwWU16 319.9951 spg_uw_q0p00488 0.00 319.9951 FORMAT "%8.4" /end CHARACTERISTIC
/begin CHARACTERISTIC NEUTGEARACTMIN "Min. voltage limit for Neutral switch functionality to be active" VALUE 0x90857DE KwWU16 319.9951 spg_uw_q0p00488 0.00 319.9951 FORMAT "%8.4" /end CHARACTERISTIC
/begin CHARACTERISTIC NEUTGEARINACTMAX "Max. voltage limit for Neutral switch functionality to be inactive" VALUE 0x90857E0 KwWU16 319.9951 spg_uw_q0p00488 0.00 319.9951 FORMAT "%8.4" /end CHARACTERISTIC
/begin CHARACTERISTIC NEUTGEARINACTMIN "Min. voltage limit for Neutral switch functionality to be inactive" VALUE 0x90857E2 KwWU16 319.9951 spg_uw_q0p00488 0.00 319.9951 FORMAT "%8.4" /end CHARACTERISTIC
/begin CHARACTERISTIC NEUTINV "Inversion for NEUTRAL Gear signal" VALUE 0x90857E4 KwWU8 255.0 dez 0.00 255.0 FORMAT "%5.1" /end CHARACTERISTIC
/begin CHARACTERISTIC NMOTUB "Engine speed threshold for battery diagnosis" VALUE 0x9085676 KwWU16 16383.75 nmot_uw_q0p25 0.00 16383.75 FORMAT "%8.2" /end CHARACTERISTIC
/begin CHARACTERISTIC OILLPINV "Calibration to Invert Low Oil Pressure Input" VALUE 0x90857E5 KwWU8 255.0 dez 0.00 255.0 FORMAT "%5.1" /end CHARACTERISTIC
/begin CHARACTERISTIC PHLSNHMNXF "Heating power for adequate sensor heating(LSF with Pumped Reference)" VALUE 0x90857B4 KwUb 2.550 fak_ub_q0p01 0.00 2.550 FORMAT "%5.3" /end CHARACTERISTIC
/begin AXIS_PTS SHS30ZUUB "datapoint distribution for engine speed. 30 data points" 0x9087790 nmotfihy_w SstAU8SstU16 16383.75 nmot_uw_q0p25 30 0.00 16383.75 FORMAT "%8.2" DEPOSIT ABSOLUTE /end AXIS_PTS
/begin AXIS_PTS SRL20ZUUB "datapoint distributionrelative cylinder charge, 20 datapoints" 0x90877CE Ign_ratChrgAirLoc SstAU8SstU8 191.3 rel_ub_q0p75 20 0.00 191.3 FORMAT "%5.1" DEPOSIT ABSOLUTE /end AXIS_PTS
/begin CHARACTERISTIC SVFZPLSDST[0] "(V:VSS=NON_ABS) distance per pulse of the hardwired vehicle speed signal" VALUE 0x90857D2 KwUw 9.320533 s_q1p422Em4 0.00 9.320533 FORMAT "%8.6" /end CHARACTERISTIC
/begin CHARACTERISTIC SVFZPLSDST[1] "(V:VSS=ABS) distance per pulse of the hardwired vehicle speed signal" VALUE 0x90857D4 KwUw 9.320533 s_q1p422Em4 0.00 9.320533 FORMAT "%8.6" /end CHARACTERISTIC
/begin CHARACTERISTIC TANHKMMNXF "catalyst temperature for adequate sensor heating(LSF with Pumped Reference)" VALUE 0x90857B5 KwUb 1275. temp_ub_q5_o50 -50.00 1225. FORMAT "%5.0" /end CHARACTERISTIC
/begin CHARACTERISTIC TCYCHDLAMP "Delay time before cycle flag set by HDLAMP" VALUE 0x90857EC KwWU8 25.50 t_q0p1 0.00 25.50 FORMAT "%5.2" /end CHARACTERISTIC
/begin CHARACTERISTIC TDLOWBATT_OFF "Debounce time for turning the battery low indication lamp on" VALUE 0x9085678 KwWU16 6553.500 t100msxs_ub_b25p5 0.00 6553.500 FORMAT "%8.3" /end CHARACTERISTIC
/begin CHARACTERISTIC TDLOWBATT_ON "Debounce time for turning the battery low indication lamp off" VALUE 0x908567A KwWU16 6553.500 t100msxs_ub_b25p5 0.00 6553.500 FORMAT "%8.3" /end CHARACTERISTIC
/begin CHARACTERISTIC TDSTENDES "Time delay for B_stendes" VALUE 0x9081944 RB_Val_Wu16 300.0000 t_q0p1 0.00 300.0000 FORMAT "%8.4" EXTENDED_LIMITS 0.00 6553.500 /end CHARACTERISTIC
/begin CHARACTERISTIC TDTM "debounce time fault detection, engine temperature sensor" VALUE 0x9081946 RB_Val_Wu8 25.50 t_q0p1 0.00 25.50 FORMAT "%5.2" /end CHARACTERISTIC
/begin CHARACTERISTIC TDTMHL "Time delay for healing min/max error of engine temperature sensor" VALUE 0x9081947 RB_Val_Wu8 25.50 t_q0p1 0.00 25.50 FORMAT "%5.2" /end CHARACTERISTIC
/begin CHARACTERISTIC TDTMK "debounce time fault detection, engine temperature sensor (cold conditions)" VALUE 0x9081948 RB_Val_Wu16 6553.500 t100msxs_uw_b6553p5 0.00 6553.500 FORMAT "%8.3" /end CHARACTERISTIC
/begin CHARACTERISTIC TDTMKHL "Time delay for healing minmax error of engine temperature sensor" VALUE 0x908194A RB_Val_Wu16 6553.500 t100msxs_uw_b6553p5 0.00 6553.500 FORMAT "%8.3" /end CHARACTERISTIC
/begin CHARACTERISTIC TDUB "delay time of voltage diagnosis" VALUE 0x908567C KwWU8 25.50 t100msxs_ub_b25p5 0.00 25.50 FORMAT "%5.2" /end CHARACTERISTIC
/begin CHARACTERISTIC TDUBNPL "Delay time for voltage diagnosis - non-plausibility error" VALUE 0x908567D KwWU8 25.50 t100msxs_ub_b25p5 0.00 25.50 FORMAT "%5.2" /end CHARACTERISTIC
/begin CHARACTERISTIC TDVEHSIG "Delay time to check non availability of Vehicle speed sensor signal" VALUE 0x90857D6 KwUb 12.75 t_q0p05 0.00 12.75 FORMAT "%5.2" /end CHARACTERISTIC
/begin CHARACTERISTIC THEHXF "Time for sensor heating with maximum heater power, downstream cat (LSF with Pumped Reference)" VALUE 0x90857B6 KwUw 65.53500 t1msxs_b65p535 0.00 65.53500 FORMAT "%8.5" /end CHARACTERISTIC
/begin CHARACTERISTIC THEVXF "Time for sensor heating with maximum heater power, upstream cat (LSF with Pumped Reference)" VALUE 0x90857B8 KwUw 65.53500 t1msxs_b65p535 0.00 65.53500 FORMAT "%8.5" /end CHARACTERISTIC
/begin CHARACTERISTIC THSHAXF "Delay time for sensor sufficiently heated (LSF with Pumped Reference)" VALUE 0x90857BA KwUw 65.53500 t1msxs_b65p535 0.00 65.53500 FORMAT "%8.5" /end CHARACTERISTIC
/begin CHARACTERISTIC TMDE "substitution value for engine temperature in case of fault" VALUE 0x908194C RB_Val_Ws16 6553.500 Temp_Cels -3549.940 3003.560 FORMAT "%8.3" /end CHARACTERISTIC
/begin CHARACTERISTIC TMDMN "minimum engine temperature" VALUE 0x908194E RB_Val_Ws16 6553.500 Temp_Cels -3549.940 3003.560 FORMAT "%8.3" /end CHARACTERISTIC
/begin CHARACTERISTIC TMDMX "maximum engine temperature" VALUE 0x9081950 RB_Val_Ws16 6553.500 Temp_Cels -3549.940 3003.560 FORMAT "%8.3" /end CHARACTERISTIC
/begin CHARACTERISTIC TMDSTMX "Max temperature to initialise model" VALUE 0x9081952 RB_Val_Ws16 6553.500 Temp_Cels -3549.940 3003.560 FORMAT "%8.3" /end CHARACTERISTIC
/begin CHARACTERISTIC TMMDH "Threshold temperature for healing model error" VALUE 0x9081954 RB_Val_Ws16 6553.500 Temp_Cels -3549.940 3003.560 FORMAT "%8.3" /end CHARACTERISTIC
/begin CHARACTERISTIC TMMDS "Threshold temperature for setting model error" VALUE 0x9081956 RB_Val_Ws16 6553.500 Temp_Cels -3549.940 3003.560 FORMAT "%8.3" /end CHARACTERISTIC
/begin CHARACTERISTIC TMMMX "Max permissible value for model temperature." VALUE 0x9081958 RB_Val_Ws16 6553.500 Temp_Cels -3549.940 3003.560 FORMAT "%8.3" /end CHARACTERISTIC
/begin CHARACTERISTIC TMOTABINI "Initialisation value for engine shut off temperature in case of power failure" VALUE 0x908195A RB_Val_Ws16 6553.500 Temp_Cels -3549.940 3003.560 FORMAT "%8.3" /end CHARACTERISTIC
/begin CHARACTERISTIC TMOTELI "engine temperature calculation, inverse function" CURVE 0x908195C RB_Curve_U16_S16_Static 6553.500 Temp_Cels -3549.940 3003.560 FORMAT "%8.3"
 /begin AXIS_DESCR STD_AXIS wtmot_ggtfmloc spg_uw_q0p00488 20 0.00 319.9951 FORMAT "%8.4" DEPOSIT ABSOLUTE /end AXIS_DESCR
/end CHARACTERISTIC
/begin CHARACTERISTIC TMOTFCNT "Lowpass filter time constant for engine coolant temperature" VALUE 0x90819AE RB_Val_Wu16 6553.4999985 zk100msxs_uw_b6553 0.10000152590 6553.6000000 FORMAT "%12.7" /end CHARACTERISTIC
/begin CHARACTERISTIC TMOVH "TMOT threshold for overheat protection" VALUE 0x90819B0 RB_Val_Ws16 6553.500 Temp_Cels -3549.940 3003.560 FORMAT "%8.3" /end CHARACTERISTIC
/begin CHARACTERISTIC TSTLSMX "Maximum engine off time" VALUE 0x90857BC KwUw 65535.00 t_q1 0.00 65535.00 FORMAT "%8.2" /end CHARACTERISTIC
/begin CHARACTERISTIC TTMMERH "Delay time for healing model error" VALUE 0x90819B2 RB_Val_Wu8 25.50 t_q0p1 0.00 25.50 FORMAT "%5.2" /end CHARACTERISTIC
/begin CHARACTERISTIC TTMMERS "Delay time for setting model error" VALUE 0x90819B3 RB_Val_Wu8 25.50 t_q0p1 0.00 25.50 FORMAT "%5.2" /end CHARACTERISTIC
/begin CHARACTERISTIC TZWSPAECLD "Decrement value of counter during cooling" VALUE 0x90877E4 KwWU16 65535.00 dez 0.00 65535.00 FORMAT "%8.2" /end CHARACTERISTIC
/begin CHARACTERISTIC TZWSPAEHOT "Increment value of counter during heating" VALUE 0x90877E6 KwWU16 65535.00 dez 0.00 65535.00 FORMAT "%8.2" /end CHARACTERISTIC
/begin CHARACTERISTIC TZWSPAEMN "Min value of counter to reset engine protection limit" VALUE 0x90877E8 KwWU16 65535.00 dez 0.00 65535.00 FORMAT "%8.2" /end CHARACTERISTIC
/begin CHARACTERISTIC TZWSPAEMX "Maximum value of counter to set engine protection limit" VALUE 0x90877EA KwWU16 65535.00 dez 0.00 65535.00 FORMAT "%8.2" /end CHARACTERISTIC
/begin CHARACTERISTIC UBDE "replace value for UBATT at damaged AD-channel" VALUE 0x908567E KwWU8 17.95 spg_ubatt 0.00 17.95 FORMAT "%5.2" /end CHARACTERISTIC
/begin CHARACTERISTIC UBDMN1 "min. battery voltage (power supply)" VALUE 0x908567F KwWU8 17.95 spg_ubatt 0.00 17.95 FORMAT "%5.2" /end CHARACTERISTIC
/begin CHARACTERISTIC UBDMN2 "min. battery voltage (ADC)" VALUE 0x9085680 KwWU8 17.95 spg_ubatt 0.00 17.95 FORMAT "%5.2" /end CHARACTERISTIC
/begin CHARACTERISTIC UBDMX "max. battery voltage" VALUE 0x9085681 KwWU8 17.95 spg_ubatt 0.00 17.95 FORMAT "%5.2" /end CHARACTERISTIC
/begin CHARACTERISTIC UHSTPHXF "Heater voltage during protective heating after cat (LSF with Pumped Reference)" VALUE 0x90857BE KwUw 25.59961 spg_q0p00039 0.00 25.59961 FORMAT "%8.5" /end CHARACTERISTIC
/begin CHARACTERISTIC UHSTPVXF "Heater voltage during protective heating before cat (LSF with Pumped Reference)" VALUE 0x90857C0 KwUw 25.59961 spg_q0p00039 0.00 25.59961 FORMAT "%8.5" /end CHARACTERISTIC
/begin CHARACTERISTIC UINIRMHXF "Initial heater voltage in ramping after protective heating is finished, after cat (LSF with Pumped Reference)" VALUE 0x90857C2 KwUw 25.59961 spg_q0p00039 0.00 25.59961 FORMAT "%8.5" /end CHARACTERISTIC
/begin CHARACTERISTIC UINIRMVXF "Initial heater voltage in ramping after protective heating is finished, before cat (LSF with Pumped Reference)" VALUE 0x90857C4 KwUw 25.59961 spg_q0p00039 0.00 25.59961 FORMAT "%8.5" /end CHARACTERISTIC
/begin CHARACTERISTIC UMXRMHXF "Maximum heater voltage in heating ramp-up phase, after cat (LSF with Pumped Reference)" VALUE 0x90857C6 KwUw 25.59961 spg_q0p00039 0.00 25.59961 FORMAT "%8.5" /end CHARACTERISTIC
/begin CHARACTERISTIC UMXRMVXF "Maximum heater voltage in heating ramp-up phase, before cat (LSF with Pumped Reference)" VALUE 0x90857C8 KwUw 25.59961 spg_q0p00039 0.00 25.59961 FORMAT "%8.5" /end CHARACTERISTIC
/begin CHARACTERISTIC URMNEGHXF "Negative heater voltage gradient in heater ramping phase, after cat (LSF with Pumped Reference)" VALUE 0x90857CA KwUw 255.9961 spg_q0p0039 0.00 255.9961 FORMAT "%8.4" /end CHARACTERISTIC
/begin CHARACTERISTIC URMNEGVXF "Negative heater voltage gradient in heater ramping phase, before cat (LSF with Pumped Reference)" VALUE 0x90857CC KwUw 255.9961 spg_q0p0039 0.00 255.9961 FORMAT "%8.4" /end CHARACTERISTIC
/begin CHARACTERISTIC URMPOSHXF "Positive heater voltage gradient in heater ramping phase, after cat (LSF with Pumped Reference)" VALUE 0x90857CE KwUw 255.9961 spg_q0p0039 0.00 255.9961 FORMAT "%8.4" /end CHARACTERISTIC
/begin CHARACTERISTIC URMPOSVXF "Positive heater voltage gradient in heater ramping phase, before cat (LSF with Pumped Reference)" VALUE 0x90857D0 KwUw 255.9961 spg_q0p0039 0.00 255.9961 FORMAT "%8.4" /end CHARACTERISTIC
/begin CHARACTERISTIC VehV_numVAvrg_C "Average number of samples for Vehicle speed" VALUE 0x9085684 KwWU16 100.0000 OneToOne 0.00 100.0000 FORMAT "%8.4" EXTENDED_LIMITS 0.00 65535.00 /end CHARACTERISTIC
/begin CHARACTERISTIC VehV_swtSig_C "Switch to select vehivle speed input source" VALUE 0x9085686 KwWU8 255.0 OneToOne 0.00 255.0 FORMAT "%5.1" /end CHARACTERISTIC
/begin CHARACTERISTIC WPHN "phase correction" CURVE 0x90877EC KlAxU8SstxU16WS8_Static 191.3 zw_sb_q0p75 -96.00 95.25 FORMAT "%5.2"
 /begin AXIS_DESCR STD_AXIS nmotfihy_w nmot_uw_q0p25 4 0.00 16383.75 FORMAT "%8.2" DEPOSIT ABSOLUTE /end AXIS_DESCR
/end CHARACTERISTIC
/begin CHARACTERISTIC ZFVFZ "time constant for filter vehicle speed signal" VALUE 0x9085688 KwWU16 655.34999985 zk10msxs_uw_b655 0.010000152590 655.36000000 FORMAT "%12.8" /end CHARACTERISTIC
/begin CHARACTERISTIC ZWMNLH "Minimum ignition angle during limp home of phase sensor." VALUE 0x90877FA KwWS8 191.3 zw_sb_q0p75 -96.00 95.25 FORMAT "%5.2" /end CHARACTERISTIC
/begin MEASUREMENT AngZotTicks "Angletimervalue of the TDCs" ULONG AngleCrS 1 100 0.00 94371839.9781 FORMAT "%13.4" ARRAY_SIZE 1 ECU_ADDRESS 0x40008EBC /end MEASUREMENT
/begin MEASUREMENT anzesab_w "Injection abortion counter, Word" UWORD dez 1 100 0.00 65535.00 FORMAT "%8.2" ECU_ADDRESS 0x4000861C
 /begin IF_DATA XCPplus 0x0102
  /begin DAQ_EVENT VARIABLE /begin AVAILABLE_EVENT_LIST EVENT 0 EVENT 1 EVENT 2 EVENT 3 /end AVAILABLE_EVENT_LIST /begin DEFAULT_EVENT_LIST EVENT 0 /end DEFAULT_EVENT_LIST /end DAQ_EVENT
 /end IF_DATA
/end MEASUREMENT
/begin MEASUREMENT anzti "injection counter" UBYTE dez 1 100 0.00 255.0 FORMAT "%5.1" ECU_ADDRESS 0x400089FF
 /begin IF_DATA XCPplus 0x0102
  /begin DAQ_EVENT VARIABLE /begin AVAILABLE_EVENT_LIST EVENT 0 EVENT 1 EVENT 2 EVENT 3 /end AVAILABLE_EVENT_LIST /begin DEFAULT_EVENT_LIST EVENT 0 /end DEFAULT_EVENT_LIST /end DAQ_EVENT
 /end IF_DATA
/end MEASUREMENT
/begin MEASUREMENT anztib "injection counter limited" UBYTE dez 1 100 0.00 255.0 FORMAT "%5.1" ECU_ADDRESS 0x400089FE
 /begin IF_DATA XCPplus 0x0102
  /begin DAQ_EVENT VARIABLE /begin AVAILABLE_EVENT_LIST EVENT 0 EVENT 1 EVENT 2 EVENT 3 /end AVAILABLE_EVENT_LIST /begin DEFAULT_EVENT_LIST EVENT 0 /end DEFAULT_EVENT_LIST /end DAQ_EVENT
 /end IF_DATA
/end MEASUREMENT
/begin MEASUREMENT anztib_w "injection counter with limit" UWORD dez 1 100 0.00 65535.00 FORMAT "%8.2" ECU_ADDRESS 0x4000861A
 /begin IF_DATA XCPplus 0x0102
  /begin DAQ_EVENT VARIABLE /begin AVAILABLE_EVENT_LIST EVENT 0 EVENT 1 EVENT 2 EVENT 3 /end AVAILABLE_EVENT_LIST /begin DEFAULT_EVENT_LIST EVENT 0 /end DEFAULT_EVENT_LIST /end DAQ_EVENT
 /end IF_DATA
/end MEASUREMENT
/begin MEASUREMENT anzti_w "injection counter" UWORD dez 1 100 0.00 65535.00 FORMAT "%8.2" ECU_ADDRESS 0x40008618
 /begin IF_DATA XCPplus 0x0102
  /begin DAQ_EVENT VARIABLE /begin AVAILABLE_EVENT_LIST EVENT 0 EVENT 1 EVENT 2 EVENT 3 /end AVAILABLE_EVENT_LIST /begin DEFAULT_EVENT_LIST EVENT 0 /end DEFAULT_EVENT_LIST /end DAQ_EVENT
 /end IF_DATA
/end MEASUREMENT
/begin MEASUREMENT ATS_InjPfiTstFlg_u8 "ATS injection test status for PFI" UBYTE dez 1 100 0.00 255.0 FORMAT "%5.1" ECU_ADDRESS 0x40008A03 /end MEASUREMENT
/begin MEASUREMENT avgvfzg "Array to store average vehicle speed for last five driving cycles" UBYTE vfzg_ub_q1p25 1 100 0.00 318.8 FORMAT "%5.1" ARRAY_SIZE 10 ECU_ADDRESS 0x4000C6F8
 /begin IF_DATA XCPplus 0x0102
  /begin DAQ_EVENT VARIABLE /begin AVAILABLE_EVENT_LIST EVENT 0 EVENT 1 EVENT 2 EVENT 3 /end AVAILABLE_EVENT_LIST /begin DEFAULT_EVENT_LIST EVENT 3 /end DEFAULT_EVENT_LIST /end DAQ_EVENT
 /end IF_DATA
/end MEASUREMENT
/begin MEASUREMENT azoffmsk_w "Fade out mask ignition output" UWORD OneToOne 1 100 0.00 65535.00 FORMAT "%8.2" ECU_ADDRESS 0x40008012
 /begin IF_DATA XCPplus 0x0102
  /begin DAQ_EVENT VARIABLE /begin AVAILABLE_EVENT_LIST EVENT 0 EVENT 1 EVENT 2 EVENT 3 /end AVAILABLE_EVENT_LIST /begin DEFAULT_EVENT_LIST EVENT 1 /end DEFAULT_EVENT_LIST /end DAQ_EVENT
 /end IF_DATA
/end MEASUREMENT
/begin MEASUREMENT Btmovh "Local variable to hold the over heat condition" UBYTE OneToOne 1 100 0.00 255.0 FORMAT "%5.1" ECU_ADDRESS 0x40008F70
 /begin IF_DATA XCPplus 0x0102
  /begin DAQ_EVENT VARIABLE /begin AVAILABLE_EVENT_LIST EVENT 0 EVENT 1 EVENT 2 EVENT 3 /end AVAILABLE_EVENT_LIST /begin DEFAULT_EVENT_LIST EVENT 2 /end DEFAULT_EVENT_LIST /end DAQ_EVENT
 /end IF_DATA
/end MEASUREMENT
/begin MEASUREMENT B_etmot "Condition error cooling wter temperature sesnor" UBYTE B_TRUE 1 100 0.00 1.00000000000 BIT_MASK 0x1 FORMAT "%13.11" ECU_ADDRESS 0x4000C6F2
 /begin IF_DATA XCPplus 0x0102
  /begin DAQ_EVENT VARIABLE /begin AVAILABLE_EVENT_LIST EVENT 0 EVENT 1 EVENT 2 EVENT 3 /end AVAILABLE_EVENT_LIST /begin DEFAULT_EVENT_LIST EVENT 2 /end DEFAULT_EVENT_LIST /end DAQ_EVENT
 /end IF_DATA
/end MEASUREMENT
/begin MEASUREMENT B_firstSyn "Condition: First synchro after synchronization" UBYTE B_TRUE 1 100 0.00 1.00000000000 BIT_MASK 0x1 FORMAT "%13.11" ECU_ADDRESS 0x400089F4 /end MEASUREMENT
/begin MEASUREMENT B_flgGGTFMDSMClr "ocal variable to hold the fault clear request for DFC_TMmax or DFC_TMmin or DFC_TMnpl" UBYTE B_TRUE 1 100 0.00 1.00000000000 BIT_MASK 0x1 FORMAT "%13.11" ECU_ADDRESS 0x40008716
 /begin IF_DATA XCPplus 0x0102
  /begin DAQ_EVENT VARIABLE /begin AVAILABLE_EVENT_LIST EVENT 0 EVENT 1 EVENT 2 EVENT 3 /end AVAILABLE_EVENT_LIST /begin DEFAULT_EVENT_LIST EVENT 2 /end DEFAULT_EVENT_LIST /end DAQ_EVENT
 /end IF_DATA
/end MEASUREMENT
/begin MEASUREMENT B_flgHdLampDSMClr "Clear DFC information after DSM clear proc is triggered" UBYTE B_TRUE 1 100 0.00 1.00000000000 BIT_MASK 0x1 FORMAT "%13.11" ECU_ADDRESS 0x400089A0
 /begin IF_DATA XCPplus 0x0102
  /begin DAQ_EVENT VARIABLE /begin AVAILABLE_EVENT_LIST EVENT 0 EVENT 1 EVENT 2 EVENT 3 /end AVAILABLE_EVENT_LIST /begin DEFAULT_EVENT_LIST EVENT 2 /end DEFAULT_EVENT_LIST /end DAQ_EVENT
 /end IF_DATA
/end MEASUREMENT
/begin MEASUREMENT B_HdLamp "State of Headlamp Relay" UBYTE B_TRUE 1 100 0.00 1.00000000000 BIT_MASK 0x1 FORMAT "%13.11" ECU_ADDRESS 0x4000899F
 /begin IF_DATA XCPplus 0x0102
  /begin DAQ_EVENT VARIABLE /begin AVAILABLE_EVENT_LIST EVENT 0 EVENT 1 EVENT 2 EVENT 3 /end AVAILABLE_EVENT_LIST /begin DEFAULT_EVENT_LIST EVENT 2 /end DEFAULT_EVENT_LIST /end DAQ_EVENT
 /end IF_DATA
/end MEASUREMENT
/begin MEASUREMENT B_hsha "Condition for lambda sensor downstream cat enough heated" UBYTE B_TRUE 1 100 0.00 1.00000000000 BIT_MASK 0x1 FORMAT "%13.11" ECU_ADDRESS 0x400089A6 /end MEASUREMENT
/begin MEASUREMENT B_hshe "condition for lambda sensor heating-switch downstream cat on" UBYTE B_TRUE 1 100 0.00 1.00000000000 BIT_MASK 0x1 FORMAT "%13.11" ECU_ADDRESS 0x400089A5 /end MEASUREMENT
/begin MEASUREMENT B_hskfhxf "Status of completion of heater ramping phase, after cat (LSF with Pumped Reference)" UBYTE B_TRUE 1 100 0.00 1.00000000000 BIT_MASK 0x1 FORMAT "%13.11" ECU_ADDRESS 0x400089A4 /end MEASUREMENT
/begin MEASUREMENT B_hskfvxf "Status of completion of heater ramping phase, before cat (LSF with Pumped Reference)" UBYTE B_TRUE 1 100 0.00 1.00000000000 BIT_MASK 0x1 FORMAT "%13.11" ECU_ADDRESS 0x400089A3 /end MEASUREMENT
/begin MEASUREMENT B_hsve "condition for lambda sensor heating-switch upstream catalyst on" UBYTE B_TRUE 1 100 0.00 1.00000000000 BIT_MASK 0x1 FORMAT "%13.11" ECU_ADDRESS 0x400089A2 /end MEASUREMENT
/begin MEASUREMENT B_kuppl "Condition clutch pedal pressed" UBYTE B_TRUE 1 100 0.00 1.00000000000 BIT_MASK 0x1 FORMAT "%13.11" ECU_ADDRESS 0x4000877C /end MEASUREMENT
/begin MEASUREMENT B_LowBatt "Low Battery Indication Bit" UBYTE B_TRUE 1 100 0.00 1.00000000000 BIT_MASK 0x1 FORMAT "%13.11" ECU_ADDRESS 0x4000899E
 /begin IF_DATA XCPplus 0x0102
  /begin DAQ_EVENT VARIABLE /begin AVAILABLE_EVENT_LIST EVENT 0 EVENT 1 EVENT 2 EVENT 3 /end AVAILABLE_EVENT_LIST /begin DEFAULT_EVENT_LIST EVENT 2 /end DEFAULT_EVENT_LIST /end DAQ_EVENT
 /end IF_DATA
/end MEASUREMENT
/begin MEASUREMENT B_neutgear "Condition: Neutral Gear ON" UBYTE B_TRUE 1 100 0.00 1.00000000000 BIT_MASK 0x1 FORMAT "%13.11" ECU_ADDRESS 0x4000877B /end MEASUREMENT
/begin MEASUREMENT B_pokayoke "Pokayoke BIT" UBYTE B_TRUE 1 100 0.00 1.00000000000 BIT_MASK 0x1 FORMAT "%13.11" ECU_ADDRESS 0x4000877A /end MEASUREMENT
/begin MEASUREMENT B_redhshxf "Status to reduce heater power during ramping strategy, downstream cat (LSF with Pumped Reference)" UBYTE B_TRUE 1 100 0.00 1.00000000000 BIT_MASK 0x1 FORMAT "%13.11" ECU_ADDRESS 0x400089BB /end MEASUREMENT
/begin MEASUREMENT B_redhsvxf "Status to reduce heater power during ramping strategy, upstream cat (LSF with Pumped Reference)" UBYTE B_TRUE 1 100 0.00 1.00000000000 BIT_MASK 0x1 FORMAT "%13.11" ECU_ADDRESS 0x400089B1 /end MEASUREMENT
/begin MEASUREMENT B_rehs "Restart Lambda sensor heating" UBYTE B_TRUE 1 100 0.00 1.00000000000 BIT_MASK 0x1 FORMAT "%13.11" ECU_ADDRESS 0x400089B7 /end MEASUREMENT
/begin MEASUREMENT B_tmmodst "Condition to intialise modelled coolant temperature" UBYTE B_TRUE 1 100 0.00 1.00000000000 BIT_MASK 0x1 FORMAT "%13.11" ECU_ADDRESS 0x40008715
 /begin IF_DATA XCPplus 0x0102
  /begin DAQ_EVENT VARIABLE /begin AVAILABLE_EVENT_LIST EVENT 0 EVENT 1 EVENT 2 EVENT 3 /end AVAILABLE_EVENT_LIST /begin DEFAULT_EVENT_LIST EVENT 2 /end DEFAULT_EVENT_LIST /end DAQ_EVENT
 /end IF_DATA
/end MEASUREMENT
/begin MEASUREMENT B_tmovh "bit for the condition over heat" UBYTE B_TRUE 1 100 0.00 1.00000000000 BIT_MASK 0x1 FORMAT "%13.11" ECU_ADDRESS 0x40008706
 /begin IF_DATA XCPplus 0x0102
  /begin DAQ_EVENT VARIABLE /begin AVAILABLE_EVENT_LIST EVENT 0 EVENT 1 EVENT 2 EVENT 3 /end AVAILABLE_EVENT_LIST /begin DEFAULT_EVENT_LIST EVENT 2 /end DEFAULT_EVENT_LIST /end DAQ_EVENT
 /end IF_DATA
/end MEASUREMENT
/begin MEASUREMENT B_ubattdiag "Battery Voltage check for enabling diagnosis of Headlamp Realy PS" UBYTE B_TRUE 1 100 0.00 1.00000000000 BIT_MASK 0x1 FORMAT "%13.11" ECU_ADDRESS 0x400089A1
 /begin IF_DATA XCPplus 0x0102
  /begin DAQ_EVENT VARIABLE /begin AVAILABLE_EVENT_LIST EVENT 0 EVENT 1 EVENT 2 EVENT 3 /end AVAILABLE_EVENT_LIST /begin DEFAULT_EVENT_LIST EVENT 2 /end DEFAULT_EVENT_LIST /end DAQ_EVENT
 /end IF_DATA
/end MEASUREMENT
/begin MEASUREMENT B_ubg "Validity of ub, ubsq, ubrsq" UBYTE B_TRUE 1 100 0.00 1.00000000000 BIT_MASK 0x1 FORMAT "%13.11" ECU_ADDRESS 0x4000899B
 /begin IF_DATA XCPplus 0x0102
  /begin DAQ_EVENT VARIABLE /begin AVAILABLE_EVENT_LIST EVENT 0 EVENT 1 EVENT 2 EVENT 3 /end AVAILABLE_EVENT_LIST /begin DEFAULT_EVENT_LIST EVENT 1 /end DEFAULT_EVENT_LIST /end DAQ_EVENT
 /end IF_DATA
/end MEASUREMENT
/begin MEASUREMENT B_vehpulse "Vehicle speed sensor signal detected." UBYTE B_TRUE 1 100 0.00 1.00000000000 BIT_MASK 0x1 FORMAT "%13.11" ECU_ADDRESS 0x40008776 /end MEASUREMENT
/begin MEASUREMENT B_vfzhws "Hardwired vehicle speed Sensor Present" UBYTE B_TRUE 1 100 0.00 1.00000000000 BIT_MASK 0x1 FORMAT "%13.11" ECU_ADDRESS 0x40008772
 /begin IF_DATA XCPplus 0x0102
  /begin DAQ_EVENT VARIABLE /begin AVAILABLE_EVENT_LIST EVENT 0 EVENT 1 EVENT 2 EVENT 3 /end AVAILABLE_EVENT_LIST /begin DEFAULT_EVENT_LIST EVENT 3 /end DEFAULT_EVENT_LIST /end DAQ_EVENT
 /end IF_DATA
/end MEASUREMENT
/begin MEASUREMENT B_zesync "Condition ignition synchronized" UBYTE B_TRUE 1 100 0.00 1.00000000000 BIT_MASK 0x1 FORMAT "%13.11" ECU_ADDRESS 0x400064D6
 /begin IF_DATA XCPplus 0x0102
  /begin DAQ_EVENT VARIABLE /begin AVAILABLE_EVENT_LIST EVENT 0 EVENT 1 EVENT 2 EVENT 3 /end AVAILABLE_EVENT_LIST /begin DEFAULT_EVENT_LIST EVENT 0 /end DEFAULT_EVENT_LIST /end DAQ_EVENT
 /end IF_DATA
/end MEASUREMENT
/begin MEASUREMENT B_zwdyn "condition for engine protection limit" UBYTE B_TRUE 1 100 0.00 1.00000000000 BIT_MASK 0x1 FORMAT "%13.11" ECU_ADDRESS 0x400089C7
 /begin IF_DATA XCPplus 0x0102
  /begin DAQ_EVENT VARIABLE /begin AVAILABLE_EVENT_LIST EVENT 0 EVENT 1 EVENT 2 EVENT 3 /end AVAILABLE_EVENT_LIST /begin DEFAULT_EVENT_LIST EVENT 0 /end DEFAULT_EVENT_LIST /end DAQ_EVENT
 /end IF_DATA
/end MEASUREMENT
/begin MEASUREMENT CEngDsT_flgEngRunngSTC "Flag to indicate engine running condition" UBYTE B_TRUE 1 100 0.00 1.00000000000 BIT_MASK 0x1 FORMAT "%13.11" ECU_ADDRESS 0x400062A0
 /begin IF_DATA XCPplus 0x0102
  /begin DAQ_EVENT VARIABLE /begin AVAILABLE_EVENT_LIST EVENT 0 EVENT 1 EVENT 2 EVENT 3 /end AVAILABLE_EVENT_LIST /begin DEFAULT_EVENT_LIST EVENT 2 /end DEFAULT_EVENT_LIST /end DAQ_EVENT
 /end IF_DATA
/end MEASUREMENT
/begin MEASUREMENT CEngDsT_flgPlausSTCErr "Condition: Error Stuck-Check for engine coolant temperature sensor" UBYTE B_TRUE 1 100 0.00 1.00000000000 BIT_MASK 0x1 FORMAT "%13.11" ECU_ADDRESS 0x4000629F
 /begin IF_DATA XCPplus 0x0102
  /begin DAQ_EVENT VARIABLE /begin AVAILABLE_EVENT_LIST EVENT 0 EVENT 1 EVENT 2 EVENT 3 /end AVAILABLE_EVENT_LIST /begin DEFAULT_EVENT_LIST EVENT 2 /end DEFAULT_EVENT_LIST /end DAQ_EVENT
 /end IF_DATA
/end MEASUREMENT
/begin MEASUREMENT CEngDsT_flgPlausSTCErrDi "Stuck Check for coolant temperature sensor blocked by electrical check errors" UBYTE B_TRUE 1 100 0.00 1.00000000000 BIT_MASK 0x1 FORMAT "%13.11" ECU_ADDRESS 0x4000629E
 /begin IF_DATA XCPplus 0x0102
  /begin DAQ_EVENT VARIABLE /begin AVAILABLE_EVENT_LIST EVENT 0 EVENT 1 EVENT 2 EVENT 3 /end AVAILABLE_EVENT_LIST /begin DEFAULT_EVENT_LIST EVENT 2 /end DEFAULT_EVENT_LIST /end DAQ_EVENT
 /end IF_DATA
/end MEASUREMENT
/begin MEASUREMENT CEngDsT_flgPlausSTCHeal "Condition: HealingStuck-Check for engine coolant temperature sensor" UBYTE B_TRUE 1 100 0.00 1.00000000000 BIT_MASK 0x1 FORMAT "%13.11" ECU_ADDRESS 0x4000629D
 /begin IF_DATA XCPplus 0x0102
  /begin DAQ_EVENT VARIABLE /begin AVAILABLE_EVENT_LIST EVENT 0 EVENT 1 EVENT 2 EVENT 3 /end AVAILABLE_EVENT_LIST /begin DEFAULT_EVENT_LIST EVENT 2 /end DEFAULT_EVENT_LIST /end DAQ_EVENT
 /end IF_DATA
/end MEASUREMENT
/begin MEASUREMENT CEngDsT_flgSRCMaxErr "debounced Max-error Signal-Range-Check engine coolant temperature sensor" UBYTE B_TRUE 1 100 0.00 1.00000000000 BIT_MASK 0x1 FORMAT "%13.11" ECU_ADDRESS 0x40008714
 /begin IF_DATA XCPplus 0x0102
  /begin DAQ_EVENT VARIABLE /begin AVAILABLE_EVENT_LIST EVENT 0 EVENT 1 EVENT 2 EVENT 3 /end AVAILABLE_EVENT_LIST /begin DEFAULT_EVENT_LIST EVENT 2 /end DEFAULT_EVENT_LIST /end DAQ_EVENT
 /end IF_DATA
/end MEASUREMENT
/begin MEASUREMENT CEngDsT_flgSRCMaxHeal "healing max error Signal-Range-Check engine coolant temperature sensor" UBYTE B_TRUE 1 100 0.00 1.00000000000 BIT_MASK 0x1 FORMAT "%13.11" ECU_ADDRESS 0x40008713
 /begin IF_DATA XCPplus 0x0102
  /begin DAQ_EVENT VARIABLE /begin AVAILABLE_EVENT_LIST EVENT 0 EVENT 1 EVENT 2 EVENT 3 /end AVAILABLE_EVENT_LIST /begin DEFAULT_EVENT_LIST EVENT 2 /end DEFAULT_EVENT_LIST /end DAQ_EVENT
 /end IF_DATA
/end MEASUREMENT
/begin MEASUREMENT CEngDsT_flgSRCMinErr "debounced Min-error Signal-Range-Check engine coolant temperature sensor" UBYTE B_TRUE 1 100 0.00 1.00000000000 BIT_MASK 0x1 FORMAT "%13.11" ECU_ADDRESS 0x40008712
 /begin IF_DATA XCPplus 0x0102
  /begin DAQ_EVENT VARIABLE /begin AVAILABLE_EVENT_LIST EVENT 0 EVENT 1 EVENT 2 EVENT 3 /end AVAILABLE_EVENT_LIST /begin DEFAULT_EVENT_LIST EVENT 2 /end DEFAULT_EVENT_LIST /end DAQ_EVENT
 /end IF_DATA
/end MEASUREMENT
/begin MEASUREMENT CEngDsT_flgSRCMinHeal "Heilung Min-Fehler elektrische Bereichsprüfung KühlmitteltemperaturSensor" UBYTE B_TRUE 1 100 0.00 1.00000000000 BIT_MASK 0x1 FORMAT "%13.11" ECU_ADDRESS 0x40008711
 /begin IF_DATA XCPplus 0x0102
  /begin DAQ_EVENT VARIABLE /begin AVAILABLE_EVENT_LIST EVENT 0 EVENT 1 EVENT 2 EVENT 3 /end AVAILABLE_EVENT_LIST /begin DEFAULT_EVENT_LIST EVENT 2 /end DEFAULT_EVENT_LIST /end DAQ_EVENT
 /end IF_DATA
/end MEASUREMENT
/begin MEASUREMENT CEngDsT_tDifMaxMinSnsrSTC "Difference between maximum and minimum values of CEngDsT sensor used for stuck at high error or heal detection" SLONG TempDiff_Kelv 1 100 -214748364.800 214748364.700 FORMAT "%13.3" ECU_ADDRESS 0x40004754
 /begin IF_DATA XCPplus 0x0102
  /begin DAQ_EVENT VARIABLE /begin AVAILABLE_EVENT_LIST EVENT 0 EVENT 1 EVENT 2 EVENT 3 /end AVAILABLE_EVENT_LIST /begin DEFAULT_EVENT_LIST EVENT 2 /end DEFAULT_EVENT_LIST /end DAQ_EVENT
 /end IF_DATA
/end MEASUREMENT
/begin MEASUREMENT CEngDsT_tPreRamp "Pre-ramped engine coolent downstream temperature" SWORD Temp_Cels 1 100 -3549.940 3003.560 FORMAT "%8.3" ECU_ADDRESS 0x40005C38
 /begin IF_DATA XCPplus 0x0102
  /begin DAQ_EVENT VARIABLE /begin AVAILABLE_EVENT_LIST EVENT 0 EVENT 1 EVENT 2 EVENT 3 /end AVAILABLE_EVENT_LIST /begin DEFAULT_EVENT_LIST EVENT 2 /end DEFAULT_EVENT_LIST /end DAQ_EVENT
 /end IF_DATA
/end MEASUREMENT
/begin MEASUREMENT CEngDsT_tRamp "Ramped engine coolent downstream temperature" SWORD Temp_Cels 1 100 -3549.940 3003.560 FORMAT "%8.3" ECU_ADDRESS 0x40005C36
 /begin IF_DATA XCPplus 0x0102
  /begin DAQ_EVENT VARIABLE /begin AVAILABLE_EVENT_LIST EVENT 0 EVENT 1 EVENT 2 EVENT 3 /end AVAILABLE_EVENT_LIST /begin DEFAULT_EVENT_LIST EVENT 2 /end DEFAULT_EVENT_LIST /end DAQ_EVENT
 /end IF_DATA
/end MEASUREMENT
/begin MEASUREMENT CEngDsT_tSnsrMaxSTC "Maximum value of CEngDsT sensor recorded in a driving cycle for stuck check" SWORD Temp_Cels 1 100 -3549.940 3003.560 FORMAT "%8.3" ECU_ADDRESS 0x40005C34
 /begin IF_DATA XCPplus 0x0102
  /begin DAQ_EVENT VARIABLE /begin AVAILABLE_EVENT_LIST EVENT 0 EVENT 1 EVENT 2 EVENT 3 /end AVAILABLE_EVENT_LIST /begin DEFAULT_EVENT_LIST EVENT 2 /end DEFAULT_EVENT_LIST /end DAQ_EVENT
 /end IF_DATA
/end MEASUREMENT
/begin MEASUREMENT CEngDsT_tSnsrMinSTC "Minimum value of CEngDsT sensor recorded in a driving cycle for stuck check" SWORD Temp_Cels 1 100 -3549.940 3003.560 FORMAT "%8.3" ECU_ADDRESS 0x40005C32
 /begin IF_DATA XCPplus 0x0102
  /begin DAQ_EVENT VARIABLE /begin AVAILABLE_EVENT_LIST EVENT 0 EVENT 1 EVENT 2 EVENT 3 /end AVAILABLE_EVENT_LIST /begin DEFAULT_EVENT_LIST EVENT 2 /end DEFAULT_EVENT_LIST /end DAQ_EVENT
 /end IF_DATA
/end MEASUREMENT
/begin MEASUREMENT dzwfl "Delta ignition angle incase of full load." SBYTE zw_sb_q0p75 1 100 -96.00 95.25 FORMAT "%5.2" ECU_ADDRESS 0x400089DD
 /begin IF_DATA XCPplus 0x0102
  /begin DAQ_EVENT VARIABLE /begin AVAILABLE_EVENT_LIST EVENT 0 EVENT 1 EVENT 2 EVENT 3 /end AVAILABLE_EVENT_LIST /begin DEFAULT_EVENT_LIST EVENT 0 /end DEFAULT_EVENT_LIST /end DAQ_EVENT
 /end IF_DATA
/end MEASUREMENT
/begin MEASUREMENT dzwkta "Delta ignition angle for temperature correction." SBYTE zw_sb_q0p75 1 100 -96.00 95.25 FORMAT "%5.2" ECU_ADDRESS 0x400089DC
 /begin IF_DATA XCPplus 0x0102
  /begin DAQ_EVENT VARIABLE /begin AVAILABLE_EVENT_LIST EVENT 0 EVENT 1 EVENT 2 EVENT 3 /end AVAILABLE_EVENT_LIST /begin DEFAULT_EVENT_LIST EVENT 0 /end DEFAULT_EVENT_LIST /end DAQ_EVENT
 /end IF_DATA
/end MEASUREMENT
/begin MEASUREMENT dzwspae "correction ignition angle for latest permissible ignition angle" SBYTE zw_sb_q0p75 1 100 -96.00 95.25 FORMAT "%5.2" ECU_ADDRESS 0x400089DB
 /begin IF_DATA XCPplus 0x0102
  /begin DAQ_EVENT VARIABLE /begin AVAILABLE_EVENT_LIST EVENT 0 EVENT 1 EVENT 2 EVENT 3 /end AVAILABLE_EVENT_LIST /begin DEFAULT_EVENT_LIST EVENT 0 /end DEFAULT_EVENT_LIST /end DAQ_EVENT
 /end IF_DATA
/end MEASUREMENT
/begin MEASUREMENT dzwwl "delta ignition angle from warm-up" SBYTE zw_sb_q0p75 1 100 -96.00 95.25 FORMAT "%5.2" ECU_ADDRESS 0x400089DA
 /begin IF_DATA XCPplus 0x0102
  /begin DAQ_EVENT VARIABLE /begin AVAILABLE_EVENT_LIST EVENT 0 EVENT 1 EVENT 2 EVENT 3 /end AVAILABLE_EVENT_LIST /begin DEFAULT_EVENT_LIST EVENT 0 /end DEFAULT_EVENT_LIST /end DAQ_EVENT
 /end IF_DATA
/end MEASUREMENT
/begin MEASUREMENT etazwmn "minimum ignition angle effectiveness" UBYTE rel_ub_b127p5 1 100 0.00 127.5 FORMAT "%5.1" ECU_ADDRESS 0x400089D9
 /begin IF_DATA XCPplus 0x0102
  /begin DAQ_EVENT VARIABLE /begin AVAILABLE_EVENT_LIST EVENT 0 EVENT 1 EVENT 2 EVENT 3 /end AVAILABLE_EVENT_LIST /begin DEFAULT_EVENT_LIST EVENT 0 /end DEFAULT_EVENT_LIST /end DAQ_EVENT
 /end IF_DATA
/end MEASUREMENT
/begin MEASUREMENT frstinjcyl "cylinder number first injection" UBYTE dez 1 100 0.00 255.0 FORMAT "%5.1" ECU_ADDRESS 0x400089FD
 /begin IF_DATA XCPplus 0x0102
  /begin DAQ_EVENT VARIABLE /begin AVAILABLE_EVENT_LIST EVENT 0 EVENT 1 EVENT 2 EVENT 3 /end AVAILABLE_EVENT_LIST /begin DEFAULT_EVENT_LIST EVENT 0 /end DEFAULT_EVENT_LIST /end DAQ_EVENT
 /end IF_DATA
/end MEASUREMENT
/begin MEASUREMENT HEGOD_SimnS1_I.uWithSimn "Dynamics simulation lambda sensor 1 / Output voltage with dynamics simulation" UWORD spg_q0p005 1 100 0.00 327.6750 FORMAT "%8.4" ECU_ADDRESS 0x40008D34
 /begin IF_DATA XCPplus 0x0102
  /begin DAQ_EVENT VARIABLE /begin AVAILABLE_EVENT_LIST EVENT 0 EVENT 1 EVENT 2 EVENT 3 /end AVAILABLE_EVENT_LIST /begin DEFAULT_EVENT_LIST EVENT 1 /end DEFAULT_EVENT_LIST /end DAQ_EVENT
 /end IF_DATA
/end MEASUREMENT
/begin MEASUREMENT HEGOD_SimnS1_I.DlyTtOpt_I.buffer "Dynamics simulation lambda sensor 1 / DlyTtOpt_I / buffer" UWORD spg_q0p005 1 100 0.00 327.6750 FORMAT "%8.4" ARRAY_SIZE 21 ECU_ADDRESS 0x40008D36
 /begin IF_DATA XCPplus 0x0102
  /begin DAQ_EVENT VARIABLE /begin AVAILABLE_EVENT_LIST EVENT 0 EVENT 1 EVENT 2 EVENT 3 /end AVAILABLE_EVENT_LIST /begin DEFAULT_EVENT_LIST EVENT 1 /end DEFAULT_EVENT_LIST /end DAQ_EVENT
 /end IF_DATA
/end MEASUREMENT
/begin MEASUREMENT HEGOD_SimnS1_I.DlyTtOpt_I.counter "Dynamics simulation lambda sensor 1 / DlyTtOpt_I / counter" UWORD fak_uw_b2 1 100 0.00 1.000000 FORMAT "%8.6" ECU_ADDRESS 0x40008D60
 /begin IF_DATA XCPplus 0x0102
  /begin DAQ_EVENT VARIABLE /begin AVAILABLE_EVENT_LIST EVENT 0 EVENT 1 EVENT 2 EVENT 3 /end AVAILABLE_EVENT_LIST /begin DEFAULT_EVENT_LIST EVENT 1 /end DEFAULT_EVENT_LIST /end DAQ_EVENT
 /end IF_DATA
/end MEASUREMENT
/begin MEASUREMENT HEGOD_SimnS1_I.DlyTtOpt_I.ds "Dynamics simulation lambda sensor 1 / DlyTtOpt_I / ds" UWORD fak_uw_b2 1 100 0.00 1.000000 FORMAT "%8.6" ECU_ADDRESS 0x40008D62 /end MEASUREMENT
/begin MEASUREMENT HEGOD_SimnS1_I.DlyTtOpt_I.pointer "Dynamics simulation lambda sensor 1 / DlyTtOpt_I / pointer" UBYTE dez 1 100 0.00 255.0 FORMAT "%5.1" ECU_ADDRESS 0x40008D64
 /begin IF_DATA XCPplus 0x0102
  /begin DAQ_EVENT VARIABLE /begin AVAILABLE_EVENT_LIST EVENT 0 EVENT 1 EVENT 2 EVENT 3 /end AVAILABLE_EVENT_LIST /begin DEFAULT_EVENT_LIST EVENT 1 /end DEFAULT_EVENT_LIST /end DAQ_EVENT
 /end IF_DATA
/end MEASUREMENT
/begin MEASUREMENT HEGOD_SimnS1_I.FolwSimnLT_I.memory "Dynamics simulation lambda sensor 1 / Low pass filter: dynamic simulation / current lowpass value" ULONG fak_uw_b0p005 1 100 0.00 327.679999924 FORMAT "%13.9" ECU_ADDRESS 0x40008D68 /end MEASUREMENT
/begin MEASUREMENT HEGOD_SimnS2_I.uWithSimn "Dynamics simulation lambda sensor 2 / Output voltage with dynamics simulation" UWORD spg_q0p005 1 100 0.00 327.6750 FORMAT "%8.4" ECU_ADDRESS 0x40008D6C /end MEASUREMENT
/begin MEASUREMENT HEGOD_SimnS2_I.DlyTtOpt_I.buffer "Dynamics simulation lambda sensor 2 / DlyTtOpt_I / buffer" UWORD spg_q0p005 1 100 0.00 327.6750 FORMAT "%8.4" ARRAY_SIZE 21 ECU_ADDRESS 0x40008D6E /end MEASUREMENT
/begin MEASUREMENT HEGOD_SimnS2_I.DlyTtOpt_I.counter "Dynamics simulation lambda sensor 2 / DlyTtOpt_I / counter" UWORD fak_uw_b2 1 100 0.00 1.000000 FORMAT "%8.6" ECU_ADDRESS 0x40008D98 /end MEASUREMENT
/begin MEASUREMENT HEGOD_SimnS2_I.DlyTtOpt_I.ds "Dynamics simulation lambda sensor 2 / DlyTtOpt_I / ds" UWORD fak_uw_b2 1 100 0.00 1.000000 FORMAT "%8.6" ECU_ADDRESS 0x40008D9A /end MEASUREMENT
/begin MEASUREMENT HEGOD_SimnS2_I.DlyTtOpt_I.pointer "Dynamics simulation lambda sensor 2 / DlyTtOpt_I / pointer" UBYTE dez 1 100 0.00 255.0 FORMAT "%5.1" ECU_ADDRESS 0x40008D9C /end MEASUREMENT
/begin MEASUREMENT HEGOD_SimnS2_I.FolwSimnLT_I.memory "Dynamics simulation lambda sensor 2 / Low pass filter: dynamic simulation / current lowpass value" ULONG fak_uw_b0p005 1 100 0.00 327.679999924 FORMAT "%13.9" ECU_ADDRESS 0x40008DA0 /end MEASUREMENT
/begin MEASUREMENT HEGO_drNomClcS1 "Internal resistance difference for closed loop heating controller, Sensor 1" SWORD r_uw_q2 1 100 -65536.00 65534.00 FORMAT "%8.2" ECU_ADDRESS 0x400085D8 /end MEASUREMENT
/begin MEASUREMENT HEGO_drNomClcS2 "Internal resistance difference for closed loop heating controller, Sensor 2" SWORD r_uw_q2 1 100 -65536.00 65534.00 FORMAT "%8.2" ECU_ADDRESS 0x400085F2 /end MEASUREMENT
/begin MEASUREMENT HEGO_duNomHeatgClcS1 "Nominal heating voltage correction of closed loop heating control, Sensor 1" SWORD spg_q0p00039 1 100 -12.80000 12.79961 FORMAT "%8.5" ECU_ADDRESS 0x400085DE /end MEASUREMENT
/begin MEASUREMENT HEGO_duNomHeatgClcS2 "Nominal heating voltage correction of closed loop heating control, Sensor 2" SWORD spg_q0p00039 1 100 -12.80000 12.79961 FORMAT "%8.5" ECU_ADDRESS 0x400085F8 /end MEASUREMENT
/begin MEASUREMENT HEGO_duNomHeatgIntglS1 "Nominal heating voltage correction of closed loop heating control, I-part, Sensor 1" SWORD spg_q0p00039 1 100 -12.80000 12.79961 FORMAT "%8.5" ECU_ADDRESS 0x400085DA /end MEASUREMENT
/begin MEASUREMENT HEGO_duNomHeatgIntglS2 "Nominal heating voltage correction of closed loop heating control, I-part, Sensor 2" SWORD spg_q0p00039 1 100 -12.80000 12.79961 FORMAT "%8.5" ECU_ADDRESS 0x400085F4 /end MEASUREMENT
/begin MEASUREMENT HEGO_duNomHeatgPropS1 "Nominal heating voltage correction of closed loop heating control, P-part, Sensor 1" SWORD spg_q0p00039 1 100 -12.80000 12.79961 FORMAT "%8.5" ECU_ADDRESS 0x400085DC /end MEASUREMENT
/begin MEASUREMENT HEGO_duNomHeatgPropS2 "Nominal heating voltage correction of closed loop heating control, P-part, Sensor 2" SWORD spg_q0p00039 1 100 -12.80000 12.79961 FORMAT "%8.5" ECU_ADDRESS 0x400085F6 /end MEASUREMENT
/begin MEASUREMENT HEGO_flgHeatgClcAntiWndUpS1 "Bit anti wind up of for closed loop heating control, Sensor 1" UBYTE B_TRUE 1 100 0.00 1.00000000000 BIT_MASK 0x1 FORMAT "%13.11" ECU_ADDRESS 0x400089B3 /end MEASUREMENT
/begin MEASUREMENT HEGO_flgHeatgClcAntiWndUpS2 "Bit anti wind up of for closed loop heating control, Sensor 2" UBYTE B_TRUE 1 100 0.00 1.00000000000 BIT_MASK 0x1 FORMAT "%13.11" ECU_ADDRESS 0x400089BD /end MEASUREMENT
/begin MEASUREMENT HEGO_flgHeatgClcEnadS1 "Bit enable closed loop heating control, Sensor 1" UBYTE B_TRUE 1 100 0.00 1.00000000000 BIT_MASK 0x1 FORMAT "%13.11" ECU_ADDRESS 0x400089B2 /end MEASUREMENT
/begin MEASUREMENT HEGO_flgHeatgClcEnadS2 "Bit enable closed loop heating control, Sensor 2" UBYTE B_TRUE 1 100 0.00 1.00000000000 BIT_MASK 0x1 FORMAT "%13.11" ECU_ADDRESS 0x400089BC /end MEASUREMENT
/begin MEASUREMENT HEGO_flgHeatgOffHiTS1 "Bit heating turned off because of too high temperature, Sensor 1" UBYTE B_TRUE 1 100 0.00 1.00000000000 BIT_MASK 0x1 FORMAT "%13.11" ECU_ADDRESS 0x400089B6 /end MEASUREMENT
/begin MEASUREMENT HEGO_flgHeatgOffHiTS2 "Bit heating turned off because of too high temperature, Sensor 2" UBYTE B_TRUE 1 100 0.00 1.00000000000 BIT_MASK 0x1 FORMAT "%13.11" ECU_ADDRESS 0x400089BF /end MEASUREMENT
/begin MEASUREMENT HEGO_flgHeatrStrtNoInhbn "Inhibition flag for heater start" UBYTE B_TRUE 1 100 0.00 1.00000000000 BIT_MASK 0x1 FORMAT "%13.11" ECU_ADDRESS 0x400089B5 /end MEASUREMENT
/begin MEASUREMENT HEGO_ratDutyS1 "Upstream sensor heating duty ratio" UWORD fak_q3p906Em5 1 100 0.00 2.559961 FORMAT "%8.6" ECU_ADDRESS 0x400085CC /end MEASUREMENT
/begin MEASUREMENT HEGO_ratDutyS2 "Downstream sensor heating duty ratio" UWORD fak_q3p906Em5 1 100 0.00 2.559961 FORMAT "%8.6" ECU_ADDRESS 0x400085CA /end MEASUREMENT
/begin MEASUREMENT HEGO_uNomHeatgClcS1 "Nominal heating voltage of closed loop heating control, Sensor 1" UWORD spg_q0p00039 1 100 0.00 25.59961 FORMAT "%8.5" ECU_ADDRESS 0x400085E0 /end MEASUREMENT
/begin MEASUREMENT HEGO_uNomHeatgClcS2 "Nominal heating voltage of closed loop heating control, Sensor 2" UWORD spg_q0p00039 1 100 0.00 25.59961 FORMAT "%8.5" ECU_ADDRESS 0x400085FA /end MEASUREMENT
/begin MEASUREMENT HEGO_uNomHeatgLimS1 "Limited nominal heating voltage, Sensor 1" UWORD spg_q0p00039 1 100 0.00 25.59961 FORMAT "%8.5" ECU_ADDRESS 0x400085E2 /end MEASUREMENT
/begin MEASUREMENT HEGO_uNomHeatgLimS2 "Limited nominal heating voltage, Sensor 2" UWORD spg_q0p00039 1 100 0.00 25.59961 FORMAT "%8.5" ECU_ADDRESS 0x400085FC /end MEASUREMENT
/begin MEASUREMENT HEGO_uNomHeatgOpenLoopS1 "Nominal heating voltage of open loop heating control, Sensor 1" UWORD spg_q0p00039 1 100 0.00 25.59961 FORMAT "%8.5" ECU_ADDRESS 0x400085D6 /end MEASUREMENT
/begin MEASUREMENT HEGO_uNomHeatgOpenLoopS2 "Nominal heating voltage of open loop heating control, Sensor 2" UWORD spg_q0p00039 1 100 0.00 25.59961 FORMAT "%8.5" ECU_ADDRESS 0x400085F0 /end MEASUREMENT
/begin MEASUREMENT HEGO_uNomHeatgS1 "Upstream sensor nominal heating voltage" UWORD spg_q0p00039 1 100 0.00 25.59961 FORMAT "%8.5" ECU_ADDRESS 0x400085D2 /end MEASUREMENT
/begin MEASUREMENT HEGO_uNomHeatgS2 "Downstream sensor nominal heating voltage" UWORD spg_q0p00039 1 100 0.00 25.59961 FORMAT "%8.5" ECU_ADDRESS 0x400085EC /end MEASUREMENT
/begin MEASUREMENT HEGO_uWithDynSimnS1 "Output voltage of HEGO sensor 1, with dynamics simulation" UWORD spg_q0p005 1 100 0.00 327.6750 FORMAT "%8.4" ECU_ADDRESS 0x400085C4
 /begin IF_DATA XCPplus 0x0102
  /begin DAQ_EVENT VARIABLE /begin AVAILABLE_EVENT_LIST EVENT 0 EVENT 1 EVENT 2 EVENT 3 /end AVAILABLE_EVENT_LIST /begin DEFAULT_EVENT_LIST EVENT 1 /end DEFAULT_EVENT_LIST /end DAQ_EVENT
 /end IF_DATA
/end MEASUREMENT
/begin MEASUREMENT HEGO_uWithDynSimnS2 "Output voltage of HEGO sensor 2, with dynamics simulation" UWORD spg_q0p005 1 100 0.00 327.6750 FORMAT "%8.4" ECU_ADDRESS 0x400085C2
 /begin IF_DATA XCPplus 0x0102
  /begin DAQ_EVENT VARIABLE /begin AVAILABLE_EVENT_LIST EVENT 0 EVENT 1 EVENT 2 EVENT 3 /end AVAILABLE_EVENT_LIST /begin DEFAULT_EVENT_LIST EVENT 1 /end DEFAULT_EVENT_LIST /end DAQ_EVENT
 /end IF_DATA
/end MEASUREMENT
/begin MEASUREMENT I15031_FILLSIG1 "Fillsignal for not supported signals with the size of 1 Byte" UBYTE OneToOne 1 100 0.00 255.0 FORMAT "%5.1" ECU_ADDRESS 0x400063CE /end MEASUREMENT
/begin MEASUREMENT I15031_FILLSIG2 "Fillsignal for not supported signals with the size of 2 Bytes" UWORD OneToOne 1 100 0.00 65535.00 FORMAT "%8.2" ECU_ADDRESS 0x40005D88 /end MEASUREMENT
/begin MEASUREMENT I15031_FILLSIG4 "Fillsignal for not supported signals with the size of 4 Bytes" ULONG OneToOne 1 100 0.00 4294967295.00 FORMAT "%13.2" ECU_ADDRESS 0x400048BC /end MEASUREMENT
/begin MEASUREMENT I15031_PID1C "OBD requirements to which vehicle is designed" UBYTE OneToOne 1 100 0.00 255.0 FORMAT "%5.1" ECU_ADDRESS 0x400063CD /end MEASUREMENT
/begin MEASUREMENT I15031_PID71A "Shows which Variable Geometry Turbo (VGT) Control data are supported in PID71" UBYTE OneToOne 1 100 0.00 255.0 FORMAT "%5.1" ECU_ADDRESS 0x400063CC /end MEASUREMENT
/begin MEASUREMENT I15031_PID9AA "Shows if HybridEV Vehicle State is supported in PID9A" UBYTE OneToOne 1 100 0.00 255.0 FORMAT "%5.1" ECU_ADDRESS 0x400063CB /end MEASUREMENT
/begin MEASUREMENT I15031_PIDSuppSrv1 "PIDs supported in Service 1 are indicated in 32 bit measurement array" ULONG OneToOne 1 100 0.00 4294967295.00 FORMAT "%13.2" ARRAY_SIZE 8 ECU_ADDRESS 0x40005A9C /end MEASUREMENT
/begin MEASUREMENT I15031_PIDSuppSrv2 "PIDs supported in Service 2 are indicated in 32 bit measurement array" ULONG OneToOne 1 100 0.00 4294967295.00 FORMAT "%13.2" ARRAY_SIZE 8 ECU_ADDRESS 0x40005A7C /end MEASUREMENT
/begin MEASUREMENT I15031_srv9_CalidCvnOrd_mp "CALID CVN Order Measurement Point" UBYTE I15031_srv9_CalidcvnOrdVerb 1 100 0.00 255.000000000 FORMAT "%13.9" ARRAY_SIZE 1 ECU_ADDRESS 0x40009E1C
 /begin IF_DATA XCPplus 0x0102
  /begin DAQ_EVENT VARIABLE /begin AVAILABLE_EVENT_LIST EVENT 0 EVENT 1 EVENT 2 EVENT 3 /end AVAILABLE_EVENT_LIST /begin DEFAULT_EVENT_LIST EVENT 1 /end DEFAULT_EVENT_LIST /end DAQ_EVENT
 /end IF_DATA
/end MEASUREMENT
/begin MEASUREMENT i15031_srv9_CVN_Calc_ui "State of CVN calculation" UBYTE I15031_srv9_CVN_CalcVerb 1 100 0.00 7. FORMAT "%2.0" ECU_ADDRESS 0x400063B4 /end MEASUREMENT
/begin MEASUREMENT I15031_srv9_stCVNRecalc "Recalculation of CVN" UBYTE OneToOne 1 100 0.00 255.0 FORMAT "%5.1" ECU_ADDRESS 0x400063C9 /end MEASUREMENT
/begin MEASUREMENT I15031_srv9_ValidCVN "Availability of valid CVN in Envram." UBYTE OneToOne 1 100 0.00 255.0 FORMAT "%5.1" ECU_ADDRESS 0x400063CA /end MEASUREMENT
/begin MEASUREMENT IGC2W_EngDa_tStrtLoc "Engine starting temperature" UWORD temp_q1_om30 1 100 -30.00000 65505.00 FORMAT "%8.2" ECU_ADDRESS 0x40008612
 /begin IF_DATA XCPplus 0x0102
  /begin DAQ_EVENT VARIABLE /begin AVAILABLE_EVENT_LIST EVENT 0 EVENT 1 EVENT 2 EVENT 3 /end AVAILABLE_EVENT_LIST /begin DEFAULT_EVENT_LIST EVENT 0 /end DEFAULT_EVENT_LIST /end DAQ_EVENT
 /end IF_DATA
/end MEASUREMENT
/begin MEASUREMENT IgCtl_cntrCoil1DiagErr "error counter for diagnosis of coil 1" UBYTE OneToOne 1 100 0.00 255.0 FORMAT "%5.1" ECU_ADDRESS 0x400089E1
 /begin IF_DATA XCPplus 0x0102
  /begin DAQ_EVENT VARIABLE /begin AVAILABLE_EVENT_LIST EVENT 0 EVENT 1 EVENT 2 EVENT 3 /end AVAILABLE_EVENT_LIST /begin DEFAULT_EVENT_LIST EVENT 0 /end DEFAULT_EVENT_LIST /end DAQ_EVENT
 /end IF_DATA
/end MEASUREMENT
/begin MEASUREMENT IgCtl_cntrCoil1DiagTest "test counter for diagnosis of coil 1" UBYTE OneToOne 1 100 0.00 255.0 FORMAT "%5.1" ECU_ADDRESS 0x400089E0
 /begin IF_DATA XCPplus 0x0102
  /begin DAQ_EVENT VARIABLE /begin AVAILABLE_EVENT_LIST EVENT 0 EVENT 1 EVENT 2 EVENT 3 /end AVAILABLE_EVENT_LIST /begin DEFAULT_EVENT_LIST EVENT 0 /end DEFAULT_EVENT_LIST /end DAQ_EVENT
 /end IF_DATA
/end MEASUREMENT
/begin MEASUREMENT IgCtl_cntrCoil2DiagErr "error counter for diagnosis of coil 2" UBYTE OneToOne 1 100 0.00 255.0 FORMAT "%5.1" ECU_ADDRESS 0x400089E5
 /begin IF_DATA XCPplus 0x0102
  /begin DAQ_EVENT VARIABLE /begin AVAILABLE_EVENT_LIST EVENT 0 EVENT 1 EVENT 2 EVENT 3 /end AVAILABLE_EVENT_LIST /begin DEFAULT_EVENT_LIST EVENT 0 /end DEFAULT_EVENT_LIST /end DAQ_EVENT
 /end IF_DATA
/end MEASUREMENT
/begin MEASUREMENT IgCtl_cntrCoil2DiagTest "test counter for diagnosis of coil 2" UBYTE OneToOne 1 100 0.00 255.0 FORMAT "%5.1" ECU_ADDRESS 0x400089E4
 /begin IF_DATA XCPplus 0x0102
  /begin DAQ_EVENT VARIABLE /begin AVAILABLE_EVENT_LIST EVENT 0 EVENT 1 EVENT 2 EVENT 3 /end AVAILABLE_EVENT_LIST /begin DEFAULT_EVENT_LIST EVENT 0 /end DEFAULT_EVENT_LIST /end DAQ_EVENT
 /end IF_DATA
/end MEASUREMENT
/begin MEASUREMENT IgCtl_cntrCycDly "delay counter for number of synchros until misfire is detected" UWORD OneToOne 1 100 0.00 65535.00 FORMAT "%8.2" ECU_ADDRESS 0x4000860C
 /begin IF_DATA XCPplus 0x0102
  /begin DAQ_EVENT VARIABLE /begin AVAILABLE_EVENT_LIST EVENT 0 EVENT 1 EVENT 2 EVENT 3 /end AVAILABLE_EVENT_LIST /begin DEFAULT_EVENT_LIST EVENT 0 /end DEFAULT_EVENT_LIST /end DAQ_EVENT
 /end IF_DATA
/end MEASUREMENT
/begin MEASUREMENT IgCtl_cntrRamp "step width counter for ramping from burning limit to component protection limit" UBYTE OneToOne 1 100 0.00 255.0 FORMAT "%5.1" ECU_ADDRESS 0x400089ED
 /begin IF_DATA XCPplus 0x0102
  /begin DAQ_EVENT VARIABLE /begin AVAILABLE_EVENT_LIST EVENT 0 EVENT 1 EVENT 2 EVENT 3 /end AVAILABLE_EVENT_LIST /begin DEFAULT_EVENT_LIST EVENT 0 /end DEFAULT_EVENT_LIST /end DAQ_EVENT
 /end IF_DATA
/end MEASUREMENT
/begin MEASUREMENT IgCtl_diaLteRamp "delta IA for ramping from burning limit to component protection limit" SBYTE zw_sb_q0p75 1 100 0.00 95.25 FORMAT "%5.2" ECU_ADDRESS 0x400089EC
 /begin IF_DATA XCPplus 0x0102
  /begin DAQ_EVENT VARIABLE /begin AVAILABLE_EVENT_LIST EVENT 0 EVENT 1 EVENT 2 EVENT 3 /end AVAILABLE_EVENT_LIST /begin DEFAULT_EVENT_LIST EVENT 0 /end DEFAULT_EVENT_LIST /end DAQ_EVENT
 /end IF_DATA
/end MEASUREMENT
/begin MEASUREMENT IgCtl_diaStrt "ignition angle correction at start based on throttle" SBYTE zw_sb_q0p75 1 100 -96.00 95.25 FORMAT "%5.2" ECU_ADDRESS 0x400089EE
 /begin IF_DATA XCPplus 0x0102
  /begin DAQ_EVENT VARIABLE /begin AVAILABLE_EVENT_LIST EVENT 0 EVENT 1 EVENT 2 EVENT 3 /end AVAILABLE_EVENT_LIST /begin DEFAULT_EVENT_LIST EVENT 0 /end DEFAULT_EVENT_LIST /end DAQ_EVENT
 /end IF_DATA
/end MEASUREMENT
/begin MEASUREMENT IgCtl_flgCoil1DiagActv "diagnosis of coil 1 active" UBYTE B_TRUE 1 100 0.00 1.00000000000 BIT_MASK 0x1 FORMAT "%13.11" ECU_ADDRESS 0x400089C6
 /begin IF_DATA XCPplus 0x0102
  /begin DAQ_EVENT VARIABLE /begin AVAILABLE_EVENT_LIST EVENT 0 EVENT 1 EVENT 2 EVENT 3 /end AVAILABLE_EVENT_LIST /begin DEFAULT_EVENT_LIST EVENT 0 /end DEFAULT_EVENT_LIST /end DAQ_EVENT
 /end IF_DATA
/end MEASUREMENT
/begin MEASUREMENT IgCtl_flgCoil1DiagCmpl "diagnosis of coil 1 completed" UBYTE B_TRUE 1 100 0.00 1.00000000000 BIT_MASK 0x1 FORMAT "%13.11" ECU_ADDRESS 0x400089DF
 /begin IF_DATA XCPplus 0x0102
  /begin DAQ_EVENT VARIABLE /begin AVAILABLE_EVENT_LIST EVENT 0 EVENT 1 EVENT 2 EVENT 3 /end AVAILABLE_EVENT_LIST /begin DEFAULT_EVENT_LIST EVENT 2 /end DEFAULT_EVENT_LIST /end DAQ_EVENT
 /end IF_DATA
/end MEASUREMENT
/begin MEASUREMENT IgCtl_flgCoil1DiagErr "error detected during diagnosis of coil 1" UBYTE B_TRUE 1 100 0.00 1.00000000000 BIT_MASK 0x1 FORMAT "%13.11" ECU_ADDRESS 0x400089C5
 /begin IF_DATA XCPplus 0x0102
  /begin DAQ_EVENT VARIABLE /begin AVAILABLE_EVENT_LIST EVENT 0 EVENT 1 EVENT 2 EVENT 3 /end AVAILABLE_EVENT_LIST /begin DEFAULT_EVENT_LIST EVENT 2 /end DEFAULT_EVENT_LIST /end DAQ_EVENT
 /end IF_DATA
/end MEASUREMENT
/begin MEASUREMENT IgCtl_flgCoil1DiagTest "diagnosis of coil 1 completed" UBYTE B_TRUE 1 100 0.00 1.00000000000 BIT_MASK 0x1 FORMAT "%13.11" ECU_ADDRESS 0x400089C4
 /begin IF_DATA XCPplus 0x0102
  /begin DAQ_EVENT VARIABLE /begin AVAILABLE_EVENT_LIST EVENT 0 EVENT 1 EVENT 2 EVENT 3 /end AVAILABLE_EVENT_LIST /begin DEFAULT_EVENT_LIST EVENT 2 /end DEFAULT_EVENT_LIST /end DAQ_EVENT
 /end IF_DATA
/end MEASUREMENT
/begin MEASUREMENT IgCtl_flgCoil1MisfDetd "misfire detected during coil 1 diagnosis" UBYTE B_TRUE 1 100 0.00 1.00000000000 BIT_MASK 0x1 FORMAT "%13.11" ECU_ADDRESS 0x400089E7
 /begin IF_DATA XCPplus 0x0102
  /begin DAQ_EVENT VARIABLE /begin AVAILABLE_EVENT_LIST EVENT 0 EVENT 1 EVENT 2 EVENT 3 /end AVAILABLE_EVENT_LIST /begin DEFAULT_EVENT_LIST EVENT 0 /end DEFAULT_EVENT_LIST /end DAQ_EVENT
 /end IF_DATA
/end MEASUREMENT
/begin MEASUREMENT IgCtl_flgCoil2DiagActv "diagnosis of coil 2 active" UBYTE B_TRUE 1 100 0.00 1.00000000000 BIT_MASK 0x1 FORMAT "%13.11" ECU_ADDRESS 0x400089C3
 /begin IF_DATA XCPplus 0x0102
  /begin DAQ_EVENT VARIABLE /begin AVAILABLE_EVENT_LIST EVENT 0 EVENT 1 EVENT 2 EVENT 3 /end AVAILABLE_EVENT_LIST /begin DEFAULT_EVENT_LIST EVENT 0 /end DEFAULT_EVENT_LIST /end DAQ_EVENT
 /end IF_DATA
/end MEASUREMENT
/begin MEASUREMENT IgCtl_flgCoil2DiagCmpl "diagnosis of coil 2 completed" UBYTE B_TRUE 1 100 0.00 1.00000000000 BIT_MASK 0x1 FORMAT "%13.11" ECU_ADDRESS 0x400089E3
 /begin IF_DATA XCPplus 0x0102
  /begin DAQ_EVENT VARIABLE /begin AVAILABLE_EVENT_LIST EVENT 0 EVENT 1 EVENT 2 EVENT 3 /end AVAILABLE_EVENT_LIST /begin DEFAULT_EVENT_LIST EVENT 2 /end DEFAULT_EVENT_LIST /end DAQ_EVENT
 /end IF_DATA
/end MEASUREMENT
/begin MEASUREMENT IgCtl_flgCoil2DiagErr "error detected during diagnosis of coil 2" UBYTE B_TRUE 1 100 0.00 1.00000000000 BIT_MASK 0x1 FORMAT "%13.11" ECU_ADDRESS 0x400089C2
 /begin IF_DATA XCPplus 0x0102
  /begin DAQ_EVENT VARIABLE /begin AVAILABLE_EVENT_LIST EVENT 0 EVENT 1 EVENT 2 EVENT 3 /end AVAILABLE_EVENT_LIST /begin DEFAULT_EVENT_LIST EVENT 2 /end DEFAULT_EVENT_LIST /end DAQ_EVENT
 /end IF_DATA
/end MEASUREMENT
/begin MEASUREMENT IgCtl_flgCoil2DiagTest "diagnosis of coil 2 completed" UBYTE B_TRUE 1 100 0.00 1.00000000000 BIT_MASK 0x1 FORMAT "%13.11" ECU_ADDRESS 0x400089C1
 /begin IF_DATA XCPplus 0x0102
  /begin DAQ_EVENT VARIABLE /begin AVAILABLE_EVENT_LIST EVENT 0 EVENT 1 EVENT 2 EVENT 3 /end AVAILABLE_EVENT_LIST /begin DEFAULT_EVENT_LIST EVENT 2 /end DEFAULT_EVENT_LIST /end DAQ_EVENT
 /end IF_DATA
/end MEASUREMENT
/begin MEASUREMENT IgCtl_flgCoil2MisfDetd "misfire detected during coil 2 diagnosis" UBYTE B_TRUE 1 100 0.00 1.00000000000 BIT_MASK 0x1 FORMAT "%13.11" ECU_ADDRESS 0x400089E8
 /begin IF_DATA XCPplus 0x0102
  /begin DAQ_EVENT VARIABLE /begin AVAILABLE_EVENT_LIST EVENT 0 EVENT 1 EVENT 2 EVENT 3 /end AVAILABLE_EVENT_LIST /begin DEFAULT_EVENT_LIST EVENT 0 /end DEFAULT_EVENT_LIST /end DAQ_EVENT
 /end IF_DATA
/end MEASUREMENT
/begin MEASUREMENT IgCtl_flgCoilDiagActv "coil diagnosis active" UBYTE B_TRUE 1 100 0.00 1.00000000000 BIT_MASK 0x1 FORMAT "%13.11" ECU_ADDRESS 0x400089C0
 /begin IF_DATA XCPplus 0x0102
  /begin DAQ_EVENT VARIABLE /begin AVAILABLE_EVENT_LIST EVENT 0 EVENT 1 EVENT 2 EVENT 3 /end AVAILABLE_EVENT_LIST /begin DEFAULT_EVENT_LIST EVENT 2 /end DEFAULT_EVENT_LIST /end DAQ_EVENT
 /end IF_DATA
/end MEASUREMENT
/begin MEASUREMENT IgCtl_flgEnaCoilDiag "coil diagnosis enabled" UBYTE B_TRUE 1 100 0.00 1.00000000000 BIT_MASK 0x1 FORMAT "%13.11" ECU_ADDRESS 0x400089E2
 /begin IF_DATA XCPplus 0x0102
  /begin DAQ_EVENT VARIABLE /begin AVAILABLE_EVENT_LIST EVENT 0 EVENT 1 EVENT 2 EVENT 3 /end AVAILABLE_EVENT_LIST /begin DEFAULT_EVENT_LIST EVENT 2 /end DEFAULT_EVENT_LIST /end DAQ_EVENT
 /end IF_DATA
/end MEASUREMENT
/begin MEASUREMENT IgCtl_flgTrigCoilCutOff "flag indicating misfire is not detected" UBYTE B_TRUE 1 100 0.00 1.00000000000 BIT_MASK 0x1 FORMAT "%13.11" ECU_ADDRESS 0x400089E6
 /begin IF_DATA XCPplus 0x0102
  /begin DAQ_EVENT VARIABLE /begin AVAILABLE_EVENT_LIST EVENT 0 EVENT 1 EVENT 2 EVENT 3 /end AVAILABLE_EVENT_LIST /begin DEFAULT_EVENT_LIST EVENT 2 /end DEFAULT_EVENT_LIST /end DAQ_EVENT
 /end IF_DATA
/end MEASUREMENT
/begin MEASUREMENT IgCtl_nrDwellCutOff "Bit mask for ignition cut off by calibration" UBYTE OneToOne 1 100 0.00 3.000 FORMAT "%5.3" ECU_ADDRESS 0x400089DE
 /begin IF_DATA XCPplus 0x0102
  /begin DAQ_EVENT VARIABLE /begin AVAILABLE_EVENT_LIST EVENT 0 EVENT 1 EVENT 2 EVENT 3 /end AVAILABLE_EVENT_LIST /begin DEFAULT_EVENT_LIST EVENT 2 /end DEFAULT_EVENT_LIST /end DAQ_EVENT
 /end IF_DATA
/end MEASUREMENT
/begin MEASUREMENT IgCtl_stCutOff "status indicating reason for igntion cutoff(bitwise)" UWORD dez 1 100 0.00 65535.00 FORMAT "%8.2" ECU_ADDRESS 0x40008608
 /begin IF_DATA XCPplus 0x0102
  /begin DAQ_EVENT VARIABLE /begin AVAILABLE_EVENT_LIST EVENT 0 EVENT 1 EVENT 2 EVENT 3 /end AVAILABLE_EVENT_LIST /begin DEFAULT_EVENT_LIST EVENT 0 /end DEFAULT_EVENT_LIST /end DAQ_EVENT
 /end IF_DATA
/end MEASUREMENT
/begin MEASUREMENT iginjlock "Bitmask for injection cutoff by IGBT diagnosis.(iginjlock is Obsolete)use Ign_IgbtDiag_stCylCutOffPat(Message read)" UBYTE dez 1 100 0.00 255.0 FORMAT "%5.1" ECU_ADDRESS 0x400089F0
 /begin IF_DATA XCPplus 0x0102
  /begin DAQ_EVENT VARIABLE /begin AVAILABLE_EVENT_LIST EVENT 0 EVENT 1 EVENT 2 EVENT 3 /end AVAILABLE_EVENT_LIST /begin DEFAULT_EVENT_LIST EVENT 0 /end DEFAULT_EVENT_LIST /end DAQ_EVENT
 /end IF_DATA
/end MEASUREMENT
/begin MEASUREMENT ignactf_w "Activity flag for ignition channels" UWORD OneToOne 1 100 0.00 65535.00 FORMAT "%8.2" ECU_ADDRESS 0x40006094 /end MEASUREMENT
/begin MEASUREMENT igndd_cylFreeze "bitcoded cylinderno. with freezed paremeters" UBYTE OneToOne 1 100 0.00 255.0 FORMAT "%5.1" ECU_ADDRESS 0x400064D9
 /begin IF_DATA XCPplus 0x0102
  /begin DAQ_EVENT VARIABLE /begin AVAILABLE_EVENT_LIST EVENT 0 EVENT 1 EVENT 2 EVENT 3 /end AVAILABLE_EVENT_LIST /begin DEFAULT_EVENT_LIST EVENT 0 /end DEFAULT_EVENT_LIST /end DAQ_EVENT
 /end IF_DATA
/end MEASUREMENT
/begin MEASUREMENT igndd_fdOutPattern_u16 "Current fade out pattern" UWORD OneToOne 1 100 0.00 65535.00 FORMAT "%8.2" ECU_ADDRESS 0x40006092
 /begin IF_DATA XCPplus 0x0102
  /begin DAQ_EVENT VARIABLE /begin AVAILABLE_EVENT_LIST EVENT 0 EVENT 1 EVENT 2 EVENT 3 /end AVAILABLE_EVENT_LIST /begin DEFAULT_EVENT_LIST EVENT 1 /end DEFAULT_EVENT_LIST /end DAQ_EVENT
 /end IF_DATA
/end MEASUREMENT
/begin MEASUREMENT igndd_fdPatArray_u16 "Ausblendmuster (Feld indiziert nach Ausblendanfordererer)" UWORD OneToOne 1 100 0.00 65535.00 FORMAT "%8.2" ARRAY_SIZE 17 ECU_ADDRESS 0x40006070
 /begin IF_DATA XCPplus 0x0102
  /begin DAQ_EVENT VARIABLE /begin AVAILABLE_EVENT_LIST EVENT 0 EVENT 1 EVENT 2 EVENT 3 /end AVAILABLE_EVENT_LIST /begin DEFAULT_EVENT_LIST EVENT 1 /end DEFAULT_EVENT_LIST /end DAQ_EVENT
 /end IF_DATA
/end MEASUREMENT
/begin MEASUREMENT igndd_oldIgnCntVal_u8 "Old value of the hardware driver ignition counter" UBYTE OneToOne 1 100 0.00 255.0 FORMAT "%5.1" ECU_ADDRESS 0x400064DB /end MEASUREMENT
/begin MEASUREMENT igndd_ovl_u8 "Start-Dwell overlap counter" UBYTE OneToOne 1 100 0.00 255.0 FORMAT "%5.1" ECU_ADDRESS 0x400064DA /end MEASUREMENT
/begin MEASUREMENT igndd_state "internal state IgnDD" SLONG OneToOne 1 100 -2147483648.00 2147483647.00 FORMAT "%13.2" ECU_ADDRESS 0x4000531C /end MEASUREMENT
/begin MEASUREMENT igndd_TDCActFlg_u8 "Activation flag for the scheduled Cylinder TDC" UBYTE dez 1 100 0.00 255.0 FORMAT "%5.1" ECU_ADDRESS 0x40007F64
 /begin IF_DATA XCPplus 0x0102
  /begin DAQ_EVENT VARIABLE /begin AVAILABLE_EVENT_LIST EVENT 0 EVENT 1 EVENT 2 EVENT 3 /end AVAILABLE_EVENT_LIST /begin DEFAULT_EVENT_LIST EVENT 0 /end DEFAULT_EVENT_LIST /end DAQ_EVENT
 /end IF_DATA
/end MEASUREMENT
/begin MEASUREMENT igndd_TiDwlMax_u16 "Max dwell time for Ignition coil in angle mode." UWORD t_q0p001_ms 1 100 0.00 65.53500 FORMAT "%8.5" ECU_ADDRESS 0x4000606E /end MEASUREMENT
/begin MEASUREMENT igndd_TiDwlMin_u16 "Min dwell time for Ignition coil in angle mode" UWORD t_q0p001_ms 1 100 0.00 65.53500 FORMAT "%8.5" ECU_ADDRESS 0x4000606C /end MEASUREMENT
/begin MEASUREMENT igndd_zwFreeze "freezed ignition angles (cyl.individual)" SBYTE zw_sb_q0p75 1 100 -96.00 95.25 FORMAT "%5.2" ARRAY_SIZE 1 ECU_ADDRESS 0x40005320 /end MEASUREMENT
/begin MEASUREMENT igndd_zwFreeze1 "freezed ignition angles (cyl.individual) for secondary channel in case of twin spark ignition" SBYTE zw_sb_q0p75 1 100 -96.00 95.25 FORMAT "%5.2" ARRAY_SIZE 1 ECU_ADDRESS 0x40005324 /end MEASUREMENT
/begin MEASUREMENT igndglck "Bitmask for ignition cutoff by IGBT diagnosis" UBYTE dez 1 100 0.00 255.0 FORMAT "%5.1" ECU_ADDRESS 0x400089EF
 /begin IF_DATA XCPplus 0x0102
  /begin DAQ_EVENT VARIABLE /begin AVAILABLE_EVENT_LIST EVENT 0 EVENT 1 EVENT 2 EVENT 3 /end AVAILABLE_EVENT_LIST /begin DEFAULT_EVENT_LIST EVENT 0 /end DEFAULT_EVENT_LIST /end DAQ_EVENT
 /end IF_DATA
/end MEASUREMENT
/begin MEASUREMENT ignFadeStatBits_u32 "Ignition fade out request status (which shows the fade out sources that currently request an fade out)" ULONG OneToOne 1 100 0.00 4294967295.00 FORMAT "%13.2" ECU_ADDRESS 0x40005328
 /begin IF_DATA XCPplus 0x0102
  /begin DAQ_EVENT VARIABLE /begin AVAILABLE_EVENT_LIST EVENT 0 EVENT 1 EVENT 2 EVENT 3 /end AVAILABLE_EVENT_LIST /begin DEFAULT_EVENT_LIST EVENT 1 /end DEFAULT_EVENT_LIST /end DAQ_EVENT
 /end IF_DATA
/end MEASUREMENT
/begin MEASUREMENT ignlock "Bitmask for ignition cutoff" UBYTE dez 1 100 0.00 255.0 FORMAT "%5.1" ECU_ADDRESS 0x400089D8
 /begin IF_DATA XCPplus 0x0102
  /begin DAQ_EVENT VARIABLE /begin AVAILABLE_EVENT_LIST EVENT 0 EVENT 1 EVENT 2 EVENT 3 /end AVAILABLE_EVENT_LIST /begin DEFAULT_EVENT_LIST EVENT 0 /end DEFAULT_EVENT_LIST /end DAQ_EVENT
 /end IF_DATA
/end MEASUREMENT
/begin MEASUREMENT ignswofdly "Number of Ignitions in swith Off synchro" UBYTE OneToOne 1 100 0.00 255.0 FORMAT "%5.1" ECU_ADDRESS 0x400064DC /end MEASUREMENT
/begin MEASUREMENT Ign_facDesLamLoc "Local Variable of desired lambda" UBYTE fak_q0p0039_op0p5 1 100 0.5000 1.496 FORMAT "%5.3" ECU_ADDRESS 0x400089EA
 /begin IF_DATA XCPplus 0x0102
  /begin DAQ_EVENT VARIABLE /begin AVAILABLE_EVENT_LIST EVENT 0 EVENT 1 EVENT 2 EVENT 3 /end AVAILABLE_EVENT_LIST /begin DEFAULT_EVENT_LIST EVENT 0 /end DEFAULT_EVENT_LIST /end DAQ_EVENT
 /end IF_DATA
/end MEASUREMENT
/begin MEASUREMENT Ign_IgbtDiag_flgDiagEna "Flag variable to enable ignition IGBT diagnosis" UBYTE B_TRUE 1 100 0.00 1.00000000000 FORMAT "%13.11" ECU_ADDRESS 0x400089F3 /end MEASUREMENT
/begin MEASUREMENT Ign_IgbtDiag_iginjlock "Injection and igntion lock when igbt error occurs" UBYTE OneToOne 1 100 0.00 255.0 FORMAT "%5.1" ECU_ADDRESS 0x400089F2 /end MEASUREMENT
/begin MEASUREMENT Ign_IgbtDiag_num_intDeb "Debounce counter for IGBT error and heal conditions" UBYTE OneToOne 1 100 0.00 255.0 FORMAT "%5.1" ECU_ADDRESS 0x400089F1 /end MEASUREMENT
/begin MEASUREMENT Ign_ratChrgAirLoc "Local variable of relative air charge" UBYTE rel_ub_q0p75 1 100 0.00 191.3 FORMAT "%5.1" ECU_ADDRESS 0x400089E9
 /begin IF_DATA XCPplus 0x0102
  /begin DAQ_EVENT VARIABLE /begin AVAILABLE_EVENT_LIST EVENT 0 EVENT 1 EVENT 2 EVENT 3 /end AVAILABLE_EVENT_LIST /begin DEFAULT_EVENT_LIST EVENT 0 /end DEFAULT_EVENT_LIST /end DAQ_EVENT
 /end IF_DATA
/end MEASUREMENT
/begin MEASUREMENT Injddpfi_actualWeeofl "Injection driver actual pulse placed end angle" ULONG AngleCrS 1 100 0.00 94371839.9781 FORMAT "%13.4" ECU_ADDRESS 0x40008EB8 /end MEASUREMENT
/begin MEASUREMENT injddpfi_agFrstTdc "TDC angletimervalue of the first injection" ULONG AngleCrS 1 100 0.00 94371839.9781 FORMAT "%13.4" ECU_ADDRESS 0x40008E9C
 /begin IF_DATA XCPplus 0x0102
  /begin DAQ_EVENT VARIABLE /begin AVAILABLE_EVENT_LIST EVENT 0 EVENT 1 EVENT 2 EVENT 3 /end AVAILABLE_EVENT_LIST /begin DEFAULT_EVENT_LIST EVENT 0 /end DEFAULT_EVENT_LIST /end DAQ_EVENT
 /end IF_DATA
/end MEASUREMENT
/begin MEASUREMENT injddpfi_dtiefftr_w "Delta Inj.Time for post injection in 1ms computed for 1us quantization" ULONG t1p0usxms 1 100 0.00 4294967.29500 FORMAT "%13.5" ECU_ADDRESS 0x40008EB4 /end MEASUREMENT
/begin MEASUREMENT injddpfi_frstinjcyl "raw value cylinder number first injection" UBYTE dez 1 100 0.00 255.0 FORMAT "%5.1" ECU_ADDRESS 0x400089FC
 /begin IF_DATA XCPplus 0x0102
  /begin DAQ_EVENT VARIABLE /begin AVAILABLE_EVENT_LIST EVENT 0 EVENT 1 EVENT 2 EVENT 3 /end AVAILABLE_EVENT_LIST /begin DEFAULT_EVENT_LIST EVENT 0 /end DEFAULT_EVENT_LIST /end DAQ_EVENT
 /end IF_DATA
/end MEASUREMENT
/begin MEASUREMENT InjDDPfi_injEnadCylMsk "Bit mask: Injection or cut off delivered to hardware driver" UWORD dez 1 100 0.00 65535.00 FORMAT "%8.2" ECU_ADDRESS 0x40008616
 /begin IF_DATA XCPplus 0x0102
  /begin DAQ_EVENT VARIABLE /begin AVAILABLE_EVENT_LIST EVENT 0 EVENT 1 EVENT 2 EVENT 3 /end AVAILABLE_EVENT_LIST /begin DEFAULT_EVENT_LIST EVENT 0 /end DEFAULT_EVENT_LIST /end DAQ_EVENT
 /end IF_DATA
/end MEASUREMENT
/begin MEASUREMENT InjDDPfi_injTrigCylMsk "Bit mask: Injection or cut off delivered to hardware driver" UWORD dez 1 100 0.00 65535.00 FORMAT "%8.2" ECU_ADDRESS 0x40008614
 /begin IF_DATA XCPplus 0x0102
  /begin DAQ_EVENT VARIABLE /begin AVAILABLE_EVENT_LIST EVENT 0 EVENT 1 EVENT 2 EVENT 3 /end AVAILABLE_EVENT_LIST /begin DEFAULT_EVENT_LIST EVENT 0 /end DEFAULT_EVENT_LIST /end DAQ_EVENT
 /end IF_DATA
/end MEASUREMENT
/begin MEASUREMENT Injddpfi_PstInjCylMsk "Bit Mask: Post Inj delivered to hardware driver" UBYTE dez 1 100 0.00 255.0 FORMAT "%5.1" ECU_ADDRESS 0x40008A02 /end MEASUREMENT
/begin MEASUREMENT Injddpfi_PulseStartAngle "Start of previous injection pulse" ULONG AngleCrS 1 100 0.00 94371839.9781 FORMAT "%13.4" ECU_ADDRESS 0x40008EB0 /end MEASUREMENT
/begin MEASUREMENT Injddpfi_stPhaCorrn "Injection driver phase correction flag" UBYTE OneToOne 1 100 0.00 255.0 FORMAT "%5.1" ECU_ADDRESS 0x400064DF /end MEASUREMENT
/begin MEASUREMENT injddpfi_tfuelfl_l "flight time of fuel between injection valve and intake valve" ULONG t1p0usxms 1 100 0.00 4294967.29500 FORMAT "%13.5" ECU_ADDRESS 0x40008628 /end MEASUREMENT
/begin MEASUREMENT InjHGdi_ChlNumRequestedInj "channel specific counter for injections which are passed to the hardware" ULONG DEZ 1 100 0.00 4294967295.00 FORMAT "%13.2" ARRAY_SIZE 16 ECU_ADDRESS 0x4000563C /end MEASUREMENT
/begin MEASUREMENT InjHGdi_ChlNumStartedInj "channel specific counter for started injections" ULONG DEZ 1 100 0.00 4294967295.00 FORMAT "%13.2" ARRAY_SIZE 16 ECU_ADDRESS 0x40005638 /end MEASUREMENT
/begin MEASUREMENT InjHGdi_InfoFlgs "information flag value" UWORD DEZ 1 100 0.00 65535.00 FORMAT "%8.2" ECU_ADDRESS 0x400060A4 /end MEASUREMENT
/begin MEASUREMENT InjHGdi_numAbortedInj "counter for injections aborted at the abort angle" ULONG DEZ 1 100 0.00 4294967295.00 FORMAT "%13.2" ECU_ADDRESS 0x40005640 /end MEASUREMENT
/begin MEASUREMENT InjHGdi_numFinishedInj "counter for finished injections" ULONG DEZ 1 100 0.00 4294967295.00 FORMAT "%13.2" ECU_ADDRESS 0x40005664 /end MEASUREMENT
/begin MEASUREMENT InjHGdi_numRequestedInj "counter for injections which are passed to the hardware" ULONG DEZ 1 100 0.00 4294967295.00 FORMAT "%13.2" ECU_ADDRESS 0x40005668 /end MEASUREMENT
/begin MEASUREMENT InjHGdi_numStartedInj "counter for started injections" ULONG DEZ 1 100 0.00 4294967295.00 FORMAT "%13.2" ECU_ADDRESS 0x40005660 /end MEASUREMENT
/begin MEASUREMENT InjHGdi_numWithdrawedInj "counter for withdrawed injections which are already passed to the hardware" ULONG DEZ 1 100 0.00 4294967295.00 FORMAT "%13.2" ECU_ADDRESS 0x40005644 /end MEASUREMENT
/begin MEASUREMENT Inj_one_ms_feature_u8 "1ms transient compensation feature : Enable and Disable" UBYTE dez 1 100 0.00 255.0 FORMAT "%5.1" ECU_ADDRESS 0x40008A01 /end MEASUREMENT
/begin MEASUREMENT lastzyl "cylinder number with the last injection" UBYTE dez 1 100 0.00 255.0 FORMAT "%5.1" ECU_ADDRESS 0x400089FB
 /begin IF_DATA XCPplus 0x0102
  /begin DAQ_EVENT VARIABLE /begin AVAILABLE_EVENT_LIST EVENT 0 EVENT 1 EVENT 2 EVENT 3 /end AVAILABLE_EVENT_LIST /begin DEFAULT_EVENT_LIST EVENT 0 /end DEFAULT_EVENT_LIST /end DAQ_EVENT
 /end IF_DATA
/end MEASUREMENT
/begin MEASUREMENT ml_ggtfmloc "Local variable to hold the Air mass flow" UWORD m_uw_b6553p5 1 100 0.00 6553.500 FORMAT "%8.3" ECU_ADDRESS 0x40008F68
 /begin IF_DATA XCPplus 0x0102
  /begin DAQ_EVENT VARIABLE /begin AVAILABLE_EVENT_LIST EVENT 0 EVENT 1 EVENT 2 EVENT 3 /end AVAILABLE_EVENT_LIST /begin DEFAULT_EVENT_LIST EVENT 2 /end DEFAULT_EVENT_LIST /end DAQ_EVENT
 /end IF_DATA
/end MEASUREMENT
/begin MEASUREMENT nexttizyl "pointer to next cylinders for injection" UBYTE dez 1 100 0.00 255.0 FORMAT "%5.1" ARRAY_SIZE 3 ECU_ADDRESS 0x400089F8
 /begin IF_DATA XCPplus 0x0102
  /begin DAQ_EVENT VARIABLE /begin AVAILABLE_EVENT_LIST EVENT 0 EVENT 1 EVENT 2 EVENT 3 /end AVAILABLE_EVENT_LIST /begin DEFAULT_EVENT_LIST EVENT 0 /end DEFAULT_EVENT_LIST /end DAQ_EVENT
 /end IF_DATA
/end MEASUREMENT
/begin MEASUREMENT Oil_bRawLPSwmp "low pressure switch raw state" UBYTE B_TRUE 1 100 0.00 1.00000000000 BIT_MASK 0x1 FORMAT "%13.11" ECU_ADDRESS 0x40008779 /end MEASUREMENT
/begin MEASUREMENT ovlctr "Overlap counter dwell-event" UBYTE OneToOne 1 100 0.00 255.0 FORMAT "%5.1" ECU_ADDRESS 0x40008011
 /begin IF_DATA XCPplus 0x0102
  /begin DAQ_EVENT VARIABLE /begin AVAILABLE_EVENT_LIST EVENT 0 EVENT 1 EVENT 2 EVENT 3 /end AVAILABLE_EVENT_LIST /begin DEFAULT_EVENT_LIST EVENT 0 /end DEFAULT_EVENT_LIST /end DAQ_EVENT
 /end IF_DATA
/end MEASUREMENT
/begin MEASUREMENT phlsnhxf "Standardized heating power of the Lambda sensor downstream of the catalyzer(LSF with Pumped Reference)" UBYTE fak_ub_q0p01 1 100 0.00 2.550 FORMAT "%5.3" ECU_ADDRESS 0x400089A8 /end MEASUREMENT
/begin MEASUREMENT phlsnvxf "normalized heating power of lambda sensor upstream of catalyst(LSF with Pumped Reference)" UBYTE fak_ub_q0p01 1 100 0.00 2.550 FORMAT "%5.3" ECU_ADDRESS 0x400089A7 /end MEASUREMENT
/begin MEASUREMENT preschd_dtiefftr_w "Delta Inj.Time for post injection in last 1ms computed for 1us quantization" ULONG t1p0usxms 1 100 0.00 4294967.29500 FORMAT "%13.5" ECU_ADDRESS 0x40008EAC /end MEASUREMENT
/begin MEASUREMENT presch_tez_l "Previous effective injection time for individual cylinder" ULONG t1p0usxms 1 100 0.00 4294967.29500 FORMAT "%13.5" ARRAY_SIZE 1 ECU_ADDRESS 0x40008EA8 /end MEASUREMENT
/begin MEASUREMENT szmax1_w "Maximum dwell time for coil protection for second coil" UWORD txms_uw_q0p001 1 100 0.00 65.53500 FORMAT "%8.5" ECU_ADDRESS 0x40008606
 /begin IF_DATA XCPplus 0x0102
  /begin DAQ_EVENT VARIABLE /begin AVAILABLE_EVENT_LIST EVENT 0 EVENT 1 EVENT 2 EVENT 3 /end AVAILABLE_EVENT_LIST /begin DEFAULT_EVENT_LIST EVENT 2 /end DEFAULT_EVENT_LIST /end DAQ_EVENT
 /end IF_DATA
/end MEASUREMENT
/begin MEASUREMENT szmax_w "Maximum dwell time for coil protection" UWORD txms_uw_q0p001 1 100 0.00 65.53500 FORMAT "%8.5" ECU_ADDRESS 0x40008604
 /begin IF_DATA XCPplus 0x0102
  /begin DAQ_EVENT VARIABLE /begin AVAILABLE_EVENT_LIST EVENT 0 EVENT 1 EVENT 2 EVENT 3 /end AVAILABLE_EVENT_LIST /begin DEFAULT_EVENT_LIST EVENT 2 /end DEFAULT_EVENT_LIST /end DAQ_EVENT
 /end IF_DATA
/end MEASUREMENT
/begin MEASUREMENT szout1loc "local variable for dwell time of secondary coil" UWORD txms_uw_q0p001 1 100 0.00 65.53500 FORMAT "%8.5" ECU_ADDRESS 0x4000860E
 /begin IF_DATA XCPplus 0x0102
  /begin DAQ_EVENT VARIABLE /begin AVAILABLE_EVENT_LIST EVENT 0 EVENT 1 EVENT 2 EVENT 3 /end AVAILABLE_EVENT_LIST /begin DEFAULT_EVENT_LIST EVENT 2 /end DEFAULT_EVENT_LIST /end DAQ_EVENT
 /end IF_DATA
/end MEASUREMENT
/begin MEASUREMENT szout1_w "dwell time for secondary channel in case of twin spark ignition" UWORD txms_uw_q0p001 1 100 0.00 65.53500 FORMAT "%8.5" ECU_ADDRESS 0x40008602
 /begin IF_DATA XCPplus 0x0102
  /begin DAQ_EVENT VARIABLE /begin AVAILABLE_EVENT_LIST EVENT 0 EVENT 1 EVENT 2 EVENT 3 /end AVAILABLE_EVENT_LIST /begin DEFAULT_EVENT_LIST EVENT 2 /end DEFAULT_EVENT_LIST /end DAQ_EVENT
 /end IF_DATA
/end MEASUREMENT
/begin MEASUREMENT szoutloc "local variable for dwell time of primary coil" UWORD txms_uw_q0p001 1 100 0.00 65.53500 FORMAT "%8.5" ECU_ADDRESS 0x4000860A
 /begin IF_DATA XCPplus 0x0102
  /begin DAQ_EVENT VARIABLE /begin AVAILABLE_EVENT_LIST EVENT 0 EVENT 1 EVENT 2 EVENT 3 /end AVAILABLE_EVENT_LIST /begin DEFAULT_EVENT_LIST EVENT 2 /end DEFAULT_EVENT_LIST /end DAQ_EVENT
 /end IF_DATA
/end MEASUREMENT
/begin MEASUREMENT szout_w "dwell time" UWORD txms_uw_q0p001 1 100 0.00 65.53500 FORMAT "%8.5" ECU_ADDRESS 0x40008600
 /begin IF_DATA XCPplus 0x0102
  /begin DAQ_EVENT VARIABLE /begin AVAILABLE_EVENT_LIST EVENT 0 EVENT 1 EVENT 2 EVENT 3 /end AVAILABLE_EVENT_LIST /begin DEFAULT_EVENT_LIST EVENT 2 /end DEFAULT_EVENT_LIST /end DAQ_EVENT
 /end IF_DATA
/end MEASUREMENT
/begin MEASUREMENT taikrmfxf "Exhaust gas temperature at manifold out of model filtered(LSF with Pumped Reference)" UBYTE temp_ub_q5_o50 1 100 -50.00 1225. FORMAT "%5.0" ECU_ADDRESS 0x400089AE /end MEASUREMENT
/begin MEASUREMENT tempstspxf "Bed temperature of main catalyst, modelled for LSF with Pumped Reference" UBYTE temp_ub_q5_o50 1 100 -50.00 1225. FORMAT "%5.0" ECU_ADDRESS 0x400089B8 /end MEASUREMENT
/begin MEASUREMENT tez_l "effectiv injection time (long) cylinderindividuell" ULONG t1p0usxms 1 100 0.00 4294967.29500 FORMAT "%13.5" ARRAY_SIZE 1 ECU_ADDRESS 0x40008EA4
 /begin IF_DATA XCPplus 0x0102
  /begin DAQ_EVENT VARIABLE /begin AVAILABLE_EVENT_LIST EVENT 0 EVENT 1 EVENT 2 EVENT 3 /end AVAILABLE_EVENT_LIST /begin DEFAULT_EVENT_LIST EVENT 0 /end DEFAULT_EVENT_LIST /end DAQ_EVENT
 /end IF_DATA
/end MEASUREMENT
/begin MEASUREMENT te_l "effectiv injection time (long)" ULONG t1p0usxms 1 100 0.00 4294967.29500 FORMAT "%13.5" ECU_ADDRESS 0x40008EA0
 /begin IF_DATA XCPplus 0x0102
  /begin DAQ_EVENT VARIABLE /begin AVAILABLE_EVENT_LIST EVENT 0 EVENT 1 EVENT 2 EVENT 3 /end AVAILABLE_EVENT_LIST /begin DEFAULT_EVENT_LIST EVENT 0 /end DEFAULT_EVENT_LIST /end DAQ_EVENT
 /end IF_DATA
/end MEASUREMENT
/begin MEASUREMENT thaistxf_w """Off""-duration for sensor heating downstream catalyst (LSF with Pumped Reference)" UWORD t1msxs_b65p535 1 100 0.00 65.53500 FORMAT "%8.5" ECU_ADDRESS 0x400085C8 /end MEASUREMENT
/begin MEASUREMENT thhatxf_w "Uncorrected switch off time for lambda sensor heating post cat (LSF with Pumped Reference)" UWORD t1msxs_b65p535 1 100 0.00 65.53500 FORMAT "%8.5" ECU_ADDRESS 0x400085FE /end MEASUREMENT
/begin MEASUREMENT thvatxf_w "Uncorrected switch off time for lambda sensor heating pre cat (LSF with Pumped Reference)" UWORD t1msxs_b65p535 1 100 0.00 65.53500 FORMAT "%8.5" ECU_ADDRESS 0x400085E4 /end MEASUREMENT
/begin MEASUREMENT tmctr "time counter to calculate average speed." UWORD dez 1 100 0.00 65535.00 FORMAT "%8.2" ECU_ADDRESS 0x4000821C
 /begin IF_DATA XCPplus 0x0102
  /begin DAQ_EVENT VARIABLE /begin AVAILABLE_EVENT_LIST EVENT 0 EVENT 1 EVENT 2 EVENT 3 /end AVAILABLE_EVENT_LIST /begin DEFAULT_EVENT_LIST EVENT 3 /end DEFAULT_EVENT_LIST /end DAQ_EVENT
 /end IF_DATA
/end MEASUREMENT
/begin MEASUREMENT tmot "Engine temperature" SWORD Temp_Cels 1 100 -3549.940 3003.560 FORMAT "%8.3" ECU_ADDRESS 0x40008F64
 /begin IF_DATA XCPplus 0x0102
  /begin DAQ_EVENT VARIABLE /begin AVAILABLE_EVENT_LIST EVENT 0 EVENT 1 EVENT 2 EVENT 3 /end AVAILABLE_EVENT_LIST /begin DEFAULT_EVENT_LIST EVENT 2 /end DEFAULT_EVENT_LIST /end DAQ_EVENT
 /end IF_DATA
/end MEASUREMENT
/begin MEASUREMENT tmotab "engine coolant temperature at engine stop or cut-off cranking" SWORD Temp_Cels 1 100 -3549.940 3003.560 FORMAT "%8.3" ECU_ADDRESS 0x4000CDD6
 /begin IF_DATA XCPplus 0x0102
  /begin DAQ_EVENT VARIABLE /begin AVAILABLE_EVENT_LIST EVENT 0 EVENT 1 EVENT 2 EVENT 3 /end AVAILABLE_EVENT_LIST /begin DEFAULT_EVENT_LIST EVENT 2 /end DEFAULT_EVENT_LIST /end DAQ_EVENT
 /end IF_DATA
/end MEASUREMENT
/begin MEASUREMENT tmotlin "Engine coolant temperature, linearised and calculated" SWORD Temp_Cels 1 100 -3549.940 3003.560 FORMAT "%8.3" ECU_ADDRESS 0x40008F62
 /begin IF_DATA XCPplus 0x0102
  /begin DAQ_EVENT VARIABLE /begin AVAILABLE_EVENT_LIST EVENT 0 EVENT 1 EVENT 2 EVENT 3 /end AVAILABLE_EVENT_LIST /begin DEFAULT_EVENT_LIST EVENT 2 /end DEFAULT_EVENT_LIST /end DAQ_EVENT
 /end IF_DATA
/end MEASUREMENT
/begin MEASUREMENT tmrw "model-based reference value for plausibility check of engine temperature signal" SWORD Temp_Cels 1 100 -3549.940 3003.560 FORMAT "%8.3" ECU_ADDRESS 0x40008F60
 /begin IF_DATA XCPplus 0x0102
  /begin DAQ_EVENT VARIABLE /begin AVAILABLE_EVENT_LIST EVENT 0 EVENT 1 EVENT 2 EVENT 3 /end AVAILABLE_EVENT_LIST /begin DEFAULT_EVENT_LIST EVENT 2 /end DEFAULT_EVENT_LIST /end DAQ_EVENT
 /end IF_DATA
/end MEASUREMENT
/begin MEASUREMENT tmrwab "Engine temperature default value from model at engine stop or engine stall" SWORD Temp_Cels 1 100 -3549.940 3003.560 FORMAT "%8.3" ECU_ADDRESS 0x4000CDD4
 /begin IF_DATA XCPplus 0x0102
  /begin DAQ_EVENT VARIABLE /begin AVAILABLE_EVENT_LIST EVENT 0 EVENT 1 EVENT 2 EVENT 3 /end AVAILABLE_EVENT_LIST /begin DEFAULT_EVENT_LIST EVENT 2 /end DEFAULT_EVENT_LIST /end DAQ_EVENT
 /end IF_DATA
/end MEASUREMENT
/begin MEASUREMENT tmst "engine temperature at start" SWORD Temp_Cels 1 100 -3549.940 3003.560 FORMAT "%8.3" ECU_ADDRESS 0x40008F5E
 /begin IF_DATA XCPplus 0x0102
  /begin DAQ_EVENT VARIABLE /begin AVAILABLE_EVENT_LIST EVENT 0 EVENT 1 EVENT 2 EVENT 3 /end AVAILABLE_EVENT_LIST /begin DEFAULT_EVENT_LIST EVENT 2 /end DEFAULT_EVENT_LIST /end DAQ_EVENT
 /end IF_DATA
/end MEASUREMENT
/begin MEASUREMENT tvaistxf_w """Off""-duration for sensor heating upstream catalyst (LSF with Pumped Reference)" UWORD t1msxs_b65p535 1 100 0.00 65.53500 FORMAT "%8.5" ECU_ADDRESS 0x400085C6 /end MEASUREMENT
/begin MEASUREMENT tvub_w "Delay time of injection valves, dependant on battery voltage" UWORD t1p0usxms 1 100 0.00 65.53500 FORMAT "%8.5" ECU_ADDRESS 0x40008624
 /begin IF_DATA XCPplus 0x0102
  /begin DAQ_EVENT VARIABLE /begin AVAILABLE_EVENT_LIST EVENT 0 EVENT 1 EVENT 2 EVENT 3 /end AVAILABLE_EVENT_LIST /begin DEFAULT_EVENT_LIST EVENT 0 /end DEFAULT_EVENT_LIST /end DAQ_EVENT
 /end IF_DATA
/end MEASUREMENT
/begin MEASUREMENT tzwspdis_w "Counter to check thermal status" UWORD dez 1 100 0.00 65535.00 FORMAT "%8.2" ECU_ADDRESS 0x40008610
 /begin IF_DATA XCPplus 0x0102
  /begin DAQ_EVENT VARIABLE /begin AVAILABLE_EVENT_LIST EVENT 0 EVENT 1 EVENT 2 EVENT 3 /end AVAILABLE_EVENT_LIST /begin DEFAULT_EVENT_LIST EVENT 0 /end DEFAULT_EVENT_LIST /end DAQ_EVENT
 /end IF_DATA
/end MEASUREMENT
/begin MEASUREMENT uabmhxf_w "Voltage setpoint for heater offtime calculation based on exhaust gas temp. after cat (LSF with Pumped Reference)" UWORD spg_q0p00039 1 100 0.00 25.59961 FORMAT "%8.5" ECU_ADDRESS 0x400085EA /end MEASUREMENT
/begin MEASUREMENT uabmvxf_w "Voltage setpoint for heater offtime calculation based on exhaust gas temp. before cat (LSF with Pumped Reference)" UWORD spg_q0p00039 1 100 0.00 25.59961 FORMAT "%8.5" ECU_ADDRESS 0x400085D0 /end MEASUREMENT
/begin MEASUREMENT ub "Battery voltage" UBYTE spg_ubatt 1 100 0.00 17.95 FORMAT "%5.2" ECU_ADDRESS 0x4000899D
 /begin IF_DATA XCPplus 0x0102
  /begin DAQ_EVENT VARIABLE /begin AVAILABLE_EVENT_LIST EVENT 0 EVENT 1 EVENT 2 EVENT 3 /end AVAILABLE_EVENT_LIST /begin DEFAULT_EVENT_LIST EVENT 1 /end DEFAULT_EVENT_LIST /end DAQ_EVENT
 /end IF_DATA
/end MEASUREMENT
/begin MEASUREMENT ubsq "battery voltage (on board), conversed to standard quantization" UBYTE spg_q0p1 1 100 0.00 25.50 FORMAT "%5.2" ECU_ADDRESS 0x4000899C
 /begin IF_DATA XCPplus 0x0102
  /begin DAQ_EVENT VARIABLE /begin AVAILABLE_EVENT_LIST EVENT 0 EVENT 1 EVENT 2 EVENT 3 /end AVAILABLE_EVENT_LIST /begin DEFAULT_EVENT_LIST EVENT 1 /end DEFAULT_EVENT_LIST /end DAQ_EVENT
 /end IF_DATA
/end MEASUREMENT
/begin MEASUREMENT urmhxf_w "heater voltage during ramping, after cat (LSF with Pumped Reference)" UWORD spg_q0p00039 1 100 0.00 25.59961 FORMAT "%8.5" ECU_ADDRESS 0x400085EE /end MEASUREMENT
/begin MEASUREMENT urmvxf_w "heater voltage during ramping, before cat (LSF with Pumped Reference)" UWORD spg_q0p00039 1 100 0.00 25.59961 FORMAT "%8.5" ECU_ADDRESS 0x400085D4 /end MEASUREMENT
/begin MEASUREMENT VehVOld_v "Previous vehicle speed value" SWORD vel_q0p01 1 100 0.00 327.6700 FORMAT "%8.4" ECU_ADDRESS 0x4000821E
 /begin IF_DATA XCPplus 0x0102
  /begin DAQ_EVENT VARIABLE /begin AVAILABLE_EVENT_LIST EVENT 0 EVENT 1 EVENT 2 EVENT 3 /end AVAILABLE_EVENT_LIST /begin DEFAULT_EVENT_LIST EVENT 1 /end DEFAULT_EVENT_LIST /end DAQ_EVENT
 /end IF_DATA
/end MEASUREMENT
/begin MEASUREMENT VehV_a "Vehicle Acceleration" SWORD Acc 1 100 -32.76800 32.76700 FORMAT "%8.5" ECU_ADDRESS 0x4000821A
 /begin IF_DATA XCPplus 0x0102
  /begin DAQ_EVENT VARIABLE /begin AVAILABLE_EVENT_LIST EVENT 0 EVENT 1 EVENT 2 EVENT 3 /end AVAILABLE_EVENT_LIST /begin DEFAULT_EVENT_LIST EVENT 1 /end DEFAULT_EVENT_LIST /end DAQ_EVENT
 /end IF_DATA
/end MEASUREMENT
/begin MEASUREMENT VehV_flgVAvrgInit "Status flag to indicate the Vehicle speed array is initialised" UBYTE B_TRUE 1 100 0.00 1.00000000000 BIT_MASK 0x1 FORMAT "%13.11" ECU_ADDRESS 0x40008775
 /begin IF_DATA XCPplus 0x0102
  /begin DAQ_EVENT VARIABLE /begin AVAILABLE_EVENT_LIST EVENT 0 EVENT 1 EVENT 2 EVENT 3 /end AVAILABLE_EVENT_LIST /begin DEFAULT_EVENT_LIST EVENT 1 /end DEFAULT_EVENT_LIST /end DAQ_EVENT
 /end IF_DATA
/end MEASUREMENT
/begin MEASUREMENT VehV_v "Vehicle speed" SWORD Vel 1 100 -327.6800 327.6700 FORMAT "%8.4" ECU_ADDRESS 0x40008218
 /begin IF_DATA XCPplus 0x0102
  /begin DAQ_EVENT VARIABLE /begin AVAILABLE_EVENT_LIST EVENT 0 EVENT 1 EVENT 2 EVENT 3 /end AVAILABLE_EVENT_LIST /begin DEFAULT_EVENT_LIST EVENT 1 /end DEFAULT_EVENT_LIST /end DAQ_EVENT
 /end IF_DATA
/end MEASUREMENT
/begin MEASUREMENT VehV_vArr "Vehicel speed array" SWORD Vel 1 100 -327.6800 327.6700 FORMAT "%8.4" ARRAY_SIZE 100 ECU_ADDRESS 0x40008222
 /begin IF_DATA XCPplus 0x0102
  /begin DAQ_EVENT VARIABLE /begin AVAILABLE_EVENT_LIST EVENT 0 EVENT 1 EVENT 2 EVENT 3 /end AVAILABLE_EVENT_LIST /begin DEFAULT_EVENT_LIST EVENT 1 /end DEFAULT_EVENT_LIST /end DAQ_EVENT
 /end IF_DATA
/end MEASUREMENT
/begin MEASUREMENT VehV_vAvrg "Average Vehicle Speed in Km per hr" SWORD Vel 1 100 -327.6800 327.6700 FORMAT "%8.4" ECU_ADDRESS 0x40008216
 /begin IF_DATA XCPplus 0x0102
  /begin DAQ_EVENT VARIABLE /begin AVAILABLE_EVENT_LIST EVENT 0 EVENT 1 EVENT 2 EVENT 3 /end AVAILABLE_EVENT_LIST /begin DEFAULT_EVENT_LIST EVENT 1 /end DEFAULT_EVENT_LIST /end DAQ_EVENT
 /end IF_DATA
/end MEASUREMENT
/begin MEASUREMENT VehV_vIdx "Vehicel speed array index" UBYTE OneToOne 1 100 0.00 255.0 FORMAT "%5.1" ECU_ADDRESS 0x40008774
 /begin IF_DATA XCPplus 0x0102
  /begin DAQ_EVENT VARIABLE /begin AVAILABLE_EVENT_LIST EVENT 0 EVENT 1 EVENT 2 EVENT 3 /end AVAILABLE_EVENT_LIST /begin DEFAULT_EVENT_LIST EVENT 1 /end DEFAULT_EVENT_LIST /end DAQ_EVENT
 /end IF_DATA
/end MEASUREMENT
/begin MEASUREMENT vfil_w "Filtered speed (16-bit)" UWORD vfzg_uw_b512 1 100 0.00 511.9922 FORMAT "%8.4" ECU_ADDRESS 0x40008220
 /begin IF_DATA XCPplus 0x0102
  /begin DAQ_EVENT VARIABLE /begin AVAILABLE_EVENT_LIST EVENT 0 EVENT 1 EVENT 2 EVENT 3 /end AVAILABLE_EVENT_LIST /begin DEFAULT_EVENT_LIST EVENT 1 /end DEFAULT_EVENT_LIST /end DAQ_EVENT
 /end IF_DATA
/end MEASUREMENT
/begin MEASUREMENT vfzg "vehicle speed (km/h)" UBYTE vfzg_ub_q1p25 1 100 0.00 318.8 FORMAT "%5.1" ECU_ADDRESS 0x40008773
 /begin IF_DATA XCPplus 0x0102
  /begin DAQ_EVENT VARIABLE /begin AVAILABLE_EVENT_LIST EVENT 0 EVENT 1 EVENT 2 EVENT 3 /end AVAILABLE_EVENT_LIST /begin DEFAULT_EVENT_LIST EVENT 1 /end DEFAULT_EVENT_LIST /end DAQ_EVENT
 /end IF_DATA
/end MEASUREMENT
/begin MEASUREMENT vfzg_w "vehicle speed" UWORD vfzg_uw_b512 1 100 0.00 511.9922 FORMAT "%8.4" ECU_ADDRESS 0x40008214
 /begin IF_DATA XCPplus 0x0102
  /begin DAQ_EVENT VARIABLE /begin AVAILABLE_EVENT_LIST EVENT 0 EVENT 1 EVENT 2 EVENT 3 /end AVAILABLE_EVENT_LIST /begin DEFAULT_EVENT_LIST EVENT 1 /end DEFAULT_EVENT_LIST /end DAQ_EVENT
 /end IF_DATA
/end MEASUREMENT
/begin MEASUREMENT vfzrohl_w "vehicle speed output value to scan tool limited" UWORD vfzg_uw_b512 1 100 0.00 511.9922 FORMAT "%8.4" ECU_ADDRESS 0x40008212
 /begin IF_DATA XCPplus 0x0102
  /begin DAQ_EVENT VARIABLE /begin AVAILABLE_EVENT_LIST EVENT 0 EVENT 1 EVENT 2 EVENT 3 /end AVAILABLE_EVENT_LIST /begin DEFAULT_EVENT_LIST EVENT 1 /end DEFAULT_EVENT_LIST /end DAQ_EVENT
 /end IF_DATA
/end MEASUREMENT
/begin MEASUREMENT vfzroh_w "vehicle speed output value to scan tool" UWORD vfzg_uw_b512 1 100 0.00 511.9922 FORMAT "%8.4" ECU_ADDRESS 0x40008210
 /begin IF_DATA XCPplus 0x0102
  /begin DAQ_EVENT VARIABLE /begin AVAILABLE_EVENT_LIST EVENT 0 EVENT 1 EVENT 2 EVENT 3 /end AVAILABLE_EVENT_LIST /begin DEFAULT_EVENT_LIST EVENT 1 /end DEFAULT_EVENT_LIST /end DAQ_EVENT
 /end IF_DATA
/end MEASUREMENT
/begin MEASUREMENT vroh_w "Vehicle speed" UWORD vfzg_uw_b512 1 100 0.00 511.9922 FORMAT "%8.4" ECU_ADDRESS 0x400082EA /end MEASUREMENT
/begin MEASUREMENT wea "anglemark injection break off" UBYTE kw_q6 1 100 0.00 1530. FORMAT "%5.0" ECU_ADDRESS 0x40008A00
 /begin IF_DATA XCPplus 0x0102
  /begin DAQ_EVENT VARIABLE /begin AVAILABLE_EVENT_LIST EVENT 0 EVENT 1 EVENT 2 EVENT 3 /end AVAILABLE_EVENT_LIST /begin DEFAULT_EVENT_LIST EVENT 0 /end DEFAULT_EVENT_LIST /end DAQ_EVENT
 /end IF_DATA
/end MEASUREMENT
/begin MEASUREMENT weea "angle injection-end in normal operation (array dim 3x1)" UWORD kw_q6 1 100 0.00 393210.0 FORMAT "%8.1" ARRAY_SIZE 3 ECU_ADDRESS 0x4000861E
 /begin IF_DATA XCPplus 0x0102
  /begin DAQ_EVENT VARIABLE /begin AVAILABLE_EVENT_LIST EVENT 0 EVENT 1 EVENT 2 EVENT 3 /end AVAILABLE_EVENT_LIST /begin DEFAULT_EVENT_LIST EVENT 0 /end DEFAULT_EVENT_LIST /end DAQ_EVENT
 /end IF_DATA
/end MEASUREMENT
/begin MEASUREMENT wtmot_ggtfmloc "ADC result of engine temperature sensor 10 bit (local variable)" UWORD spg_uw_q0p00488 1 100 0.00 319.9951 FORMAT "%8.4" ECU_ADDRESS 0x40008F66
 /begin IF_DATA XCPplus 0x0102
  /begin DAQ_EVENT VARIABLE /begin AVAILABLE_EVENT_LIST EVENT 0 EVENT 1 EVENT 2 EVENT 3 /end AVAILABLE_EVENT_LIST /begin DEFAULT_EVENT_LIST EVENT 2 /end DEFAULT_EVENT_LIST /end DAQ_EVENT
 /end IF_DATA
/end MEASUREMENT
/begin MEASUREMENT zwbas "earliest possible ignition angle (knock-limitation)" SBYTE zw_sb_q0p75 1 100 -96.00 95.25 FORMAT "%5.2" ECU_ADDRESS 0x400089D7
 /begin IF_DATA XCPplus 0x0102
  /begin DAQ_EVENT VARIABLE /begin AVAILABLE_EVENT_LIST EVENT 0 EVENT 1 EVENT 2 EVENT 3 /end AVAILABLE_EVENT_LIST /begin DEFAULT_EVENT_LIST EVENT 0 /end DEFAULT_EVENT_LIST /end DAQ_EVENT
 /end IF_DATA
/end MEASUREMENT
/begin MEASUREMENT zwbasokr "basic ignition angle without knock control intervention" SBYTE zw_sb_q0p75 1 100 -96.00 95.25 FORMAT "%5.2" ECU_ADDRESS 0x400089D6
 /begin IF_DATA XCPplus 0x0102
  /begin DAQ_EVENT VARIABLE /begin AVAILABLE_EVENT_LIST EVENT 0 EVENT 1 EVENT 2 EVENT 3 /end AVAILABLE_EVENT_LIST /begin DEFAULT_EVENT_LIST EVENT 0 /end DEFAULT_EVENT_LIST /end DAQ_EVENT
 /end IF_DATA
/end MEASUREMENT
/begin MEASUREMENT zwbasokr2 "basic ignition angle without knock control intervention(Bank2)" SBYTE zw_sb_q0p75 1 100 -96.00 95.25 FORMAT "%5.2" ECU_ADDRESS 0x400089D5
 /begin IF_DATA XCPplus 0x0102
  /begin DAQ_EVENT VARIABLE /begin AVAILABLE_EVENT_LIST EVENT 0 EVENT 1 EVENT 2 EVENT 3 /end AVAILABLE_EVENT_LIST /begin DEFAULT_EVENT_LIST EVENT 0 /end DEFAULT_EVENT_LIST /end DAQ_EVENT
 /end IF_DATA
/end MEASUREMENT
/begin MEASUREMENT zwcalcar "Ignition angle output array" SBYTE zw_sb_q0p75 1 100 -96.00 95.25 FORMAT "%5.2" ARRAY_SIZE 1 ECU_ADDRESS 0x400089D4
 /begin IF_DATA XCPplus 0x0102
  /begin DAQ_EVENT VARIABLE /begin AVAILABLE_EVENT_LIST EVENT 0 EVENT 1 EVENT 2 EVENT 3 /end AVAILABLE_EVENT_LIST /begin DEFAULT_EVENT_LIST EVENT 0 /end DEFAULT_EVENT_LIST /end DAQ_EVENT
 /end IF_DATA
/end MEASUREMENT
/begin MEASUREMENT zwcalcar1 "Ignition angle output array for twinspark" SBYTE zw_sb_q0p75 1 100 -96.00 95.25 FORMAT "%5.2" ARRAY_SIZE 1 ECU_ADDRESS 0x400089D0
 /begin IF_DATA XCPplus 0x0102
  /begin DAQ_EVENT VARIABLE /begin AVAILABLE_EVENT_LIST EVENT 0 EVENT 1 EVENT 2 EVENT 3 /end AVAILABLE_EVENT_LIST /begin DEFAULT_EVENT_LIST EVENT 0 /end DEFAULT_EVENT_LIST /end DAQ_EVENT
 /end IF_DATA
/end MEASUREMENT
/begin MEASUREMENT zwgru "basic ignition angle" SBYTE zw_sb_q0p75 1 100 -96.00 95.25 FORMAT "%5.2" ECU_ADDRESS 0x400089CE
 /begin IF_DATA XCPplus 0x0102
  /begin DAQ_EVENT VARIABLE /begin AVAILABLE_EVENT_LIST EVENT 0 EVENT 1 EVENT 2 EVENT 3 /end AVAILABLE_EVENT_LIST /begin DEFAULT_EVENT_LIST EVENT 0 /end DEFAULT_EVENT_LIST /end DAQ_EVENT
 /end IF_DATA
/end MEASUREMENT
/begin MEASUREMENT zwist "real ignition angle" SBYTE zw_sb_q0p75 1 100 -96.00 95.25 FORMAT "%5.2" ECU_ADDRESS 0x400089CD
 /begin IF_DATA XCPplus 0x0102
  /begin DAQ_EVENT VARIABLE /begin AVAILABLE_EVENT_LIST EVENT 0 EVENT 1 EVENT 2 EVENT 3 /end AVAILABLE_EVENT_LIST /begin DEFAULT_EVENT_LIST EVENT 0 /end DEFAULT_EVENT_LIST /end DAQ_EVENT
 /end IF_DATA
/end MEASUREMENT
/begin MEASUREMENT zwout "Ignition angle output value" SBYTE zw_sb_q0p75 1 100 -96.00 95.25 FORMAT "%5.2" ECU_ADDRESS 0x400089CC
 /begin IF_DATA XCPplus 0x0102
  /begin DAQ_EVENT VARIABLE /begin AVAILABLE_EVENT_LIST EVENT 0 EVENT 1 EVENT 2 EVENT 3 /end AVAILABLE_EVENT_LIST /begin DEFAULT_EVENT_LIST EVENT 0 /end DEFAULT_EVENT_LIST /end DAQ_EVENT
 /end IF_DATA
/end MEASUREMENT
/begin MEASUREMENT zwout1 "Ignition angle output value for twinspark" SBYTE zw_sb_q0p75 1 100 -96.00 95.25 FORMAT "%5.2" ECU_ADDRESS 0x400089CB
 /begin IF_DATA XCPplus 0x0102
  /begin DAQ_EVENT VARIABLE /begin AVAILABLE_EVENT_LIST EVENT 0 EVENT 1 EVENT 2 EVENT 3 /end AVAILABLE_EVENT_LIST /begin DEFAULT_EVENT_LIST EVENT 0 /end DEFAULT_EVENT_LIST /end DAQ_EVENT
 /end IF_DATA
/end MEASUREMENT
/begin MEASUREMENT zwout1_akt "Ignition angle output value for secondary channel incase of twin spark ignition: real angle in actual ignition segment" SBYTE kw_q0p75 1 100 -96.00 95.25 FORMAT "%5.2" ECU_ADDRESS 0x400064D8
 /begin IF_DATA XCPplus 0x0102
  /begin DAQ_EVENT VARIABLE /begin AVAILABLE_EVENT_LIST EVENT 0 EVENT 1 EVENT 2 EVENT 3 /end AVAILABLE_EVENT_LIST /begin DEFAULT_EVENT_LIST EVENT 0 /end DEFAULT_EVENT_LIST /end DAQ_EVENT
 /end IF_DATA
/end MEASUREMENT
/begin MEASUREMENT zwout1_aktar "final value of ignition angle for secondary channel of the cylinder in case of twin spark requested to the hw driver" SBYTE kw_q0p75 1 100 -96.00 95.25 FORMAT "%5.2" ARRAY_SIZE 1 ECU_ADDRESS 0x40005330
 /begin IF_DATA XCPplus 0x0102
  /begin DAQ_EVENT VARIABLE /begin AVAILABLE_EVENT_LIST EVENT 0 EVENT 1 EVENT 2 EVENT 3 /end AVAILABLE_EVENT_LIST /begin DEFAULT_EVENT_LIST EVENT 0 /end DEFAULT_EVENT_LIST /end DAQ_EVENT
 /end IF_DATA
/end MEASUREMENT
/begin MEASUREMENT zwoutakt "Ignition angle output value: real angle in actual ignition segment" SBYTE kw_q0p75 1 100 -96.00 95.25 FORMAT "%5.2" ECU_ADDRESS 0x400064D7
 /begin IF_DATA XCPplus 0x0102
  /begin DAQ_EVENT VARIABLE /begin AVAILABLE_EVENT_LIST EVENT 0 EVENT 1 EVENT 2 EVENT 3 /end AVAILABLE_EVENT_LIST /begin DEFAULT_EVENT_LIST EVENT 0 /end DEFAULT_EVENT_LIST /end DAQ_EVENT
 /end IF_DATA
/end MEASUREMENT
/begin MEASUREMENT zwoutaktar "actual output ignition angle array" SBYTE kw_q0p75 1 100 -96.00 95.25 FORMAT "%5.2" ARRAY_SIZE 1 ECU_ADDRESS 0x4000532C
 /begin IF_DATA XCPplus 0x0102
  /begin DAQ_EVENT VARIABLE /begin AVAILABLE_EVENT_LIST EVENT 0 EVENT 1 EVENT 2 EVENT 3 /end AVAILABLE_EVENT_LIST /begin DEFAULT_EVENT_LIST EVENT 0 /end DEFAULT_EVENT_LIST /end DAQ_EVENT
 /end IF_DATA
/end MEASUREMENT
/begin MEASUREMENT zwspae "Most retarded ignition angle" SBYTE zw_sb_q0p75 1 100 -96.00 95.25 FORMAT "%5.2" ECU_ADDRESS 0x400089CA
 /begin IF_DATA XCPplus 0x0102
  /begin DAQ_EVENT VARIABLE /begin AVAILABLE_EVENT_LIST EVENT 0 EVENT 1 EVENT 2 EVENT 3 /end AVAILABLE_EVENT_LIST /begin DEFAULT_EVENT_LIST EVENT 0 /end DEFAULT_EVENT_LIST /end DAQ_EVENT
 /end IF_DATA
/end MEASUREMENT
/begin MEASUREMENT zwspaetm "Latest Ignition angle based on thermal limit" SBYTE zw_sb_q0p75 1 100 -96.00 95.25 FORMAT "%5.2" ECU_ADDRESS 0x400089EB
 /begin IF_DATA XCPplus 0x0102
  /begin DAQ_EVENT VARIABLE /begin AVAILABLE_EVENT_LIST EVENT 0 EVENT 1 EVENT 2 EVENT 3 /end AVAILABLE_EVENT_LIST /begin DEFAULT_EVENT_LIST EVENT 0 /end DEFAULT_EVENT_LIST /end DAQ_EVENT
 /end IF_DATA
/end MEASUREMENT
/begin MEASUREMENT zwstt "Ignition angle during start" SBYTE zw_sb_q0p75 1 100 -96.00 95.25 FORMAT "%5.2" ECU_ADDRESS 0x400089C9
 /begin IF_DATA XCPplus 0x0102
  /begin DAQ_EVENT VARIABLE /begin AVAILABLE_EVENT_LIST EVENT 0 EVENT 1 EVENT 2 EVENT 3 /end AVAILABLE_EVENT_LIST /begin DEFAULT_EVENT_LIST EVENT 0 /end DEFAULT_EVENT_LIST /end DAQ_EVENT
 /end IF_DATA
/end MEASUREMENT
/begin MEASUREMENT zzaehl "Ignition counter(ref.%HT2KTIGNI / IGNDD)" UBYTE OneToOne 1 100 0.00 255.0 FORMAT "%5.1" ECU_ADDRESS 0x40008010
 /begin IF_DATA XCPplus 0x0102
  /begin DAQ_EVENT VARIABLE /begin AVAILABLE_EVENT_LIST EVENT 0 EVENT 1 EVENT 2 EVENT 3 /end AVAILABLE_EVENT_LIST /begin DEFAULT_EVENT_LIST EVENT 0 /end DEFAULT_EVENT_LIST /end DAQ_EVENT
 /end IF_DATA
/end MEASUREMENT
/begin MEASUREMENT zzaehl_w "Ignition counter(ref.%HT2KTIGNI / IGNDD)" UWORD OneToOne 1 100 0.00 65535.00 FORMAT "%8.2" ECU_ADDRESS 0x4000800E
 /begin IF_DATA XCPplus 0x0102
  /begin DAQ_EVENT VARIABLE /begin AVAILABLE_EVENT_LIST EVENT 0 EVENT 1 EVENT 2 EVENT 3 /end AVAILABLE_EVENT_LIST /begin DEFAULT_EVENT_LIST EVENT 0 /end DEFAULT_EVENT_LIST /end DAQ_EVENT
 /end IF_DATA
/end MEASUREMENT
/begin MEASUREMENT zzylzue "SW-cylinder counter for ignition calculation" UBYTE OneToOne 1 100 0.00 255.0 FORMAT "%5.1" ECU_ADDRESS 0x400089C8
 /begin IF_DATA XCPplus 0x0102
  /begin DAQ_EVENT VARIABLE /begin AVAILABLE_EVENT_LIST EVENT 0 EVENT 1 EVENT 2 EVENT 3 /end AVAILABLE_EVENT_LIST /begin DEFAULT_EVENT_LIST EVENT 0 /end DEFAULT_EVENT_LIST /end DAQ_EVENT
 /end IF_DATA
/end MEASUREMENT
/begin FUNCTION GGTFM "9000.15.0 Evaluation of signal engine temperature sensor"
 /begin DEF_CHARACTERISTIC CEngDsT_stSwtPlausSTC_C CEngDsT_swtEnaRamp_C CEngDsT_tDeltaRamp_C CEngDsT_tDifSTCErrThd_C CEngDsT_tiEngRunngDebSTC_C CEngDsT_tiSRCMaxErr_C CEngDsT_tiSRCMaxHeal_C CEngDsT_tiSRCMinErr_C CEngDsT_tiSRCMinHeal_C CEngDsT_tSnsrMinSTCErrDetn_C CEngDsT_uRawSRCMax_C CEngDsT_uRawSRCMin_C CWTMOTMODAVL CWTMOVHSELN DFC_CtlMsk2.DFC_CEngDsTPlausSTC_C DFC_CtlMsk2.DFC_CEngDsTPhysRngHi_C DFC_CtlMsk2.DFC_CEngDsTPhysRngLo_C DFC_CtlMsk2.DFC_CEngDsTSRCMax_C DFC_CtlMsk2.DFC_CEngDsTSRCMin_C DFC_CtlMsk2.DFC_TMnpl_C DFC_DisblMsk2.DFC_CEngDsTPlausSTC_C DFC_DisblMsk2.DFC_CEngDsTPhysRngHi_C DFC_DisblMsk2.DFC_CEngDsTPhysRngLo_C DFC_DisblMsk2.DFC_CEngDsTSRCMax_C DFC_DisblMsk2.DFC_CEngDsTSRCMin_C DFC_DisblMsk2.DFC_TMnpl_C DTMMOD DTMOVH DTMTAMN ENGOFFTIM KFDTMFC KFDTMTA KFDTMTR KLDTTMRW KLENGOFF TDSTENDES TDTM TDTMHL TDTMK TDTMKHL TMDE TMDMN TMDMX TMDSTMX TMMDH TMMDS TMMMX TMOTABINI TMOTELI TMOTFCNT TMOVH TTMMERH TTMMERS /end DEF_CHARACTERISTIC
 /begin IN_MEASUREMENT B_etans B_nmot B_pwf B_sa B_stendes ml_w SyC_stSub SyC_tiPostDrv tans t_engoff_w wtmot_w /end IN_MEASUREMENT
 /begin OUT_MEASUREMENT B_etmot B_tmovh tmot tmotab tmotlin tmrw tmrwab tmst /end OUT_MEASUREMENT
 /begin LOC_MEASUREMENT Btmovh B_flgGGTFMDSMClr B_tmmodst CEngDsT_flgEngRunngSTC CEngDsT_flgPlausSTCErr CEngDsT_flgPlausSTCErrDi CEngDsT_flgPlausSTCHeal CEngDsT_flgSRCMaxErr CEngDsT_flgSRCMaxHeal CEngDsT_flgSRCMinErr CEngDsT_flgSRCMinHeal CEngDsT_tDifMaxMinSnsrSTC CEngDsT_tPreRamp CEngDsT_tRamp CEngDsT_tSnsrMaxSTC CEngDsT_tSnsrMinSTC ml_ggtfmloc wtmot_ggtfmloc /end LOC_MEASUREMENT
 FUNCTION_VERSION "9000.15.0" /end FUNCTION
/begin FUNCTION GGUB "9000.3.0_1.1.0Sensor variable for battery voltage incl. diagnosis"
 /begin DEF_CHARACTERISTIC DFC_CtlMsk2.DFC_UBmax_C DFC_CtlMsk2.DFC_UBmin_C DFC_CtlMsk2.DFC_UBnpl_C DFC_DisblMsk2.DFC_UBmax_C DFC_DisblMsk2.DFC_UBmin_C DFC_DisblMsk2.DFC_UBnpl_C GGUB_nLowBattEngSpd_C GGUB_uLowBattHi_C GGUB_uLowBattLo_C NMOTUB TDLOWBATT_OFF TDLOWBATT_ON TDUB TDUBNPL UBDE UBDMN1 UBDMN2 UBDMX /end DEF_CHARACTERISTIC
 /begin IN_MEASUREMENT nmot_w SyC_stSub wub /end IN_MEASUREMENT
 /begin OUT_MEASUREMENT B_LowBatt B_ubg ub ubsq /end OUT_MEASUREMENT
 FUNCTION_VERSION "9000.3.0_1.1.0" /end FUNCTION
/begin FUNCTION GGVFZG "386.0.1   Input signal: vehicle speed" /begin DEF_CHARACTERISTIC DVFZBEG VehV_numVAvrg_C VehV_swtSig_C ZFVFZ /end DEF_CHARACTERISTIC
 /begin IN_MEASUREMENT B_kl15 B_nmot Com_vVehWhlSpdABS Com_vVehWhlSpdAMT SyC_stSub vroh_w /end IN_MEASUREMENT
 /begin OUT_MEASUREMENT avgvfzg B_vfzhws VehV_a VehV_v VehV_vAvrg vfzg vfzg_w vfzrohl_w vfzroh_w /end OUT_MEASUREMENT
 /begin LOC_MEASUREMENT tmctr VehVOld_v VehV_flgVAvrgInit VehV_vArr VehV_vIdx vfil_w /end LOC_MEASUREMENT
 FUNCTION_VERSION "386.0.1" /end FUNCTION
/begin FUNCTION HdLampCtrl "9001.2.0_386.0.0HeadLamp Control"
 /begin DEF_CHARACTERISTIC BlDev_uBattHdLampMaxThd_C BlDev_uBattHdLampMinThd_C CWPSHdLamp DFC_CtlMsk2.DFC_HdLampMax_C DFC_CtlMsk2.DFC_HdLampMin_C DFC_CtlMsk2.DFC_HdLampSig_C DFC_DisblMsk2.DFC_HdLampMax_C DFC_DisblMsk2.DFC_HdLampMin_C DFC_DisblMsk2.DFC_HdLampSig_C HDLAMPVEHVMN TCYCHDLAMP /end DEF_CHARACTERISTIC
 /begin IN_MEASUREMENT CoEng_st SyC_stSub ubsq VehV_v /end IN_MEASUREMENT
 /begin OUT_MEASUREMENT B_HdLamp /end OUT_MEASUREMENT
 /begin LOC_MEASUREMENT B_flgHdLampDSMClr B_ubattdiag /end LOC_MEASUREMENT
 FUNCTION_VERSION "9001.2.0_386.0.0" /end FUNCTION
/begin FUNCTION HEGOD_DynSimn "9001.2.0  Dynamics simulation for binary oxygen sensors"
 /begin DEF_CHARACTERISTIC HEGO_flgDynSimnS1_C HEGO_flgDynSimnS2_C HEGO_tiFolwSimn_C HEGO_tiHldSimn_C HEGO_uLimdMaxSimnS1_C HEGO_uLimdMaxSimnS2_C HEGO_uLimdMinSimnS1_C HEGO_uLimdMinSimnS2_C /end DEF_CHARACTERISTIC
 /begin IN_MEASUREMENT ESC_tiSampling HEGO_uWoDynSimnS1 HEGO_uWoDynSimnS2 SyC_stSub /end IN_MEASUREMENT
 /begin OUT_MEASUREMENT HEGO_uWithDynSimnS1 HEGO_uWithDynSimnS2 /end OUT_MEASUREMENT
 /begin LOC_MEASUREMENT HEGOD_SimnS1_I.uWithSimn HEGOD_SimnS1_I.DlyTtOpt_I.buffer HEGOD_SimnS1_I.DlyTtOpt_I.counter HEGOD_SimnS1_I.DlyTtOpt_I.ds HEGOD_SimnS1_I.DlyTtOpt_I.pointer HEGOD_SimnS1_I.FolwSimnLT_I.memory HEGOD_SimnS2_I.uWithSimn HEGOD_SimnS2_I.DlyTtOpt_I.buffer HEGOD_SimnS2_I.DlyTtOpt_I.counter HEGOD_SimnS2_I.DlyTtOpt_I.ds HEGOD_SimnS2_I.DlyTtOpt_I.pointer HEGOD_SimnS2_I.FolwSimnLT_I.memory /end LOC_MEASUREMENT
 FUNCTION_VERSION "9001.2.0" /end FUNCTION
/begin FUNCTION HLS "9000.5.0  Lambda sensor heater"
 /begin DEF_CHARACTERISTIC HEGO_duHeatgMapMax_C HEGO_duNomHeatrIntglMax_C HEGO_duNomHeatrIntglMin_C HEGO_duNomHeatrPropMax_C HEGO_duNomHeatrPropMin_C HEGO_facHeatgKi_C HEGO_facHeatgKp_T HEGO_ratHeatgAntiWndUpMax_C HEGO_ratHeatgAntiWndUpMin_C HEGO_rDbndMax_C HEGO_rDbndMin_C HEGO_rHeatgOffLo_C HEGO_rHeatgOff_C HEGO_rNom_C HEGO_stHeatrCtrl_C HEGO_tEgHeatgEnaMax_C HEGO_tEgMinHeatrStrt_C HEGO_tiDebHeatgMapClc_C HEGO_tiDebHeatgMaxHys_C HEGO_tiDebHeatgMax_C HEGO_tiDebHeatrStrtInhb_C HEGO_uHeatgMaxDeb_C HEGO_uHeatgMax_C KFHSUVXF KLHSUHXF KLTTAIKRXF PHLSNHMNXF TANHKMMNXF THEHXF THEVXF THSHAXF TSTLSMX UHSTPHXF UHSTPVXF UINIRMHXF UINIRMVXF UMXRMHXF UMXRMVXF URMNEGHXF URMNEGVXF URMPOSHXF URMPOSVXF /end DEF_CHARACTERISTIC
 /begin REF_CHARACTERISTIC RIXFSBHK RIXFSBVK /end REF_CHARACTERISTIC
 /begin IN_MEASUREMENT B_atmtpa B_atmtpk B_rinavgh B_rinavgv B_stendes ExhMod_flgHeatgTspS1B1 ml_w PrjCon_stLamSensRrCat_b rinavgh_w rinavgv_w SyC_stSub taikrm tkihkm t_engoff_w ubsq /end IN_MEASUREMENT
 /begin OUT_MEASUREMENT B_hsha B_hshe B_hskfhxf B_hskfvxf B_hsve HEGO_ratDutyS1 HEGO_ratDutyS2 phlsnhxf phlsnvxf thaistxf_w tvaistxf_w /end OUT_MEASUREMENT
 /begin LOC_MEASUREMENT B_redhshxf B_redhsvxf B_rehs HEGO_drNomClcS1 HEGO_drNomClcS2 HEGO_duNomHeatgClcS1 HEGO_duNomHeatgClcS2 HEGO_duNomHeatgIntglS1 HEGO_duNomHeatgIntglS2 HEGO_duNomHeatgPropS1 HEGO_duNomHeatgPropS2 HEGO_flgHeatgClcAntiWndUpS1 HEGO_flgHeatgClcAntiWndUpS2 HEGO_flgHeatgClcEnadS1 HEGO_flgHeatgClcEnadS2 HEGO_flgHeatgOffHiTS1 HEGO_flgHeatgOffHiTS2 HEGO_flgHeatrStrtNoInhbn HEGO_uNomHeatgClcS1 HEGO_uNomHeatgClcS2 HEGO_uNomHeatgLimS1 HEGO_uNomHeatgLimS2 HEGO_uNomHeatgOpenLoopS1 HEGO_uNomHeatgOpenLoopS2 HEGO_uNomHeatgS1 HEGO_uNomHeatgS2 taikrmfxf tempstspxf thhatxf_w thvatxf_w uabmhxf_w uabmvxf_w urmhxf_w urmvxf_w /end LOC_MEASUREMENT
 FUNCTION_VERSION "9000.5.0" /end FUNCTION
/begin FUNCTION HT2KTTEV "9100.3.0  Interface hardware driver - component driver output canister purge valve" /begin IN_MEASUREMENT SyC_stSub tateout_w tevper /end IN_MEASUREMENT FUNCTION_VERSION "9100.3.0" /end FUNCTION
/begin FUNCTION HT2KTVFZG "9100.1.0  Hardware capsulation of input signal vehicle speed" /begin DEF_CHARACTERISTIC SVFZPLSDST[0] SVFZPLSDST[1] TDVEHSIG /end DEF_CHARACTERISTIC /begin IN_MEASUREMENT B_vfzhws SyC_stSub /end IN_MEASUREMENT /begin OUT_MEASUREMENT B_vehpulse vroh_w /end OUT_MEASUREMENT FUNCTION_VERSION "9100.1.0" /end FUNCTION
/begin FUNCTION HWSIG "386.0.0_0040_LSF2_00Hardware Signals"
 /begin DEF_CHARACTERISTIC CWDISELCN CWPNSELCN_C KUPPINV NEUTGEARACTMAX NEUTGEARACTMIN NEUTGEARINACTMAX NEUTGEARINACTMIN NEUTINV OILLPINV /end DEF_CHARACTERISTIC
 /begin IN_MEASUREMENT BIDev_flgSidstSt B_autget B_ekp B_HdLamp B_hshe B_hsve B_kl15 B_lf1s B_LowBatt B_slv MILLmp_stPs Strt_stPs uneutgear_w /end IN_MEASUREMENT
 /begin OUT_MEASUREMENT B_kuppl B_neutgear B_pokayoke Oil_bRawLPSwmp /end OUT_MEASUREMENT
 FUNCTION_VERSION "386.0.0_0040_LSF2_00" /end FUNCTION
/begin FUNCTION I15031Extd_srv1 "30000.9.0 Request current powertrain diagnostic data extended" FUNCTION_VERSION "30000.9.0" /end FUNCTION
/begin FUNCTION I15031Extd_srv2 "30000.7.0 Request powertrain freeze frame data extended" FUNCTION_VERSION "30000.7.0" /end FUNCTION
/begin FUNCTION I15031Extd_srv37 "30000.6.0 Request of emission-relevant Diagnostic Trouble Codes from currentcompleted driving cycles extended" FUNCTION_VERSION "30000.6.0" /end FUNCTION
/begin FUNCTION I15031Extd_srv4 "30000.5.0 Clear and reset emission-related diagnostic information extended" /begin DEF_CHARACTERISTIC I15031_nMaxSrv4_C /end DEF_CHARACTERISTIC /begin IN_MEASUREMENT Epm_nEng /end IN_MEASUREMENT FUNCTION_VERSION "30000.5.0" /end FUNCTION
/begin FUNCTION I15031Extd_srv9 "30000.17.0Request vehicle informations extended" /begin OUT_MEASUREMENT I15031_srv9_stCVNRecalc /end OUT_MEASUREMENT /begin LOC_MEASUREMENT i15031_srv9_CVN_Calc_ui /end LOC_MEASUREMENT FUNCTION_VERSION "30000.17.0" /end FUNCTION
/begin FUNCTION I15031_srv1 "30000.12.0_3.3.0Request current powertrain diagnostic data" /begin DEF_CHARACTERISTIC I15031_PID1C_C I15031_PID9AA_C I15031_stRfrshCal_C /end DEF_CHARACTERISTIC
 /begin OUT_MEASUREMENT I15031_FILLSIG1 I15031_FILLSIG2 I15031_FILLSIG4 I15031_PID1C I15031_PID71A I15031_PID9AA I15031_PIDSuppSrv1 /end OUT_MEASUREMENT
 /begin LOC_MEASUREMENT I15031_PIDSuppSrv2 /end LOC_MEASUREMENT
 FUNCTION_VERSION "30000.12.0_3.3.0" /end FUNCTION
/begin FUNCTION I15031_srv2 "30000.4.0 Request powertrain freeze frame data" FUNCTION_VERSION "30000.4.0" /end FUNCTION
/begin FUNCTION I15031_srv37 "30000.4.0 Request of emission-relevant DTC's from current/completed driving cycle(s)" FUNCTION_VERSION "30000.4.0" /end FUNCTION
/begin FUNCTION I15031_srv4 "30000.4.0_1.1.0Clear and reset emission-related diagnostic information" FUNCTION_VERSION "30000.4.0_1.1.0" /end FUNCTION
/begin FUNCTION I15031_srv6 "30000.5.0 Request on-board monitoring test results for specific monitored systems" FUNCTION_VERSION "30000.5.0" /end FUNCTION
/begin FUNCTION I15031_Srv8 "3.0.0     Request control of on-board system, test or component" FUNCTION_VERSION "3.0.0" /end FUNCTION
/begin FUNCTION I15031_srv9 "30000.9.0_1.2.0Request vehicle informations"
 /begin DEF_CHARACTERISTIC I15031_srv9PIDTable.PID0_C I15031_srv9PIDTable.PID1_C I15031_srv9PIDTable.PID2_C I15031_srv9PIDTable.PID3_C I15031_srv9PIDTable.PID4_C I15031_srv9PIDTable.PID5_C I15031_srv9PIDTable.PID6_C I15031_srv9PIDTable.PID7_C I15031_srv9PIDTable.PID8_C I15031_srv9PIDTable.PID9_C I15031_srv9PIDTable.PIDA_C I15031_srv9PIDTable.PIDB_C I15031_srv9PIDTable.PIDF_C /end DEF_CHARACTERISTIC
 /begin OUT_MEASUREMENT I15031_srv9_CalidCvnOrd_mp I15031_srv9_ValidCVN /end OUT_MEASUREMENT
 FUNCTION_VERSION "30000.9.0_1.2.0" /end FUNCTION
/begin FUNCTION I15031_Std "30000.8.0 Base subservices for emission relevant diagnosis"
 /begin REF_CHARACTERISTIC I15031_srv9PIDTable.PID0_C I15031_srv9PIDTable.PID1_C I15031_srv9PIDTable.PID2_C I15031_srv9PIDTable.PID3_C I15031_srv9PIDTable.PID4_C I15031_srv9PIDTable.PID5_C I15031_srv9PIDTable.PID6_C I15031_srv9PIDTable.PID7_C I15031_srv9PIDTable.PID8_C I15031_srv9PIDTable.PID9_C I15031_srv9PIDTable.PIDA_C I15031_srv9PIDTable.PIDB_C I15031_srv9PIDTable.PIDF_C /end REF_CHARACTERISTIC
 /begin IN_MEASUREMENT I15031_PIDSuppSrv1 I15031_srv9_CalidCvnOrd_mp SyC_stSub T15_flgOn T15_st /end IN_MEASUREMENT
 FUNCTION_VERSION "30000.8.0" /end FUNCTION
/begin FUNCTION IGC2W "9001.21.0 Ignition control function for motorbike projects"
 /begin DEF_CHARACTERISTIC CWZWMIN DFC_CtlMsk2.DFC_IgnCoil1Err_C DFC_CtlMsk2.DFC_IgnCoil2Err_C DFC_DisblMsk2.DFC_IgnCoil1Err_C DFC_DisblMsk2.DFC_IgnCoil2Err_C FSZTM FSZTMSL IgCtl_cntrRampInin_C IgCtl_diaRampStep_C IgCtl_facAltiThd_C IgCtl_facIaCorrnStrt_M IgCtl_iaDifThd_C IgCtl_iaMax_C IgCtl_iaMin_C IgCtl_iaTraEngSpd_M IgCtl_iaTraThrAg_M IgCtl_nHiCutOff_C IgCtl_nHiEnaCoilDiag_C IgCtl_nLoCutOff_C IgCtl_nLoEnaCoilDiag_C IgCtl_nrCoil1DiagErrThd_C IgCtl_nrCoil1DiagTestThd_C IgCtl_nrCoil2DiagErrThd_C IgCtl_nrCoil2DiagTestThd_C IgCtl_nrCutoffCycDlyThd_C IgCtl_nrCycDlyThd_C IgCtl_nrTIaCutOff_T IgCtl_ratHiCutOff_C IgCtl_ratHiEnaCoilDiag_C IgCtl_ratLoCutOff_C IgCtl_ratLoEnaCoilDiag_C IgCtl_stRstCoilDiag_C IgCtl_tEngCoilDiagThd_C IgCtl_tiCoil2ActvDiagDly_C IgCtl_tiEnaCoilDiagDly_C IgCtl_tiMaskRelsStcDly IgCtl_tiTrigCoilCutOffDly_C KFDZWFL KFDZWKG KFDZWSTT KFNRDZWBSL KFSZNUB KFSZNUBSL KFZW KFZWFNRLTA KFZWFNRLTM KFZWMN KFZWMS KFZWSL KFZWSTTM KFZWTA KFZYLZAUS_GM KLSZMX KLSZMX1 KLTDZWBSL KLZWTM SHS30ZUUB SRL20ZUUB TZWSPAECLD TZWSPAEHOT TZWSPAEMN TZWSPAEMX WPHN ZWMNLH /end DEF_CHARACTERISTIC
 /begin REF_CHARACTERISTIC CWSDSTACT ETADZW /end REF_CHARACTERISTIC
 /begin IN_MEASUREMENT B_llrein B_mdoffap B_nlph B_nlzoff B_nozwe B_OvHEngShDwn B_sa B_sdstact B_tltsig dwdkba_w dzwap dzwap2 EngDa_tEng EngDa_tStrt Epm_ctCyl Epm_dnEngSma Epm_nEng fho igndglck lamsol MisfDet_maskRelsStc MisfDet_stcCatMisfCntrBnk MisfDet_stcEmiMisfCntrSum MisfDet_stDnDet nmotfihy_w nmot_w redsol rl SyC_stSub tans tmot ubsq wdkba zwopt zwsol /end IN_MEASUREMENT
 /begin OUT_MEASUREMENT B_zwdyn dzwfl dzwkta dzwspae dzwwl etazwmn IgCtl_flgCoil1DiagActv IgCtl_flgCoil1DiagErr IgCtl_flgCoil1DiagTest IgCtl_flgCoil2DiagActv IgCtl_flgCoil2DiagErr IgCtl_flgCoil2DiagTest IgCtl_flgCoilDiagActv IgCtl_stCutOff ignlock szmax1_w szmax_w szout1_w szout_w zwbas zwbasokr zwbasokr2 zwcalcar zwcalcar1 zwgru zwist zwout zwout1 zwspae zwstt zzylzue /end OUT_MEASUREMENT
 /begin LOC_MEASUREMENT IGC2W_EngDa_tStrtLoc IgCtl_cntrCoil1DiagErr IgCtl_cntrCoil1DiagTest IgCtl_cntrCoil2DiagErr IgCtl_cntrCoil2DiagTest IgCtl_cntrCycDly IgCtl_cntrRamp IgCtl_diaLteRamp IgCtl_diaStrt IgCtl_flgCoil1DiagCmpl IgCtl_flgCoil1MisfDetd IgCtl_flgCoil2DiagCmpl IgCtl_flgCoil2MisfDetd IgCtl_flgEnaCoilDiag IgCtl_flgTrigCoilCutOff IgCtl_nrDwellCutOff Ign_facDesLamLoc Ign_ratChrgAirLoc szout1loc szoutloc tzwspdis_w zwspaetm /end LOC_MEASUREMENT
 FUNCTION_VERSION "9001.21.0" /end FUNCTION
/begin FUNCTION IgnDD "3000.4.0  Componentdriver ignition" /begin DEF_CHARACTERISTIC CWZUEAB igndd_PercOffsDwlMax_T igndd_PercOffsDwlMin_T /end DEF_CHARACTERISTIC /begin REF_CHARACTERISTIC CWDMDZAG /end REF_CHARACTERISTIC
 /begin IN_MEASUREMENT B_nlzoff EpmSyn_stEnaDblIgn Epm_ctCyl Epm_nEng Epm_nEngLRes Epm_numCyl Epm_stOpMode Epm_stSync flgstign_w frstinjcyl SyC_stSub szout1_w szout_w zwcalc1_ar zwcalcar zzylzuear /end IN_MEASUREMENT
 /begin OUT_MEASUREMENT azoffmsk_w B_zesync ignactf_w igndd_TDCActFlg_u8 ovlctr zwout1_akt zwoutakt zzaehl zzaehl_w /end OUT_MEASUREMENT
 /begin LOC_MEASUREMENT igndd_cylFreeze igndd_fdOutPattern_u16 igndd_fdPatArray_u16 igndd_oldIgnCntVal_u8 igndd_ovl_u8 igndd_state igndd_TiDwlMax_u16 igndd_TiDwlMin_u16 igndd_zwFreeze igndd_zwFreeze1 ignFadeStatBits_u32 ignswofdly zwout1_aktar zwoutaktar /end LOC_MEASUREMENT
 FUNCTION_VERSION "3000.4.0" /end FUNCTION
/begin FUNCTION IgnH "3000.6.0  Hardwaredriver Ignition" /begin DEF_CHARACTERISTIC IgnH_SelnPinActvLvl_C /end DEF_CHARACTERISTIC /begin IN_MEASUREMENT Epm_numCyl igndd_TDCActFlg_u8 /end IN_MEASUREMENT FUNCTION_VERSION "3000.6.0" /end FUNCTION
/begin FUNCTION Ign_IgbtDiag "3000.4.1  Ignition internal Insulated Gate Bipolar Transistor(IGBT) driver stage diagnosis"
 /begin DEF_CHARACTERISTIC DFC_CtlMsk2.DFC_IgnIgbtDiagSCG_0_C DFC_CtlMsk2.DFC_IgnIgbtDiagSCG_1_C DFC_DisblMsk2.DFC_IgnIgbtDiagSCG_0_C DFC_DisblMsk2.DFC_IgnIgbtDiagSCG_1_C Ign_IgbtDiag_iginjlock_C Ign_IgbtDiag_num_intDeb_T Ign_IgbtDiag_uBattMin_C /end DEF_CHARACTERISTIC
 /begin IN_MEASUREMENT Epm_nEngLRes Epm_numCyl SyC_stSub ubsq /end IN_MEASUREMENT
 /begin OUT_MEASUREMENT iginjlock igndglck /end OUT_MEASUREMENT
 /begin LOC_MEASUREMENT Ign_IgbtDiag_flgDiagEna Ign_IgbtDiag_iginjlock Ign_IgbtDiag_num_intDeb /end LOC_MEASUREMENT
 FUNCTION_VERSION "3000.4.1" /end FUNCTION
/begin FUNCTION InjDDPfi "9400.9.0  Device Driver Port Fuel Injection"
 /begin DEF_CHARACTERISTIC ATS_numInjPfiImp_C ATS_tiInjPfiLngth_C ATS_tiInjPfiPer_C INJDDPFI_ONE_MS_TRANSIENT_FEATURE_C /end DEF_CHARACTERISTIC
 /begin IN_MEASUREMENT B_gktiposv B_nsp B_stendes dtemnkt_w dtiefftr_w EpmSyn_stPhaCorrn Epm_ctCyl Epm_nEng Epm_phiToNxtSyn Epm_stSync evz_austot flgstinj_w SyC_stSub tfuelfl_w tieff_w tvevub_w weeofl weestsim wes /end IN_MEASUREMENT
 /begin OUT_MEASUREMENT anzesab_w anzti anztib anztib_w anzti_w frstinjcyl injddpfi_agFrstTdc injddpfi_frstinjcyl InjDDPfi_injEnadCylMsk InjDDPfi_injTrigCylMsk lastzyl nexttizyl /end OUT_MEASUREMENT
 /begin LOC_MEASUREMENT AngZotTicks ATS_InjPfiTstFlg_u8 B_firstSyn Injddpfi_actualWeeofl injddpfi_dtiefftr_w Injddpfi_PstInjCylMsk Injddpfi_PulseStartAngle Injddpfi_stPhaCorrn injddpfi_tfuelfl_l Inj_one_ms_feature_u8 preschd_dtiefftr_w presch_tez_l tez_l te_l tvub_w wea weea /end LOC_MEASUREMENT
 FUNCTION_VERSION "9400.9.0" /end FUNCTION
/begin FUNCTION InjHGdi "9400.2.0  Injection Hardware Driver, Solenoid Injectors" /begin IN_MEASUREMENT Epm_numCyl /end IN_MEASUREMENT
 /begin LOC_MEASUREMENT InjHGdi_ChlNumRequestedInj InjHGdi_ChlNumStartedInj InjHGdi_InfoFlgs InjHGdi_numAbortedInj InjHGdi_numFinishedInj InjHGdi_numRequestedInj InjHGdi_numStartedInj InjHGdi_numWithdrawedInj /end LOC_MEASUREMENT
 FUNCTION_VERSION "9400.2.0" /end FUNCTION
/*********** End of merged COMPU_METHOD blocks ***********/
/begin COMPU_METHOD Acc "" RAT_FUNC "%6.5" "m/s^2" COEFFS 0 1000 0 0 0 1 /end COMPU_METHOD
/begin COMPU_METHOD AngleCrS "" RAT_FUNC "%6.4" "deg CrS" COEFFS 0 45.5111111111 0 0 0 1 /end COMPU_METHOD
/begin COMPU_METHOD B_TRUE "" TAB_VERB "%6.3" "" COMPU_TAB_REF B_TRUE /end COMPU_METHOD
/begin COMPU_VTAB B_TRUE "" TAB_VERB 2 0 "FALSE" 1 "TRUE" /end COMPU_VTAB
/begin COMPU_METHOD DEZ "" RAT_FUNC "%6.2" "" COEFFS 0 1 0 0 0 1 /end COMPU_METHOD
/begin COMPU_METHOD dez "" RAT_FUNC "%6.2" "" COEFFS 0 1 0 0 0 1 /end COMPU_METHOD
/begin COMPU_METHOD DFES_OneToOne "" RAT_FUNC "%6.2" "-" COEFFS 0 1 0 0 0 1 /end COMPU_METHOD
/begin COMPU_METHOD EngN "" RAT_FUNC "%6.3" "rpm" COEFFS 0 2 0 0 0 1 /end COMPU_METHOD
/begin COMPU_METHOD EngNGrd "" RAT_FUNC "%6.3" "rpm/s" COEFFS 0 2 0 0 0 1 /end COMPU_METHOD
/begin COMPU_METHOD EngN_LRes "" RAT_FUNC "%6.1" "rpm" COEFFS 0 0.025 0 0 0 1 /end COMPU_METHOD
/begin COMPU_METHOD fak_q0p0039_op0p5 "" RAT_FUNC "%6.3" "" COEFFS 0 256 -128 0 0 1 /end COMPU_METHOD
/begin COMPU_METHOD fak_q3p906Em5 "" RAT_FUNC "%7.6" "-" COEFFS 0 25600 0 0 0 1 /end COMPU_METHOD
/begin COMPU_METHOD fak_sw_b2 "" RAT_FUNC "%7.6" "-" COEFFS 0 65536 0 0 0 4 /end COMPU_METHOD
/begin COMPU_METHOD fak_ub_b1 "" RAT_FUNC "%6.4" "-" COEFFS 0 256 0 0 0 1 /end COMPU_METHOD
/begin COMPU_METHOD fak_ub_b2 "" RAT_FUNC "%8.5" "-" COEFFS 0 256 0 0 0 2 /end COMPU_METHOD
/begin COMPU_METHOD fak_ub_b4 "" RAT_FUNC "%6.4" "-" COEFFS 0 256 0 0 0 4 /end COMPU_METHOD
/begin COMPU_METHOD fak_ub_q0p01 "" RAT_FUNC "%6.4" "-" COEFFS 0 1 0 0 0 0.01 /end COMPU_METHOD
/begin COMPU_METHOD fak_uw_b0p005 "" RAT_FUNC "%10.9" "" COEFFS 0 65536 0 0 0 0.005 /end COMPU_METHOD
/begin COMPU_METHOD fak_uw_b2 "" RAT_FUNC "%7.6" "-" COEFFS 0 65536 0 0 0 2 /end COMPU_METHOD
/begin COMPU_METHOD Fl_2 "" RAT_FUNC "%6.1" "l" COEFFS 0 0.1 0 0 0 1 /end COMPU_METHOD
/begin COMPU_METHOD Fl_Half_L "" RAT_FUNC "%6.3" "l" COEFFS 0 2 0 0 0 1 /end COMPU_METHOD
/begin COMPU_METHOD Fl_L "" RAT_FUNC "%6.4" "l" COEFFS 0 100 0 0 0 1 /end COMPU_METHOD
/begin COMPU_METHOD Fl_Vol "" RAT_FUNC "%6.5" "l/100km" COEFFS 0 1000 0 0 0 1 /end COMPU_METHOD
/begin COMPU_METHOD Fl_Vol_q0p05 "" RAT_FUNC "%6.4" "l" COEFFS 0 20 0 0 0 1 /end COMPU_METHOD
/begin COMPU_METHOD FRNM_SC_Compu "" TAB_VERB "%6.3" "" COMPU_TAB_REF FRNM_SC_Compu /end COMPU_METHOD
/begin COMPU_VTAB FRNM_SC_Compu "" TAB_VERB 2 0 "False" 1 "True" /end COMPU_VTAB
/begin COMPU_METHOD FrqCylPres "" RAT_FUNC "%6.2" "Hz" COEFFS 0 1 0 0 0 1 /end COMPU_METHOD
/begin COMPU_METHOD FRTP_SC_Compu "" TAB_VERB "%6.3" "" COMPU_TAB_REF FRTP_SC_Compu /end COMPU_METHOD
/begin COMPU_VTAB FRTP_SC_Compu "" TAB_VERB 2 0 "False" 1 "True" /end COMPU_VTAB
/begin COMPU_METHOD GBXNPOS_SY_Compu "" TAB_VERB "%6.3" "" COMPU_TAB_REF GBXNPOS_SY_Compu /end COMPU_METHOD
/begin COMPU_VTAB GBXNPOS_SY_Compu "" TAB_VERB 7 0 "GBXNPOS_OFF" 1 "GBXNPOS_ADC" 2 "GBXNPOS_PWM" 3 "GBXNPOS_INTSENS" 4 "GBXNPOS_CAL" 5 "GBXNPOS_DIO" 6 "GBXNPOS_CAN" /end COMPU_VTAB
/begin COMPU_METHOD GBXPOS_HWINPCFG_SC_Compu "" TAB_VERB "%6.3" "" COMPU_TAB_REF GBXPOS_HWINPCFG_SC_Compu /end COMPU_METHOD
/begin COMPU_VTAB GBXPOS_HWINPCFG_SC_Compu "" TAB_VERB 6 1 "SENT" 2 "Puls_Coded" 3 "PWMIN" 4 "ADCIN" 5 "CAN" 6 "DIO" /end COMPU_VTAB
/begin COMPU_METHOD GBXPOS_NEUTLRNG_SC_Compu "" TAB_VERB "%6.3" "" COMPU_TAB_REF GBXPOS_NEUTLRNG_SC_Compu /end COMPU_METHOD
/begin COMPU_VTAB GBXPOS_NEUTLRNG_SC_Compu "" TAB_VERB 2 0 "False" 1 "True" /end COMPU_VTAB
/begin COMPU_METHOD GBXPOS_SC_Compu "" TAB_VERB "%6.3" "" COMPU_TAB_REF GBXPOS_SC_Compu /end COMPU_METHOD
/begin COMPU_VTAB GBXPOS_SC_Compu "" TAB_VERB 2 0 "False" 1 "True" /end COMPU_VTAB
/begin COMPU_METHOD GC_Volt "" RAT_FUNC "%6.2" "mV" COEFFS 0 0.2046 0 0 0 1 /end COMPU_METHOD
/begin COMPU_METHOD GDI_SY_Compu "" TAB_VERB "%6.3" "" COMPU_TAB_REF GDI_SY_Compu /end COMPU_METHOD
/begin COMPU_VTAB GDI_SY_Compu "" TAB_VERB 2 0 "GDI_NO" 1 "GDI" /end COMPU_VTAB
/begin COMPU_METHOD GEARBX_NUMGEAR_MAX_Compu "" RAT_FUNC "%6.2" "" COEFFS 0 1 0 0 0 1 /end COMPU_METHOD
/begin COMPU_METHOD GEARDETNSNSR_TYPAVL_SC_Compu "" TAB_VERB "%6.3" "" COMPU_TAB_REF GEARDETNSNSR_TYPAVL_SC_Compu /end COMPU_METHOD
/begin COMPU_VTAB GEARDETNSNSR_TYPAVL_SC_Compu "" TAB_VERB 2 0 "False" 1 "True" /end COMPU_VTAB
/begin COMPU_METHOD GEARDPDTIA_SC_Compu "" TAB_VERB "%6.3" "" COMPU_TAB_REF GEARDPDTIA_SC_Compu /end COMPU_METHOD
/begin COMPU_VTAB GEARDPDTIA_SC_Compu "" TAB_VERB 2 0 "False" 1 "True" /end COMPU_VTAB
/begin COMPU_METHOD GPTA_TOGSEL_SC_Compu "" TAB_VERB "%6.3" "" COMPU_TAB_REF GPTA_TOGSEL_SC_Compu /end COMPU_METHOD
/begin COMPU_VTAB GPTA_TOGSEL_SC_Compu "" TAB_VERB 2 0 "STANDARD" 1 "HON" /end COMPU_VTAB
/begin COMPU_METHOD GrpDlyTime "" RAT_FUNC "%6.3" "usec" COEFFS 0 10 0 0 0 1 /end COMPU_METHOD
/begin COMPU_METHOD HBR_SC_Compu "" TAB_VERB "%6.3" "" COMPU_TAB_REF HBR_SC_Compu /end COMPU_METHOD
/begin COMPU_VTAB HBR_SC_Compu "" TAB_VERB 2 0 "False" 1 "True" /end COMPU_VTAB
/begin COMPU_METHOD HCMassPerTime "" RAT_FUNC "%6.3" "mg/s" COEFFS 0 10 0 0 0 1 /end COMPU_METHOD
/begin COMPU_METHOD HCMassPerTime_q0p0000004 "" RAT_FUNC "%9.8" "kg/s" COEFFS 0 2500000 0 0 0 1 /end COMPU_METHOD
/begin COMPU_METHOD HCMassPerTime_q0p4 "" RAT_FUNC "%6.3" "mg/s" COEFFS 0 2.5 0 0 0 1 /end COMPU_METHOD
/begin COMPU_METHOD HCMassPerTime_q0p8 "" RAT_FUNC "%6.2" "mg/s" COEFFS 0 1.25 0 0 0 1 /end COMPU_METHOD
/begin COMPU_METHOD HCMass_q0p005 "" RAT_FUNC "%6.4" "g" COEFFS 0 200 0 0 0 1 /end COMPU_METHOD
/begin COMPU_METHOD HDLMPRLY_SY_Compu "" TAB_VERB "%6.3" "" COMPU_TAB_REF HDLMPRLY_SY_Compu /end COMPU_METHOD
/begin COMPU_VTAB HDLMPRLY_SY_Compu "" TAB_VERB 2 0 "False" 1 "True" /end COMPU_VTAB
/begin COMPU_METHOD HeatCapacity "" RAT_FUNC "%6.3" "J/K" COEFFS 0 10 0 0 0 1 /end COMPU_METHOD
/begin COMPU_METHOD HEGODDYNSIMN_SY_Compu "" TAB_VERB "%6.3" "" COMPU_TAB_REF HEGODDYNSIMN_SY_Compu /end COMPU_METHOD
/begin COMPU_VTAB HEGODDYNSIMN_SY_Compu "" TAB_VERB 2 0 "False" 1 "True" /end COMPU_VTAB
/begin COMPU_METHOD HEGO_STDDIAGPS_SC_Compu "" TAB_VERB "%6.3" "" COMPU_TAB_REF HEGO_STDDIAGPS_SC_Compu /end COMPU_METHOD
/begin COMPU_VTAB HEGO_STDDIAGPS_SC_Compu "" TAB_VERB 2 0 "False" 1 "True" /end COMPU_VTAB
/begin COMPU_METHOD HEGO_VAR_SY_Compu "" TAB_VERB "%6.3" "" COMPU_TAB_REF HEGO_VAR_SY_Compu /end COMPU_METHOD
/begin COMPU_VTAB HEGO_VAR_SY_Compu "" TAB_VERB 47 1 "DAI" 3 "VWW" 4 "POR" 5 "AUD" 6 "OPE" 9 "FIA" 11 "BMW" 14 "PSA" 15 "REN" 17 "ALF" 18 "SAB" 19 "VOL" 20 "NIS" 21 "GMU" 22 "FOR" 26 "IMJ" 51 "SEA" 53 "CHR" 54 "JAG" 55 "ROL" 69 "FER" 72 "TOY" 112 "BMW-Motorrad AG" 123 "MIT" 147 "HYU" 159 "HON" 160 "MAZ" 183 "CU" 190 "LRG" 204 "VVW" 214 "AVT" 242 "Iveco" 243 "DMC" 248 "SUZ" 267 "SSANGYONG" 270 "KEF" 289 "AMG" 308 "TAT" 319 "MVM" 330 "TVS" 385 "UAES" 590 "Scania" 828 "RBCD" 999 "ALL" 2887 "Nonox" 9397 "Kawasaki" 9454 "Fuso" /end COMPU_VTAB
/begin COMPU_METHOD HEM_SY_Compu "" TAB_VERB "%6.3" "" COMPU_TAB_REF HEM_SY_Compu /end COMPU_METHOD
/begin COMPU_VTAB HEM_SY_Compu "" TAB_VERB 3 0 "NO_HEM" 1 "HEM_CYL" 2 "HEM_BNK" /end COMPU_VTAB
/begin COMPU_METHOD HESRV_HETYP_SY_Compu "" TAB_VERB "%6.3" "" COMPU_TAB_REF HESRV_HETYP_SY_Compu /end COMPU_METHOD
/begin COMPU_VTAB HESRV_HETYP_SY_Compu "" TAB_VERB 4 1 "HESRV_MASTERSLAVE" 2 "HESRV_VCU" 3 "HESRV_HCU" 255 "HESRV_ONEBOX" /end COMPU_VTAB
/begin COMPU_METHOD HEVCHGR_SY_Compu "" TAB_VERB "%6.3" "" COMPU_TAB_REF HEVCHGR_SY_Compu /end COMPU_METHOD
/begin COMPU_VTAB HEVCHGR_SY_Compu "" TAB_VERB 5 0 "NOCHGR" 1 "CHGR_UHV" 2 "CHGR_UHVLV" 3 "CHGR_BHV" 4 "CHGR_BHVLV" /end COMPU_VTAB
/begin COMPU_METHOD HEVPLINAVL_SC_Compu "" TAB_VERB "%6.3" "" COMPU_TAB_REF HEVPLINAVL_SC_Compu /end COMPU_METHOD
/begin COMPU_VTAB HEVPLINAVL_SC_Compu "" TAB_VERB 2 0 "False" 1 "True" /end COMPU_VTAB
/begin COMPU_METHOD HEVTYP_SY_Compu "" TAB_VERB "%6.3" "" COMPU_TAB_REF HEVTYP_SY_Compu /end COMPU_METHOD
/begin COMPU_VTAB HEVTYP_SY_Compu "" TAB_VERB 8 0 "0" 1 "HEVTYP_SER" 2 "HEVTYP_SERPARL" 3 "HEVTYP_PWRSPLT" 4 "HEVTYP_PARL" 5 "HEVTYP_EAD" 6 "HEVTYP_EDCT" 7 "HEVTYP_PARLSER" /end COMPU_VTAB
/begin COMPU_METHOD HWDPD_SC_Compu "" TAB_VERB "%6.3" "" COMPU_TAB_REF HWDPD_SC_Compu /end COMPU_METHOD
/begin COMPU_VTAB HWDPD_SC_Compu "" TAB_VERB 3 0 "HWDPD_NEUT" 1 "HWDPD_SWNOTSEL" 2 "HWDPD_SWSEL" /end COMPU_VTAB
/begin COMPU_METHOD I15031_OBD_CNTL_SC_Compu "" TAB_VERB "%6.3" "" COMPU_TAB_REF I15031_OBD_CNTL_SC_Compu /end COMPU_METHOD
/begin COMPU_VTAB I15031_OBD_CNTL_SC_Compu "" TAB_VERB 4 0 "I15031_ACTIVE" 1 "I15031_SRV_ADJUST" 2 "I15031_INACTIVE" 3 "I15031_NOT_EXISTING" /end COMPU_VTAB
/begin COMPU_METHOD I15031_PID1CVerb "" TAB_VERB "%6.3" "-" COMPU_TAB_REF I15031_PID1CVerb /end COMPU_METHOD
/begin COMPU_VTAB I15031_PID1CVerb "" TAB_VERB 39 1 "OBD II" 2 "OBD" 3 "OBD and OBD II" 4 "OBD I" 5 "No OBD" 6 "EOBD" 7 "EOBD and OBD II" 8 "EOBD and OBD" 9 "EOBD, OBD and OBD II" 10 "JOBD" 11 "JOBD and OBD II" 12 "JOBD and EOBD" 13 "JOBD, EOBD and OBD II" 14 "OBD, EOBD and KOBD" 15 "OBD, OBD II, EOBD and KOBD" 17 "EMD" 18 "EMD+" 19 "HD OBD-C" 20 "HD OBD" 21 "WWH OBD" 23 "HD EOBD-I" 24 "HD EOBD-I N" 25 "HD EOBD-II" 26 "HD EOBD-II N" 28 "OBDBr-1" 29 "OBDBr-2" 30 "KOBD" 31 "IOBD I" 32 "IOBD II" 33 "HD EOBD-VI" 34 "OBD, OBD II and HD OBD" 35 "OBDBr-3" 36 "MC EOBD-I" 37 "MC EOBD-II" 38 "MC COBD-I" 39 "MC TOBD-I" 40 "MC JOBD-I" 41 "CN-OBD-6" 42 "OBDBr-D" /end COMPU_VTAB
/begin COMPU_METHOD I15031_SRV8_SY_Compu "" TAB_VERB "%6.3" "" COMPU_TAB_REF I15031_SRV8_SY_Compu /end COMPU_METHOD
/begin COMPU_VTAB I15031_SRV8_SY_Compu "" TAB_VERB 2 0 "0" 1 "1" /end COMPU_VTAB
/begin COMPU_METHOD I15031_srv9_CalidcvnOrdVerb "" TAB_VERB "%6.3" "" COMPU_TAB_REF I15031_srv9_CalidcvnOrdVerb /end COMPU_METHOD
/begin COMPU_VTAB I15031_srv9_CalidcvnOrdVerb "" TAB_VERB 2 255 "NONE" 0 "ENG1" /end COMPU_VTAB
/begin COMPU_METHOD I15031_srv9_CVN_CalcVerb "" TAB_VERB "%2.1" "-" COMPU_TAB_REF I15031_srv9_CVN_CalcVerb /end COMPU_METHOD
/begin COMPU_VTAB I15031_srv9_CVN_CalcVerb "" TAB_VERB 8 0 "NOTAVAILABLE" 1 "CALC_START" 2 "CALC_BUSY" 3 "CALC_WRITE" 4 "CALC_WRITE_EEPROM" 5 "CALC_READY" 6 "CALC_CLEAR" 7 "CALC_CLEARBUSY" /end COMPU_VTAB
/begin COMPU_METHOD I27145_CANID_SC_Compu "" TAB_VERB "%6.3" "" COMPU_TAB_REF I27145_CANID_SC_Compu /end COMPU_METHOD
/begin COMPU_VTAB I27145_CANID_SC_Compu "" TAB_VERB 3 0 "WWHOBD_0" 1 "WWHOBD_1" 2 "WWHOBD_2" /end COMPU_VTAB
/begin COMPU_METHOD I27145_SC_Compu "" TAB_VERB "%6.3" "" COMPU_TAB_REF I27145_SC_Compu /end COMPU_METHOD
/begin COMPU_VTAB I27145_SC_Compu "" TAB_VERB 2 0 "False" 1 "True" /end COMPU_VTAB
/begin COMPU_METHOD IDLESCRWADJMT_SC_Compu "" TAB_VERB "%6.3" "" COMPU_TAB_REF IDLESCRWADJMT_SC_Compu /end COMPU_METHOD
/begin COMPU_VTAB IDLESCRWADJMT_SC_Compu "" TAB_VERB 2 0 "False" 1 "True" /end COMPU_VTAB
/begin COMPU_METHOD IGCTL_VAR_SY_Compu "" TAB_VERB "%6.3" "" COMPU_TAB_REF IGCTL_VAR_SY_Compu /end COMPU_METHOD
/begin COMPU_VTAB IGCTL_VAR_SY_Compu "" TAB_VERB 46 1 "DAI" 3 "VWW" 4 "POR" 5 "AUD" 6 "OPE" 9 "FIA" 11 "BMW" 14 "PSA" 15 "REN" 17 "ALF" 18 "SAB" 19 "VOL" 20 "NIS" 21 "GMU" 22 "FOR" 26 "IMJ" 51 "SEA" 53 "CHR" 54 "JAG" 55 "ROL" 69 "FER" 72 "TOY" 123 "MIT" 147 "HYU" 159 "HON" 160 "MAZ" 183 "CU" 190 "LRG" 204 "VVW" 214 "AVT" 242 "Iveco" 243 "DMC" 248 "SUZ" 267 "SSANGYONG" 270 "KEF" 289 "AMG" 308 "TAT" 319 "MVM" 330 "TVS" 385 "UAES" 386 "Bajaj" 590 "Scania" 828 "RBCD" 999 "ALL" 2887 "Nonox" 9454 "Fuso" /end COMPU_VTAB
/begin COMPU_METHOD IGNARCDURMONI_SY_Compu "" TAB_VERB "%6.3" "" COMPU_TAB_REF IGNARCDURMONI_SY_Compu /end COMPU_METHOD
/begin COMPU_VTAB IGNARCDURMONI_SY_Compu "" TAB_VERB 2 0 "Spark Duration Diagnosis Ignition Output inactive" 1 "Spark Duration Diagnosis Ignition Output active" /end COMPU_VTAB
/begin COMPU_METHOD IGNCLMPVLTGDURMON_SC_Compu "" TAB_VERB "%6.3" "" COMPU_TAB_REF IGNCLMPVLTGDURMON_SC_Compu /end COMPU_METHOD
/begin COMPU_VTAB IGNCLMPVLTGDURMON_SC_Compu "" TAB_VERB 2 0 "False" 1 "True" /end COMPU_VTAB
/begin COMPU_METHOD IGNCL_INTCALCNXTCHL_SC_Compu "" TAB_VERB "%6.3" "" COMPU_TAB_REF IGNCL_INTCALCNXTCHL_SC_Compu /end COMPU_METHOD
/begin COMPU_VTAB IGNCL_INTCALCNXTCHL_SC_Compu "" TAB_VERB 2 0 "False" 1 "True" /end COMPU_VTAB
/begin COMPU_METHOD IGNCL_QAG_SY_Compu "" TAB_VERB "%6.3" "" COMPU_TAB_REF IGNCL_QAG_SY_Compu /end COMPU_METHOD
/begin COMPU_VTAB IGNCL_QAG_SY_Compu "" TAB_VERB 2 1 "0.75 GradKW" 2 "0.10 GradKW" /end COMPU_VTAB
/begin COMPU_METHOD InjMass "" RAT_FUNC "%6.4" "mg/hub" COEFFS 0 100 0 0 0 1 /end COMPU_METHOD
/begin COMPU_METHOD InjMassCyc "" RAT_FUNC "%6.4" "mg/cyc" COEFFS 0 100 0 0 0 1 /end COMPU_METHOD
/begin COMPU_METHOD InjMassInj "" RAT_FUNC "%6.4" "mg/inj" COEFFS 0 100 0 0 0 1 /end COMPU_METHOD
/begin COMPU_METHOD InjMassPerTime "" RAT_FUNC "%6.4" "Kg/h" COEFFS 0 100 0 0 0 1 /end COMPU_METHOD
/begin COMPU_METHOD InjMassPerTimeHi "" RAT_FUNC "%7.6" "Kg/h" COEFFS 0 10000 0 0 0 1 /end COMPU_METHOD
/begin COMPU_METHOD InjMsPrTime_q0p001_COMPU "" RAT_FUNC "%6.5" "Kg/h" COEFFS 0 1000 0 0 0 1 /end COMPU_METHOD
/begin COMPU_METHOD InjMs_q0p1_COMPU "" RAT_FUNC "%6.3" "mg/hub" COEFFS 0 10 0 0 0 1 /end COMPU_METHOD
/begin COMPU_METHOD InjMs_q0p2_COMPU "" RAT_FUNC "%6.3" "mg/hub" COEFFS 0 5 0 0 0 1 /end COMPU_METHOD
/begin COMPU_METHOD InjQnt "" RAT_FUNC "%6.3" "mm^3/hub" COEFFS 0 10 0 0 0 1 /end COMPU_METHOD
/begin COMPU_METHOD InjQntInj "" RAT_FUNC "%6.4" "mm^3/inj" COEFFS 0 100 0 0 0 1 /end COMPU_METHOD
/begin COMPU_METHOD INJSYG_FUCNSDISP_SC_Compu "" TAB_VERB "%6.3" "" COMPU_TAB_REF INJSYG_FUCNSDISP_SC_Compu /end COMPU_METHOD
/begin COMPU_VTAB INJSYG_FUCNSDISP_SC_Compu "" TAB_VERB 2 0 "False" 1 "True" /end COMPU_VTAB
/begin COMPU_METHOD INJSYG_FUTOG_SC_Compu "" TAB_VERB "%6.3" "" COMPU_TAB_REF INJSYG_FUTOG_SC_Compu /end COMPU_METHOD
/begin COMPU_VTAB INJSYG_FUTOG_SC_Compu "" TAB_VERB 2 0 "False" 1 "True" /end COMPU_VTAB
/begin COMPU_METHOD INJSYG_INTRPTIDFUTOGSDLD_SC_Compu "" RAT_FUNC "%6.2" "" COEFFS 0 1 0 0 0 1 /end COMPU_METHOD
/begin COMPU_METHOD INJSYG_VAR_SY_Compu "" TAB_VERB "%6.3" "" COMPU_TAB_REF INJSYG_VAR_SY_Compu /end COMPU_METHOD
/begin COMPU_VTAB INJSYG_VAR_SY_Compu "" TAB_VERB 45 1 "DAI" 3 "VWW" 4 "POR" 5 "AUD" 6 "OPE" 9 "FIA" 11 "BMW" 14 "PSA" 15 "REN" 17 "ALF" 18 "SAB" 19 "VOL" 20 "NIS" 21 "GMU" 22 "FOR" 26 "IMJ" 51 "SEA" 53 "CHR" 54 "JAG" 55 "ROL" 69 "FER" 72 "TOY" 123 "MIT" 147 "HYU" 159 "HON" 160 "MAZ" 183 "CU" 190 "LRG" 204 "VVW" 214 "AVT" 242 "Iveco" 243 "DMC" 248 "SUZ" 267 "SSANGYONG" 270 "KEF" 289 "AMG" 308 "TAT" 319 "MVM" 385 "UAES" 425 "Polaris" 590 "Scania" 828 "RBCD" 999 "ALL" 2887 "Nonox" 9454 "Fuso" /end COMPU_VTAB
/begin COMPU_METHOD INJSYS_TWNINJR_SC_Compu "" TAB_VERB "%6.3" "" COMPU_TAB_REF INJSYS_TWNINJR_SC_Compu /end COMPU_METHOD
/begin COMPU_VTAB INJSYS_TWNINJR_SC_Compu "" TAB_VERB 2 0 "False" 1 "True" /end COMPU_VTAB
/begin COMPU_METHOD INJSYS_TWOSTEPINJ_SC_Compu "" TAB_VERB "%6.3" "" COMPU_TAB_REF INJSYS_TWOSTEPINJ_SC_Compu /end COMPU_METHOD
/begin COMPU_VTAB INJSYS_TWOSTEPINJ_SC_Compu "" TAB_VERB 2 0 "False" 1 "True" /end COMPU_VTAB
/begin COMPU_METHOD InjTime_us "" RAT_FUNC "%6.3" "us" COEFFS 0 2.5 0 0 0 1 /end COMPU_METHOD
/begin COMPU_METHOD INJVLV_ATS_SY_Compu "" TAB_VERB "%6.3" "" COMPU_TAB_REF INJVLV_ATS_SY_Compu /end COMPU_METHOD
/begin COMPU_VTAB INJVLV_ATS_SY_Compu "" TAB_VERB 2 0 "False" 1 "True" /end COMPU_VTAB
/begin COMPU_METHOD INJVLV_FSTRCVAFTFCO_SY_Compu "" TAB_VERB "%6.3" "" COMPU_TAB_REF INJVLV_FSTRCVAFTFCO_SY_Compu /end COMPU_METHOD
/begin COMPU_VTAB INJVLV_FSTRCVAFTFCO_SY_Compu "" TAB_VERB 2 0 "OFF" 1 "ON" /end COMPU_VTAB
/begin COMPU_METHOD INJVLV_ONOFF_ATS_SC_Compu "" TAB_VERB "%6.3" "" COMPU_TAB_REF INJVLV_ONOFF_ATS_SC_Compu /end COMPU_METHOD
/begin COMPU_VTAB INJVLV_ONOFF_ATS_SC_Compu "" TAB_VERB 2 0 "False" 1 "True" /end COMPU_VTAB
/begin COMPU_METHOD INJVLV_PSIC_SC_Compu "" TAB_VERB "%6.3" "" COMPU_TAB_REF INJVLV_PSIC_SC_Compu /end COMPU_METHOD
/begin COMPU_VTAB INJVLV_PSIC_SC_Compu "" TAB_VERB 7 0 "CJ841" 1 "CJ870" 2 "CY335" 3 "CY372" 4 "CY375" 5 "SC900685" 6 "CY373" /end COMPU_VTAB
/begin COMPU_METHOD INJVLV_PSNR_SC_Compu "" RAT_FUNC "%6.2" "" COEFFS 0 1 0 0 0 1 /end COMPU_METHOD
/begin COMPU_METHOD InjVlv_stABE_COMPU_VERB "" TAB_VERB "%6.3" "" COMPU_TAB_REF InjVlv_stABE_COMPU_VERB /end COMPU_METHOD
/begin COMPU_VTAB InjVlv_stABE_COMPU_VERB "" TAB_VERB 2 0 "INJVLV_ABE_ACTIVE" 1 "INJVLV_ABE_NOTACTIVE" /end COMPU_VTAB
/begin COMPU_METHOD InrtTrq_COMPU "" RAT_FUNC "%6.5" "kg*s^2" COEFFS 0 1024 0 0 0 1 /end COMPU_METHOD
/begin COMPU_METHOD INTKAIRT_AIRFILDS_SC_Compu "" TAB_VERB "%6.3" "" COMPU_TAB_REF INTKAIRT_AIRFILDS_SC_Compu /end COMPU_METHOD
/begin COMPU_VTAB INTKAIRT_AIRFILDS_SC_Compu "" TAB_VERB 3 0 "no_signal" 1 "sensor" 2 "model" /end COMPU_VTAB
/begin COMPU_METHOD INTKAIRT_SNSR1POS_SC_Compu "" TAB_VERB "%6.3" "" COMPU_TAB_REF INTKAIRT_SNSR1POS_SC_Compu /end COMPU_METHOD
/begin COMPU_VTAB INTKAIRT_SNSR1POS_SC_Compu "" TAB_VERB 6 0 "no_sensor" 1 "IntkMnfld" 2 "MnfldIcoDs" 3 "ThrVlvUs" 4 "CmprDs" 5 "AirFltDs" /end COMPU_VTAB
/begin COMPU_METHOD IOEXTDEV_CJ260_SC_Compu "" RAT_FUNC "%6.2" "" COEFFS 0 1 0 0 0 1 /end COMPU_METHOD
/begin COMPU_METHOD IOEXTDEV_PORTEXP_SC_Compu "" TAB_VERB "%6.3" "" COMPU_TAB_REF IOEXTDEV_PORTEXP_SC_Compu /end COMPU_METHOD
/begin COMPU_VTAB IOEXTDEV_PORTEXP_SC_Compu "" TAB_VERB 2 0 "No_Port_Expander" 1 "Port_Expander_I2C" /end COMPU_VTAB
/begin COMPU_METHOD IPDUM_SC_Compu "" TAB_VERB "%6.3" "" COMPU_TAB_REF IPDUM_SC_Compu /end COMPU_METHOD
/begin COMPU_VTAB IPDUM_SC_Compu "" TAB_VERB 2 0 "False" 1 "True" /end COMPU_VTAB
/begin COMPU_METHOD IUMPR_SY_Compu "" TAB_VERB "%6.3" "" COMPU_TAB_REF IUMPR_SY_Compu /end COMPU_METHOD
/begin COMPU_VTAB IUMPR_SY_Compu "" TAB_VERB 2 0 "NO_IUMPR_ACTIVE" 1 "IUMPR_ACTIVE" /end COMPU_VTAB
/begin COMPU_METHOD IUMPR_VERS_SY_Compu "" TAB_VERB "%6.3" "" COMPU_TAB_REF IUMPR_VERS_SY_Compu /end COMPU_METHOD
/begin COMPU_VTAB IUMPR_VERS_SY_Compu "" TAB_VERB 3 0 "IUMPR_2005" 1 "IUMPR_2007" 2 "IUMPR_2009" /end COMPU_VTAB
/begin COMPU_METHOD IVPFIPS_TESTPLSENA_SC_Compu "" TAB_VERB "%6.3" "" COMPU_TAB_REF IVPFIPS_TESTPLSENA_SC_Compu /end COMPU_METHOD
/begin COMPU_VTAB IVPFIPS_TESTPLSENA_SC_Compu "" TAB_VERB 2 0 "False" 1 "True" /end COMPU_VTAB
/begin COMPU_METHOD J1939TP_SC_Compu "" TAB_VERB "%6.3" "" COMPU_TAB_REF J1939TP_SC_Compu /end COMPU_METHOD
/begin COMPU_VTAB J1939TP_SC_Compu "" TAB_VERB 2 0 "False" 1 "True" /end COMPU_VTAB
/begin COMPU_METHOD Kd "" RAT_FUNC "%7.6" "1/1" COEFFS 0 65536 0 0 0 1 /end COMPU_METHOD
/begin COMPU_METHOD Kd_1 "" RAT_FUNC "%6.4" "1/1" COEFFS 0 512 0 0 0 1 /end COMPU_METHOD
/begin COMPU_METHOD Kd_Lin_16 "" RAT_FUNC "%7.6" "1/1" COEFFS 0 32767 0 0 0 1 /end COMPU_METHOD
/begin COMPU_METHOD Kd_pRail2Q_1 "" RAT_FUNC "%7.6" "mm^3/s/hPa" COEFFS 0 40960 0 0 0 1 /end COMPU_METHOD
/begin COMPU_METHOD Kd_Prc_COMPU "" RAT_FUNC "%6.5" "%" COEFFS 0 8000 0 0 0 1 /end COMPU_METHOD
/begin COMPU_METHOD Ki "" RAT_FUNC "%6.5" "1/s" COEFFS 0 2147.483648 0 0 0 1 /end COMPU_METHOD
/begin COMPU_METHOD KILLSWT_SC_Compu "" TAB_VERB "%6.3" "" COMPU_TAB_REF KILLSWT_SC_Compu /end COMPU_METHOD
/begin COMPU_VTAB KILLSWT_SC_Compu "" TAB_VERB 2 0 "False" 1 "True" /end COMPU_VTAB
/begin COMPU_METHOD Ki_1 "" RAT_FUNC "%6.4" "1/s" COEFFS 0 67.108864 0 0 0 1 /end COMPU_METHOD
/begin COMPU_METHOD Ki_Temp2EGTFact "" RAT_FUNC "%8.7" "-" COEFFS 0 429496.7296 0 0 0 1 /end COMPU_METHOD
/begin COMPU_METHOD kw_q0p75 "" RAT_FUNC "%6.3" "Grad KW" COEFFS 0 4 0 0 0 3 /end COMPU_METHOD
/begin COMPU_METHOD kw_q6 "" RAT_FUNC "%6.2" "Grad KW" COEFFS 0 1 0 0 0 6 /end COMPU_METHOD
/begin COMPU_METHOD m_uw_b6553p5 "" RAT_FUNC "%6.3" "kg/h" COEFFS 0 1 0 0 0 0.1 /end COMPU_METHOD
/begin COMPU_METHOD nmot_uw_q0p25 "" RAT_FUNC "%6.3" "1/min" COEFFS 0 1 0 0 0 0.25 /end COMPU_METHOD
/begin COMPU_METHOD OneToOne "" RAT_FUNC "%6.2" "-" COEFFS 0 1 0 0 0 1 /end COMPU_METHOD
/begin COMPU_METHOD q1p953125Em4_V_DIV_Ohm "" RAT_FUNC "%6.5" "V/Ohm" COEFFS 0 5120 0 0 0 1 /end COMPU_METHOD
/begin COMPU_METHOD q1p953125Em4_V_DIV_s_Ohm "" RAT_FUNC "%6.5" "V/(s*Ohm)" COEFFS 0 5120 0 0 0 1 /end COMPU_METHOD
/begin COMPU_METHOD relDK_q0p02441 "" RAT_FUNC "%6.4" "%DK" COEFFS 0 65536 0 0 0 1600 /end COMPU_METHOD
/begin COMPU_METHOD relDK_ub_b100 "" RAT_FUNC "%6.3" "%DK" COEFFS 0 255 0 0 0 100 /end COMPU_METHOD
/begin COMPU_METHOD rel_ub_b127p5 "" RAT_FUNC "%6.3" "%" COEFFS 0 2 0 0 0 1 /end COMPU_METHOD
/begin COMPU_METHOD rel_ub_q0p75 "" RAT_FUNC "%6.3" "%" COEFFS 0 1 0 0 0 0.75 /end COMPU_METHOD
/begin COMPU_METHOD r_uw_q2 "" RAT_FUNC "%6.2" "Ohm" COEFFS 0 1 0 0 0 2 /end COMPU_METHOD
/begin COMPU_METHOD spg_q0p00039 "" RAT_FUNC "%6.5" "V" COEFFS 0 1 0 0 0 0.000390625 /end COMPU_METHOD
/begin COMPU_METHOD spg_q0p0039 "" RAT_FUNC "%6.4" "V" COEFFS 0 256 0 0 0 1 /end COMPU_METHOD
/begin COMPU_METHOD spg_q0p005 "" RAT_FUNC "%6.4" "V" COEFFS 0 1 0 0 0 0.005 /end COMPU_METHOD
/begin COMPU_METHOD spg_q0p1 "" RAT_FUNC "%6.3" "V" COEFFS 0 1 0 0 0 0.1 /end COMPU_METHOD
/begin COMPU_METHOD spg_ubatt "" RAT_FUNC "%6.4" "V" COEFFS 0 14.2045454545455 0 0 0 1 /end COMPU_METHOD
/begin COMPU_METHOD spg_uw_q0p00488 "" RAT_FUNC "%6.4" "V" COEFFS 0 1024 0 0 0 5 /end COMPU_METHOD
/begin COMPU_METHOD s_q1p422Em4 "" RAT_FUNC "%6.5" "m" COEFFS 0 28125 0 0 0 4 /end COMPU_METHOD
/begin COMPU_METHOD t100msxs_ub_b25p5 "" RAT_FUNC "%6.3" "s" COEFFS 0 1 0 0 0 0.1 /end COMPU_METHOD
/begin COMPU_METHOD t100msxs_uw_b6553p5 "" RAT_FUNC "%6.3" "s" COEFFS 0 1 0 0 0 0.1 /end COMPU_METHOD
/begin COMPU_METHOD t1msxs_b65p535 "" RAT_FUNC "%6.5" "s" COEFFS 0 65535 0 0 0 65.535 /end COMPU_METHOD
/begin COMPU_METHOD t1p0usxms "" RAT_FUNC "%6.5" "ms" COEFFS 0 1000 0 0 0 1 /end COMPU_METHOD
/begin COMPU_METHOD t1usxms_q0p001 "" RAT_FUNC "%6.5" "ms" COEFFS 0 1 0 0 0 0.001 /end COMPU_METHOD
/begin COMPU_METHOD TempDiff_Kelv "" RAT_FUNC "%6.3" "K" COEFFS 0 10 0 0 0 1 /end COMPU_METHOD
/begin COMPU_METHOD Temp_Cels "" RAT_FUNC "%6.1" "deg C" COEFFS 0 10 2731.4 0 0 1 /end COMPU_METHOD
/begin COMPU_METHOD Temp_Kelv "" RAT_FUNC "%6.3" "K" COEFFS 0 10 0 0 0 1 /end COMPU_METHOD
/begin COMPU_METHOD temp_q1_om30 "" RAT_FUNC "%6.2" "Grad C" COEFFS 0 1 30 0 0 1 /end COMPU_METHOD
/begin COMPU_METHOD temp_sb_b0p093 "" RAT_FUNC "%6.5" "Grad C" COEFFS 0 512 0 0 0 0.375 /end COMPU_METHOD
/begin COMPU_METHOD temp_ub_q5_o50 "" RAT_FUNC "%6.2" "Grad C" COEFFS 0 1 50 0 0 5 /end COMPU_METHOD
/begin COMPU_METHOD txms_uw_q0p001 "" RAT_FUNC "%6.5" "ms" COEFFS 0 1000 0 0 0 1 /end COMPU_METHOD
/begin COMPU_METHOD t_q0p001 "" RAT_FUNC "%6.5" "s" COEFFS 0 1000 0 0 0 1 /end COMPU_METHOD
/begin COMPU_METHOD t_q0p001_ms "" RAT_FUNC "%6.5" "ms" COEFFS 0 1 0 0 0 0.001 /end COMPU_METHOD
/begin COMPU_METHOD t_q0p01 "" RAT_FUNC "%6.4" "s" COEFFS 0 100 0 0 0 1 /end COMPU_METHOD
/begin COMPU_METHOD t_q0p02 "" RAT_FUNC "%6.4" "s" COEFFS 0 100 0 0 0 2 /end COMPU_METHOD
/begin COMPU_METHOD t_q0p05 "" RAT_FUNC "%6.4" "s" COEFFS 0 100 0 0 0 5 /end COMPU_METHOD
/begin COMPU_METHOD t_q0p1 "" RAT_FUNC "%6.3" "s" COEFFS 0 10 0 0 0 1 /end COMPU_METHOD
/begin COMPU_METHOD t_q1 "" RAT_FUNC "%6.2" "s" COEFFS 0 1 0 0 0 1 /end COMPU_METHOD
/begin COMPU_METHOD Vel "" RAT_FUNC "%6.4" "km/h" COEFFS 0 100 0 0 0 1 /end COMPU_METHOD
/begin COMPU_METHOD vel_q0p01 "" RAT_FUNC "%6.4" "km/h" COEFFS 0 100 0 0 0 1 /end COMPU_METHOD
/begin COMPU_METHOD vfzg_ub_q1p25 "" RAT_FUNC "%6.2" "km/h" COEFFS 0 1 0 0 0 1.25 /end COMPU_METHOD
/begin COMPU_METHOD vfzg_uw_b512 "" RAT_FUNC "%6.4" "km/h" COEFFS 0 65536 0 0 0 512 /end COMPU_METHOD
/begin COMPU_METHOD zk100msxs_uw_b6553 "" RAT_FUNC "%6.1" "s" COEFFS 0 0 65536 0 10 0 /end COMPU_METHOD
/begin COMPU_METHOD zk10msxs_uw_b655 "" RAT_FUNC "%6.2" "s" COEFFS 0 0 65536 0 100 0 /end COMPU_METHOD
/begin COMPU_METHOD zk10msxs_uw_b655p36 "" RAT_FUNC "%6.2" "s" COEFFS 0 0 65536 0 100 0 /end COMPU_METHOD
/begin COMPU_METHOD zw_q0p75 "" RAT_FUNC "%6.3" "Grad KW" COEFFS 0 4 0 0 0 3 /end COMPU_METHOD
/begin COMPU_METHOD zw_sb_q0p75 "" RAT_FUNC "%6.3" "Grad KW" COEFFS 0 255 0 0 0 191.25 /end COMPU_METHOD
/begin COMPU_METHOD zw_sw_q0p75 "" RAT_FUNC "%6.3" "Grad KW" COEFFS 0 65536 0 0 0 49152 /end COMPU_METHOD
/begin RECORD_LAYOUT GkfWS8 FNC_VALUES 1 SBYTE COLUMN_DIR DIRECT /end RECORD_LAYOUT
/begin RECORD_LAYOUT GkfWU8 FNC_VALUES 1 UBYTE COLUMN_DIR DIRECT /end RECORD_LAYOUT
/begin RECORD_LAYOUT KfAxU8AyU8SstxS16SstyS16WS16 NO_AXIS_PTS_X 1 SWORD NO_AXIS_PTS_Y 2 SWORD AXIS_PTS_X 3 SWORD INDEX_INCR DIRECT AXIS_PTS_Y 4 SWORD INDEX_INCR DIRECT FNC_VALUES 5 SWORD COLUMN_DIR DIRECT /end RECORD_LAYOUT
/begin RECORD_LAYOUT KfAxU8AyU8SstxU16SstyU16WS16 NO_AXIS_PTS_X 1 UWORD NO_AXIS_PTS_Y 2 UWORD AXIS_PTS_X 3 UWORD INDEX_INCR DIRECT AXIS_PTS_Y 4 UWORD INDEX_INCR DIRECT FNC_VALUES 5 SWORD COLUMN_DIR DIRECT /end RECORD_LAYOUT
/begin RECORD_LAYOUT KfAxU8AyU8SstxU16SstyU16WU16 NO_AXIS_PTS_X 1 UWORD NO_AXIS_PTS_Y 2 UWORD AXIS_PTS_X 3 UWORD INDEX_INCR DIRECT AXIS_PTS_Y 4 UWORD INDEX_INCR DIRECT FNC_VALUES 5 UWORD COLUMN_DIR DIRECT /end RECORD_LAYOUT
/begin RECORD_LAYOUT KfAxU8AyU8SstxU8SstyU16WU16 NO_AXIS_PTS_X 1 UBYTE NO_AXIS_PTS_Y 2 UBYTE AXIS_PTS_X 3 UBYTE INDEX_INCR DIRECT AXIS_PTS_Y 4 UWORD INDEX_INCR DIRECT FNC_VALUES 5 UWORD COLUMN_DIR DIRECT /end RECORD_LAYOUT
/begin RECORD_LAYOUT KfAxU8AyU8SstxU8SstyU8WS8 NO_AXIS_PTS_X 1 UBYTE NO_AXIS_PTS_Y 2 UBYTE AXIS_PTS_X 3 UBYTE INDEX_INCR DIRECT AXIS_PTS_Y 4 UBYTE INDEX_INCR DIRECT FNC_VALUES 5 SBYTE COLUMN_DIR DIRECT /end RECORD_LAYOUT
/begin RECORD_LAYOUT KfAxUbAyUbSstxUwSstyUwWUw NO_AXIS_PTS_X 1 UWORD NO_AXIS_PTS_Y 2 UWORD AXIS_PTS_X 3 UWORD INDEX_INCR DIRECT AXIS_PTS_Y 4 UWORD INDEX_INCR DIRECT FNC_VALUES 5 UWORD COLUMN_DIR DIRECT /end RECORD_LAYOUT
/begin RECORD_LAYOUT KlAUbSstUbWUb NO_AXIS_PTS_X 1 UBYTE AXIS_PTS_X 2 UBYTE INDEX_INCR DIRECT FNC_VALUES 3 UBYTE COLUMN_DIR DIRECT /end RECORD_LAYOUT
/begin RECORD_LAYOUT KlAUbSstUbWUw_Static NO_AXIS_PTS_X 1 UBYTE AXIS_PTS_X 2 UBYTE INDEX_INCR DIRECT FNC_VALUES 3 UWORD COLUMN_DIR DIRECT STATIC_RECORD_LAYOUT /end RECORD_LAYOUT
/begin RECORD_LAYOUT KlAUwSstUwWUw NO_AXIS_PTS_X 1 UWORD AXIS_PTS_X 2 UWORD INDEX_INCR DIRECT FNC_VALUES 3 UWORD COLUMN_DIR DIRECT /end RECORD_LAYOUT
/begin RECORD_LAYOUT KlAxU8SstxS16WS16 NO_AXIS_PTS_X 1 SWORD AXIS_PTS_X 2 SWORD INDEX_INCR DIRECT FNC_VALUES 3 SWORD COLUMN_DIR DIRECT /end RECORD_LAYOUT
/begin RECORD_LAYOUT KlAxU8SstxS16WU16_Static NO_AXIS_PTS_X 1 UWORD AXIS_PTS_X 2 SWORD INDEX_INCR DIRECT FNC_VALUES 3 UWORD COLUMN_DIR DIRECT STATIC_RECORD_LAYOUT /end RECORD_LAYOUT
/begin RECORD_LAYOUT KlAxU8SstxU16WS8_Static NO_AXIS_PTS_X 1 UBYTE AXIS_PTS_X 2 UWORD INDEX_INCR DIRECT FNC_VALUES 3 SBYTE COLUMN_DIR DIRECT STATIC_RECORD_LAYOUT /end RECORD_LAYOUT
/begin RECORD_LAYOUT KlAxU8SstxU8WU16_Static NO_AXIS_PTS_X 1 UBYTE AXIS_PTS_X 2 UBYTE INDEX_INCR DIRECT FNC_VALUES 3 UWORD COLUMN_DIR DIRECT STATIC_RECORD_LAYOUT /end RECORD_LAYOUT
/begin RECORD_LAYOUT KwSw FNC_VALUES 1 SWORD COLUMN_DIR DIRECT /end RECORD_LAYOUT
/begin RECORD_LAYOUT KwUb FNC_VALUES 1 UBYTE COLUMN_DIR DIRECT /end RECORD_LAYOUT
/begin RECORD_LAYOUT KwUl FNC_VALUES 1 ULONG COLUMN_DIR DIRECT /end RECORD_LAYOUT
/begin RECORD_LAYOUT KwUw FNC_VALUES 1 UWORD COLUMN_DIR DIRECT /end RECORD_LAYOUT
/begin RECORD_LAYOUT KwWS16 FNC_VALUES 1 SWORD COLUMN_DIR DIRECT /end RECORD_LAYOUT
/begin RECORD_LAYOUT KwWS8 FNC_VALUES 1 SBYTE COLUMN_DIR DIRECT /end RECORD_LAYOUT
/begin RECORD_LAYOUT KwWU16 FNC_VALUES 1 UWORD COLUMN_DIR DIRECT /end RECORD_LAYOUT
/begin RECORD_LAYOUT KwWU8 FNC_VALUES 1 UBYTE COLUMN_DIR DIRECT /end RECORD_LAYOUT
/begin RECORD_LAYOUT RB_Curve_S16_S16 NO_AXIS_PTS_X 1 SWORD AXIS_PTS_X 2 SWORD INDEX_INCR DIRECT FNC_VALUES 3 SWORD COLUMN_DIR DIRECT /end RECORD_LAYOUT
/begin RECORD_LAYOUT RB_Curve_S16_S8_Static NO_AXIS_PTS_X 1 SWORD AXIS_PTS_X 2 SWORD INDEX_INCR DIRECT FNC_VALUES 3 SBYTE COLUMN_DIR DIRECT STATIC_RECORD_LAYOUT /end RECORD_LAYOUT
/begin RECORD_LAYOUT RB_Curve_U16_S16_Static NO_AXIS_PTS_X 1 UWORD AXIS_PTS_X 2 UWORD INDEX_INCR DIRECT FNC_VALUES 3 SWORD COLUMN_DIR DIRECT STATIC_RECORD_LAYOUT /end RECORD_LAYOUT
/begin RECORD_LAYOUT RB_Curve_U16_U8_Static NO_AXIS_PTS_X 1 UWORD AXIS_PTS_X 2 UWORD INDEX_INCR DIRECT FNC_VALUES 3 UBYTE COLUMN_DIR DIRECT STATIC_RECORD_LAYOUT /end RECORD_LAYOUT
/begin RECORD_LAYOUT RB_Curve_U8_U8 NO_AXIS_PTS_X 1 UBYTE AXIS_PTS_X 2 UBYTE INDEX_INCR DIRECT FNC_VALUES 3 UBYTE COLUMN_DIR DIRECT /end RECORD_LAYOUT
/begin RECORD_LAYOUT RB_Map_U16S16_S8 NO_AXIS_PTS_X 1 UWORD NO_AXIS_PTS_Y 2 UWORD AXIS_PTS_X 3 UWORD INDEX_INCR DIRECT AXIS_PTS_Y 4 SWORD INDEX_INCR DIRECT FNC_VALUES 5 SBYTE COLUMN_DIR DIRECT /end RECORD_LAYOUT
/begin RECORD_LAYOUT RB_Val_Ws16 FNC_VALUES 1 SWORD COLUMN_DIR DIRECT /end RECORD_LAYOUT
/begin RECORD_LAYOUT RB_Val_Ws32 FNC_VALUES 1 SLONG COLUMN_DIR DIRECT /end RECORD_LAYOUT
/begin RECORD_LAYOUT RB_Val_Wu16 FNC_VALUES 1 UWORD COLUMN_DIR DIRECT /end RECORD_LAYOUT
/begin RECORD_LAYOUT RB_Val_Wu8 FNC_VALUES 1 UBYTE COLUMN_DIR DIRECT /end RECORD_LAYOUT
/begin RECORD_LAYOUT SstAU8SstU16 NO_AXIS_PTS_X 1 UWORD AXIS_PTS_X 2 UWORD INDEX_INCR DIRECT /end RECORD_LAYOUT
/begin RECORD_LAYOUT SstAU8SstU8 NO_AXIS_PTS_X 1 UBYTE AXIS_PTS_X 2 UBYTE INDEX_INCR DIRECT /end RECORD_LAYOUT
/begin RECORD_LAYOUT Val_Ws16 FNC_VALUES 1 SWORD COLUMN_DIR DIRECT /end RECORD_LAYOUT
/begin RECORD_LAYOUT Val_Wu8 FNC_VALUES 1 UBYTE COLUMN_DIR DIRECT /end RECORD_LAYOUT
/end MODULE
/end PROJECT
