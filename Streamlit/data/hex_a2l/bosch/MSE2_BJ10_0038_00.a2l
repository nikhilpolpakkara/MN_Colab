ASAP2_VERSION 1 60
/begin PROJECT MSE2_BJ10_0038_00 "MDG1"
/begin HEADER "" VERSION "MSE2_BJ10_0038_00" PROJECT_NO MSE2_BJ10_0038_00 /end HEADER
/begin MODULE DIM ""
/begin MOD_COMMON "" BYTE_ORDER MSB_FIRST ALIGNMENT_BYTE 1 ALIGNMENT_WORD 2 ALIGNMENT_LONG 4 ALIGNMENT_INT64 4 ALIGNMENT_FLOAT32_IEEE 4 ALIGNMENT_FLOAT64_IEEE 4 /end MOD_COMMON
/begin CHARACTERISTIC AirMod_IdleSuprt_C "parameter to consider mass flow for idle control support along with screw" VALUE 0x9083E82 KwWU8 255.0 dez 0.00 255.0 FORMAT "%5.1" /end CHARACTERISTIC
/begin CHARACTERISTIC ANZMINPUSAMPL "minimum ambient pressure sample parameter" VALUE 0x9083E2C KwWU16 30.00000 dez 0.00 30.00000 FORMAT "%8.5" EXTENDED_LIMITS 0.00 65535.00 /end CHARACTERISTIC
/begin CHARACTERISTIC ANZPUTCTSYN "Number to set engine cycle counter based on number of samples for part load adoptation" VALUE 0x9083E2E KwWU8 254.0 dez 1.000 255.0 FORMAT "%5.1" EXTENDED_LIMITS 0.00 255.0 /end CHARACTERISTIC
/begin CHARACTERISTIC ATMTANS "temperature correction of the exhaust model temperature" CURVE 0x908392C KlAxU8SstxS16WS16 1275.000 temp_q5 -640.0000 635.0000 FORMAT "%8.4" EXTENDED_LIMITS -163840.0 163835.0
 /begin AXIS_DESCR STD_AXIS tans Temp_Cels 3 -3549.940 3003.560 FORMAT "%8.3" DEPOSIT ABSOLUTE /end AXIS_DESCR
/end CHARACTERISTIC
/begin CHARACTERISTIC ATS_numIgnImp_C "Number of the ignitions for actuator test" VALUE 0x9083C56 KwWU16 65535.00 dez 0.00 65535.00 FORMAT "%8.2" /end CHARACTERISTIC
/begin CHARACTERISTIC ATS_Standby_Disabled_C "Activate or deactivate Standbytest" VALUE 0x9089EA4 Val_Wu8 255.0 OneToOne 0.00 255.0 FORMAT "%5.1" /end CHARACTERISTIC
/begin CHARACTERISTIC ATS_tiIgnLngth_C "Ignition duration for actuator test" VALUE 0x9083C58 KwWU16 65.53500 t_q0p001_ms 0.00 65.53500 FORMAT "%8.5" /end CHARACTERISTIC
/begin CHARACTERISTIC ATS_tiIgnPer_C "Ignition period for actuator test" VALUE 0x9083C5A KwWU16 65.53500 txms_uw_q0p001 0.00 65.53500 FORMAT "%8.5" /end CHARACTERISTIC
/begin CHARACTERISTIC ATS_tiTstDemHeal_C "Minimum time without actuator test for re-release after time" VALUE 0x9089EA6 Val_Wu16 655.3500 Time_s 0.00 655.3500 FORMAT "%8.4" /end CHARACTERISTIC
/begin CHARACTERISTIC ATS_tiTstDemMax_C "Maximum permissible actuator test time" VALUE 0x9089EA8 Val_Wu16 655.3500 Time_s 0.00 655.3500 FORMAT "%8.4" /end CHARACTERISTIC
/begin CHARACTERISTIC ATS_TmrBehaviour_C "Time limit response for new tester demands" VALUE 0x9089EAA Val_Wu8 255.0 OneToOne 0.00 255.0 FORMAT "%5.1" /end CHARACTERISTIC
/begin CHARACTERISTIC ATS_TstDemMaxEngN_C "Maximum permissible engine speed for actuator test" VALUE 0x9089EAB Val_Wu8 10200. EngN_LRes 0.00 10200. FORMAT "%5.0" /end CHARACTERISTIC
/begin CHARACTERISTIC ATS_TstDemMaxVSSCDV_C "Maximum permissible vehicle speed for actuator test" VALUE 0x9089EAC Val_Ws16 655.3500 Vel -327.6800 327.6700 FORMAT "%8.4" /end CHARACTERISTIC
/begin CHARACTERISTIC BusDiag_stOpenLoadErrMskCan0_C "Open Load Error Mask for Can 0" VALUE 0x9081350 KwWU32 4294967295.00 dez 0.00 4294967295.00 FORMAT "%13.2" /end CHARACTERISTIC
/begin CHARACTERISTIC BusDiag_tiInitFadeOutCan0_C "Fade Out time for Can 0" VALUE 0x9089ED0 Val_Wu16 655350.0 Time_ms 0.00 655350.0 FORMAT "%8.1" /end CHARACTERISTIC
/begin CHARACTERISTIC CoEng_nDeltaFuCutOff_T "Engine speed threshold for fuel cut off based on current gear" CURVE 0x9083D00 KlAxU8SstxU16WU16 16383.75 nmot_uw_q0p25 0.00 16383.75 FORMAT "%8.2"
 /begin AXIS_DESCR STD_AXIS gangi dez 7 0.00 255.0000 FORMAT "%8.4" EXTENDED_LIMITS 0.00 65535.00 DEPOSIT ABSOLUTE /end AXIS_DESCR
/end CHARACTERISTIC
/begin CHARACTERISTIC CoEng_swtFuCutOffSeln_C "Switch to select the logic for fuel cut off threshold computation." VALUE 0x9083D1E KwWU8 1.00000000000 B_TRUE 0.00 1.00000000000 FORMAT "%13.11" /end CHARACTERISTIC
/begin CHARACTERISTIC CWAEVAB "codeword AEVAB" VALUE 0x908386E KwWU8 255.0 dez 0.00 255.0 FORMAT "%5.1" /end CHARACTERISTIC
/begin CHARACTERISTIC CWAPPLIF "Codeword application interface" VALUE 0x9083C62 KwWU16 65535.00 dez 0.00 65535.00 FORMAT "%8.2" /end CHARACTERISTIC
/begin CHARACTERISTIC CWATM "Codeword for exhaust temperature model" VALUE 0x908393A KwWU8 255.0 dez 0.00 255.0 FORMAT "%5.1" /end CHARACTERISTIC
/begin CHARACTERISTIC CWBBTEGA "codeword activation canister purge, mixture adaptation" VALUE 0x9083D60 KwWU8 255.0 dez 0.00 255.0 FORMAT "%5.1" /end CHARACTERISTIC
/begin CHARACTERISTIC CWBGKMST "CWBGKMST- 0:Vehicle speed considered for distance calculation 1:Front Wheel speed from ABSCom_vABSFrnt-WhlSpd is used when Com_flgFrntwhlSpd?Vld is TRUE, otherwise Com_vABSReWhlSpd is used for the calculation of distance travelled" VALUE 0x9083E2A KwWU8 255.0 OneToOne 0.00 255.0 FORMAT "%5.1" /end CHARACTERISTIC
/begin CHARACTERISTIC CWBGRL "code word for BGRL" VALUE 0x9084D4E KwWU8 255.0 dez 0.00 255.0 FORMAT "%5.1" /end CHARACTERISTIC
/begin CHARACTERISTIC CWEVAB "codeword injection valve cutoff" VALUE 0x9083C64 KwWU8 255.0 dez 0.00 255.0 FORMAT "%5.1" /end CHARACTERISTIC
/begin CHARACTERISTIC CWMDARE "Codeword delta torque from antijerking" VALUE 0x9083870 KwWU8 255.0 dez 0.00 255.0 FORMAT "%5.1" /end CHARACTERISTIC
/begin CHARACTERISTIC DDRC_DurDeb.BusDiag_tiBusOffOL_Can0DebOk_C "debouncing parameter / Duration of healing debouncing for check DFC_BusDiagOpenLoad_Can0" VALUE 0x9080388 Val_Wu16 655350.0 DDRCTime_ms 0.00 655350.0 FORMAT "%8.1" /end CHARACTERISTIC
/begin CHARACTERISTIC DDRC_DurDeb.BusDiag_tiBusOffOL_Can0DebDef_C "debouncing parameter / Duration of defect debouncing for check DFC_BusDiagOpenLoad_Can0" VALUE 0x908038A Val_Wu16 655350.0 DDRCTime_ms 0.00 655350.0 FORMAT "%8.1" /end CHARACTERISTIC
/begin CHARACTERISTIC DDRC_DurDeb.BusDiag_numBusOff_Can0DebOk_C "debouncing parameter / Duration of healing debouncing for check DFC_BusDiagBusOff_Can0" VALUE 0x9080394 Val_Wu16 65535.00 OneToOne 0.00 65535.00 FORMAT "%8.2" /end CHARACTERISTIC
/begin CHARACTERISTIC DDRC_DurDeb.BusDiag_numBusOff_Can0DebDef_C "debouncing parameter / Duration of defect debouncing for check DFC_BusDiagBusOff_Can0" VALUE 0x9080396 Val_Wu16 65535.00 OneToOne 0.00 65535.00 FORMAT "%8.2" /end CHARACTERISTIC
/begin CHARACTERISTIC DFC_CtlMsk2.DFC_BusDiagOpenLoad_Can0_C "Behaviour control mask / Behaviour control masks of check DFC_BusDiagOpenLoad_Can0" VALUE 0x9080399 Val_Wu8 255.0 DFES_OneToOne 0.00 255.0 FORMAT "%5.1" /end CHARACTERISTIC
/begin CHARACTERISTIC DFC_CtlMsk2.DFC_BusDiagBusOff_Can0_C "Behaviour control mask / Behaviour control masks of check DFC_BusDiagBusOff_Can0" VALUE 0x908039C Val_Wu8 255.0 DFES_OneToOne 0.00 255.0 FORMAT "%5.1" /end CHARACTERISTIC
/begin CHARACTERISTIC DFC_DisblMsk2.DFC_BusDiagOpenLoad_Can0_C "disable mask / Disable masks of check DFC_BusDiagOpenLoad_Can0" VALUE 0x9080D69 Val_Wu8 255.0 DFES_OneToOne 0.00 255.0 FORMAT "%5.1" /end CHARACTERISTIC
/begin CHARACTERISTIC DFC_DisblMsk2.DFC_BusDiagBusOff_Can0_C "disable mask / Disable masks of check DFC_BusDiagBusOff_Can0" VALUE 0x9080D6C Val_Wu8 255.0 DFES_OneToOne 0.00 255.0 FORMAT "%5.1" /end CHARACTERISTIC
/begin CHARACTERISTIC DFGWAR "Delta for ramp of factor gear change anti-jerking function" VALUE 0x9083872 KwWU16 1.000000 fak_uw_b2 0.00 1.000000 FORMAT "%8.6" EXTENDED_LIMITS 0.00 1.999969 /end CHARACTERISTIC
/begin CHARACTERISTIC DNDIA "Delta engine speed for overrun fuel cut-off in case of defective idle actuator" VALUE 0x9083D1F KwWU8 10200. nmot_ub_q40 0.00 10200. FORMAT "%5.0" /end CHARACTERISTIC
/begin CHARACTERISTIC DNSAHY "Delta engine speed for hysteresis in case of overrun fuel cut-off" VALUE 0x9083D20 KwWU8 10200. nmot_ub_q40 0.00 10200. FORMAT "%5.0" /end CHARACTERISTIC
/begin CHARACTERISTIC DNWEGN "Delta engine speed for overrun fuel cut-off" CURVE 0x9083D22 KlAxU8SstxS16WU16_Static 16383.75 nmot_uw_q0p25 0.00 16383.75 FORMAT "%8.2"
 /begin AXIS_DESCR STD_AXIS nmotgfil_w nmot_sw_q0p25 4 -8192.000 8191.750 FORMAT "%8.3" DEPOSIT ABSOLUTE /end AXIS_DESCR
/end CHARACTERISTIC
/begin CHARACTERISTIC DOFMSDKMNQ "delta min value offset norm air mass flow through throttle" VALUE 0x9083D6C KwWS16 655.3500 m_sw_q0p01 -327.6800 327.6700 FORMAT "%8.4" /end CHARACTERISTIC
/begin CHARACTERISTIC DOFMSDKMXQ "delta max value offset norm air mass flow through throttle" VALUE 0x9083D6E KwWS16 655.3500 m_sw_q0p01 -327.6800 327.6700 FORMAT "%8.4" /end CHARACTERISTIC
/begin CHARACTERISTIC DPUMADPTL "Delta pressure check to confirm jumpsactual adopt value" VALUE 0x9083E30 KwWU16 2559.961 p_uw_q0p039 0.00 2559.961 FORMAT "%8.3" /end CHARACTERISTIC
/begin CHARACTERISTIC DPUPVDK "pressure difference pu-pvdk" CURVE 0x9083E32 KlAxU8SstxU16WU16 2559.961 p_uw_q0p039 0.00 2559.961 FORMAT "%8.3"
 /begin AXIS_DESCR STD_AXIS msdkrohq_w m_uw_b655p35 6 0.00 655.3500 FORMAT "%8.4" DEPOSIT ABSOLUTE /end AXIS_DESCR
/end CHARACTERISTIC
/begin CHARACTERISTIC DRLDKTN "Min delta charge value due to model tolerances" VALUE 0x9083E84 KwWU16 39.99939 rel_uw_b40 0.00 39.99939 FORMAT "%8.5" /end CHARACTERISTIC
/begin CHARACTERISTIC DRLDKTX "Max delta charge value due to model tolerances" VALUE 0x9083E86 KwWU16 39.99939 rel_uw_b40 0.00 39.99939 FORMAT "%8.5" /end CHARACTERISTIC
/begin CHARACTERISTIC DTKH "absolute value difference (tans -tmst) for catalyst heating" VALUE 0x9083C84 KwWS16 6553.500 Temp_Cels -3549.940 3003.560 FORMAT "%8.3" /end CHARACTERISTIC
/begin CHARACTERISTIC DWDKFAR "Threshold for filtered delta throttle angle" VALUE 0x9083874 KwWS16 1599.976 relDK_q0p02441 -800.0000 799.9756 FORMAT "%8.4" /end CHARACTERISTIC
/begin CHARACTERISTIC DZWAPP "ignition angle offset for application" VALUE 0x9083C65 KwWS8 191.3 zw_sb_q0p75 -96.00 95.25 FORMAT "%5.2" /end CHARACTERISTIC
/begin CHARACTERISTIC DZWAPP2 "ignition angle offset for application" VALUE 0x9083C66 KwWS8 191.3 zw_sb_q0p75 -96.00 95.25 FORMAT "%5.2" /end CHARACTERISTIC
/begin CHARACTERISTIC ExhMgT_tiMaxActvCatHeatg_M "Map maximum time for active catalyst heating" MAP 0x9083C86 KfAxU8AyU8SstxS16SstyU16WU16 6553.500 t100msxs_uw_b6553p5 0.00 6553.500 FORMAT "%8.3"
 /begin AXIS_DESCR STD_AXIS EngDa_tStrt Temp_Cels 5 -3549.940 3003.560 FORMAT "%8.3" DEPOSIT ABSOLUTE /end AXIS_DESCR
 /begin AXIS_DESCR STD_AXIS fho_w fak_uw_b4 5 0.00 3.999939 FORMAT "%8.6" DEPOSIT ABSOLUTE /end AXIS_DESCR
/end CHARACTERISTIC
/begin CHARACTERISTIC ExhMod_flgSelFcoCpvCls_C "Flag to select Condition fuel cut-off requested for canister purge valve close" VALUE 0x908393B KwWU8 1.00000000000 B_TRUE 0.00 1.00000000000 FORMAT "%13.11" /end CHARACTERISTIC
/begin CHARACTERISTIC ExhMod_numMaxColdStrtTSPS1_C "number of cold start threshold for dew point end consideration for TSPS1" VALUE 0x908393C KwWU8 255.0 dez 0.00 255.0 FORMAT "%5.1" /end CHARACTERISTIC
/begin CHARACTERISTIC ExhMod_qHeatgDewpEndTSPS1_M "Heat quantity model for dew point estimation for TSPS1" MAP 0x908393E KfAxU8AyU8SstxS16SstyS16WS16 14912.63 q_q0p4551 0.00 14912.63 FORMAT "%8.2" EXTENDED_LIMITS -14913.08 14912.63
 /begin AXIS_DESCR STD_AXIS taikrmmst temp_ub_q5_o50 5 -50.00000 1225.000 FORMAT "%8.3" EXTENDED_LIMITS -163890.0 163785.0 DEPOSIT ABSOLUTE /end AXIS_DESCR
 /begin AXIS_DESCR STD_AXIS EngDa_tStrt Temp_Cels 5 -3549.940 3003.560 FORMAT "%8.3" DEPOSIT ABSOLUTE /end AXIS_DESCR
/end CHARACTERISTIC
/begin CHARACTERISTIC ExhMod_tCorrnEgMnfld_Crv "Characterisitc curve for the correction of exhaust gas manifold temperature modelled value" CURVE 0x9083988 GklWU8 1275. temp_ub_q5_o50 -50.00 1225. FORMAT "%5.0"
 /begin AXIS_DESCR COM_AXIS ml_w m_uw_b6553p5 6 0.00 6553.500 FORMAT "%8.3" AXIS_PTS_REF SML06TMUW /end AXIS_DESCR
/end CHARACTERISTIC
/begin CHARACTERISTIC ExhMod_tiDlyEgTDurgFuCutOff_C "Delay for exhaust gas temperature update by fixed value TATMSA during fuel cutoff" VALUE 0x908398E KwWU8 3.000 t_q0p2 0.00 3.000 FORMAT "%5.3" EXTENDED_LIMITS 0.00 51.00 /end CHARACTERISTIC
/begin CHARACTERISTIC ExhMod_tRampEgMf_Crv "Characterisitc curve for the exhaust gas manifold temperature ramp based on mass flow" CURVE 0x9083990 KlAxU8SstxU16WU8_Static 1275. temp_q5 0.00 1275. FORMAT "%5.0"
 /begin AXIS_DESCR STD_AXIS ml_w m_uw_b6553p5 6 0.00 6553.500 FORMAT "%8.3" DEPOSIT ABSOLUTE /end AXIS_DESCR
/end CHARACTERISTIC
/begin CHARACTERISTIC ExhMod_tStatEgCorrnEng_T "Characteristic curve for the correction of Exhaust gas static temperature based on the Engine temperature" CURVE 0x90839A4 KlAxU8SstxS16WU16_Static 49151.25 temp_ub_q0p75_o48 -48.00000 49103.25 FORMAT "%8.2"
 /begin AXIS_DESCR STD_AXIS EngDa_tEng Temp_Cels 5 -3549.940 3003.560 FORMAT "%8.3" DEPOSIT ABSOLUTE /end AXIS_DESCR
/end CHARACTERISTIC
/begin CHARACTERISTIC FATMRML "divide factor exhaust-/exhaust-pipe temperature" CURVE 0x90839BA GklWU8 0.9961 fak_ub_b1 0.00 0.9961
 /begin AXIS_DESCR COM_AXIS ml_w m_uw_b6553p5 6 0.00 6553.500 FORMAT "%8.3" AXIS_PTS_REF SML06TMUW /end AXIS_DESCR
/end CHARACTERISTIC
/begin CHARACTERISTIC FGWARST "Start value of factor gear change anti-jerking function" VALUE 0x9083876 KwWU16 1.000000 fak_uw_b2 0.00 1.000000 FORMAT "%8.6" EXTENDED_LIMITS 0.00 1.999969 /end CHARACTERISTIC
/begin CHARACTERISTIC FHOAPP "Ini value altitude factor for application" VALUE 0x9083C68 KwWU16 3.999939 fak_uw_b4 0.00 3.999939 FORMAT "%8.6" /end CHARACTERISTIC
/begin CHARACTERISTIC FHOCORR "Curve: Altitude correction factor" CURVE 0x908484E KlAxU8SstxU16WU16 3.999939 fak_uw_b4 0.00 3.999939 FORMAT "%8.6"
 /begin AXIS_DESCR STD_AXIS fho_w fak_uw_b4 10 0.00 3.999939 FORMAT "%8.6" DEPOSIT ABSOLUTE /end AXIS_DESCR
/end CHARACTERISTIC
/begin CHARACTERISTIC FHOE "default value for altitude in case of sensor failure" VALUE 0x9083E4C KwWU8 3.984 fak_ub_b4 0.00 3.984 FORMAT "%5.3" /end CHARACTERISTIC
/begin CHARACTERISTIC FHOKH "minimum altitude threshold to enable catalyst heating" VALUE 0x9083CCE KwWU16 3.999939 fak_uw_b4 0.00 3.999939 FORMAT "%8.6" /end CHARACTERISTIC
/begin CHARACTERISTIC FKHABMN "threshold terminating factor catalyst heating" VALUE 0x9083CD0 KwWU8 0.9961 fak_ub_b1 0.00 0.9961 /end CHARACTERISTIC
/begin CHARACTERISTIC FKPVDKMN "lower limit for mass-flow correction of throttle valve" VALUE 0x9083D70 KwWU16 3.999939 fak_uw_b4 0.00 3.999939 FORMAT "%8.6" /end CHARACTERISTIC
/begin CHARACTERISTIC FKPVDKMX "high limit for mass-flow correction of throttle valve" VALUE 0x9083D72 KwWU16 3.999939 fak_uw_b4 0.00 3.999939 FORMAT "%8.6" /end CHARACTERISTIC
/begin CHARACTERISTIC FKRLXVL "correction factor maximum air charge at full load" VALUE 0x9084D1C KwWU16 1.999969 fak_uw_b2 0.00 1.999969 FORMAT "%8.6" /end CHARACTERISTIC
/begin CHARACTERISTIC FPCtl_tEngThd_C "engine-temperature threshold for canister purge" VALUE 0x9083D62 KwWS16 6553.500 Temp_Cels -3549.940 3003.560 FORMAT "%8.3" /end CHARACTERISTIC
/begin CHARACTERISTIC FPVDKMN "lower limit for pressure upstream of throttle valve" VALUE 0x9083E4E KwWU16 3.999939 fak_uw_b4 0.00 3.999939 FORMAT "%8.6" /end CHARACTERISTIC
/begin CHARACTERISTIC FPVDKMX "upper limit for pressure upstream of throttle valve" VALUE 0x9083E50 KwWU16 3.999939 fak_uw_b4 0.00 3.999939 FORMAT "%8.6" /end CHARACTERISTIC
/begin CHARACTERISTIC FPVDKTN "Minimum pressure factor correction for min mass flow limit" VALUE 0x9083E88 KwWU16 7.999878 fak_uw_b8 0.00 7.999878 FORMAT "%8.6" /end CHARACTERISTIC
/begin CHARACTERISTIC FPVDKTX "Maximum pressure factor correction for max mass flow limit" VALUE 0x9083E8A KwWU16 7.999878 fak_uw_b8 0.00 7.999878 FORMAT "%8.6" /end CHARACTERISTIC
/begin CHARACTERISTIC FRKAP "factor, relative fuel mass for application" VALUE 0x9083C6A KwWU8 1.992188 fak_ub_b2 0.00 1.992188 FORMAT "%8.6" /end CHARACTERISTIC
/begin CHARACTERISTIC FRLDKTN "Minimum charge factor value due to model tolerances" VALUE 0x9083E8C KwWU8 1.992188 fak_ub_b2 0.00 1.992188 FORMAT "%8.6" /end CHARACTERISTIC
/begin CHARACTERISTIC FRLDKTX "Maximum charge factor value due to model tolerances" VALUE 0x9083E8D KwWU8 1.992188 fak_ub_b2 0.00 1.992188 FORMAT "%8.6" /end CHARACTERISTIC
/begin CHARACTERISTIC FTAFTVDK "Curve: for the temperature correction factor" CURVE 0x9083D74 KlAxU8SstxS16WU16_Static 1.999969 fak_uw_b2 0.00 1.999969 FORMAT "%8.6"
 /begin AXIS_DESCR STD_AXIS tans Temp_Cels 12 -3549.940 3003.560 FORMAT "%8.3" DEPOSIT ABSOLUTE /end AXIS_DESCR
/end CHARACTERISTIC
/begin CHARACTERISTIC FWFTBRTA "Weighting for ftbr as a function of tans" CURVE 0x9084878 KlAxU8SstxS16WU16_Static 1.999969 fak_uw_b2 0.00 1.999969 FORMAT "%8.6"
 /begin AXIS_DESCR STD_AXIS evtmodfa Temp_Cels 14 -3549.940 3003.560 FORMAT "%8.3" DEPOSIT ABSOLUTE /end AXIS_DESCR
/end CHARACTERISTIC
/begin CHARACTERISTIC FWMABGW "factor heat quantity upstream pre-cat. when dew-point end not reached last trip" VALUE 0x90839C0 KwWU8 0.9961 fak_ub_b1 0.00 0.9961 /end CHARACTERISTIC
/begin CHARACTERISTIC FZKMSDKT "integrator speed for fast constant mass-flow adaption" VALUE 0x9083DA6 KwWU16 655.34999985 zk10msxs_uw_b655 0.010000152590 655.36000000 FORMAT "%12.8" /end CHARACTERISTIC
/begin CHARACTERISTIC FZKPVDKT "integrator speed for slow constant mass-flow adaption" VALUE 0x9083DA8 KwWU16 65534.000000 zk1sxs_uw_b65535 1.0000000000 65535.000000 FORMAT "%12.6" /end CHARACTERISTIC
/begin CHARACTERISTIC KATMIEXML "Temperature of the exotherme in the catalyst tikatm" CURVE 0x90839C1 GklWS8 1275. temp_q5 -640.0 635.0 FORMAT "%5.1"
 /begin AXIS_DESCR COM_AXIS ml_w m_uw_b6553p5 6 0.00 6553.500 FORMAT "%8.3" AXIS_PTS_REF SML06TMUW /end AXIS_DESCR
/end CHARACTERISTIC
/begin CHARACTERISTIC KFATMLA "map exhaust gas temperature correction = f(lambda)" MAP 0x90839C7 GkfWS8 1275. temp_q5 -640.0 635.0 FORMAT "%5.1"
 /begin AXIS_DESCR COM_AXIS ml_w m_uw_b6553p5 6 0.00 6553.500 FORMAT "%8.3" AXIS_PTS_REF SML06TMUW /end AXIS_DESCR
 /begin AXIS_DESCR COM_AXIS lamsol fak_q0p0039_op0p5 6 0.5000 1.496 FORMAT "%5.3" AXIS_PTS_REF SLM06TMUB /end AXIS_DESCR
/end CHARACTERISTIC
/begin CHARACTERISTIC KFATMZW "map exhaust gas temperature correction = f(ignition-variation)" MAP 0x90839EB GkfWS8 1275. temp_q5 -640.0 635.0 FORMAT "%5.1"
 /begin AXIS_DESCR COM_AXIS ml_w m_uw_b6553p5 6 0.00 6553.500 FORMAT "%8.3" AXIS_PTS_REF SML06TMUW /end AXIS_DESCR
 /begin AXIS_DESCR COM_AXIS etazwimt rel_ub_b127p5 6 0.00 127.5 FORMAT "%5.1" AXIS_PTS_REF SEZ06TMUB /end AXIS_DESCR
/end CHARACTERISTIC
/begin CHARACTERISTIC KFFKLLSMS "Correction value for idle air mass flow based throttle opening" MAP 0x9083E8E KfAxU8AyU8SstxS16SstyU16WU16 1.999969 fak_uw_b2 0.00 1.999969 FORMAT "%8.6"
 /begin AXIS_DESCR STD_AXIS wdkba_w relDK_q0p02441 14 -800.0000 799.9756 FORMAT "%8.4" DEPOSIT ABSOLUTE /end AXIS_DESCR
 /begin AXIS_DESCR STD_AXIS nmotfafz_w nmot_uw_q0p25 12 0.00 16383.75 FORMAT "%8.2" DEPOSIT ABSOLUTE /end AXIS_DESCR
/end CHARACTERISTIC
/begin CHARACTERISTIC KFFKMSDK "limit for fast mass-flow correction of throttle valve" MAP 0x9083DAA KfAxU8AyU8SstxU16SstyU16WU16 0.9999847 fak_uw_b1 0.00 0.9999847 FORMAT "%9.7"
 /begin AXIS_DESCR STD_AXIS wdkfawu_w relDK_uw_b100 6 0.00 100.0000 FORMAT "%8.4" DEPOSIT ABSOLUTE /end AXIS_DESCR
 /begin AXIS_DESCR STD_AXIS nmot_w nmot_uw_q0p25 6 0.00 16383.75 FORMAT "%8.2" DEPOSIT ABSOLUTE /end AXIS_DESCR
/end CHARACTERISTIC
/begin CHARACTERISTIC KFINTPSAN "characteristic map: interpolation of relative air charge between main charge signal, a-n model" MAP 0x9084D50 KfAxU8AyU8SstxU16SstyU16WU16 1.999969 fak_uw_b2 0.00 1.999969 FORMAT "%8.6"
 /begin AXIS_DESCR STD_AXIS wdkfawu_w relDK_uw_b100 12 0.00 100.0000 FORMAT "%8.4" DEPOSIT ABSOLUTE /end AXIS_DESCR
 /begin AXIS_DESCR STD_AXIS nmot_w nmot_uw_q0p25 12 0.00 16383.75 FORMAT "%8.2" DEPOSIT ABSOLUTE /end AXIS_DESCR
/end CHARACTERISTIC
/begin CHARACTERISTIC KFMSOLLS "Map for scaled mass flow over idle speed actuator" MAP 0x9084014 KfAxU8AyU8SstxS16SstyU16WU16 655.3500 m_uw_b655p35 0.00 655.3500 FORMAT "%8.4"
 /begin AXIS_DESCR STD_AXIS ollst_w rel_sw_b100 14 -100.0000 99.99695 FORMAT "%8.4" DEPOSIT ABSOLUTE /end AXIS_DESCR
 /begin AXIS_DESCR STD_AXIS nmot_w nmot_uw_q0p25 12 0.00 16383.75 FORMAT "%8.2" DEPOSIT ABSOLUTE /end AXIS_DESCR
/end CHARACTERISTIC
/begin CHARACTERISTIC KFMSWDKQ "Map for real mass flow over throttle valve (increased resolution)" MAP 0x908419A KfAxU8AyU8SstxS16SstyU16WU16 655.3500 m_uw_b655p35 0.00 655.3500 FORMAT "%8.4"
 /begin AXIS_DESCR STD_AXIS wdkba_w relDK_q0p02441 25 -800.0000 799.9756 FORMAT "%8.4" DEPOSIT ABSOLUTE /end AXIS_DESCR
 /begin AXIS_DESCR STD_AXIS nmot_w nmot_uw_q0p25 30 0.00 16383.75 FORMAT "%8.2" DEPOSIT ABSOLUTE /end AXIS_DESCR
/end CHARACTERISTIC
/begin CHARACTERISTIC KFRLSN "Map of relative fresh air as function of ps and engine speed" MAP 0x90848B2 KfAxU8AyU8SstxU16SstyU16WU16 1535.977 rel_uw_q0p0234 0.00 1535.977 FORMAT "%8.3"
 /begin AXIS_DESCR STD_AXIS psxzs_w p_uw_q0p039 20 0.00 2559.961 FORMAT "%8.3" DEPOSIT ABSOLUTE /end AXIS_DESCR
 /begin AXIS_DESCR STD_AXIS nmot_w nmot_uw_q0p25 25 0.00 16383.75 FORMAT "%8.2" DEPOSIT ABSOLUTE /end AXIS_DESCR
/end CHARACTERISTIC
/begin CHARACTERISTIC KFSARDYN "Threshold for dynamical anti-jerking interventions" MAP 0x9083878 KfAxU8AyU8SstxS16SstyU8WU16 100.0000 rel_sw_b100 0.00 100.0000 FORMAT "%8.4" EXTENDED_LIMITS 0.00 199.9969
 /begin AXIS_DESCR STD_AXIS mkfanb_w rel_sw_b100 6 -100.0000 99.99695 FORMAT "%8.4" DEPOSIT ABSOLUTE /end AXIS_DESCR
 /begin AXIS_DESCR STD_AXIS gangi dez 7 0.00 255.0 FORMAT "%5.1" DEPOSIT ABSOLUTE /end AXIS_DESCR
/end CHARACTERISTIC
/begin CHARACTERISTIC KFTATM "map exhaust gas temperature f(nmot,rl)" MAP 0x9083A10 KfAxU8AyU8SstxU16SstyU8WU8 1275. temp_ub_q5_o50 -50.00 1225. FORMAT "%5.0"
 /begin AXIS_DESCR STD_AXIS nmot_w nmot_uw_q0p25 16 0.00 16383.75 FORMAT "%8.2" DEPOSIT ABSOLUTE /end AXIS_DESCR
 /begin AXIS_DESCR STD_AXIS rl rel_ub_q0p75 8 0.00 191.3 FORMAT "%5.1" DEPOSIT ABSOLUTE /end AXIS_DESCR
/end CHARACTERISTIC
/begin CHARACTERISTIC KFVARDYN "Amplification of anti-jerking intervention" MAP 0x90838E2 KfAxU8AyU8SstxU16SstyU8WU8 1.556 q0p0061_pc_DIV_rpm 0.00 1.556 FORMAT "%5.3"
 /begin AXIS_DESCR STD_AXIS nmot_w nmot_uw_q0p25 4 0.00 16383.75 FORMAT "%8.2" DEPOSIT ABSOLUTE /end AXIS_DESCR
 /begin AXIS_DESCR STD_AXIS gangi dez 7 0.00 255.0 FORMAT "%5.1" DEPOSIT ABSOLUTE /end AXIS_DESCR
/end CHARACTERISTIC
/begin CHARACTERISTIC KFWMABG "map for heat-quantity threshold dew-point end upstream bank1" MAP 0x9083ABA KfAxU8AyU8SstxS16SstyS16WS16 14912.63 q_q0p4551 0.00 14912.63 FORMAT "%8.2" EXTENDED_LIMITS -14913.08 14912.63
 /begin AXIS_DESCR STD_AXIS taikrmmst temp_ub_q5_o50 5 -50.00000 1225.000 FORMAT "%8.3" EXTENDED_LIMITS -163890.0 163785.0 DEPOSIT ABSOLUTE /end AXIS_DESCR
 /begin AXIS_DESCR STD_AXIS EngDa_tStrt Temp_Cels 5 -3549.940 3003.560 FORMAT "%8.3" DEPOSIT ABSOLUTE /end AXIS_DESCR
/end CHARACTERISTIC
/begin CHARACTERISTIC KFWMKAT "map for heat quantity threshold dew-point end downstream" MAP 0x9083B04 KfAxU8AyU8SstxS16SstyS16WS16 14912.63 q_q0p4551 0.00 14912.63 FORMAT "%8.2" EXTENDED_LIMITS -14913.08 14912.63
 /begin AXIS_DESCR STD_AXIS tempamb temp_ub_q0p75_o48 5 -48.00000 143.2500 FORMAT "%8.4" EXTENDED_LIMITS -24624.00 24527.25 DEPOSIT ABSOLUTE /end AXIS_DESCR
 /begin AXIS_DESCR STD_AXIS EngDa_tStrt Temp_Cels 5 -3549.940 3003.560 FORMAT "%8.3" DEPOSIT ABSOLUTE /end AXIS_DESCR
/end CHARACTERISTIC
/begin CHARACTERISTIC KIMSALL "Correction value for idling air mass integrator for E gas" VALUE 0x9083E0E KwWU16 2559.9609369 mk1sxs_b2560 0.039063096056 2560.0000000 FORMAT "%12.7" /end CHARACTERISTIC
/begin CHARACTERISTIC KLAFI "characteristic of Saint-Venant" CURVE 0x90847E6 FklWU16 1.999969 fak_uw_b2 0.00 1.999969 FORMAT "%8.6"
 /begin AXIS_DESCR FIX_AXIS psrgwpvdk_w fak_uw_b2 33 0.5000000 1.000000 FORMAT "%8.6" FIX_AXIS_PAR 16384 9 33 /end AXIS_DESCR
/end CHARACTERISTIC
/begin CHARACTERISTIC KLATMABKA "Curve- correction exhaust temperature in start" CURVE 0x9083B4E KlAxU8SstxU16WU8_Static 0.9961 fak_ub_b1 0.00 0.9961
 /begin AXIS_DESCR STD_AXIS t_engoff_w t_q1 6 0.00 65535.00 FORMAT "%8.2" DEPOSIT ABSOLUTE /end AXIS_DESCR
/end CHARACTERISTIC
/begin CHARACTERISTIC KLATMABKK "Curve- correction exhaust temperature in catalyst in start" CURVE 0x9083B62 KlAxU8SstxU16WU8_Static 0.9961 fak_ub_b1 0.00 0.9961
 /begin AXIS_DESCR STD_AXIS t_engoff_w t_q1 6 0.00 65535.00 FORMAT "%8.2" DEPOSIT ABSOLUTE /end AXIS_DESCR
/end CHARACTERISTIC
/begin CHARACTERISTIC KLATMILAE "Temperature of the exotherme decrease during enrichment tikatm" CURVE 0x9083B76 GklWU8 1.992188 fak_ub_b2 0.00 1.992188 FORMAT "%8.6"
 /begin AXIS_DESCR COM_AXIS lamsol fak_q0p0039_op0p5 6 0.5000 1.496 FORMAT "%5.3" AXIS_PTS_REF SLM06TMUB /end AXIS_DESCR
/end CHARACTERISTIC
/begin CHARACTERISTIC KLFKOFMSN "Correction factor for leakage mass low based on engine speed" CURVE 0x9084828 KlAxU8SstxU16WU16 3.984375 fak_ub_b4 0.00 3.984375 FORMAT "%8.6" EXTENDED_LIMITS 0.00 1023.984
 /begin AXIS_DESCR STD_AXIS nmot_w nmot_uw_q0p25 6 0.00 16383.75 FORMAT "%8.2" DEPOSIT ABSOLUTE /end AXIS_DESCR
/end CHARACTERISTIC
/begin CHARACTERISTIC KLFWMKAT "Safety factor for dew point end of downstream sensor" CURVE 0x9083B7C KlAxU8SstxS16WU16_Static 15.93750 fak_ub_b16 0.00 15.93750 FORMAT "%8.5" EXTENDED_LIMITS 0.00 4095.938
 /begin AXIS_DESCR STD_AXIS EngDa_tStrt Temp_Cels 5 -3549.940 3003.560 FORMAT "%8.3" DEPOSIT ABSOLUTE /end AXIS_DESCR
/end CHARACTERISTIC
/begin CHARACTERISTIC KLKIWM "correction curve for integrated heat quantity" CURVE 0x9083B92 KlAxU8SstxU16WU16 1.999969 fak_uw_b2 0.00 1.999969 FORMAT "%8.6"
 /begin AXIS_DESCR STD_AXIS ml_w m_uw_b6553p5 6 0.00 6553.500 FORMAT "%8.3" DEPOSIT ABSOLUTE /end AXIS_DESCR
/end CHARACTERISTIC
/begin CHARACTERISTIC KLKIWMK "Corrective characteristic for integrated heat quantity downstream sensor" CURVE 0x9083BAC KlAxU8SstxU16WU16 1.999969 fak_uw_b2 0.00 1.999969 FORMAT "%8.6"
 /begin AXIS_DESCR STD_AXIS ml_w m_uw_b6553p5 6 0.00 6553.500 FORMAT "%8.3" DEPOSIT ABSOLUTE /end AXIS_DESCR
/end CHARACTERISTIC
/begin CHARACTERISTIC KLMLTPATU "Mass flow rate threshold for dew point delay, pre cat" CURVE 0x9083BC6 KlAxU8SstxU8WU16_Static 6553.500 m_uw_b6553p5 0.00 6553.500 FORMAT "%8.3"
 /begin AXIS_DESCR STD_AXIS tempamb temp_ub_q0p75_o48 4 -48.00 143.3 FORMAT "%5.1" DEPOSIT ABSOLUTE /end AXIS_DESCR
/end CHARACTERISTIC
/begin CHARACTERISTIC KLRLMXN "maximum filling at WOT under standard condition" CURVE 0x9084D1E KlAxU8SstxU16WU16 1535.977 rel_uw_q0p0234 0.00 1535.977 FORMAT "%8.3"
 /begin AXIS_DESCR STD_AXIS nmot_w nmot_uw_q0p25 5 0.00 16383.75 FORMAT "%8.2" DEPOSIT ABSOLUTE /end AXIS_DESCR
/end CHARACTERISTIC
/begin CHARACTERISTIC KLTDMSDKEN "Curve: Delay enable adjustment after cranking" CURVE 0x9083E10 KlAxU8SstxS16WU16_Static 655.3500 t_q0p01 0.00 655.3500 FORMAT "%8.4"
 /begin AXIS_DESCR STD_AXIS EngDa_tEng Temp_Cels 4 -3549.940 3003.560 FORMAT "%8.3" DEPOSIT ABSOLUTE /end AXIS_DESCR
/end CHARACTERISTIC
/begin CHARACTERISTIC KLTNLATM "minimal ECM-afterrun for ATM - afterrun-time" CURVE 0x9083BD4 KlAxU8SstxS16WU16_Static 6553.500 t_q0p1 0.00 6553.500 FORMAT "%8.3"
 /begin AXIS_DESCR STD_AXIS EngDa_tEng Temp_Cels 4 -3549.940 3003.560 FORMAT "%8.3" DEPOSIT ABSOLUTE /end AXIS_DESCR
/end CHARACTERISTIC
/begin CHARACTERISTIC KLTVARSDYN "Curve for delay time for deactivation of anti-jerking interventions during change of gear" CURVE 0x9083910 FklWU8 2.540 t_q0p01 0.01000 2.550 FORMAT "%5.3" EXTENDED_LIMITS 0.00 2.550
 /begin AXIS_DESCR FIX_AXIS gangi dez 7 1.000 7.000 FORMAT "%5.3" FIX_AXIS_PAR 1 0 7 /end AXIS_DESCR
/end CHARACTERISTIC
/begin CHARACTERISTIC KLTVSABTE "delay time for CPV closing for fuel cut off" CURVE 0x9083D34 KlAxU8SstxU8WU16_Static 10.00000 t_q0p01 0.00 10.00000 FORMAT "%8.5" EXTENDED_LIMITS 0.00 655.3500
 /begin AXIS_DESCR STD_AXIS gangi dez 8 0.00 255.0 FORMAT "%5.1" DEPOSIT ABSOLUTE /end AXIS_DESCR
/end CHARACTERISTIC
/begin CHARACTERISTIC KLWMABGKH "Curve for heat-quantity-correction at catalyst heating for dew-point end" CURVE 0x9083BE6 KlAxU8SstxS16WU16_Static 1.992188 fak_ub_b2 0.00 1.992188 FORMAT "%8.6" EXTENDED_LIMITS 0.00 511.9922
 /begin AXIS_DESCR STD_AXIS EngDa_tStrt Temp_Cels 4 -3549.940 3003.560 FORMAT "%8.3" DEPOSIT ABSOLUTE /end AXIS_DESCR
/end CHARACTERISTIC
/begin CHARACTERISTIC KLWMKATKH "Curve- for heat-quantity-correction at catalyst heating for dew-point end of downstream sensor" CURVE 0x9083BF8 KlAxU8SstxS16WU16_Static 1.992188 fak_ub_b2 0.00 1.992188 FORMAT "%8.6" EXTENDED_LIMITS 0.00 511.9922
 /begin AXIS_DESCR STD_AXIS EngDa_tStrt Temp_Cels 4 -3549.940 3003.560 FORMAT "%8.3" DEPOSIT ABSOLUTE /end AXIS_DESCR
/end CHARACTERISTIC
/begin CHARACTERISTIC KLWTBR "Weighting factor Tans/Tmot for combustion chamber temperature model" CURVE 0x9084CF8 KlAxU8SstxU16WU8_Static 1.992188 fak_ub_b2 0.00 1.992188 FORMAT "%8.6"
 /begin AXIS_DESCR STD_AXIS msdkrohq_w m_uw_b655p35 10 0.00 655.3500 FORMAT "%8.4" DEPOSIT ABSOLUTE /end AXIS_DESCR
/end CHARACTERISTIC
/begin CHARACTERISTIC KLZKPUSA "time constant for ambient pressure" CURVE 0x9083E52 KlAxU8SstxU8WU16_Static 6553.4999985 zk100msxs_uw_b6553 0.10000152590 6553.6000000 FORMAT "%12.7"
 /begin AXIS_DESCR STD_AXIS vfzg vfzg_ub_q1p25 5 0.00 318.8 FORMAT "%5.1" DEPOSIT ABSOLUTE /end AXIS_DESCR
/end CHARACTERISTIC
/begin CHARACTERISTIC KUMSIRL "conversion constant from mass flow to relative air charge" VALUE 0x9084842 KwWU16 0.003999938965 kumsrl_uw_b0p004 0.00 0.003999938965 FORMAT "%14.12" /end CHARACTERISTIC
/begin CHARACTERISTIC KWZKPUA "time constant for ambient pressure" VALUE 0x9083E62 KwWU16 6553.4999985 zk100msxs_uw_b6553 0.10000152590 6553.6000000 FORMAT "%12.7" /end CHARACTERISTIC
/begin CHARACTERISTIC LAMSOLAPP "Lambda target value for application" VALUE 0x9083C6B KwWU8 0.9961 fak_q0p0039_op0p5 0.5000 1.496 FORMAT "%5.3" /end CHARACTERISTIC
/begin CHARACTERISTIC MLFKMSDKQ "Air flow threshold for multiple adjustment of MAP and throttle air flow" VALUE 0x9083E22 KwWU16 655.3500 m_uw_b655p35 0.00 655.3500 FORMAT "%8.4" /end CHARACTERISTIC
/begin CHARACTERISTIC MLMNTATU "Threshold for air masss flow for the calculation of ambient temperature in ATM" VALUE 0x9083C0A KwWU16 6553.500 m_uw_b6553p5 0.00 6553.500 FORMAT "%8.3" /end CHARACTERISTIC
/begin CHARACTERISTIC MLSUMX "reference of air mass flow integral for catalyst heating" CURVE 0x9083CD2 KlAxU8SstxS16WU16_Static 23.30133 m_uw_b23p3 0.00 23.30133 FORMAT "%8.5"
 /begin AXIS_DESCR STD_AXIS EngDa_tStrt Temp_Cels 5 -3549.940 3003.560 FORMAT "%8.3" DEPOSIT ABSOLUTE /end AXIS_DESCR
/end CHARACTERISTIC
/begin CHARACTERISTIC NARU "lower n-threshold anti-surge function" VALUE 0x9083918 KwWU16 16383.75 nmot_uw_q0p25 0.00 16383.75 FORMAT "%8.2" /end CHARACTERISTIC
/begin CHARACTERISTIC NLLKHM "Nominal idling speed during catalyzer heating" CURVE 0x9083CE8 KlAxU8SstxS16WU16_Static 2550.000 nmot_ub_q10 0.00 2550.000 FORMAT "%8.3" EXTENDED_LIMITS 0.00 655350.0
 /begin AXIS_DESCR STD_AXIS EngDa_tEng Temp_Cels 4 -3549.940 3003.560 FORMAT "%8.3" DEPOSIT ABSOLUTE /end AXIS_DESCR
/end CHARACTERISTIC
/begin CHARACTERISTIC NMOTWINEN "Engine speed threshold for enabling pressure sampling" VALUE 0x9083C5C KwUw 16383.75 nmot_uw_q0p25 0.00 16383.75 FORMAT "%8.2" /end CHARACTERISTIC
/begin CHARACTERISTIC NUMPUTLSAMP "Number of engine cycle to check part load altitude factor adoptation" VALUE 0x9083E64 KwWU8 16.00 dez 0.00 16.00 FORMAT "%5.2" EXTENDED_LIMITS 0.00 255.0 /end CHARACTERISTIC
/begin CHARACTERISTIC NVQMNGA "Minimum ratio engine to vehicle speed for gear detection" CURVE 0x9083C6C FklWU16 12000.00 fak_q0p2 0.00 12000.00 FORMAT "%8.2" EXTENDED_LIMITS 0.00 13107.00
 /begin AXIS_DESCR FIX_AXIS galok dez 6 1.000 6.000 FORMAT "%5.3" FIX_AXIS_PAR 1 0 6 /end AXIS_DESCR
/end CHARACTERISTIC
/begin CHARACTERISTIC NVQMXGA "Maximum ratio engine to vehicle speed for gear detection" CURVE 0x9083C78 FklWU16 12000.00 fak_q0p2 0.00 12000.00 FORMAT "%8.2" EXTENDED_LIMITS 0.00 13107.00
 /begin AXIS_DESCR FIX_AXIS galok dez 6 1.000 6.000 FORMAT "%5.3" FIX_AXIS_PAR 1 0 6 /end AXIS_DESCR
/end CHARACTERISTIC
/begin CHARACTERISTIC OFMSNDKNIQ "Initialisation value normalized massflow through throttle blade (increased resolution)" VALUE 0x9084844 KwWS16 655.3500 m_sw_q0p01 -327.6800 327.6700 FORMAT "%8.4" /end CHARACTERISTIC
/begin CHARACTERISTIC OFMSNDKTN "min. leakage of throttle blade for model based diagnosis" VALUE 0x9084846 KwWS16 655.3500 m_sw_q0p01 -327.6800 327.6700 FORMAT "%8.4" /end CHARACTERISTIC
/begin CHARACTERISTIC OFMSNDKTX "max. leakage of throttle blade for model based diagnosis" VALUE 0x9084848 KwWS16 655.3500 m_sw_q0p01 -327.6800 327.6700 FORMAT "%8.4" /end CHARACTERISTIC
/begin CHARACTERISTIC PBRINT "partial pressure residual gas in combustion chamber" VALUE 0x9084EA4 KwWU8 2550. p_ub_q10 0.00 2550. FORMAT "%5.0" /end CHARACTERISTIC
/begin CHARACTERISTIC PUADAPEN "pressure tolerance threshold for part load ambient pressure adaptation activation" VALUE 0x9083E66 KwWU16 2559.961 p_uw_q0p039 0.00 2559.961 FORMAT "%8.3" /end CHARACTERISTIC
/begin CHARACTERISTIC RLNOT "limp-home relative air charge rl in case of E_DK and E_LM" CURVE 0x9084D34 KlAxU8SstxU16WU16 1535.977 rel_uw_q0p0234 0.00 1535.977 FORMAT "%8.3"
 /begin AXIS_DESCR STD_AXIS nmot_w nmot_uw_q0p25 6 0.00 16383.75 FORMAT "%8.2" DEPOSIT ABSOLUTE /end AXIS_DESCR
/end CHARACTERISTIC
/begin CHARACTERISTIC RLPUADPTL "Air-Charge limiting for pu adaptation" VALUE 0x9083E68 KwWU16 1535.977 rel_uw_q0p0234 0.00 1535.977 FORMAT "%8.3" /end CHARACTERISTIC
/begin AXIS_PTS SEZ06TMUB "Datapoint distribution of ignition timing efficiency" 0x9083C0C etazwimt SstAU8SstU8 127.5 rel_ub_b127p5 6 0.00 127.5 FORMAT "%5.1" DEPOSIT ABSOLUTE /end AXIS_PTS
/begin AXIS_PTS SLM06TMUB "lambda dependent basic point (number 6)" 0x9083C13 lamsol SstAU8SstU8 0.9961 fak_q0p0039_op0p5 6 0.5000 1.496 FORMAT "%5.3" DEPOSIT ABSOLUTE /end AXIS_PTS
/begin AXIS_PTS SML06TMUW "ml dependent basic point (number 6)" 0x9083C1A ml_w SstAU8SstU16 6553.500 m_uw_b6553p5 6 0.00 6553.500 FORMAT "%8.3" DEPOSIT ABSOLUTE /end AXIS_PTS
/begin CHARACTERISTIC TABGMEX "Exhaust-gas temperature below the catalyzer light-off temperature" VALUE 0x9083C28 KwWU8 1275. temp_ub_q5_o50 -50.00 1225. FORMAT "%5.0" /end CHARACTERISTIC
/begin CHARACTERISTIC TAIKRMMN "Minimum exhaust-gas temp. upstream catalyst at which water still evaporates at idle" VALUE 0x9083C29 KwWU8 1275. temp_ub_q5_o50 -50.00 1225. FORMAT "%5.0" /end CHARACTERISTIC
/begin CHARACTERISTIC TARNSGA "time constant for D2T2-model" CURVE 0x908391A FklWU8 1.240 t_q0p005 0.03500 1.275 FORMAT "%5.3" EXTENDED_LIMITS 0.00 1.275
 /begin AXIS_DESCR FIX_AXIS gangi dez 7 1.000 7.000 FORMAT "%5.3" FIX_AXIS_PAR 1 0 7 /end AXIS_DESCR
/end CHARACTERISTIC
/begin CHARACTERISTIC TATMRTPA "Time delay to reset the heat quantity integrator iwmatma" VALUE 0x9083C2A KwWU16 13107.00 t_q0p2 0.00 13107.00 FORMAT "%8.2" /end CHARACTERISTIC
/begin CHARACTERISTIC TATMSA "exhaust gas temperature at fuel cut off" VALUE 0x9083C2C KwWU8 1275. temp_ub_q5_o50 -50.00 1225. FORMAT "%5.0" /end CHARACTERISTIC
/begin CHARACTERISTIC TATMSAE "exothermal temperature offset at fuel cut off" VALUE 0x9083C2D KwWU8 1275. temp_ub_q5_o50 -50.00 1225. FORMAT "%5.0" /end CHARACTERISTIC
/begin CHARACTERISTIC TATMWM "Temperature offset for heat-quantity calculation" VALUE 0x9083C2E KwWS8 1275. temp_q5 -640.0 635.0 FORMAT "%5.1" /end CHARACTERISTIC
/begin CHARACTERISTIC TATMWMK "Temperature offset for heat-quantity calculation" VALUE 0x9083C2F KwWS8 1275. temp_q5 -640.0 635.0 FORMAT "%5.1" /end CHARACTERISTIC
/begin CHARACTERISTIC TDIDSSU "Delay time till initialisation of ambient pressure value with measured intake manifold Pressure" VALUE 0x9083E6A KwWU8 25.50 t_q0p1 0.00 25.50 FORMAT "%5.2" /end CHARACTERISTIC
/begin CHARACTERISTIC TDMSDKS "Time delay for the bit B_fkmsdks" VALUE 0x9083E24 KwWU16 655.3500 t_q0p01 0.00 655.3500 FORMAT "%8.4" /end CHARACTERISTIC
/begin CHARACTERISTIC TDTKHNAB "time for calculating idle speed at end of catalyst heating" VALUE 0x9083CFA KwWU16 6553.500 t_q0p1 0.00 6553.500 FORMAT "%8.3" /end CHARACTERISTIC
/begin CHARACTERISTIC TGAMN "Minimum time for mixture adaptation" VALUE 0x9083D64 KwWU16 6553.500 t100msxs_uw_b6553p6 0.00 6553.500 FORMAT "%8.3" /end CHARACTERISTIC
/begin CHARACTERISTIC TKHNAB "time for reducing idle speed at end of catalyst heating" VALUE 0x9083CFC KwWU16 6553.4999985 zk100msxs_uw_b6553 0.10000152590 6553.6000000 FORMAT "%12.7" /end CHARACTERISTIC
/begin CHARACTERISTIC TMAR "Lower TMOT threshold for AR release" VALUE 0x9083922 KwWS16 6553.500 Temp_Cels -3549.940 3003.560 FORMAT "%8.3" /end CHARACTERISTIC
/begin CHARACTERISTIC TMDFHO "debounce time for engine speed, altitude factor adaption" VALUE 0x9083E6B KwWU8 5.100 t_q0p02 0.00 5.100 FORMAT "%5.3" /end CHARACTERISTIC
/begin CHARACTERISTIC TMOFMSDKMX "maximum limit of engine temperature for enable leakage adaptation of throttle blade" VALUE 0x9083E26 KwWS16 6553.500 Temp_Cels -3549.940 3003.560 FORMAT "%8.3" /end CHARACTERISTIC
/begin CHARACTERISTIC TMOFMSNDKE "engine temperature for enable leakage adaptation of throttle blade" VALUE 0x9083E28 KwWS16 6553.500 Temp_Cels -3549.940 3003.560 FORMAT "%8.3" /end CHARACTERISTIC
/begin CHARACTERISTIC TTEGA "time during canister purge for basic adaptation" VALUE 0x9083D66 KwWU16 6553.500 t100msxs_uw_b6553p6 0.00 6553.500 FORMAT "%8.3" /end CHARACTERISTIC
/begin CHARACTERISTIC TTEMN "time for minimum canister purge phase" VALUE 0x9083D68 KwWU16 6553.500 t100msxs_uw_b6553p6 0.00 6553.500 FORMAT "%8.3" /end CHARACTERISTIC
/begin CHARACTERISTIC TTEMX "Maximum time for canister purge" VALUE 0x9083D6A KwWU16 6553.500 t100msxs_uw_b6553p6 0.00 6553.500 FORMAT "%8.3" /end CHARACTERISTIC
/begin CHARACTERISTIC TVARV "Delay time for enabling of anti-jerking function by vehicle speed" VALUE 0x9083924 KwWU8 2.550 t_q0p01 0.00 2.550 FORMAT "%5.3" /end CHARACTERISTIC
/begin CHARACTERISTIC TVGWAR "delay time at gear change for anti-jerking function" VALUE 0x9083925 KwWU8 2.550 t_q0p01 0.00 2.550 FORMAT "%5.3" /end CHARACTERISTIC
/begin CHARACTERISTIC TVKUPAR "delay time of clutch for anti-jerking function" VALUE 0x9083926 KwWU8 2.550 t_q0p01 0.00 2.550 FORMAT "%5.3" /end CHARACTERISTIC
/begin CHARACTERISTIC TVSABGEAR "Delay time for fuel cut-off in case of Neutral" VALUE 0x9083D4E KwWU16 10.00000 t_q0p01 0.00 10.00000 FORMAT "%8.5" EXTENDED_LIMITS 0.00 655.3500 /end CHARACTERISTIC
/begin CHARACTERISTIC TVSABGW "Delay time for fuel cut-off in case of gear change" VALUE 0x9083D50 KwWU16 10.00000 t_q0p01 0.00 10.00000 FORMAT "%8.5" EXTENDED_LIMITS 0.00 655.3500 /end CHARACTERISTIC
/begin CHARACTERISTIC TVSATM "delay time after cranking for fuel cut off" CURVE 0x9083D52 KlAxU8SstxS16WU16_Static 510.0000 t_q2 0.00 510.0000 FORMAT "%8.4" EXTENDED_LIMITS 0.00 131070.0
 /begin AXIS_DESCR STD_AXIS EngDa_tStrt Temp_Cels 3 -3549.940 3003.560 FORMAT "%8.3" DEPOSIT ABSOLUTE /end AXIS_DESCR
/end CHARACTERISTIC
/begin CHARACTERISTIC TVTUMA "Delay time for the actualisation of ambient temperature in ATM" VALUE 0x9083C30 KwWU16 13107.00 t_q0p2 0.00 13107.00 FORMAT "%8.2" /end CHARACTERISTIC
/begin CHARACTERISTIC TZPUSZ "Delay Time to initialisation of altitude factor for downhill movement" VALUE 0x9083E6C KwWU8 25.50 t_q0p1 0.00 25.50 FORMAT "%5.2" /end CHARACTERISTIC
/begin CHARACTERISTIC VARAO "maximum limit vehicle speed for anti-surge function" VALUE 0x9083928 KwWU16 511.9922 vfzg_uw_b512 0.00 511.9922 FORMAT "%8.4" /end CHARACTERISTIC
/begin CHARACTERISTIC VARAU "vehicle speed for anti-jerk active" VALUE 0x908392A KwWU16 511.9922 vfzg_uw_b512 0.00 511.9922 FORMAT "%8.4" /end CHARACTERISTIC
/begin CHARACTERISTIC VHA "Speed threshold for altitude adaptation" VALUE 0x9083E6D KwWU8 318.8 vfzg_ub_q1p25 0.00 318.8 FORMAT "%5.1" /end CHARACTERISTIC
/begin CHARACTERISTIC WDKUGDN "throttle angle necessary for 95 % of the maximum possible air charge" CURVE 0x9083E6E KlAxU8SstxU16WU16 100.0000 relDK_ub_b100 0.00 100.0000 FORMAT "%8.4" EXTENDED_LIMITS 0.00 25700.00
 /begin AXIS_DESCR STD_AXIS nmot_w nmot_uw_q0p25 4 0.00 16383.75 FORMAT "%8.2" DEPOSIT ABSOLUTE /end AXIS_DESCR
/end CHARACTERISTIC
/begin CHARACTERISTIC WINDENCYL0 "end point for pressure sampling window for cylinder 0" VALUE 0x9083C5E KwUw 6553.500 zw_q0p1 0.00 6553.500 FORMAT "%8.3" /end CHARACTERISTIC
/begin CHARACTERISTIC WINDPUSAMPL "window period for number of samples for ambinent pressure detection" VALUE 0x9083E80 KwWU16 710.0000 kw_q1 10.00000 720.0000 FORMAT "%8.4" EXTENDED_LIMITS 0.00 65535.00 /end CHARACTERISTIC
/begin CHARACTERISTIC WINDSTCYL0 "start point for pressure sampling window for cylinder 0" VALUE 0x9083C60 KwUw 720.0000 zw_q0p1 0.00 720.0000 FORMAT "%8.4" EXTENDED_LIMITS 0.00 6553.500 /end CHARACTERISTIC
/begin CHARACTERISTIC ZATMAML "time constant for exhaust gas temperature model" CURVE 0x9083C32 GklWU16 13106.999997 zk200msxs_uw_b13107p2 0.20000305180 13107.200000 FORMAT "%12.6"
 /begin AXIS_DESCR COM_AXIS ml_w m_uw_b6553p5 6 0.00 6553.500 FORMAT "%8.3" AXIS_PTS_REF SML06TMUW /end AXIS_DESCR
/end CHARACTERISTIC
/begin CHARACTERISTIC ZATMIKML "time constant for modelled temperature in catayst tikatm" CURVE 0x9083C3E GklWU16 13106.999997 zk200msxs_uw_b13107p2 0.20000305180 13107.200000 FORMAT "%12.6"
 /begin AXIS_DESCR COM_AXIS ml_w m_uw_b6553p5 6 0.00 6553.500 FORMAT "%8.3" AXIS_PTS_REF SML06TMUW /end AXIS_DESCR
/end CHARACTERISTIC
/begin CHARACTERISTIC ZATMRML "time constant for exhaust model temperature - pipe temperature" CURVE 0x9083C4A GklWU16 13106.999997 zk200msxs_uw_b13107p2 0.20000305180 13107.200000 FORMAT "%12.6"
 /begin AXIS_DESCR COM_AXIS ml_w m_uw_b6553p5 6 0.00 6553.500 FORMAT "%8.3" AXIS_PTS_REF SML06TMUW /end AXIS_DESCR
/end CHARACTERISTIC
/begin CHARACTERISTIC ZBRT "time constant for combustion chamber temp. model" VALUE 0x9084D18 KwWU16 6553.4999985 zk100msxs_uw_b655 0.10000152590 6553.6000000 FORMAT "%12.7" /end CHARACTERISTIC
/begin CHARACTERISTIC ZBRTMOD "Time constant for combustion chamber temp. model (faster time constant)" VALUE 0x9084D1A KwWS16 2.5400000000 zk20msxs_ub_b2p55 0.010000000000 2.5500000000 FORMAT "%12.10" EXTENDED_LIMITS 0.000077822199164 2.5500000000 /end CHARACTERISTIC
/begin CHARACTERISTIC ZKHABB "Time constant for abort low-pass catalyzer heating" VALUE 0x9083CFE KwWU8 25.4996 zk100msxs_ub_b25p5 0.100392 25.6000 FORMAT "%7.4" /end CHARACTERISTIC
/begin CHARACTERISTIC ZKMSDK "integrator speed for fast constant mass-flow adaption" VALUE 0x908484A KwWU16 0.9999847 fak_uw_b1 0.00 0.9999847 FORMAT "%9.7" /end CHARACTERISTIC
/begin CHARACTERISTIC ZKRLDK "Time constant for relative air charge based on DK" VALUE 0x908484C KwWU16 0.9999847 fak_uw_b1 0.00 0.9999847 FORMAT "%9.7" /end CHARACTERISTIC
/begin MEASUREMENT absnsarvar "Absolute value of delta torque anti-jerk used as threshold to activate anti-jerking intervention" UWORD rel_sw_b100 1 100 0.00 199.9969 FORMAT "%8.4" ECU_ADDRESS 0x400083CE
 /begin IF_DATA XCPplus 0x0102
  /begin DAQ_EVENT VARIABLE /begin AVAILABLE_EVENT_LIST EVENT 0 EVENT 1 EVENT 2 EVENT 3 /end AVAILABLE_EVENT_LIST /begin DEFAULT_EVENT_LIST EVENT 0 /end DEFAULT_EVENT_LIST /end DAQ_EVENT
 /end IF_DATA
/end MEASUREMENT
/begin MEASUREMENT ATS_ctCurRunTst "Number of current activated actuators" UBYTE OneToOne 1 100 0.00 255.0 FORMAT "%5.1" ECU_ADDRESS 0x400063E5
 /begin IF_DATA XCPplus 0x0102
  /begin DAQ_EVENT VARIABLE /begin AVAILABLE_EVENT_LIST EVENT 0 EVENT 1 EVENT 2 EVENT 3 /end AVAILABLE_EVENT_LIST /begin DEFAULT_EVENT_LIST EVENT 2 /end DEFAULT_EVENT_LIST /end DAQ_EVENT
 /end IF_DATA
/end MEASUREMENT
/begin MEASUREMENT ATS_IntvVal_mp "Intervention value" SWORD OneToOne 1 100 -32768.00 32767.00 FORMAT "%8.2" ECU_ADDRESS 0x40009E16 /end MEASUREMENT
/begin MEASUREMENT ATS_stIgnTst_u8 "Status ignition test activ, bit border" UBYTE dez 1 100 0.00 255.0 FORMAT "%5.1" ECU_ADDRESS 0x400087E5
 /begin IF_DATA XCPplus 0x0102
  /begin DAQ_EVENT VARIABLE /begin AVAILABLE_EVENT_LIST EVENT 0 EVENT 1 EVENT 2 EVENT 3 /end AVAILABLE_EVENT_LIST /begin DEFAULT_EVENT_LIST EVENT 1 /end DEFAULT_EVENT_LIST /end DAQ_EVENT
 /end IF_DATA
/end MEASUREMENT
/begin MEASUREMENT ATS_stMon "status of ATS internal monitoring" UBYTE OneToOne 1 100 0.00 255.0 FORMAT "%5.1" ECU_ADDRESS 0x40006419
 /begin IF_DATA XCPplus 0x0102
  /begin DAQ_EVENT VARIABLE /begin AVAILABLE_EVENT_LIST EVENT 0 EVENT 1 EVENT 2 EVENT 3 /end AVAILABLE_EVENT_LIST /begin DEFAULT_EVENT_LIST EVENT 2 /end DEFAULT_EVENT_LIST /end DAQ_EVENT
 /end IF_DATA
/end MEASUREMENT
/begin MEASUREMENT ATS_stMonTimeLimit "Behaviour time limit response for new tester demands" UBYTE OneToOne 1 100 0.00 255.0 FORMAT "%5.1" ECU_ADDRESS 0x400063E4
 /begin IF_DATA XCPplus 0x0102
  /begin DAQ_EVENT VARIABLE /begin AVAILABLE_EVENT_LIST EVENT 0 EVENT 1 EVENT 2 EVENT 3 /end AVAILABLE_EVENT_LIST /begin DEFAULT_EVENT_LIST EVENT 2 /end DEFAULT_EVENT_LIST /end DAQ_EVENT
 /end IF_DATA
/end MEASUREMENT
/begin MEASUREMENT ATS_TstStatus_mp "Status of actuatorintervention" UBYTE OneToOne 1 100 0.00 255.0 FORMAT "%5.1" ECU_ADDRESS 0x40009E41 /end MEASUREMENT
/begin MEASUREMENT BusDiag_stCAN0_mp "MP for Can 0 Bus Off Status" UBYTE B_TRUE 1 100 0.00 1.00000000000 BIT_MASK 0x1 FORMAT "%13.11" ECU_ADDRESS 0x40009E57 /end MEASUREMENT
/begin MEASUREMENT BusDiag_stCAN0_msg "Can 0 Bus Off Status" UBYTE B_TRUE 1 100 0.00 1.00000000000 BIT_MASK 0x1 FORMAT "%13.11" ECU_ADDRESS 0x400063E3
 /begin IF_DATA XCPplus 0x0102
  /begin DAQ_EVENT VARIABLE /begin AVAILABLE_EVENT_LIST EVENT 0 EVENT 1 EVENT 2 EVENT 3 /end AVAILABLE_EVENT_LIST /begin DEFAULT_EVENT_LIST EVENT 1 /end DEFAULT_EVENT_LIST /end DAQ_EVENT
 /end IF_DATA
/end MEASUREMENT
/begin MEASUREMENT BusDiag_stOpenLoadCan0_mp "MP for Can O Open Load Status" ULONG OneToOne 1 100 0.00 4294967295.00 FORMAT "%13.2" ECU_ADDRESS 0x40009D70 /end MEASUREMENT
/begin MEASUREMENT BusDiag_stOpenLoadCan0_msg "Can O Open Load Status" UBYTE B_TRUE 1 100 0.00 1.00000000000 BIT_MASK 0x1 FORMAT "%13.11" ECU_ADDRESS 0x400063E2
 /begin IF_DATA XCPplus 0x0102
  /begin DAQ_EVENT VARIABLE /begin AVAILABLE_EVENT_LIST EVENT 0 EVENT 1 EVENT 2 EVENT 3 /end AVAILABLE_EVENT_LIST /begin DEFAULT_EVENT_LIST EVENT 1 /end DEFAULT_EVENT_LIST /end DAQ_EVENT
 /end IF_DATA
/end MEASUREMENT
/begin MEASUREMENT BusDiag_stPSRCan0 "Can 0 PSR Status" ULONG OneToOne 1 100 0.00 4294967295.00 FORMAT "%13.2" ECU_ADDRESS 0x400048CC
 /begin IF_DATA XCPplus 0x0102
  /begin DAQ_EVENT VARIABLE /begin AVAILABLE_EVENT_LIST EVENT 0 EVENT 1 EVENT 2 EVENT 3 /end AVAILABLE_EVENT_LIST /begin DEFAULT_EVENT_LIST EVENT 1 /end DEFAULT_EVENT_LIST /end DAQ_EVENT
 /end IF_DATA
/end MEASUREMENT
/begin MEASUREMENT B_ar "condition anti-jerk active" UBYTE B_TRUE 1 100 0.00 1.00000000000 BIT_MASK 0x1 FORMAT "%13.11" ECU_ADDRESS 0x400087D5
 /begin IF_DATA XCPplus 0x0102
  /begin DAQ_EVENT VARIABLE /begin AVAILABLE_EVENT_LIST EVENT 0 EVENT 1 EVENT 2 EVENT 3 /end AVAILABLE_EVENT_LIST /begin DEFAULT_EVENT_LIST EVENT 1 /end DEFAULT_EVENT_LIST /end DAQ_EVENT
 /end IF_DATA
/end MEASUREMENT
/begin MEASUREMENT B_asvarap "Condition target air system actuator position for application" UBYTE B_TRUE 1 100 0.00 1.00000000000 BIT_MASK 0x4 FORMAT "%13.11" ECU_ADDRESS 0x400087CE
 /begin IF_DATA XCPplus 0x0102
  /begin DAQ_EVENT VARIABLE /begin AVAILABLE_EVENT_LIST EVENT 0 EVENT 1 EVENT 2 EVENT 3 /end AVAILABLE_EVENT_LIST /begin DEFAULT_EVENT_LIST EVENT 2 /end DEFAULT_EVENT_LIST /end DAQ_EVENT
 /end IF_DATA
/end MEASUREMENT
/begin MEASUREMENT B_atmrtpa "Condition integrator iwmatm for dew point upstream catalyst is reset" UBYTE B_TRUE 1 100 0.00 1.00000000000 BIT_MASK 0x1 FORMAT "%13.11" ECU_ADDRESS 0x400087E2
 /begin IF_DATA XCPplus 0x0102
  /begin DAQ_EVENT VARIABLE /begin AVAILABLE_EVENT_LIST EVENT 0 EVENT 1 EVENT 2 EVENT 3 /end AVAILABLE_EVENT_LIST /begin DEFAULT_EVENT_LIST EVENT 3 /end DEFAULT_EVENT_LIST /end DAQ_EVENT
 /end IF_DATA
/end MEASUREMENT
/begin MEASUREMENT B_atmtpa "condition temperature upstream catalyst exceeds dew-point" UBYTE B_TRUE 1 100 0.00 1.00000000000 BIT_MASK 0x1 FORMAT "%13.11" ECU_ADDRESS 0x400087D9
 /begin IF_DATA XCPplus 0x0102
  /begin DAQ_EVENT VARIABLE /begin AVAILABLE_EVENT_LIST EVENT 0 EVENT 1 EVENT 2 EVENT 3 /end AVAILABLE_EVENT_LIST /begin DEFAULT_EVENT_LIST EVENT 2 /end DEFAULT_EVENT_LIST /end DAQ_EVENT
 /end IF_DATA
/end MEASUREMENT
/begin MEASUREMENT B_atmtpk "condition temperature downstream catalyst exceeds dew-point" UBYTE B_TRUE 1 100 0.00 1.00000000000 BIT_MASK 0x1 FORMAT "%13.11" ECU_ADDRESS 0x400087D8
 /begin IF_DATA XCPplus 0x0102
  /begin DAQ_EVENT VARIABLE /begin AVAILABLE_EVENT_LIST EVENT 0 EVENT 1 EVENT 2 EVENT 3 /end AVAILABLE_EVENT_LIST /begin DEFAULT_EVENT_LIST EVENT 2 /end DEFAULT_EVENT_LIST /end DAQ_EVENT
 /end IF_DATA
/end MEASUREMENT
/begin MEASUREMENT B_atmtpkl "condition temperature downstream catalyst exceeds dew-point (last trip)" UBYTE B_TRUE 1 100 0.00 1.00000000000 BIT_MASK 0x1 FORMAT "%13.11" ECU_ADDRESS 0x4000C707
 /begin IF_DATA XCPplus 0x0102
  /begin DAQ_EVENT VARIABLE /begin AVAILABLE_EVENT_LIST EVENT 0 EVENT 1 EVENT 2 EVENT 3 /end AVAILABLE_EVENT_LIST /begin DEFAULT_EVENT_LIST EVENT 2 /end DEFAULT_EVENT_LIST /end DAQ_EVENT
 /end IF_DATA
/end MEASUREMENT
/begin MEASUREMENT B_bevab "condition: Inj. valve cut off on Bank/Bank1" UBYTE B_TRUE 1 100 0.00 1.00000000000 BIT_MASK 0x1 FORMAT "%13.11" ECU_ADDRESS 0x400087BE
 /begin IF_DATA XCPplus 0x0102
  /begin DAQ_EVENT VARIABLE /begin AVAILABLE_EVENT_LIST EVENT 0 EVENT 1 EVENT 2 EVENT 3 /end AVAILABLE_EVENT_LIST /begin DEFAULT_EVENT_LIST EVENT 0 /end DEFAULT_EVENT_LIST /end DAQ_EVENT
 /end IF_DATA
/end MEASUREMENT
/begin MEASUREMENT B_cylcntend "Condition: End of engine cycle counter for part load adoptation" UBYTE B_TRUE 1 100 0.00 1.00000000000 BIT_MASK 0x1 FORMAT "%13.11" ECU_ADDRESS 0x4000880D
 /begin IF_DATA XCPplus 0x0102
  /begin DAQ_EVENT VARIABLE /begin AVAILABLE_EVENT_LIST EVENT 0 EVENT 1 EVENT 2 EVENT 3 /end AVAILABLE_EVENT_LIST /begin DEFAULT_EVENT_LIST EVENT 0 /end DEFAULT_EVENT_LIST /end DAQ_EVENT
 /end IF_DATA
/end MEASUREMENT
/begin MEASUREMENT B_dofmsndkqini "Condition throttle valve leakage same Min Max limits and initialize with same value" UBYTE B_TRUE 1 100 0.00 1.00000000000 BIT_MASK 0x1 FORMAT "%13.11" ECU_ADDRESS 0x40008807
 /begin IF_DATA XCPplus 0x0102
  /begin DAQ_EVENT VARIABLE /begin AVAILABLE_EVENT_LIST EVENT 0 EVENT 1 EVENT 2 EVENT 3 /end AVAILABLE_EVENT_LIST /begin DEFAULT_EVENT_LIST EVENT 3 /end DEFAULT_EVENT_LIST /end DAQ_EVENT
 /end IF_DATA
/end MEASUREMENT
/begin MEASUREMENT B_engHrClr "Condition: Engine Hours Cleared" UBYTE B_TRUE 1 100 0.00 1.00000000000 BIT_MASK 0x1 FORMAT "%13.11" ECU_ADDRESS 0x40008760 /end MEASUREMENT
/begin MEASUREMENT B_errwind "Error status for window based pressure sampling" UBYTE B_TRUE 1 100 0.00 1.00000000000 BIT_MASK 0x1 FORMAT "%13.11" ECU_ADDRESS 0x400087C5 /end MEASUREMENT
/begin MEASUREMENT B_evakt "Condition all injection valves active" UBYTE B_TRUE 1 100 0.00 1.00000000000 BIT_MASK 0x1 FORMAT "%13.11" ECU_ADDRESS 0x400087BD
 /begin IF_DATA XCPplus 0x0102
  /begin DAQ_EVENT VARIABLE /begin AVAILABLE_EVENT_LIST EVENT 0 EVENT 1 EVENT 2 EVENT 3 /end AVAILABLE_EVENT_LIST /begin DEFAULT_EVENT_LIST EVENT 0 /end DEFAULT_EVENT_LIST /end DAQ_EVENT
 /end IF_DATA
/end MEASUREMENT
/begin MEASUREMENT B_evzaustot "Condition: Total injection cut-off" UBYTE B_TRUE 1 100 0.00 1.00000000000 BIT_MASK 0x1 FORMAT "%13.11" ECU_ADDRESS 0x400087BC
 /begin IF_DATA XCPplus 0x0102
  /begin DAQ_EVENT VARIABLE /begin AVAILABLE_EVENT_LIST EVENT 0 EVENT 1 EVENT 2 EVENT 3 /end AVAILABLE_EVENT_LIST /begin DEFAULT_EVENT_LIST EVENT 0 /end DEFAULT_EVENT_LIST /end DAQ_EVENT
 /end IF_DATA
/end MEASUREMENT
/begin MEASUREMENT B_fgabgl "Condition: Enable charging compensation" UBYTE B_TRUE 1 100 0.00 1.00000000000 BIT_MASK 0x1 FORMAT "%13.11" ECU_ADDRESS 0x40008804
 /begin IF_DATA XCPplus 0x0102
  /begin DAQ_EVENT VARIABLE /begin AVAILABLE_EVENT_LIST EVENT 0 EVENT 1 EVENT 2 EVENT 3 /end AVAILABLE_EVENT_LIST /begin DEFAULT_EVENT_LIST EVENT 1 /end DEFAULT_EVENT_LIST /end DAQ_EVENT
 /end IF_DATA
/end MEASUREMENT
/begin MEASUREMENT B_fkpvdk "Confition for the release of the slow multiplicative load trim" UBYTE B_TRUE 1 100 0.00 1.00000000000 BIT_MASK 0x1 FORMAT "%13.11" ECU_ADDRESS 0x40008803
 /begin IF_DATA XCPplus 0x0102
  /begin DAQ_EVENT VARIABLE /begin AVAILABLE_EVENT_LIST EVENT 0 EVENT 1 EVENT 2 EVENT 3 /end AVAILABLE_EVENT_LIST /begin DEFAULT_EVENT_LIST EVENT 3 /end DEFAULT_EVENT_LIST /end DAQ_EVENT
 /end IF_DATA
/end MEASUREMENT
/begin MEASUREMENT B_fkpvdkini "Condition same Min Max limits for pressure correction over throttle valve and factor (fkpvdk) initialize to same value" UBYTE B_TRUE 1 100 0.00 1.00000000000 BIT_MASK 0x1 FORMAT "%13.11" ECU_ADDRESS 0x40008808
 /begin IF_DATA XCPplus 0x0102
  /begin DAQ_EVENT VARIABLE /begin AVAILABLE_EVENT_LIST EVENT 0 EVENT 1 EVENT 2 EVENT 3 /end AVAILABLE_EVENT_LIST /begin DEFAULT_EVENT_LIST EVENT 3 /end DEFAULT_EVENT_LIST /end DAQ_EVENT
 /end IF_DATA
/end MEASUREMENT
/begin MEASUREMENT B_fvoffap "Driveability functions disabled for application" UBYTE B_TRUE 1 100 0.00 1.00000000000 BIT_MASK 0x4 FORMAT "%13.11" ECU_ADDRESS 0x400087CF
 /begin IF_DATA XCPplus 0x0102
  /begin DAQ_EVENT VARIABLE /begin AVAILABLE_EVENT_LIST EVENT 0 EVENT 1 EVENT 2 EVENT 3 /end AVAILABLE_EVENT_LIST /begin DEFAULT_EVENT_LIST EVENT 2 /end DEFAULT_EVENT_LIST /end DAQ_EVENT
 /end IF_DATA
/end MEASUREMENT
/begin MEASUREMENT B_gabr "Condition for break off the Mixture Adaptation" UBYTE B_TRUE 1 100 0.00 1.00000000000 BIT_MASK 0x1 FORMAT "%13.11" ECU_ADDRESS 0x400087FF
 /begin IF_DATA XCPplus 0x0102
  /begin DAQ_EVENT VARIABLE /begin AVAILABLE_EVENT_LIST EVENT 0 EVENT 1 EVENT 2 EVENT 3 /end AVAILABLE_EVENT_LIST /begin DEFAULT_EVENT_LIST EVENT 2 /end DEFAULT_EVENT_LIST /end DAQ_EVENT
 /end IF_DATA
/end MEASUREMENT
/begin MEASUREMENT B_gamn "Condition for minimum time for Mixture Adaptation" UBYTE B_TRUE 1 100 0.00 1.00000000000 BIT_MASK 0x1 FORMAT "%13.11" ECU_ADDRESS 0x400087FE
 /begin IF_DATA XCPplus 0x0102
  /begin DAQ_EVENT VARIABLE /begin AVAILABLE_EVENT_LIST EVENT 0 EVENT 1 EVENT 2 EVENT 3 /end AVAILABLE_EVENT_LIST /begin DEFAULT_EVENT_LIST EVENT 2 /end DEFAULT_EVENT_LIST /end DAQ_EVENT
 /end IF_DATA
/end MEASUREMENT
/begin MEASUREMENT B_gwar "Condition gear change for anti-jerking function" UBYTE B_TRUE 1 100 0.00 1.00000000000 BIT_MASK 0x1 FORMAT "%13.11" ECU_ADDRESS 0x400087D3
 /begin IF_DATA XCPplus 0x0102
  /begin DAQ_EVENT VARIABLE /begin AVAILABLE_EVENT_LIST EVENT 0 EVENT 1 EVENT 2 EVENT 3 /end AVAILABLE_EVENT_LIST /begin DEFAULT_EVENT_LIST EVENT 1 /end DEFAULT_EVENT_LIST /end DAQ_EVENT
 /end IF_DATA
/end MEASUREMENT
/begin MEASUREMENT B_gwhs "Condition gear change on manual transmission vehicle" UBYTE B_TRUE 1 100 0.00 1.00000000000 BIT_MASK 0x2 FORMAT "%13.11" ECU_ADDRESS 0x400087E8
 /begin IF_DATA XCPplus 0x0102
  /begin DAQ_EVENT VARIABLE /begin AVAILABLE_EVENT_LIST EVENT 0 EVENT 1 EVENT 2 EVENT 3 /end AVAILABLE_EVENT_LIST /begin DEFAULT_EVENT_LIST EVENT 2 /end DEFAULT_EVENT_LIST /end DAQ_EVENT
 /end IF_DATA
/end MEASUREMENT
/begin MEASUREMENT B_iniabgl "Condition for initializing of the mass flow balancing" UBYTE B_TRUE 1 100 0.00 1.00000000000 BIT_MASK 0x1 FORMAT "%13.11" ECU_ADDRESS 0x40008806
 /begin IF_DATA XCPplus 0x0102
  /begin DAQ_EVENT VARIABLE /begin AVAILABLE_EVENT_LIST EVENT 0 EVENT 1 EVENT 2 EVENT 3 /end AVAILABLE_EVENT_LIST /begin DEFAULT_EVENT_LIST EVENT 1 /end DEFAULT_EVENT_LIST /end DAQ_EVENT
 /end IF_DATA
/end MEASUREMENT
/begin MEASUREMENT B_inimsdko "condition initialization of slow additvie ground current tuning" UBYTE B_TRUE 1 100 0.00 1.00000000000 BIT_MASK 0x1 FORMAT "%13.11" ECU_ADDRESS 0x40008802
 /begin IF_DATA XCPplus 0x0102
  /begin DAQ_EVENT VARIABLE /begin AVAILABLE_EVENT_LIST EVENT 0 EVENT 1 EVENT 2 EVENT 3 /end AVAILABLE_EVENT_LIST /begin DEFAULT_EVENT_LIST EVENT 3 /end DEFAULT_EVENT_LIST /end DAQ_EVENT
 /end IF_DATA
/end MEASUREMENT
/begin MEASUREMENT B_inisabgl "Condition for initializing of the fast mass flow balancing" UBYTE B_TRUE 1 100 0.00 1.00000000000 BIT_MASK 0x1 FORMAT "%13.11" ECU_ADDRESS 0x40008801
 /begin IF_DATA XCPplus 0x0102
  /begin DAQ_EVENT VARIABLE /begin AVAILABLE_EVENT_LIST EVENT 0 EVENT 1 EVENT 2 EVENT 3 /end AVAILABLE_EVENT_LIST /begin DEFAULT_EVENT_LIST EVENT 1 /end DEFAULT_EVENT_LIST /end DAQ_EVENT
 /end IF_DATA
/end MEASUREMENT
/begin MEASUREMENT B_kh "condition catalyst heating activated" UBYTE B_TRUE 1 100 0.00 1.00000000000 BIT_MASK 0x1 FORMAT "%13.11" ECU_ADDRESS 0x400087EB
 /begin IF_DATA XCPplus 0x0102
  /begin DAQ_EVENT VARIABLE /begin AVAILABLE_EVENT_LIST EVENT 0 EVENT 1 EVENT 2 EVENT 3 /end AVAILABLE_EVENT_LIST /begin DEFAULT_EVENT_LIST EVENT 2 /end DEFAULT_EVENT_LIST /end DAQ_EVENT
 /end IF_DATA
/end MEASUREMENT
/begin MEASUREMENT B_khend_FF.status "End of catalyst heating / current value of RS-FF" UBYTE B_TRUE 1 100 0.00 1.00000000000 BIT_MASK 0x1 FORMAT "%13.11" ECU_ADDRESS 0x40008FF2 /end MEASUREMENT
/begin MEASUREMENT B_kherr "error caused disable condition for bit B_kh" UBYTE B_TRUE 1 100 0.00 1.00000000000 BIT_MASK 0x1 FORMAT "%13.11" ECU_ADDRESS 0x400087EE
 /begin IF_DATA XCPplus 0x0102
  /begin DAQ_EVENT VARIABLE /begin AVAILABLE_EVENT_LIST EVENT 0 EVENT 1 EVENT 2 EVENT 3 /end AVAILABLE_EVENT_LIST /begin DEFAULT_EVENT_LIST EVENT 2 /end DEFAULT_EVENT_LIST /end DAQ_EVENT
 /end IF_DATA
/end MEASUREMENT
/begin MEASUREMENT B_khn "condition catalyst heating idle speed" UBYTE B_TRUE 1 100 0.00 1.00000000000 BIT_MASK 0x1 FORMAT "%13.11" ECU_ADDRESS 0x400087EA
 /begin IF_DATA XCPplus 0x0102
  /begin DAQ_EVENT VARIABLE /begin AVAILABLE_EVENT_LIST EVENT 0 EVENT 1 EVENT 2 EVENT 3 /end AVAILABLE_EVENT_LIST /begin DEFAULT_EVENT_LIST EVENT 2 /end DEFAULT_EVENT_LIST /end DAQ_EVENT
 /end IF_DATA
/end MEASUREMENT
/begin MEASUREMENT B_khres "condition reset bit B_kh" UBYTE B_TRUE 1 100 0.00 1.00000000000 BIT_MASK 0x1 FORMAT "%13.11" ECU_ADDRESS 0x400087EF
 /begin IF_DATA XCPplus 0x0102
  /begin DAQ_EVENT VARIABLE /begin AVAILABLE_EVENT_LIST EVENT 0 EVENT 1 EVENT 2 EVENT 3 /end AVAILABLE_EVENT_LIST /begin DEFAULT_EVENT_LIST EVENT 2 /end DEFAULT_EVENT_LIST /end DAQ_EVENT
 /end IF_DATA
/end MEASUREMENT
/begin MEASUREMENT B_khset "condition set bit B_kh" UBYTE B_TRUE 1 100 0.00 1.00000000000 BIT_MASK 0x1 FORMAT "%13.11" ECU_ADDRESS 0x400087F1
 /begin IF_DATA XCPplus 0x0102
  /begin DAQ_EVENT VARIABLE /begin AVAILABLE_EVENT_LIST EVENT 0 EVENT 1 EVENT 2 EVENT 3 /end AVAILABLE_EVENT_LIST /begin DEFAULT_EVENT_LIST EVENT 2 /end DEFAULT_EVENT_LIST /end DAQ_EVENT
 /end IF_DATA
/end MEASUREMENT
/begin MEASUREMENT B_khstc "Release of catalyst heating condition depending on temperature or soak time" UBYTE B_TRUE 1 100 0.00 1.00000000000 BIT_MASK 0x1 FORMAT "%13.11" ECU_ADDRESS 0x400087F0
 /begin IF_DATA XCPplus 0x0102
  /begin DAQ_EVENT VARIABLE /begin AVAILABLE_EVENT_LIST EVENT 0 EVENT 1 EVENT 2 EVENT 3 /end AVAILABLE_EVENT_LIST /begin DEFAULT_EVENT_LIST EVENT 2 /end DEFAULT_EVENT_LIST /end DAQ_EVENT
 /end IF_DATA
/end MEASUREMENT
/begin MEASUREMENT B_koevab "injection valve cutoff active by function KOEVAB" UBYTE B_TRUE 1 100 0.00 1.00000000000 BIT_MASK 0x1 FORMAT "%13.11" ECU_ADDRESS 0x400087C8
 /begin IF_DATA XCPplus 0x0102
  /begin DAQ_EVENT VARIABLE /begin AVAILABLE_EVENT_LIST EVENT 0 EVENT 1 EVENT 2 EVENT 3 /end AVAILABLE_EVENT_LIST /begin DEFAULT_EVENT_LIST EVENT 2 /end DEFAULT_EVENT_LIST /end DAQ_EVENT
 /end IF_DATA
/end MEASUREMENT
/begin MEASUREMENT B_lamsoap "Condition target lambda for application" UBYTE B_TRUE 1 100 0.00 1.00000000000 BIT_MASK 0x10 FORMAT "%13.11" ECU_ADDRESS 0x400087CF
 /begin IF_DATA XCPplus 0x0102
  /begin DAQ_EVENT VARIABLE /begin AVAILABLE_EVENT_LIST EVENT 0 EVENT 1 EVENT 2 EVENT 3 /end AVAILABLE_EVENT_LIST /begin DEFAULT_EVENT_LIST EVENT 2 /end DEFAULT_EVENT_LIST /end DAQ_EVENT
 /end IF_DATA
/end MEASUREMENT
/begin MEASUREMENT B_lraofap "Mixture adaptation disabled for application" UBYTE B_TRUE 1 100 0.00 1.00000000000 BIT_MASK 0x80 FORMAT "%13.11" ECU_ADDRESS 0x400087CF
 /begin IF_DATA XCPplus 0x0102
  /begin DAQ_EVENT VARIABLE /begin AVAILABLE_EVENT_LIST EVENT 0 EVENT 1 EVENT 2 EVENT 3 /end AVAILABLE_EVENT_LIST /begin DEFAULT_EVENT_LIST EVENT 2 /end DEFAULT_EVENT_LIST /end DAQ_EVENT
 /end IF_DATA
/end MEASUREMENT
/begin MEASUREMENT B_lrarsap "initialise mixture adaptation factors for application" UBYTE B_TRUE 1 100 0.00 1.00000000000 BIT_MASK 0x1 FORMAT "%13.11" ECU_ADDRESS 0x400087CE
 /begin IF_DATA XCPplus 0x0102
  /begin DAQ_EVENT VARIABLE /begin AVAILABLE_EVENT_LIST EVENT 0 EVENT 1 EVENT 2 EVENT 3 /end AVAILABLE_EVENT_LIST /begin DEFAULT_EVENT_LIST EVENT 2 /end DEFAULT_EVENT_LIST /end DAQ_EVENT
 /end IF_DATA
/end MEASUREMENT
/begin MEASUREMENT B_lroffap "Lambda control disabled for application" UBYTE B_TRUE 1 100 0.00 1.00000000000 BIT_MASK 0x8 FORMAT "%13.11" ECU_ADDRESS 0x400087CF
 /begin IF_DATA XCPplus 0x0102
  /begin DAQ_EVENT VARIABLE /begin AVAILABLE_EVENT_LIST EVENT 0 EVENT 1 EVENT 2 EVENT 3 /end AVAILABLE_EVENT_LIST /begin DEFAULT_EVENT_LIST EVENT 2 /end DEFAULT_EVENT_LIST /end DAQ_EVENT
 /end IF_DATA
/end MEASUREMENT
/begin MEASUREMENT B_mdoffap "Torque stucture disabled for application" UBYTE B_TRUE 1 100 0.00 1.00000000000 BIT_MASK 0x1 FORMAT "%13.11" ECU_ADDRESS 0x400087CF
 /begin IF_DATA XCPplus 0x0102
  /begin DAQ_EVENT VARIABLE /begin AVAILABLE_EVENT_LIST EVENT 0 EVENT 1 EVENT 2 EVENT 3 /end AVAILABLE_EVENT_LIST /begin DEFAULT_EVENT_LIST EVENT 2 /end DEFAULT_EVENT_LIST /end DAQ_EVENT
 /end IF_DATA
/end MEASUREMENT
/begin MEASUREMENT B_mlmntpa "Mass flow less than threshold value KLMLTPATU delay of B_atmtpa" UBYTE B_TRUE 1 100 0.00 1.00000000000 BIT_MASK 0x1 FORMAT "%13.11" ECU_ADDRESS 0x400087E1
 /begin IF_DATA XCPplus 0x0102
  /begin DAQ_EVENT VARIABLE /begin AVAILABLE_EVENT_LIST EVENT 0 EVENT 1 EVENT 2 EVENT 3 /end AVAILABLE_EVENT_LIST /begin DEFAULT_EVENT_LIST EVENT 3 /end DEFAULT_EVENT_LIST /end DAQ_EVENT
 /end IF_DATA
/end MEASUREMENT
/begin MEASUREMENT B_msndko "release condition for slow add. Mass flow balancing" UBYTE B_TRUE 1 100 0.00 1.00000000000 BIT_MASK 0x1 FORMAT "%13.11" ECU_ADDRESS 0x40008800
 /begin IF_DATA XCPplus 0x0102
  /begin DAQ_EVENT VARIABLE /begin AVAILABLE_EVENT_LIST EVENT 0 EVENT 1 EVENT 2 EVENT 3 /end AVAILABLE_EVENT_LIST /begin DEFAULT_EVENT_LIST EVENT 3 /end DEFAULT_EVENT_LIST /end DAQ_EVENT
 /end IF_DATA
/end MEASUREMENT
/begin MEASUREMENT B_puadapst "Enable condition for ambient pressure during start" UBYTE B_TRUE 1 100 0.00 1.00000000000 BIT_MASK 0x1 FORMAT "%13.11" ECU_ADDRESS 0x40008813
 /begin IF_DATA XCPplus 0x0102
  /begin DAQ_EVENT VARIABLE /begin AVAILABLE_EVENT_LIST EVENT 0 EVENT 1 EVENT 2 EVENT 3 /end AVAILABLE_EVENT_LIST /begin DEFAULT_EVENT_LIST EVENT 1 /end DEFAULT_EVENT_LIST /end DAQ_EVENT
 /end IF_DATA
/end MEASUREMENT
/begin MEASUREMENT B_puadptl "Enblle condition for ambient pressure adaptation" UBYTE B_TRUE 1 100 0.00 1.00000000000 BIT_MASK 0x1 FORMAT "%13.11" ECU_ADDRESS 0x40008814
 /begin IF_DATA XCPplus 0x0102
  /begin DAQ_EVENT VARIABLE /begin AVAILABLE_EVENT_LIST EVENT 0 EVENT 1 EVENT 2 EVENT 3 /end AVAILABLE_EVENT_LIST /begin DEFAULT_EVENT_LIST EVENT 1 /end DEFAULT_EVENT_LIST /end DAQ_EVENT
 /end IF_DATA
/end MEASUREMENT
/begin MEASUREMENT B_puadptlavg "Condition: Part load altitude factor sampling and averaging" UBYTE B_TRUE 1 100 0.00 1.00000000000 BIT_MASK 0x1 FORMAT "%13.11" ECU_ADDRESS 0x4000880C
 /begin IF_DATA XCPplus 0x0102
  /begin DAQ_EVENT VARIABLE /begin AVAILABLE_EVENT_LIST EVENT 0 EVENT 1 EVENT 2 EVENT 3 /end AVAILABLE_EVENT_LIST /begin DEFAULT_EVENT_LIST EVENT 1 /end DEFAULT_EVENT_LIST /end DAQ_EVENT
 /end IF_DATA
/end MEASUREMENT
/begin MEASUREMENT B_pucylcnten "Condition: Part load altitude factor sampling" UBYTE B_TRUE 1 100 0.00 1.00000000000 BIT_MASK 0x1 FORMAT "%13.11" ECU_ADDRESS 0x40008815
 /begin IF_DATA XCPplus 0x0102
  /begin DAQ_EVENT VARIABLE /begin AVAILABLE_EVENT_LIST EVENT 0 EVENT 1 EVENT 2 EVENT 3 /end AVAILABLE_EVENT_LIST /begin DEFAULT_EVENT_LIST EVENT 0 /end DEFAULT_EVENT_LIST /end DAQ_EVENT
 /end IF_DATA
/end MEASUREMENT
/begin MEASUREMENT B_puvl "Condition for initialisation of ambient pressure adaptation" UBYTE B_TRUE 1 100 0.00 1.00000000000 BIT_MASK 0x1 FORMAT "%13.11" ECU_ADDRESS 0x4000880B
 /begin IF_DATA XCPplus 0x0102
  /begin DAQ_EVENT VARIABLE /begin AVAILABLE_EVENT_LIST EVENT 0 EVENT 1 EVENT 2 EVENT 3 /end AVAILABLE_EVENT_LIST /begin DEFAULT_EVENT_LIST EVENT 2 /end DEFAULT_EVENT_LIST /end DAQ_EVENT
 /end IF_DATA
/end MEASUREMENT
/begin MEASUREMENT B_rladap "Reset of charge adaptation for application" UBYTE B_TRUE 1 100 0.00 1.00000000000 BIT_MASK 0x2 FORMAT "%13.11" ECU_ADDRESS 0x400087CF
 /begin IF_DATA XCPplus 0x0102
  /begin DAQ_EVENT VARIABLE /begin AVAILABLE_EVENT_LIST EVENT 0 EVENT 1 EVENT 2 EVENT 3 /end AVAILABLE_EVENT_LIST /begin DEFAULT_EVENT_LIST EVENT 2 /end DEFAULT_EVENT_LIST /end DAQ_EVENT
 /end IF_DATA
/end MEASUREMENT
/begin MEASUREMENT B_rlfgdssap "Condition pressure based charge calculation" UBYTE B_TRUE 1 100 0.00 1.00000000000 BIT_MASK 0x1 FORMAT "%13.11" ECU_ADDRESS 0x400087C7
 /begin IF_DATA XCPplus 0x0102
  /begin DAQ_EVENT VARIABLE /begin AVAILABLE_EVENT_LIST EVENT 0 EVENT 1 EVENT 2 EVENT 3 /end AVAILABLE_EVENT_LIST /begin DEFAULT_EVENT_LIST EVENT 2 /end DEFAULT_EVENT_LIST /end DAQ_EVENT
 /end IF_DATA
/end MEASUREMENT
/begin MEASUREMENT B_sab "Condition fuel cut-off requested" UBYTE B_TRUE 1 100 0.00 1.00000000000 BIT_MASK 0x1 FORMAT "%13.11" ECU_ADDRESS 0x400087F5
 /begin IF_DATA XCPplus 0x0102
  /begin DAQ_EVENT VARIABLE /begin AVAILABLE_EVENT_LIST EVENT 0 EVENT 1 EVENT 2 EVENT 3 /end AVAILABLE_EVENT_LIST /begin DEFAULT_EVENT_LIST EVENT 1 /end DEFAULT_EVENT_LIST /end DAQ_EVENT
 /end IF_DATA
/end MEASUREMENT
/begin MEASUREMENT B_sabte "Condition fuel cut-off requested for canister purge valve close" UBYTE B_TRUE 1 100 0.00 1.00000000000 BIT_MASK 0x1 FORMAT "%13.11" ECU_ADDRESS 0x400087F4
 /begin IF_DATA XCPplus 0x0102
  /begin DAQ_EVENT VARIABLE /begin AVAILABLE_EVENT_LIST EVENT 0 EVENT 1 EVENT 2 EVENT 3 /end AVAILABLE_EVENT_LIST /begin DEFAULT_EVENT_LIST EVENT 1 /end DEFAULT_EVENT_LIST /end DAQ_EVENT
 /end IF_DATA
/end MEASUREMENT
/begin MEASUREMENT B_sar "Actication condition for considering anti-jerking interventions torque" UBYTE B_TRUE 1 100 0.00 1.00000000000 BIT_MASK 0x1 FORMAT "%13.11" ECU_ADDRESS 0x400087D1
 /begin IF_DATA XCPplus 0x0102
  /begin DAQ_EVENT VARIABLE /begin AVAILABLE_EVENT_LIST EVENT 0 EVENT 1 EVENT 2 EVENT 3 /end AVAILABLE_EVENT_LIST /begin DEFAULT_EVENT_LIST EVENT 0 /end DEFAULT_EVENT_LIST /end DAQ_EVENT
 /end IF_DATA
/end MEASUREMENT
/begin MEASUREMENT B_sarv "Flag for deactivation of anti-jerking interventions during change of gears" UBYTE B_TRUE 1 100 0.00 1.00000000000 BIT_MASK 0x1 FORMAT "%13.11" ECU_ADDRESS 0x400087D0
 /begin IF_DATA XCPplus 0x0102
  /begin DAQ_EVENT VARIABLE /begin AVAILABLE_EVENT_LIST EVENT 0 EVENT 1 EVENT 2 EVENT 3 /end AVAILABLE_EVENT_LIST /begin DEFAULT_EVENT_LIST EVENT 0 /end DEFAULT_EVENT_LIST /end DAQ_EVENT
 /end IF_DATA
/end MEASUREMENT
/begin MEASUREMENT B_spgwhs "Condition memory of gear change for manual transmission" UBYTE B_TRUE 1 100 0.00 1.00000000000 BIT_MASK 0x1 FORMAT "%13.11" ECU_ADDRESS 0x400087D4
 /begin IF_DATA XCPplus 0x0102
  /begin DAQ_EVENT VARIABLE /begin AVAILABLE_EVENT_LIST EVENT 0 EVENT 1 EVENT 2 EVENT 3 /end AVAILABLE_EVENT_LIST /begin DEFAULT_EVENT_LIST EVENT 1 /end DEFAULT_EVENT_LIST /end DAQ_EVENT
 /end IF_DATA
/end MEASUREMENT
/begin MEASUREMENT B_st_ER.buffer "condition for start / rising edge detected" UBYTE B_TRUE 1 100 0.00 1.00000000000 BIT_MASK 0x1 FORMAT "%13.11" ECU_ADDRESS 0x40008FF0 /end MEASUREMENT
/begin MEASUREMENT B_st_ER.oldSignal "condition for start / flag rising edge" UBYTE B_TRUE 1 100 0.00 1.00000000000 BIT_MASK 0x1 FORMAT "%13.11" ECU_ADDRESS 0x40008FF1 /end MEASUREMENT
/begin MEASUREMENT B_sz "Condition fuel cut-off counter during altitude correction" UBYTE B_TRUE 1 100 0.00 1.00000000000 BIT_MASK 0x1 FORMAT "%13.11" ECU_ADDRESS 0x4000880A
 /begin IF_DATA XCPplus 0x0102
  /begin DAQ_EVENT VARIABLE /begin AVAILABLE_EVENT_LIST EVENT 0 EVENT 1 EVENT 2 EVENT 3 /end AVAILABLE_EVENT_LIST /begin DEFAULT_EVENT_LIST EVENT 2 /end DEFAULT_EVENT_LIST /end DAQ_EVENT
 /end IF_DATA
/end MEASUREMENT
/begin MEASUREMENT B_te "Condition canister purge active" UBYTE B_TRUE 1 100 0.00 1.00000000000 BIT_MASK 0x1 FORMAT "%13.11" ECU_ADDRESS 0x400087FD
 /begin IF_DATA XCPplus 0x0102
  /begin DAQ_EVENT VARIABLE /begin AVAILABLE_EVENT_LIST EVENT 0 EVENT 1 EVENT 2 EVENT 3 /end AVAILABLE_EVENT_LIST /begin DEFAULT_EVENT_LIST EVENT 2 /end DEFAULT_EVENT_LIST /end DAQ_EVENT
 /end IF_DATA
/end MEASUREMENT
/begin MEASUREMENT B_tebr "Condition for break off the Canister Purging" UBYTE B_TRUE 1 100 0.00 1.00000000000 BIT_MASK 0x1 FORMAT "%13.11" ECU_ADDRESS 0x400087FC
 /begin IF_DATA XCPplus 0x0102
  /begin DAQ_EVENT VARIABLE /begin AVAILABLE_EVENT_LIST EVENT 0 EVENT 1 EVENT 2 EVENT 3 /end AVAILABLE_EVENT_LIST /begin DEFAULT_EVENT_LIST EVENT 2 /end DEFAULT_EVENT_LIST /end DAQ_EVENT
 /end IF_DATA
/end MEASUREMENT
/begin MEASUREMENT B_tebts "Condition canister purge during component protection" UBYTE B_TRUE 1 100 0.00 1.00000000000 BIT_MASK 0x1 FORMAT "%13.11" ECU_ADDRESS 0x400087FB
 /begin IF_DATA XCPplus 0x0102
  /begin DAQ_EVENT VARIABLE /begin AVAILABLE_EVENT_LIST EVENT 0 EVENT 1 EVENT 2 EVENT 3 /end AVAILABLE_EVENT_LIST /begin DEFAULT_EVENT_LIST EVENT 2 /end DEFAULT_EVENT_LIST /end DAQ_EVENT
 /end IF_DATA
/end MEASUREMENT
/begin MEASUREMENT B_temn "Condition for minimum time for canister purging" UBYTE B_TRUE 1 100 0.00 1.00000000000 BIT_MASK 0x1 FORMAT "%13.11" ECU_ADDRESS 0x400087FA
 /begin IF_DATA XCPplus 0x0102
  /begin DAQ_EVENT VARIABLE /begin AVAILABLE_EVENT_LIST EVENT 0 EVENT 1 EVENT 2 EVENT 3 /end AVAILABLE_EVENT_LIST /begin DEFAULT_EVENT_LIST EVENT 2 /end DEFAULT_EVENT_LIST /end DAQ_EVENT
 /end IF_DATA
/end MEASUREMENT
/begin MEASUREMENT B_temx "Condition for maximum time for canister purge" UBYTE B_TRUE 1 100 0.00 1.00000000000 BIT_MASK 0x1 FORMAT "%13.11" ECU_ADDRESS 0x400087F9
 /begin IF_DATA XCPplus 0x0102
  /begin DAQ_EVENT VARIABLE /begin AVAILABLE_EVENT_LIST EVENT 0 EVENT 1 EVENT 2 EVENT 3 /end AVAILABLE_EVENT_LIST /begin DEFAULT_EVENT_LIST EVENT 2 /end DEFAULT_EVENT_LIST /end DAQ_EVENT
 /end IF_DATA
/end MEASUREMENT
/begin MEASUREMENT B_teoffap "Purge control disabled for application" UBYTE B_TRUE 1 100 0.00 1.00000000000 BIT_MASK 0x40 FORMAT "%13.11" ECU_ADDRESS 0x400087CF
 /begin IF_DATA XCPplus 0x0102
  /begin DAQ_EVENT VARIABLE /begin AVAILABLE_EVENT_LIST EVENT 0 EVENT 1 EVENT 2 EVENT 3 /end AVAILABLE_EVENT_LIST /begin DEFAULT_EVENT_LIST EVENT 2 /end DEFAULT_EVENT_LIST /end DAQ_EVENT
 /end IF_DATA
/end MEASUREMENT
/begin MEASUREMENT B_tepap "force purge control phase for application" UBYTE B_TRUE 1 100 0.00 1.00000000000 BIT_MASK 0x20 FORMAT "%13.11" ECU_ADDRESS 0x400087CF
 /begin IF_DATA XCPplus 0x0102
  /begin DAQ_EVENT VARIABLE /begin AVAILABLE_EVENT_LIST EVENT 0 EVENT 1 EVENT 2 EVENT 3 /end AVAILABLE_EVENT_LIST /begin DEFAULT_EVENT_LIST EVENT 2 /end DEFAULT_EVENT_LIST /end DAQ_EVENT
 /end IF_DATA
/end MEASUREMENT
/begin MEASUREMENT B_teph "Condition for canister purge phase." UBYTE B_TRUE 1 100 0.00 1.00000000000 BIT_MASK 0x1 FORMAT "%13.11" ECU_ADDRESS 0x400087F8
 /begin IF_DATA XCPplus 0x0102
  /begin DAQ_EVENT VARIABLE /begin AVAILABLE_EVENT_LIST EVENT 0 EVENT 1 EVENT 2 EVENT 3 /end AVAILABLE_EVENT_LIST /begin DEFAULT_EVENT_LIST EVENT 2 /end DEFAULT_EVENT_LIST /end DAQ_EVENT
 /end IF_DATA
/end MEASUREMENT
/begin MEASUREMENT B_tkihkmst "Condition Catalyst temperature calculation" UBYTE B_TRUE 1 100 0.00 1.00000000000 BIT_MASK 0x1 FORMAT "%13.11" ECU_ADDRESS 0x400087E3
 /begin IF_DATA XCPplus 0x0102
  /begin DAQ_EVENT VARIABLE /begin AVAILABLE_EVENT_LIST EVENT 0 EVENT 1 EVENT 2 EVENT 3 /end AVAILABLE_EVENT_LIST /begin DEFAULT_EVENT_LIST EVENT 3 /end DEFAULT_EVENT_LIST /end DAQ_EVENT
 /end IF_DATA
/end MEASUREMENT
/begin MEASUREMENT B_ugd "condition: throttle angle greater or equal wdkugd" UBYTE B_TRUE 1 100 0.00 1.00000000000 BIT_MASK 0x1 FORMAT "%13.11" ECU_ADDRESS 0x40008809
 /begin IF_DATA XCPplus 0x0102
  /begin DAQ_EVENT VARIABLE /begin AVAILABLE_EVENT_LIST EVENT 0 EVENT 1 EVENT 2 EVENT 3 /end AVAILABLE_EVENT_LIST /begin DEFAULT_EVENT_LIST EVENT 2 /end DEFAULT_EVENT_LIST /end DAQ_EVENT
 /end IF_DATA
/end MEASUREMENT
/begin MEASUREMENT B_wesyn "Condition re-injection after fuel cut-off from crank angle synchronous task" UBYTE B_TRUE 1 100 0.00 1.00000000000 BIT_MASK 0x1 FORMAT "%13.11" ECU_ADDRESS 0x400087F3
 /begin IF_DATA XCPplus 0x0102
  /begin DAQ_EVENT VARIABLE /begin AVAILABLE_EVENT_LIST EVENT 0 EVENT 1 EVENT 2 EVENT 3 /end AVAILABLE_EVENT_LIST /begin DEFAULT_EVENT_LIST EVENT 0 /end DEFAULT_EVENT_LIST /end DAQ_EVENT
 /end IF_DATA
/end MEASUREMENT
/begin MEASUREMENT B_wind0_err "Window sampling for cylinder0 is not valid" UBYTE B_TRUE 1 100 0.00 1.00000000000 BIT_MASK 0x1 FORMAT "%13.11" ECU_ADDRESS 0x400087C4 /end MEASUREMENT
/begin MEASUREMENT cntfhotl "Number of altitude factor sample for adaptation" UBYTE dez 1 100 0.00 255.0 FORMAT "%5.1" ECU_ADDRESS 0x40008816
 /begin IF_DATA XCPplus 0x0102
  /begin DAQ_EVENT VARIABLE /begin AVAILABLE_EVENT_LIST EVENT 0 EVENT 1 EVENT 2 EVENT 3 /end AVAILABLE_EVENT_LIST /begin DEFAULT_EVENT_LIST EVENT 0 /end DEFAULT_EVENT_LIST /end DAQ_EVENT
 /end IF_DATA
/end MEASUREMENT
/begin MEASUREMENT CoEng_nDeltaFuCutOff "delta engine speed for fuel cut off threshold computation" UWORD nmot_uw_q0p25 1 100 0.00 16383.75 FORMAT "%8.2" ECU_ADDRESS 0x400083E2
 /begin IF_DATA XCPplus 0x0102
  /begin DAQ_EVENT VARIABLE /begin AVAILABLE_EVENT_LIST EVENT 0 EVENT 1 EVENT 2 EVENT 3 /end AVAILABLE_EVENT_LIST /begin DEFAULT_EVENT_LIST EVENT 1 /end DEFAULT_EVENT_LIST /end DAQ_EVENT
 /end IF_DATA
/end MEASUREMENT
/begin MEASUREMENT dfhomm_w "correction factor: altitude from model" SWORD fak_sw_b2 1 100 -2.000000 1.999939 FORMAT "%8.6" ECU_ADDRESS 0x4000840E
 /begin IF_DATA XCPplus 0x0102
  /begin DAQ_EVENT VARIABLE /begin AVAILABLE_EVENT_LIST EVENT 0 EVENT 1 EVENT 2 EVENT 3 /end AVAILABLE_EVENT_LIST /begin DEFAULT_EVENT_LIST EVENT 2 /end DEFAULT_EVENT_LIST /end DAQ_EVENT
 /end IF_DATA
/end MEASUREMENT
/begin MEASUREMENT dfkmsadp_w "delta correction factor for mass-flow substitute load signal" SWORD fak_sw_b1 1 100 -1.000000 0.9999695 FORMAT "%8.6" ECU_ADDRESS 0x400083F4
 /begin IF_DATA XCPplus 0x0102
  /begin DAQ_EVENT VARIABLE /begin AVAILABLE_EVENT_LIST EVENT 0 EVENT 1 EVENT 2 EVENT 3 /end AVAILABLE_EVENT_LIST /begin DEFAULT_EVENT_LIST EVENT 1 /end DEFAULT_EVENT_LIST /end DAQ_EVENT
 /end IF_DATA
/end MEASUREMENT
/begin MEASUREMENT dfuelsan_w "Delta charge sensor to alpha/n-systems" SWORD fak_sw_b1 1 100 -1.000000 0.9999695 FORMAT "%8.6" ECU_ADDRESS 0x400083F2
 /begin IF_DATA XCPplus 0x0102
  /begin DAQ_EVENT VARIABLE /begin AVAILABLE_EVENT_LIST EVENT 0 EVENT 1 EVENT 2 EVENT 3 /end AVAILABLE_EVENT_LIST /begin DEFAULT_EVENT_LIST EVENT 1 /end DEFAULT_EVENT_LIST /end DAQ_EVENT
 /end IF_DATA
/end MEASUREMENT
/begin MEASUREMENT distctr_w "Pulse counter" UWORD s_q0p02777_m 1 100 0.00 1820.417 FORMAT "%8.3" ECU_ADDRESS 0x4000C6BA
 /begin IF_DATA XCPplus 0x0102
  /begin DAQ_EVENT VARIABLE /begin AVAILABLE_EVENT_LIST EVENT 0 EVENT 1 EVENT 2 EVENT 3 /end AVAILABLE_EVENT_LIST /begin DEFAULT_EVENT_LIST EVENT 3 /end DEFAULT_EVENT_LIST /end DAQ_EVENT
 /end IF_DATA
/end MEASUREMENT
/begin MEASUREMENT dmar_w "delta torque anti-jerk" SWORD rel_sw_b100 1 100 -100.0000 99.99695 FORMAT "%8.4" ECU_ADDRESS 0x400083CC
 /begin IF_DATA XCPplus 0x0102
  /begin DAQ_EVENT VARIABLE /begin AVAILABLE_EVENT_LIST EVENT 0 EVENT 1 EVENT 2 EVENT 3 /end AVAILABLE_EVENT_LIST /begin DEFAULT_EVENT_LIST EVENT 0 /end DEFAULT_EVENT_LIST /end DAQ_EVENT
 /end IF_DATA
/end MEASUREMENT
/begin MEASUREMENT dofmsndkq_w "delta offset norm air mass flow through throttle blade (increased resolution)" SWORD m_sw_q0p01 1 100 -327.6800 327.6700 FORMAT "%8.4" ECU_ADDRESS 0x4000C6B8
 /begin IF_DATA XCPplus 0x0102
  /begin DAQ_EVENT VARIABLE /begin AVAILABLE_EVENT_LIST EVENT 0 EVENT 1 EVENT 2 EVENT 3 /end AVAILABLE_EVENT_LIST /begin DEFAULT_EVENT_LIST EVENT 3 /end DEFAULT_EVENT_LIST /end DAQ_EVENT
 /end IF_DATA
/end MEASUREMENT
/begin MEASUREMENT dpupvdk_w "Delta ambient- and pre-throttle-valve pressure" UWORD p_uw_q0p039 1 100 0.00 2559.961 FORMAT "%8.3" ECU_ADDRESS 0x40008406
 /begin IF_DATA XCPplus 0x0102
  /begin DAQ_EVENT VARIABLE /begin AVAILABLE_EVENT_LIST EVENT 0 EVENT 1 EVENT 2 EVENT 3 /end AVAILABLE_EVENT_LIST /begin DEFAULT_EVENT_LIST EVENT 2 /end DEFAULT_EVENT_LIST /end DAQ_EVENT
 /end IF_DATA
/end MEASUREMENT
/begin MEASUREMENT drldk "Delta air charge between unfiltered and filtered value of alpha/n-system" UBYTE rel_ub_q0p75 1 100 0.00 191.3 FORMAT "%5.1" ECU_ADDRESS 0x4000881C
 /begin IF_DATA XCPplus 0x0102
  /begin DAQ_EVENT VARIABLE /begin AVAILABLE_EVENT_LIST EVENT 0 EVENT 1 EVENT 2 EVENT 3 /end AVAILABLE_EVENT_LIST /begin DEFAULT_EVENT_LIST EVENT 0 /end DEFAULT_EVENT_LIST /end DAQ_EVENT
 /end IF_DATA
/end MEASUREMENT
/begin MEASUREMENT drldkrohdyn_w "Delta air charge during transients- Calculates in 1 ms" SWORD rel_sw_q0p0234 1 100 -768.0000 767.9766 FORMAT "%8.4" ECU_ADDRESS 0x4000847C
 /begin IF_DATA XCPplus 0x0102
  /begin DAQ_EVENT VARIABLE /begin AVAILABLE_EVENT_LIST EVENT 0 EVENT 1 EVENT 2 EVENT 3 /end AVAILABLE_EVENT_LIST /begin DEFAULT_EVENT_LIST EVENT 1 /end DEFAULT_EVENT_LIST /end DAQ_EVENT
 /end IF_DATA
/end MEASUREMENT
/begin MEASUREMENT dzwap "ignition angle offset for application" SBYTE zw_sb_q0p75 1 100 -96.00 95.25 FORMAT "%5.2" ECU_ADDRESS 0x400087CD
 /begin IF_DATA XCPplus 0x0102
  /begin DAQ_EVENT VARIABLE /begin AVAILABLE_EVENT_LIST EVENT 0 EVENT 1 EVENT 2 EVENT 3 /end AVAILABLE_EVENT_LIST /begin DEFAULT_EVENT_LIST EVENT 2 /end DEFAULT_EVENT_LIST /end DAQ_EVENT
 /end IF_DATA
/end MEASUREMENT
/begin MEASUREMENT dzwap2 "second ignition angle offset for application" SBYTE zw_sb_q0p75 1 100 -96.00 95.25 FORMAT "%5.2" ECU_ADDRESS 0x400087CC
 /begin IF_DATA XCPplus 0x0102
  /begin DAQ_EVENT VARIABLE /begin AVAILABLE_EVENT_LIST EVENT 0 EVENT 1 EVENT 2 EVENT 3 /end AVAILABLE_EVENT_LIST /begin DEFAULT_EVENT_LIST EVENT 2 /end DEFAULT_EVENT_LIST /end DAQ_EVENT
 /end IF_DATA
/end MEASUREMENT
/begin MEASUREMENT engcmbstevnt_l "Engine combustion event counter" ULONG dez 1 100 0.00 4294967295.00 FORMAT "%13.2" ECU_ADDRESS 0x40008F90
 /begin IF_DATA XCPplus 0x0102
  /begin DAQ_EVENT VARIABLE /begin AVAILABLE_EVENT_LIST EVENT 0 EVENT 1 EVENT 2 EVENT 3 /end AVAILABLE_EVENT_LIST /begin DEFAULT_EVENT_LIST EVENT 1 /end DEFAULT_EVENT_LIST /end DAQ_EVENT
 /end IF_DATA
/end MEASUREMENT
/begin MEASUREMENT engrevcntr_l "counter for counting engine revolution" ULONG dez 1 100 0.00 4294967295.00 FORMAT "%13.2" ECU_ADDRESS 0x40008F8C
 /begin IF_DATA XCPplus 0x0102
  /begin DAQ_EVENT VARIABLE /begin AVAILABLE_EVENT_LIST EVENT 0 EVENT 1 EVENT 2 EVENT 3 /end AVAILABLE_EVENT_LIST /begin DEFAULT_EVENT_LIST EVENT 1 /end DEFAULT_EVENT_LIST /end DAQ_EVENT
 /end IF_DATA
/end MEASUREMENT
/begin MEASUREMENT etazwimt "mean efficiency at actual ignition angle (200 ms)" UBYTE rel_ub_b127p5 1 100 0.00 127.5 FORMAT "%5.1" ECU_ADDRESS 0x400087DF
 /begin IF_DATA XCPplus 0x0102
  /begin DAQ_EVENT VARIABLE /begin AVAILABLE_EVENT_LIST EVENT 0 EVENT 1 EVENT 2 EVENT 3 /end AVAILABLE_EVENT_LIST /begin DEFAULT_EVENT_LIST EVENT 3 /end DEFAULT_EVENT_LIST /end DAQ_EVENT
 /end IF_DATA
/end MEASUREMENT
/begin MEASUREMENT evabapp "injection valve cutoff pattern for calibration purpose" UBYTE dez 1 100 0.00 255.0 FORMAT "%5.1" ECU_ADDRESS 0x400087CB /end MEASUREMENT
/begin MEASUREMENT evtmod "modelled temperature at inlet valve" SWORD Temp_Cels 1 100 -3549.940 3003.560 FORMAT "%8.3" ECU_ADDRESS 0x4000848E
 /begin IF_DATA XCPplus 0x0102
  /begin DAQ_EVENT VARIABLE /begin AVAILABLE_EVENT_LIST EVENT 0 EVENT 1 EVENT 2 EVENT 3 /end AVAILABLE_EVENT_LIST /begin DEFAULT_EVENT_LIST EVENT 2 /end DEFAULT_EVENT_LIST /end DAQ_EVENT
 /end IF_DATA
/end MEASUREMENT
/begin MEASUREMENT evtmodfa "modelled temperature at inlet valve" SWORD Temp_Cels 1 100 -3549.940 3003.560 FORMAT "%8.3" ECU_ADDRESS 0x4000848C
 /begin IF_DATA XCPplus 0x0102
  /begin DAQ_EVENT VARIABLE /begin AVAILABLE_EVENT_LIST EVENT 0 EVENT 1 EVENT 2 EVENT 3 /end AVAILABLE_EVENT_LIST /begin DEFAULT_EVENT_LIST EVENT 2 /end DEFAULT_EVENT_LIST /end DAQ_EVENT
 /end IF_DATA
/end MEASUREMENT
/begin MEASUREMENT evz_auscpl "complement of injection cut off pattern total" UBYTE dez 1 100 0.00 255.0 FORMAT "%5.1" ECU_ADDRESS 0x400087C1
 /begin IF_DATA XCPplus 0x0102
  /begin DAQ_EVENT VARIABLE /begin AVAILABLE_EVENT_LIST EVENT 0 EVENT 1 EVENT 2 EVENT 3 /end AVAILABLE_EVENT_LIST /begin DEFAULT_EVENT_LIST EVENT 0 /end DEFAULT_EVENT_LIST /end DAQ_EVENT
 /end IF_DATA
/end MEASUREMENT
/begin MEASUREMENT evz_austot "injection cut off pattern total" UBYTE dez 1 100 0.00 255.0 FORMAT "%5.1" ECU_ADDRESS 0x400087C0
 /begin IF_DATA XCPplus 0x0102
  /begin DAQ_EVENT VARIABLE /begin AVAILABLE_EVENT_LIST EVENT 0 EVENT 1 EVENT 2 EVENT 3 /end AVAILABLE_EVENT_LIST /begin DEFAULT_EVENT_LIST EVENT 0 /end DEFAULT_EVENT_LIST /end DAQ_EVENT
 /end IF_DATA
/end MEASUREMENT
/begin MEASUREMENT ExhMod_flgHeatgTspS1B1 "flag reduced heat quantity threshold for TSP(Thermal shock protection) sensor 1 reached" UBYTE B_TRUE 1 100 0.00 1.00000000000 BIT_MASK 0x1 FORMAT "%13.11" ECU_ADDRESS 0x400087D7
 /begin IF_DATA XCPplus 0x0102
  /begin DAQ_EVENT VARIABLE /begin AVAILABLE_EVENT_LIST EVENT 0 EVENT 1 EVENT 2 EVENT 3 /end AVAILABLE_EVENT_LIST /begin DEFAULT_EVENT_LIST EVENT 3 /end DEFAULT_EVENT_LIST /end DAQ_EVENT
 /end IF_DATA
/end MEASUREMENT
/begin MEASUREMENT ExhMod_tEgMnfldAftCorrn "Manifold exhaust gas temperature after correction." UBYTE temp_ub_q5_o50 1 100 -50.00 1225. FORMAT "%5.0" ECU_ADDRESS 0x400087E4
 /begin IF_DATA XCPplus 0x0102
  /begin DAQ_EVENT VARIABLE /begin AVAILABLE_EVENT_LIST EVENT 0 EVENT 1 EVENT 2 EVENT 3 /end AVAILABLE_EVENT_LIST /begin DEFAULT_EVENT_LIST EVENT 3 /end DEFAULT_EVENT_LIST /end DAQ_EVENT
 /end IF_DATA
/end MEASUREMENT
/begin MEASUREMENT ExhMod_tExo "Exotherm temperature" SWORD temp_q5 1 100 -163840.0 163835.0 FORMAT "%8.1" ECU_ADDRESS 0x400083DE
 /begin IF_DATA XCPplus 0x0102
  /begin DAQ_EVENT VARIABLE /begin AVAILABLE_EVENT_LIST EVENT 0 EVENT 1 EVENT 2 EVENT 3 /end AVAILABLE_EVENT_LIST /begin DEFAULT_EVENT_LIST EVENT 3 /end DEFAULT_EVENT_LIST /end DAQ_EVENT
 /end IF_DATA
/end MEASUREMENT
/begin MEASUREMENT ExhMod_tFcoInactv "Exotherm temperature during fuel cut off" SWORD temp_q5 1 100 -163840.0 163835.0 FORMAT "%8.1" ECU_ADDRESS 0x400083DC
 /begin IF_DATA XCPplus 0x0102
  /begin DAQ_EVENT VARIABLE /begin AVAILABLE_EVENT_LIST EVENT 0 EVENT 1 EVENT 2 EVENT 3 /end AVAILABLE_EVENT_LIST /begin DEFAULT_EVENT_LIST EVENT 3 /end DEFAULT_EVENT_LIST /end DAQ_EVENT
 /end IF_DATA
/end MEASUREMENT
/begin MEASUREMENT fgwar_w "Factor for gear change anti-jerking function" UWORD fak_uw_b2 1 100 0.00 1.000000 FORMAT "%8.6" ECU_ADDRESS 0x400083D2
 /begin IF_DATA XCPplus 0x0102
  /begin DAQ_EVENT VARIABLE /begin AVAILABLE_EVENT_LIST EVENT 0 EVENT 1 EVENT 2 EVENT 3 /end AVAILABLE_EVENT_LIST /begin DEFAULT_EVENT_LIST EVENT 1 /end DEFAULT_EVENT_LIST /end DAQ_EVENT
 /end IF_DATA
/end MEASUREMENT
/begin MEASUREMENT fho "Altitude correction factor" UBYTE fak_ub_b4 1 100 0.00 3.984 FORMAT "%5.3" ECU_ADDRESS 0x40008811
 /begin IF_DATA XCPplus 0x0102
  /begin DAQ_EVENT VARIABLE /begin AVAILABLE_EVENT_LIST EVENT 0 EVENT 1 EVENT 2 EVENT 3 /end AVAILABLE_EVENT_LIST /begin DEFAULT_EVENT_LIST EVENT 2 /end DEFAULT_EVENT_LIST /end DAQ_EVENT
 /end IF_DATA
/end MEASUREMENT
/begin MEASUREMENT fhoac_w "application interface for altitude correction factor" UWORD fak_uw_b4 1 100 0.00 3.999939 FORMAT "%8.6" ECU_ADDRESS 0x40008404
 /begin IF_DATA XCPplus 0x0102
  /begin DAQ_EVENT VARIABLE /begin AVAILABLE_EVENT_LIST EVENT 0 EVENT 1 EVENT 2 EVENT 3 /end AVAILABLE_EVENT_LIST /begin DEFAULT_EVENT_LIST EVENT 2 /end DEFAULT_EVENT_LIST /end DAQ_EVENT
 /end IF_DATA
/end MEASUREMENT
/begin MEASUREMENT fhoap_w "Ini value altitude factor for application" UWORD fak_uw_b4 1 100 0.00 3.999939 FORMAT "%8.6" ECU_ADDRESS 0x400083C8
 /begin IF_DATA XCPplus 0x0102
  /begin DAQ_EVENT VARIABLE /begin AVAILABLE_EVENT_LIST EVENT 0 EVENT 1 EVENT 2 EVENT 3 /end AVAILABLE_EVENT_LIST /begin DEFAULT_EVENT_LIST EVENT 2 /end DEFAULT_EVENT_LIST /end DAQ_EVENT
 /end IF_DATA
/end MEASUREMENT
/begin MEASUREMENT fhomm_w "correction factor: altitude from model" UWORD fak_uw_b4 1 100 0.00 3.999939 FORMAT "%8.6" ECU_ADDRESS 0x4000840A
 /begin IF_DATA XCPplus 0x0102
  /begin DAQ_EVENT VARIABLE /begin AVAILABLE_EVENT_LIST EVENT 0 EVENT 1 EVENT 2 EVENT 3 /end AVAILABLE_EVENT_LIST /begin DEFAULT_EVENT_LIST EVENT 1 /end DEFAULT_EVENT_LIST /end DAQ_EVENT
 /end IF_DATA
/end MEASUREMENT
/begin MEASUREMENT fhomp "correction factor: altitude from model" UBYTE fak_ub_b4 1 100 0.00 3.984 FORMAT "%5.3" ECU_ADDRESS 0x40008810
 /begin IF_DATA XCPplus 0x0102
  /begin DAQ_EVENT VARIABLE /begin AVAILABLE_EVENT_LIST EVENT 0 EVENT 1 EVENT 2 EVENT 3 /end AVAILABLE_EVENT_LIST /begin DEFAULT_EVENT_LIST EVENT 2 /end DEFAULT_EVENT_LIST /end DAQ_EVENT
 /end IF_DATA
/end MEASUREMENT
/begin MEASUREMENT fhomp_w "correction factor: altitude from model" UWORD fak_uw_b4 1 100 0.00 3.999939 FORMAT "%8.6" ECU_ADDRESS 0x4000C6BC
 /begin IF_DATA XCPplus 0x0102
  /begin DAQ_EVENT VARIABLE /begin AVAILABLE_EVENT_LIST EVENT 0 EVENT 1 EVENT 2 EVENT 3 /end AVAILABLE_EVENT_LIST /begin DEFAULT_EVENT_LIST EVENT 2 /end DEFAULT_EVENT_LIST /end DAQ_EVENT
 /end IF_DATA
/end MEASUREMENT
/begin MEASUREMENT fhomsa_w "Altitude adaptation factor during down hill movement" UWORD fak_uw_b4 1 100 0.00 3.999939 FORMAT "%8.6" ECU_ADDRESS 0x40008402
 /begin IF_DATA XCPplus 0x0102
  /begin DAQ_EVENT VARIABLE /begin AVAILABLE_EVENT_LIST EVENT 0 EVENT 1 EVENT 2 EVENT 3 /end AVAILABLE_EVENT_LIST /begin DEFAULT_EVENT_LIST EVENT 2 /end DEFAULT_EVENT_LIST /end DAQ_EVENT
 /end IF_DATA
/end MEASUREMENT
/begin MEASUREMENT fhomst_w "Altitude adaptation factor during start condition" UWORD fak_uw_b4 1 100 0.00 3.999939 FORMAT "%8.6" ECU_ADDRESS 0x4000840C
 /begin IF_DATA XCPplus 0x0102
  /begin DAQ_EVENT VARIABLE /begin AVAILABLE_EVENT_LIST EVENT 0 EVENT 1 EVENT 2 EVENT 3 /end AVAILABLE_EVENT_LIST /begin DEFAULT_EVENT_LIST EVENT 2 /end DEFAULT_EVENT_LIST /end DAQ_EVENT
 /end IF_DATA
/end MEASUREMENT
/begin MEASUREMENT fhomtlavg_w "Part load altitude factor sampled average value" UWORD fak_uw_b4 1 100 0.00 3.999939 FORMAT "%8.6" ECU_ADDRESS 0x40008432
 /begin IF_DATA XCPplus 0x0102
  /begin DAQ_EVENT VARIABLE /begin AVAILABLE_EVENT_LIST EVENT 0 EVENT 1 EVENT 2 EVENT 3 /end AVAILABLE_EVENT_LIST /begin DEFAULT_EVENT_LIST EVENT 1 /end DEFAULT_EVENT_LIST /end DAQ_EVENT
 /end IF_DATA
/end MEASUREMENT
/begin MEASUREMENT fhomtlsamp_a "Array: Part load altitude factor sampled value" UWORD fak_uw_b4 1 100 0.00 3.999939 FORMAT "%8.6" ARRAY_SIZE 16 ECU_ADDRESS 0x40008412
 /begin IF_DATA XCPplus 0x0102
  /begin DAQ_EVENT VARIABLE /begin AVAILABLE_EVENT_LIST EVENT 0 EVENT 1 EVENT 2 EVENT 3 /end AVAILABLE_EVENT_LIST /begin DEFAULT_EVENT_LIST EVENT 0 /end DEFAULT_EVENT_LIST /end DAQ_EVENT
 /end IF_DATA
/end MEASUREMENT
/begin MEASUREMENT fhomtl_w "Altitude adaptation factor during part load condition" UWORD fak_uw_b4 1 100 0.00 3.999939 FORMAT "%8.6" ECU_ADDRESS 0x40008400
 /begin IF_DATA XCPplus 0x0102
  /begin DAQ_EVENT VARIABLE /begin AVAILABLE_EVENT_LIST EVENT 0 EVENT 1 EVENT 2 EVENT 3 /end AVAILABLE_EVENT_LIST /begin DEFAULT_EVENT_LIST EVENT 1 /end DEFAULT_EVENT_LIST /end DAQ_EVENT
 /end IF_DATA
/end MEASUREMENT
/begin MEASUREMENT fhomvl_w "Altitude adaptation factor based on WOT condition" UWORD fak_uw_b4 1 100 0.00 3.999939 FORMAT "%8.6" ECU_ADDRESS 0x40008434
 /begin IF_DATA XCPplus 0x0102
  /begin DAQ_EVENT VARIABLE /begin AVAILABLE_EVENT_LIST EVENT 0 EVENT 1 EVENT 2 EVENT 3 /end AVAILABLE_EVENT_LIST /begin DEFAULT_EVENT_LIST EVENT 2 /end DEFAULT_EVENT_LIST /end DAQ_EVENT
 /end IF_DATA
/end MEASUREMENT
/begin MEASUREMENT fhom_w "correction factor: altitude from model" UWORD fak_uw_b4 1 100 0.00 3.999939 FORMAT "%8.6" ECU_ADDRESS 0x40008408
 /begin IF_DATA XCPplus 0x0102
  /begin DAQ_EVENT VARIABLE /begin AVAILABLE_EVENT_LIST EVENT 0 EVENT 1 EVENT 2 EVENT 3 /end AVAILABLE_EVENT_LIST /begin DEFAULT_EVENT_LIST EVENT 2 /end DEFAULT_EVENT_LIST /end DAQ_EVENT
 /end IF_DATA
/end MEASUREMENT
/begin MEASUREMENT fhotlsum_w "Sum of Part load altitude factor sampled value" ULONG fak_uw_b4 1 100 0.00 262143.999939 FORMAT "%13.6" ECU_ADDRESS 0x40008E3C
 /begin IF_DATA XCPplus 0x0102
  /begin DAQ_EVENT VARIABLE /begin AVAILABLE_EVENT_LIST EVENT 0 EVENT 1 EVENT 2 EVENT 3 /end AVAILABLE_EVENT_LIST /begin DEFAULT_EVENT_LIST EVENT 0 /end DEFAULT_EVENT_LIST /end DAQ_EVENT
 /end IF_DATA
/end MEASUREMENT
/begin MEASUREMENT fho_w "correction factor: altitude" UWORD fak_uw_b4 1 100 0.00 3.999939 FORMAT "%8.6" ECU_ADDRESS 0x400083FE
 /begin IF_DATA XCPplus 0x0102
  /begin DAQ_EVENT VARIABLE /begin AVAILABLE_EVENT_LIST EVENT 0 EVENT 1 EVENT 2 EVENT 3 /end AVAILABLE_EVENT_LIST /begin DEFAULT_EVENT_LIST EVENT 2 /end DEFAULT_EVENT_LIST /end DAQ_EVENT
 /end IF_DATA
/end MEASUREMENT
/begin MEASUREMENT fintpsan_w "interpolation factor for relative air charge between primary and secondary load" UWORD fak_uw_b2 1 100 0.00 1.999969 FORMAT "%8.6" ECU_ADDRESS 0x40008442
 /begin IF_DATA XCPplus 0x0102
  /begin DAQ_EVENT VARIABLE /begin AVAILABLE_EVENT_LIST EVENT 0 EVENT 1 EVENT 2 EVENT 3 /end AVAILABLE_EVENT_LIST /begin DEFAULT_EVENT_LIST EVENT 0 /end DEFAULT_EVENT_LIST /end DAQ_EVENT
 /end IF_DATA
/end MEASUREMENT
/begin MEASUREMENT fkhab "terminating factor catalyst heating" UBYTE fak_ub_b1 1 100 0.00 0.9961 ECU_ADDRESS 0x400087ED
 /begin IF_DATA XCPplus 0x0102
  /begin DAQ_EVENT VARIABLE /begin AVAILABLE_EVENT_LIST EVENT 0 EVENT 1 EVENT 2 EVENT 3 /end AVAILABLE_EVENT_LIST /begin DEFAULT_EVENT_LIST EVENT 2 /end DEFAULT_EVENT_LIST /end DAQ_EVENT
 /end IF_DATA
/end MEASUREMENT
/begin MEASUREMENT fkhnab "idle speed reducing factor" UBYTE fak_ub_b1 1 100 0.00 0.9961 ECU_ADDRESS 0x400087F2
 /begin IF_DATA XCPplus 0x0102
  /begin DAQ_EVENT VARIABLE /begin AVAILABLE_EVENT_LIST EVENT 0 EVENT 1 EVENT 2 EVENT 3 /end AVAILABLE_EVENT_LIST /begin DEFAULT_EVENT_LIST EVENT 2 /end DEFAULT_EVENT_LIST /end DAQ_EVENT
 /end IF_DATA
/end MEASUREMENT
/begin MEASUREMENT fklaf_w "Factor saint venant (KLAF)" UWORD fak_uw_b2 1 100 0.00 1.999969 FORMAT "%8.6" ECU_ADDRESS 0x4000847A
 /begin IF_DATA XCPplus 0x0102
  /begin DAQ_EVENT VARIABLE /begin AVAILABLE_EVENT_LIST EVENT 0 EVENT 1 EVENT 2 EVENT 3 /end AVAILABLE_EVENT_LIST /begin DEFAULT_EVENT_LIST EVENT 0 /end DEFAULT_EVENT_LIST /end DAQ_EVENT
 /end IF_DATA
/end MEASUREMENT
/begin MEASUREMENT fkllsmsdk_w "Correction factor for air mass flow based throttle opening" UWORD fak_uw_b2 1 100 0.00 1.999969 FORMAT "%8.6" ECU_ADDRESS 0x40008478
 /begin IF_DATA XCPplus 0x0102
  /begin DAQ_EVENT VARIABLE /begin AVAILABLE_EVENT_LIST EVENT 0 EVENT 1 EVENT 2 EVENT 3 /end AVAILABLE_EVENT_LIST /begin DEFAULT_EVENT_LIST EVENT 0 /end DEFAULT_EVENT_LIST /end DAQ_EVENT
 /end IF_DATA
/end MEASUREMENT
/begin MEASUREMENT fkmsdkk_w "correction factor for mass-flow substitute load signal after calc.from DPUPVDK" UWORD fak_uw_b4 1 100 0.00 3.999939 FORMAT "%8.6" ECU_ADDRESS 0x400083F0
 /begin IF_DATA XCPplus 0x0102
  /begin DAQ_EVENT VARIABLE /begin AVAILABLE_EVENT_LIST EVENT 0 EVENT 1 EVENT 2 EVENT 3 /end AVAILABLE_EVENT_LIST /begin DEFAULT_EVENT_LIST EVENT 0 /end DEFAULT_EVENT_LIST /end DAQ_EVENT
 /end IF_DATA
/end MEASUREMENT
/begin MEASUREMENT fkmsdk_w "correction factor for mass-flow substitute load signal" UWORD fak_uw_b4 1 100 0.00 3.999939 FORMAT "%8.6" ECU_ADDRESS 0x400083EE
 /begin IF_DATA XCPplus 0x0102
  /begin DAQ_EVENT VARIABLE /begin AVAILABLE_EVENT_LIST EVENT 0 EVENT 1 EVENT 2 EVENT 3 /end AVAILABLE_EVENT_LIST /begin DEFAULT_EVENT_LIST EVENT 0 /end DEFAULT_EVENT_LIST /end DAQ_EVENT
 /end IF_DATA
/end MEASUREMENT
/begin MEASUREMENT fkpvdk_w "correction factor for slow mass flow signal" UWORD fak_uw_b4 1 100 0.00 3.999939 FORMAT "%8.6" ECU_ADDRESS 0x4000C6B6
 /begin IF_DATA XCPplus 0x0102
  /begin DAQ_EVENT VARIABLE /begin AVAILABLE_EVENT_LIST EVENT 0 EVENT 1 EVENT 2 EVENT 3 /end AVAILABLE_EVENT_LIST /begin DEFAULT_EVENT_LIST EVENT 3 /end DEFAULT_EVENT_LIST /end DAQ_EVENT
 /end IF_DATA
/end MEASUREMENT
/begin MEASUREMENT fpvdt_w "Intermediate correction factor for pressure upstream throttle valve" UWORD fak_uw_b4 1 100 0.00 3.999939 FORMAT "%8.6" ECU_ADDRESS 0x400083FC
 /begin IF_DATA XCPplus 0x0102
  /begin DAQ_EVENT VARIABLE /begin AVAILABLE_EVENT_LIST EVENT 0 EVENT 1 EVENT 2 EVENT 3 /end AVAILABLE_EVENT_LIST /begin DEFAULT_EVENT_LIST EVENT 2 /end DEFAULT_EVENT_LIST /end DAQ_EVENT
 /end IF_DATA
/end MEASUREMENT
/begin MEASUREMENT fpvd_w "correction factor for pressure upstream throttle valve" UWORD fak_uw_b8 1 100 0.00 7.999878 FORMAT "%8.6" ECU_ADDRESS 0x400083EC
 /begin IF_DATA XCPplus 0x0102
  /begin DAQ_EVENT VARIABLE /begin AVAILABLE_EVENT_LIST EVENT 0 EVENT 1 EVENT 2 EVENT 3 /end AVAILABLE_EVENT_LIST /begin DEFAULT_EVENT_LIST EVENT 2 /end DEFAULT_EVENT_LIST /end DAQ_EVENT
 /end IF_DATA
/end MEASUREMENT
/begin MEASUREMENT frkapp "Mixture adjustment factor for application" UBYTE fak_ub_b2 1 100 0.00 1.992188 FORMAT "%8.6" ECU_ADDRESS 0x400087CA
 /begin IF_DATA XCPplus 0x0102
  /begin DAQ_EVENT VARIABLE /begin AVAILABLE_EVENT_LIST EVENT 0 EVENT 1 EVENT 2 EVENT 3 /end AVAILABLE_EVENT_LIST /begin DEFAULT_EVENT_LIST EVENT 2 /end DEFAULT_EVENT_LIST /end DAQ_EVENT
 /end IF_DATA
/end MEASUREMENT
/begin MEASUREMENT ftbr_w "factor: temperature correction in combustion chamber" UWORD fak_uw_b2 1 100 0.00 1.999969 FORMAT "%8.6" ECU_ADDRESS 0x4000848A
 /begin IF_DATA XCPplus 0x0102
  /begin DAQ_EVENT VARIABLE /begin AVAILABLE_EVENT_LIST EVENT 0 EVENT 1 EVENT 2 EVENT 3 /end AVAILABLE_EVENT_LIST /begin DEFAULT_EVENT_LIST EVENT 0 /end DEFAULT_EVENT_LIST /end DAQ_EVENT
 /end IF_DATA
/end MEASUREMENT
/begin MEASUREMENT ftpavd_w "factor correction air density for throttle valve flow f(intake air temp.,altit.)" UWORD fak_uw_b8 1 100 0.00 7.999878 FORMAT "%8.6" ECU_ADDRESS 0x40008476
 /begin IF_DATA XCPplus 0x0102
  /begin DAQ_EVENT VARIABLE /begin AVAILABLE_EVENT_LIST EVENT 0 EVENT 1 EVENT 2 EVENT 3 /end AVAILABLE_EVENT_LIST /begin DEFAULT_EVENT_LIST EVENT 1 /end DEFAULT_EVENT_LIST /end DAQ_EVENT
 /end IF_DATA
/end MEASUREMENT
/begin MEASUREMENT ftpvdcpl_w "Complement of ftpvd_w" UWORD dez 1 100 0.00 65535.00 FORMAT "%8.2" ECU_ADDRESS 0x40008474
 /begin IF_DATA XCPplus 0x0102
  /begin DAQ_EVENT VARIABLE /begin AVAILABLE_EVENT_LIST EVENT 0 EVENT 1 EVENT 2 EVENT 3 /end AVAILABLE_EVENT_LIST /begin DEFAULT_EVENT_LIST EVENT 1 /end DEFAULT_EVENT_LIST /end DAQ_EVENT
 /end IF_DATA
/end MEASUREMENT
/begin MEASUREMENT ftpvd_w "factor temperature + pressure upstream throttle" UWORD fak_uw_b8 1 100 0.00 7.999878 FORMAT "%8.6" ECU_ADDRESS 0x40008472
 /begin IF_DATA XCPplus 0x0102
  /begin DAQ_EVENT VARIABLE /begin AVAILABLE_EVENT_LIST EVENT 0 EVENT 1 EVENT 2 EVENT 3 /end AVAILABLE_EVENT_LIST /begin DEFAULT_EVENT_LIST EVENT 1 /end DEFAULT_EVENT_LIST /end DAQ_EVENT
 /end IF_DATA
/end MEASUREMENT
/begin MEASUREMENT ftvdk_w "correction factor for temperature upstream throttle" UWORD fak_uw_b2 1 100 0.00 1.999969 FORMAT "%8.6" ECU_ADDRESS 0x400083EA
 /begin IF_DATA XCPplus 0x0102
  /begin DAQ_EVENT VARIABLE /begin AVAILABLE_EVENT_LIST EVENT 0 EVENT 1 EVENT 2 EVENT 3 /end AVAILABLE_EVENT_LIST /begin DEFAULT_EVENT_LIST EVENT 2 /end DEFAULT_EVENT_LIST /end DAQ_EVENT
 /end IF_DATA
/end MEASUREMENT
/begin MEASUREMENT galok "Local gear information" UBYTE dez 1 100 0.00 255.0 FORMAT "%5.1" ECU_ADDRESS 0x400087E9
 /begin IF_DATA XCPplus 0x0102
  /begin DAQ_EVENT VARIABLE /begin AVAILABLE_EVENT_LIST EVENT 0 EVENT 1 EVENT 2 EVENT 3 /end AVAILABLE_EVENT_LIST /begin DEFAULT_EVENT_LIST EVENT 2 /end DEFAULT_EVENT_LIST /end DAQ_EVENT
 /end IF_DATA
/end MEASUREMENT
/begin MEASUREMENT gangi "Engaged gear" UBYTE dez 1 100 0.00 255.0 FORMAT "%5.1" ECU_ADDRESS 0x400087E7
 /begin IF_DATA XCPplus 0x0102
  /begin DAQ_EVENT VARIABLE /begin AVAILABLE_EVENT_LIST EVENT 0 EVENT 1 EVENT 2 EVENT 3 /end AVAILABLE_EVENT_LIST /begin DEFAULT_EVENT_LIST EVENT 2 /end DEFAULT_EVENT_LIST /end DAQ_EVENT
 /end IF_DATA
/end MEASUREMENT
/begin MEASUREMENT igntimoz1 "status of the output of test ignitions, cylinder 1" UBYTE dez 1 100 0.00 255.0 FORMAT "%5.1" ECU_ADDRESS 0x400087E6
 /begin IF_DATA XCPplus 0x0102
  /begin DAQ_EVENT VARIABLE /begin AVAILABLE_EVENT_LIST EVENT 0 EVENT 1 EVENT 2 EVENT 3 /end AVAILABLE_EVENT_LIST /begin DEFAULT_EVENT_LIST EVENT 1 /end DEFAULT_EVENT_LIST /end DAQ_EVENT
 /end IF_DATA
/end MEASUREMENT
/begin MEASUREMENT InjSys_stInjFco "Bitwise information of Injection CutOff Status from various requests." UWORD dez 1 100 0.00 65535.00 FORMAT "%8.2" ECU_ADDRESS 0x40005D76
 /begin IF_DATA XCPplus 0x0102
  /begin DAQ_EVENT VARIABLE /begin AVAILABLE_EVENT_LIST EVENT 0 EVENT 1 EVENT 2 EVENT 3 /end AVAILABLE_EVENT_LIST /begin DEFAULT_EVENT_LIST EVENT 0 /end DEFAULT_EVENT_LIST /end DAQ_EVENT
 /end IF_DATA
/end MEASUREMENT
/begin MEASUREMENT iwmatmk_w "heat quantity to dew-point end catalyst" UWORD q_q0p4551 1 100 0.00 29825.71 FORMAT "%8.2" ECU_ADDRESS 0x400083DA
 /begin IF_DATA XCPplus 0x0102
  /begin DAQ_EVENT VARIABLE /begin AVAILABLE_EVENT_LIST EVENT 0 EVENT 1 EVENT 2 EVENT 3 /end AVAILABLE_EVENT_LIST /begin DEFAULT_EVENT_LIST EVENT 3 /end DEFAULT_EVENT_LIST /end DAQ_EVENT
 /end IF_DATA
/end MEASUREMENT
/begin MEASUREMENT iwmatm_w "heat quantity to dew-point end" UWORD q_q0p4551 1 100 0.00 29825.71 FORMAT "%8.2" ECU_ADDRESS 0x400083D8
 /begin IF_DATA XCPplus 0x0102
  /begin DAQ_EVENT VARIABLE /begin AVAILABLE_EVENT_LIST EVENT 0 EVENT 1 EVENT 2 EVENT 3 /end AVAILABLE_EVENT_LIST /begin DEFAULT_EVENT_LIST EVENT 3 /end DEFAULT_EVENT_LIST /end DAQ_EVENT
 /end IF_DATA
/end MEASUREMENT
/begin MEASUREMENT kmstand_l "distance_km with a precision of 1km" ULONG dez 1 100 0.00 4294967295.00 FORMAT "%13.2" ECU_ADDRESS 0x4000C694
 /begin IF_DATA XCPplus 0x0102
  /begin DAQ_EVENT VARIABLE /begin AVAILABLE_EVENT_LIST EVENT 0 EVENT 1 EVENT 2 EVENT 3 /end AVAILABLE_EVENT_LIST /begin DEFAULT_EVENT_LIST EVENT 3 /end DEFAULT_EVENT_LIST /end DAQ_EVENT
 /end IF_DATA
/end MEASUREMENT
/begin MEASUREMENT lamsolap "Lambda target for application" UBYTE fak_q0p0039_op0p5 1 100 0.5000 1.496 FORMAT "%5.3" ECU_ADDRESS 0x400087C9
 /begin IF_DATA XCPplus 0x0102
  /begin DAQ_EVENT VARIABLE /begin AVAILABLE_EVENT_LIST EVENT 0 EVENT 1 EVENT 2 EVENT 3 /end AVAILABLE_EVENT_LIST /begin DEFAULT_EVENT_LIST EVENT 2 /end DEFAULT_EVENT_LIST /end DAQ_EVENT
 /end IF_DATA
/end MEASUREMENT
/begin MEASUREMENT ltotdist_l "total distance since first start (in m)" ULONG dez 1 100 0.00 4294967295.00 FORMAT "%13.2" ECU_ADDRESS 0x4000C690
 /begin IF_DATA XCPplus 0x0102
  /begin DAQ_EVENT VARIABLE /begin AVAILABLE_EVENT_LIST EVENT 0 EVENT 1 EVENT 2 EVENT 3 /end AVAILABLE_EVENT_LIST /begin DEFAULT_EVENT_LIST EVENT 3 /end DEFAULT_EVENT_LIST /end DAQ_EVENT
 /end IF_DATA
/end MEASUREMENT
/begin MEASUREMENT ml "Air mass flow" UBYTE m_ub_b1020 1 100 0.00 1020. FORMAT "%5.0" ECU_ADDRESS 0x4000881A
 /begin IF_DATA XCPplus 0x0102
  /begin DAQ_EVENT VARIABLE /begin AVAILABLE_EVENT_LIST EVENT 0 EVENT 1 EVENT 2 EVENT 3 /end AVAILABLE_EVENT_LIST /begin DEFAULT_EVENT_LIST EVENT 0 /end DEFAULT_EVENT_LIST /end DAQ_EVENT
 /end IF_DATA
/end MEASUREMENT
/begin MEASUREMENT mlq_w "air mass flow (high resolution)" UWORD m_uw_b655p35 1 100 0.00 655.3500 FORMAT "%8.4" ECU_ADDRESS 0x40008440
 /begin IF_DATA XCPplus 0x0102
  /begin DAQ_EVENT VARIABLE /begin AVAILABLE_EVENT_LIST EVENT 0 EVENT 1 EVENT 2 EVENT 3 /end AVAILABLE_EVENT_LIST /begin DEFAULT_EVENT_LIST EVENT 0 /end DEFAULT_EVENT_LIST /end DAQ_EVENT
 /end IF_DATA
/end MEASUREMENT
/begin MEASUREMENT ml_w "air mass flow filtered (Word)" UWORD m_uw_b6553p5 1 100 0.00 6553.500 FORMAT "%8.3" ECU_ADDRESS 0x4000843E
 /begin IF_DATA XCPplus 0x0102
  /begin DAQ_EVENT VARIABLE /begin AVAILABLE_EVENT_LIST EVENT 0 EVENT 1 EVENT 2 EVENT 3 /end AVAILABLE_EVENT_LIST /begin DEFAULT_EVENT_LIST EVENT 0 /end DEFAULT_EVENT_LIST /end DAQ_EVENT
 /end IF_DATA
/end MEASUREMENT
/begin MEASUREMENT msddkefq_w "Effective massflow through DK and ISA" UWORD m_uw_b655p35 1 100 0.00 655.3500 FORMAT "%8.4" ECU_ADDRESS 0x40008470
 /begin IF_DATA XCPplus 0x0102
  /begin DAQ_EVENT VARIABLE /begin AVAILABLE_EVENT_LIST EVENT 0 EVENT 1 EVENT 2 EVENT 3 /end AVAILABLE_EVENT_LIST /begin DEFAULT_EVENT_LIST EVENT 0 /end DEFAULT_EVENT_LIST /end DAQ_EVENT
 /end IF_DATA
/end MEASUREMENT
/begin MEASUREMENT msdkrohq_w "fresh air over throttle blade (unfiltered) (increased resolution)" UWORD m_uw_b655p35 1 100 0.00 655.3500 FORMAT "%8.4" ECU_ADDRESS 0x4000846E
 /begin IF_DATA XCPplus 0x0102
  /begin DAQ_EVENT VARIABLE /begin AVAILABLE_EVENT_LIST EVENT 0 EVENT 1 EVENT 2 EVENT 3 /end AVAILABLE_EVENT_LIST /begin DEFAULT_EVENT_LIST EVENT 0 /end DEFAULT_EVENT_LIST /end DAQ_EVENT
 /end IF_DATA
/end MEASUREMENT
/begin MEASUREMENT msfadynq_w "Desired air mass flow requested by driver (increased resolution) for engine dynamics" UWORD m_uw_b655p35 1 100 0.00 655.3500 FORMAT "%8.4" ECU_ADDRESS 0x4000846C
 /begin IF_DATA XCPplus 0x0102
  /begin DAQ_EVENT VARIABLE /begin AVAILABLE_EVENT_LIST EVENT 0 EVENT 1 EVENT 2 EVENT 3 /end AVAILABLE_EVENT_LIST /begin DEFAULT_EVENT_LIST EVENT 1 /end DEFAULT_EVENT_LIST /end DAQ_EVENT
 /end IF_DATA
/end MEASUREMENT
/begin MEASUREMENT msfawuqfz_w "Desired air mass flow requested by driver updated in 10ms(increased resolution)" UWORD m_uw_b655p35 1 100 0.00 655.3500 FORMAT "%8.4" ECU_ADDRESS 0x4000846A
 /begin IF_DATA XCPplus 0x0102
  /begin DAQ_EVENT VARIABLE /begin AVAILABLE_EVENT_LIST EVENT 0 EVENT 1 EVENT 2 EVENT 3 /end AVAILABLE_EVENT_LIST /begin DEFAULT_EVENT_LIST EVENT 1 /end DEFAULT_EVENT_LIST /end DAQ_EVENT
 /end IF_DATA
/end MEASUREMENT
/begin MEASUREMENT msftvdk_w "mass flow over DK for temp correction factor" UWORD m_uw_b655p35 1 100 0.00 655.3500 FORMAT "%8.4" ECU_ADDRESS 0x400083E8
 /begin IF_DATA XCPplus 0x0102
  /begin DAQ_EVENT VARIABLE /begin AVAILABLE_EVENT_LIST EVENT 0 EVENT 1 EVENT 2 EVENT 3 /end AVAILABLE_EVENT_LIST /begin DEFAULT_EVENT_LIST EVENT 2 /end DEFAULT_EVENT_LIST /end DAQ_EVENT
 /end IF_DATA
/end MEASUREMENT
/begin MEASUREMENT msllseff_w "Effective massflow through ISA" UWORD m_uw_b655p35 1 100 0.00 655.3500 FORMAT "%8.4" ECU_ADDRESS 0x40008468
 /begin IF_DATA XCPplus 0x0102
  /begin DAQ_EVENT VARIABLE /begin AVAILABLE_EVENT_LIST EVENT 0 EVENT 1 EVENT 2 EVENT 3 /end AVAILABLE_EVENT_LIST /begin DEFAULT_EVENT_LIST EVENT 0 /end DEFAULT_EVENT_LIST /end DAQ_EVENT
 /end IF_DATA
/end MEASUREMENT
/begin MEASUREMENT msnfawuq_w "Standardized air mass flow through throttle valve based on driver demand(increased resolution)" UWORD m_uw_b655p35 1 100 0.00 655.3500 FORMAT "%8.4" ECU_ADDRESS 0x40008466
 /begin IF_DATA XCPplus 0x0102
  /begin DAQ_EVENT VARIABLE /begin AVAILABLE_EVENT_LIST EVENT 0 EVENT 1 EVENT 2 EVENT 3 /end AVAILABLE_EVENT_LIST /begin DEFAULT_EVENT_LIST EVENT 0 /end DEFAULT_EVENT_LIST /end DAQ_EVENT
 /end IF_DATA
/end MEASUREMENT
/begin MEASUREMENT nllkh "Idling speed for catalyzer heating" UBYTE nmot_ub_q10 1 100 0.00 2550. FORMAT "%5.0" ECU_ADDRESS 0x400087EC
 /begin IF_DATA XCPplus 0x0102
  /begin DAQ_EVENT VARIABLE /begin AVAILABLE_EVENT_LIST EVENT 0 EVENT 1 EVENT 2 EVENT 3 /end AVAILABLE_EVENT_LIST /begin DEFAULT_EVENT_LIST EVENT 2 /end DEFAULT_EVENT_LIST /end DAQ_EVENT
 /end IF_DATA
/end MEASUREMENT
/begin MEASUREMENT nmotfafz_w "Engine speed updated in 10ms for driver demand calc" UWORD nmot_uw_q0p25 1 100 0.00 16383.75 FORMAT "%8.2" ECU_ADDRESS 0x40008464
 /begin IF_DATA XCPplus 0x0102
  /begin DAQ_EVENT VARIABLE /begin AVAILABLE_EVENT_LIST EVENT 0 EVENT 1 EVENT 2 EVENT 3 /end AVAILABLE_EVENT_LIST /begin DEFAULT_EVENT_LIST EVENT 1 /end DEFAULT_EVENT_LIST /end DAQ_EVENT
 /end IF_DATA
/end MEASUREMENT
/begin MEASUREMENT nmothpar "Engine speed subjected to high?pass filter" SLONG nmot_uw_q0p25 1 100 -16383.7500000 16383.7500000 FORMAT "%13.7" ECU_ADDRESS 0x40008E20
 /begin IF_DATA XCPplus 0x0102
  /begin DAQ_EVENT VARIABLE /begin AVAILABLE_EVENT_LIST EVENT 0 EVENT 1 EVENT 2 EVENT 3 /end AVAILABLE_EVENT_LIST /begin DEFAULT_EVENT_LIST EVENT 0 /end DEFAULT_EVENT_LIST /end DAQ_EVENT
 /end IF_DATA
/end MEASUREMENT
/begin MEASUREMENT nsarvar "Delta torque anti-jerk" SWORD rel_sw_b100 1 100 -100.0000 99.99695 FORMAT "%8.4" ECU_ADDRESS 0x400083CA
 /begin IF_DATA XCPplus 0x0102
  /begin DAQ_EVENT VARIABLE /begin AVAILABLE_EVENT_LIST EVENT 0 EVENT 1 EVENT 2 EVENT 3 /end AVAILABLE_EVENT_LIST /begin DEFAULT_EVENT_LIST EVENT 0 /end DEFAULT_EVENT_LIST /end DAQ_EVENT
 /end IF_DATA
/end MEASUREMENT
/begin MEASUREMENT nsar_w "separated oscillation of engine speed for antijerking" SWORD nmot_uw_q0p25 1 100 -8192.000 8191.750 FORMAT "%8.3" ECU_ADDRESS 0x400083D6
 /begin IF_DATA XCPplus 0x0102
  /begin DAQ_EVENT VARIABLE /begin AVAILABLE_EVENT_LIST EVENT 0 EVENT 1 EVENT 2 EVENT 3 /end AVAILABLE_EVENT_LIST /begin DEFAULT_EVENT_LIST EVENT 0 /end DEFAULT_EVENT_LIST /end DAQ_EVENT
 /end IF_DATA
/end MEASUREMENT
/begin MEASUREMENT nsawe "Engine speed threshold for overrun fuel cut-off" UBYTE nmot_ub_q40 1 100 0.00 10200. FORMAT "%5.0" ECU_ADDRESS 0x400087F7
 /begin IF_DATA XCPplus 0x0102
  /begin DAQ_EVENT VARIABLE /begin AVAILABLE_EVENT_LIST EVENT 0 EVENT 1 EVENT 2 EVENT 3 /end AVAILABLE_EVENT_LIST /begin DEFAULT_EVENT_LIST EVENT 1 /end DEFAULT_EVENT_LIST /end DAQ_EVENT
 /end IF_DATA
/end MEASUREMENT
/begin MEASUREMENT nvquot_w "quotient engine speed nmot / vehicle speed vfzg" UWORD fak_q0p2 1 100 0.00 12000.00 FORMAT "%8.2" ECU_ADDRESS 0x400083E0
 /begin IF_DATA XCPplus 0x0102
  /begin DAQ_EVENT VARIABLE /begin AVAILABLE_EVENT_LIST EVENT 0 EVENT 1 EVENT 2 EVENT 3 /end AVAILABLE_EVENT_LIST /begin DEFAULT_EVENT_LIST EVENT 2 /end DEFAULT_EVENT_LIST /end DAQ_EVENT
 /end IF_DATA
/end MEASUREMENT
/begin MEASUREMENT nwe "engine speed for fuel cut-in" UBYTE nmot_ub_q40 1 100 0.00 10200. FORMAT "%5.0" ECU_ADDRESS 0x400087F6
 /begin IF_DATA XCPplus 0x0102
  /begin DAQ_EVENT VARIABLE /begin AVAILABLE_EVENT_LIST EVENT 0 EVENT 1 EVENT 2 EVENT 3 /end AVAILABLE_EVENT_LIST /begin DEFAULT_EVENT_LIST EVENT 1 /end DEFAULT_EVENT_LIST /end DAQ_EVENT
 /end IF_DATA
/end MEASUREMENT
/begin MEASUREMENT ofmsdkq_w "offset norm air mass flow through throttle blade with corrected flow speed (increased resolution)" SWORD m_sw_q0p01 1 100 -327.6800 327.6700 FORMAT "%8.4" ECU_ADDRESS 0x40008462
 /begin IF_DATA XCPplus 0x0102
  /begin DAQ_EVENT VARIABLE /begin AVAILABLE_EVENT_LIST EVENT 0 EVENT 1 EVENT 2 EVENT 3 /end AVAILABLE_EVENT_LIST /begin DEFAULT_EVENT_LIST EVENT 0 /end DEFAULT_EVENT_LIST /end DAQ_EVENT
 /end IF_DATA
/end MEASUREMENT
/begin MEASUREMENT ofmsnddkq_w "Total offset norm air mass flow through throttle blade without density and temperature correction (increased resolution)" SWORD m_sw_q0p01 1 100 -327.6800 327.6700 FORMAT "%8.4" ECU_ADDRESS 0x40008460
 /begin IF_DATA XCPplus 0x0102
  /begin DAQ_EVENT VARIABLE /begin AVAILABLE_EVENT_LIST EVENT 0 EVENT 1 EVENT 2 EVENT 3 /end AVAILABLE_EVENT_LIST /begin DEFAULT_EVENT_LIST EVENT 0 /end DEFAULT_EVENT_LIST /end DAQ_EVENT
 /end IF_DATA
/end MEASUREMENT
/begin MEASUREMENT ollst_w "ISA position with respect to lower mechanical stop (sword)" SWORD rel_sw_b100 1 100 -100.0000 99.99695 FORMAT "%8.4" ECU_ADDRESS 0x4000845E
 /begin IF_DATA XCPplus 0x0102
  /begin DAQ_EVENT VARIABLE /begin AVAILABLE_EVENT_LIST EVENT 0 EVENT 1 EVENT 2 EVENT 3 /end AVAILABLE_EVENT_LIST /begin DEFAULT_EVENT_LIST EVENT 0 /end DEFAULT_EVENT_LIST /end DAQ_EVENT
 /end IF_DATA
/end MEASUREMENT
/begin MEASUREMENT ps "intake manifold pressure (absolute)" UBYTE p_ub_q10 1 100 0.00 2550. FORMAT "%5.0" ECU_ADDRESS 0x40008819
 /begin IF_DATA XCPplus 0x0102
  /begin DAQ_EVENT VARIABLE /begin AVAILABLE_EVENT_LIST EVENT 0 EVENT 1 EVENT 2 EVENT 3 /end AVAILABLE_EVENT_LIST /begin DEFAULT_EVENT_LIST EVENT 0 /end DEFAULT_EVENT_LIST /end DAQ_EVENT
 /end IF_DATA
/end MEASUREMENT
/begin MEASUREMENT psdk_w "Intake manifold pressure calculated via mass flow at throttle valve" UWORD p_uw_q0p039 1 100 0.00 2559.961 FORMAT "%8.3" ECU_ADDRESS 0x4000843C
 /begin IF_DATA XCPplus 0x0102
  /begin DAQ_EVENT VARIABLE /begin AVAILABLE_EVENT_LIST EVENT 0 EVENT 1 EVENT 2 EVENT 3 /end AVAILABLE_EVENT_LIST /begin DEFAULT_EVENT_LIST EVENT 0 /end DEFAULT_EVENT_LIST /end DAQ_EVENT
 /end IF_DATA
/end MEASUREMENT
/begin MEASUREMENT psrgsb_w "intake manifold pressure (absolute)" UWORD p_uw_q0p039 1 100 0.00 2559.961 FORMAT "%8.3" ECU_ADDRESS 0x40008488
 /begin IF_DATA XCPplus 0x0102
  /begin DAQ_EVENT VARIABLE /begin AVAILABLE_EVENT_LIST EVENT 0 EVENT 1 EVENT 2 EVENT 3 /end AVAILABLE_EVENT_LIST /begin DEFAULT_EVENT_LIST EVENT 0 /end DEFAULT_EVENT_LIST /end DAQ_EVENT
 /end IF_DATA
/end MEASUREMENT
/begin MEASUREMENT psrgwpvdk_w "quotient: int.manif. min. pressure divided by pressure upstream of throttle valve" UWORD fak_uw_b2 1 100 0.00 1.999969 FORMAT "%8.6" ECU_ADDRESS 0x4000845C
 /begin IF_DATA XCPplus 0x0102
  /begin DAQ_EVENT VARIABLE /begin AVAILABLE_EVENT_LIST EVENT 0 EVENT 1 EVENT 2 EVENT 3 /end AVAILABLE_EVENT_LIST /begin DEFAULT_EVENT_LIST EVENT 0 /end DEFAULT_EVENT_LIST /end DAQ_EVENT
 /end IF_DATA
/end MEASUREMENT
/begin MEASUREMENT psxzs_w "Manifold pressure with altitude correction" UWORD p_uw_q0p039 1 100 0.00 2559.961 FORMAT "%8.3" ECU_ADDRESS 0x40008486
 /begin IF_DATA XCPplus 0x0102
  /begin DAQ_EVENT VARIABLE /begin AVAILABLE_EVENT_LIST EVENT 0 EVENT 1 EVENT 2 EVENT 3 /end AVAILABLE_EVENT_LIST /begin DEFAULT_EVENT_LIST EVENT 0 /end DEFAULT_EVENT_LIST /end DAQ_EVENT
 /end IF_DATA
/end MEASUREMENT
/begin MEASUREMENT ps_w "intake manifold pressure (absolute) (Word)" UWORD p_uw_q0p039 1 100 0.00 2559.961 FORMAT "%8.3" ECU_ADDRESS 0x4000843A
 /begin IF_DATA XCPplus 0x0102
  /begin DAQ_EVENT VARIABLE /begin AVAILABLE_EVENT_LIST EVENT 0 EVENT 1 EVENT 2 EVENT 3 /end AVAILABLE_EVENT_LIST /begin DEFAULT_EVENT_LIST EVENT 0 /end DEFAULT_EVENT_LIST /end DAQ_EVENT
 /end IF_DATA
/end MEASUREMENT
/begin MEASUREMENT pu "Ambient pressure" UBYTE p_ub_q5 1 100 0.00 1275. FORMAT "%5.0" ECU_ADDRESS 0x4000880F
 /begin IF_DATA XCPplus 0x0102
  /begin DAQ_EVENT VARIABLE /begin AVAILABLE_EVENT_LIST EVENT 0 EVENT 1 EVENT 2 EVENT 3 /end AVAILABLE_EVENT_LIST /begin DEFAULT_EVENT_LIST EVENT 2 /end DEFAULT_EVENT_LIST /end DAQ_EVENT
 /end IF_DATA
/end MEASUREMENT
/begin MEASUREMENT pumadptl_w "Part load ambient pressure value" UWORD p_uw_q0p039 1 100 0.00 2559.961 FORMAT "%8.3" ECU_ADDRESS 0x40008410
 /begin IF_DATA XCPplus 0x0102
  /begin DAQ_EVENT VARIABLE /begin AVAILABLE_EVENT_LIST EVENT 0 EVENT 1 EVENT 2 EVENT 3 /end AVAILABLE_EVENT_LIST /begin DEFAULT_EVENT_LIST EVENT 1 /end DEFAULT_EVENT_LIST /end DAQ_EVENT
 /end IF_DATA
/end MEASUREMENT
/begin MEASUREMENT pum_w "Ambient pressure from model" UWORD p_uw_q0p039 1 100 0.00 2559.961 FORMAT "%8.3" ECU_ADDRESS 0x400083FA
 /begin IF_DATA XCPplus 0x0102
  /begin DAQ_EVENT VARIABLE /begin AVAILABLE_EVENT_LIST EVENT 0 EVENT 1 EVENT 2 EVENT 3 /end AVAILABLE_EVENT_LIST /begin DEFAULT_EVENT_LIST EVENT 2 /end DEFAULT_EVENT_LIST /end DAQ_EVENT
 /end IF_DATA
/end MEASUREMENT
/begin MEASUREMENT pu_w "Ambient pressure" UWORD p_uw_q0p039 1 100 0.00 2559.961 FORMAT "%8.3" ECU_ADDRESS 0x400083F8
 /begin IF_DATA XCPplus 0x0102
  /begin DAQ_EVENT VARIABLE /begin AVAILABLE_EVENT_LIST EVENT 0 EVENT 1 EVENT 2 EVENT 3 /end AVAILABLE_EVENT_LIST /begin DEFAULT_EVENT_LIST EVENT 2 /end DEFAULT_EVENT_LIST /end DAQ_EVENT
 /end IF_DATA
/end MEASUREMENT
/begin MEASUREMENT pvd_w "pressure upstream throttle valve ( value from 0...5120hPa )" UWORD p_uw_q0p078 1 100 0.00 5119.922 FORMAT "%8.3" ECU_ADDRESS 0x4000845A
 /begin IF_DATA XCPplus 0x0102
  /begin DAQ_EVENT VARIABLE /begin AVAILABLE_EVENT_LIST EVENT 0 EVENT 1 EVENT 2 EVENT 3 /end AVAILABLE_EVENT_LIST /begin DEFAULT_EVENT_LIST EVENT 0 /end DEFAULT_EVENT_LIST /end DAQ_EVENT
 /end IF_DATA
/end MEASUREMENT
/begin MEASUREMENT redist "real cylinder cut-off step" UBYTE dez 1 100 0.00 255.0 FORMAT "%5.1" ECU_ADDRESS 0x400087BF
 /begin IF_DATA XCPplus 0x0102
  /begin DAQ_EVENT VARIABLE /begin AVAILABLE_EVENT_LIST EVENT 0 EVENT 1 EVENT 2 EVENT 3 /end AVAILABLE_EVENT_LIST /begin DEFAULT_EVENT_LIST EVENT 0 /end DEFAULT_EVENT_LIST /end DAQ_EVENT
 /end IF_DATA
/end MEASUREMENT
/begin MEASUREMENT rfgdss_w "Total rel. cylinder charge based on DSS (incl. EGR) 16-bit" UWORD rel_uw_q0p0234 1 100 0.00 1535.977 FORMAT "%8.3" ECU_ADDRESS 0x40008484
 /begin IF_DATA XCPplus 0x0102
  /begin DAQ_EVENT VARIABLE /begin AVAILABLE_EVENT_LIST EVENT 0 EVENT 1 EVENT 2 EVENT 3 /end AVAILABLE_EVENT_LIST /begin DEFAULT_EVENT_LIST EVENT 0 /end DEFAULT_EVENT_LIST /end DAQ_EVENT
 /end IF_DATA
/end MEASUREMENT
/begin MEASUREMENT rl "relative air charge" UBYTE rel_ub_q0p75 1 100 0.00 191.3 FORMAT "%5.1" ECU_ADDRESS 0x40008818
 /begin IF_DATA XCPplus 0x0102
  /begin DAQ_EVENT VARIABLE /begin AVAILABLE_EVENT_LIST EVENT 0 EVENT 1 EVENT 2 EVENT 3 /end AVAILABLE_EVENT_LIST /begin DEFAULT_EVENT_LIST EVENT 0 /end DEFAULT_EVENT_LIST /end DAQ_EVENT
 /end IF_DATA
/end MEASUREMENT
/begin MEASUREMENT rlabs_w "relative air charge (absolute load value) acc. to ISO 15031-5" UWORD rel_uw_q0p0234 1 100 0.00 1535.977 FORMAT "%8.3" ECU_ADDRESS 0x40008448
 /begin IF_DATA XCPplus 0x0102
  /begin DAQ_EVENT VARIABLE /begin AVAILABLE_EVENT_LIST EVENT 0 EVENT 1 EVENT 2 EVENT 3 /end AVAILABLE_EVENT_LIST /begin DEFAULT_EVENT_LIST EVENT 2 /end DEFAULT_EVENT_LIST /end DAQ_EVENT
 /end IF_DATA
/end MEASUREMENT
/begin MEASUREMENT rldkfil_w "relative air charge flowing into intake manifold (throttle based)" UWORD rel_uw_q0p0234 1 100 0.00 1535.977 FORMAT "%8.3" ECU_ADDRESS 0x40008458
 /begin IF_DATA XCPplus 0x0102
  /begin DAQ_EVENT VARIABLE /begin AVAILABLE_EVENT_LIST EVENT 0 EVENT 1 EVENT 2 EVENT 3 /end AVAILABLE_EVENT_LIST /begin DEFAULT_EVENT_LIST EVENT 0 /end DEFAULT_EVENT_LIST /end DAQ_EVENT
 /end IF_DATA
/end MEASUREMENT
/begin MEASUREMENT rldkmax_w "maximum modeled relative charge for plausibility check manifold pressure sensor" UWORD rel_uw_q0p0234 1 100 0.00 1535.977 FORMAT "%8.3" ECU_ADDRESS 0x40008456
 /begin IF_DATA XCPplus 0x0102
  /begin DAQ_EVENT VARIABLE /begin AVAILABLE_EVENT_LIST EVENT 0 EVENT 1 EVENT 2 EVENT 3 /end AVAILABLE_EVENT_LIST /begin DEFAULT_EVENT_LIST EVENT 0 /end DEFAULT_EVENT_LIST /end DAQ_EVENT
 /end IF_DATA
/end MEASUREMENT
/begin MEASUREMENT rldkmin_w "minimum modeled relative charge for plausibility check manifold pressure sensor" UWORD rel_uw_q0p0234 1 100 0.00 1535.977 FORMAT "%8.3" ECU_ADDRESS 0x40008454
 /begin IF_DATA XCPplus 0x0102
  /begin DAQ_EVENT VARIABLE /begin AVAILABLE_EVENT_LIST EVENT 0 EVENT 1 EVENT 2 EVENT 3 /end AVAILABLE_EVENT_LIST /begin DEFAULT_EVENT_LIST EVENT 0 /end DEFAULT_EVENT_LIST /end DAQ_EVENT
 /end IF_DATA
/end MEASUREMENT
/begin MEASUREMENT rldkroh_w "Relative fresh air over throttle blade (unfilterd)" UWORD rel_uw_q0p0234 1 100 0.00 1535.977 FORMAT "%8.3" ECU_ADDRESS 0x40008452
 /begin IF_DATA XCPplus 0x0102
  /begin DAQ_EVENT VARIABLE /begin AVAILABLE_EVENT_LIST EVENT 0 EVENT 1 EVENT 2 EVENT 3 /end AVAILABLE_EVENT_LIST /begin DEFAULT_EVENT_LIST EVENT 0 /end DEFAULT_EVENT_LIST /end DAQ_EVENT
 /end IF_DATA
/end MEASUREMENT
/begin MEASUREMENT rlfawu_w "driver requested relative fresh air charge" UWORD rel_uw_q0p0234 1 100 0.00 1535.977 FORMAT "%8.3" ECU_ADDRESS 0x40008450
 /begin IF_DATA XCPplus 0x0102
  /begin DAQ_EVENT VARIABLE /begin AVAILABLE_EVENT_LIST EVENT 0 EVENT 1 EVENT 2 EVENT 3 /end AVAILABLE_EVENT_LIST /begin DEFAULT_EVENT_LIST EVENT 1 /end DEFAULT_EVENT_LIST /end DAQ_EVENT
 /end IF_DATA
/end MEASUREMENT
/begin MEASUREMENT rlfa_w "Desired value for relative air charge based on driver demand and idle speed control." UWORD rel_uw_q0p0234 1 100 0.00 1535.977 FORMAT "%8.3" ECU_ADDRESS 0x4000844E
 /begin IF_DATA XCPplus 0x0102
  /begin DAQ_EVENT VARIABLE /begin AVAILABLE_EVENT_LIST EVENT 0 EVENT 1 EVENT 2 EVENT 3 /end AVAILABLE_EVENT_LIST /begin DEFAULT_EVENT_LIST EVENT 1 /end DEFAULT_EVENT_LIST /end DAQ_EVENT
 /end IF_DATA
/end MEASUREMENT
/begin MEASUREMENT rlfgdss_w "Relative air charge at inlet valve close" UWORD rel_uw_q0p0234 1 100 0.00 1535.977 FORMAT "%8.3" ECU_ADDRESS 0x40008482
 /begin IF_DATA XCPplus 0x0102
  /begin DAQ_EVENT VARIABLE /begin AVAILABLE_EVENT_LIST EVENT 0 EVENT 1 EVENT 2 EVENT 3 /end AVAILABLE_EVENT_LIST /begin DEFAULT_EVENT_LIST EVENT 0 /end DEFAULT_EVENT_LIST /end DAQ_EVENT
 /end IF_DATA
/end MEASUREMENT
/begin MEASUREMENT rlfgsb_w "Relative fresh air, Primary load sensor based" UWORD rel_uw_q0p0234 1 100 0.00 1535.977 FORMAT "%8.3" ECU_ADDRESS 0x400083E6
 /begin IF_DATA XCPplus 0x0102
  /begin DAQ_EVENT VARIABLE /begin AVAILABLE_EVENT_LIST EVENT 0 EVENT 1 EVENT 2 EVENT 3 /end AVAILABLE_EVENT_LIST /begin DEFAULT_EVENT_LIST EVENT 0 /end DEFAULT_EVENT_LIST /end DAQ_EVENT
 /end IF_DATA
/end MEASUREMENT
/begin MEASUREMENT rlmxsoe_w "maximum desired air charge without further reducing interventions" UWORD rel_uw_q0p0234 1 100 0.00 1535.977 FORMAT "%8.3" ECU_ADDRESS 0x40008446
 /begin IF_DATA XCPplus 0x0102
  /begin DAQ_EVENT VARIABLE /begin AVAILABLE_EVENT_LIST EVENT 0 EVENT 1 EVENT 2 EVENT 3 /end AVAILABLE_EVENT_LIST /begin DEFAULT_EVENT_LIST EVENT 2 /end DEFAULT_EVENT_LIST /end DAQ_EVENT
 /end IF_DATA
/end MEASUREMENT
/begin MEASUREMENT rlmxs_w "maximum desired air charge" UWORD rel_uw_q0p0234 1 100 0.00 1535.977 FORMAT "%8.3" ECU_ADDRESS 0x40008492
 /begin IF_DATA XCPplus 0x0102
  /begin DAQ_EVENT VARIABLE /begin AVAILABLE_EVENT_LIST EVENT 0 EVENT 1 EVENT 2 EVENT 3 /end AVAILABLE_EVENT_LIST /begin DEFAULT_EVENT_LIST EVENT 2 /end DEFAULT_EVENT_LIST /end DAQ_EVENT
 /end IF_DATA
/end MEASUREMENT
/begin MEASUREMENT rlmxvl_w "maximum attainable air charge at full load" UWORD rel_uw_q0p0234 1 100 0.00 1535.977 FORMAT "%8.3" ECU_ADDRESS 0x40008490
 /begin IF_DATA XCPplus 0x0102
  /begin DAQ_EVENT VARIABLE /begin AVAILABLE_EVENT_LIST EVENT 0 EVENT 1 EVENT 2 EVENT 3 /end AVAILABLE_EVENT_LIST /begin DEFAULT_EVENT_LIST EVENT 2 /end DEFAULT_EVENT_LIST /end DAQ_EVENT
 /end IF_DATA
/end MEASUREMENT
/begin MEASUREMENT rlnot_w "Limp home Relative air charge" UWORD rel_uw_q0p0234 1 100 0.00 1535.977 FORMAT "%8.3" ECU_ADDRESS 0x40008494
 /begin IF_DATA XCPplus 0x0102
  /begin DAQ_EVENT VARIABLE /begin AVAILABLE_EVENT_LIST EVENT 0 EVENT 1 EVENT 2 EVENT 3 /end AVAILABLE_EVENT_LIST /begin DEFAULT_EVENT_LIST EVENT 0 /end DEFAULT_EVENT_LIST /end DAQ_EVENT
 /end IF_DATA
/end MEASUREMENT
/begin MEASUREMENT rlp_w "rel. air charge predicted for injection calculation (Word)" UWORD rel_uw_q0p0234 1 100 0.00 1535.977 FORMAT "%8.3" ECU_ADDRESS 0x40008438
 /begin IF_DATA XCPplus 0x0102
  /begin DAQ_EVENT VARIABLE /begin AVAILABLE_EVENT_LIST EVENT 0 EVENT 1 EVENT 2 EVENT 3 /end AVAILABLE_EVENT_LIST /begin DEFAULT_EVENT_LIST EVENT 0 /end DEFAULT_EVENT_LIST /end DAQ_EVENT
 /end IF_DATA
/end MEASUREMENT
/begin MEASUREMENT rl_w "Relative air charge (Word)" UWORD rel_uw_q0p0234 1 100 0.00 1535.977 FORMAT "%8.3" ECU_ADDRESS 0x40008436
 /begin IF_DATA XCPplus 0x0102
  /begin DAQ_EVENT VARIABLE /begin AVAILABLE_EVENT_LIST EVENT 0 EVENT 1 EVENT 2 EVENT 3 /end AVAILABLE_EVENT_LIST /begin DEFAULT_EVENT_LIST EVENT 0 /end DEFAULT_EVENT_LIST /end DAQ_EVENT
 /end IF_DATA
/end MEASUREMENT
/begin MEASUREMENT rml "relative air mass (calc. load value) acc. to SAE J1979" UBYTE rel_ub_b99p6 1 100 0.00 99.61 FORMAT "%5.2" ECU_ADDRESS 0x4000881B
 /begin IF_DATA XCPplus 0x0102
  /begin DAQ_EVENT VARIABLE /begin AVAILABLE_EVENT_LIST EVENT 0 EVENT 1 EVENT 2 EVENT 3 /end AVAILABLE_EVENT_LIST /begin DEFAULT_EVENT_LIST EVENT 2 /end DEFAULT_EVENT_LIST /end DAQ_EVENT
 /end IF_DATA
/end MEASUREMENT
/begin MEASUREMENT sardyn_w "Threshold for dynamic antijerking intervention" UWORD rel_sw_b100 1 100 0.00 100.0000 FORMAT "%8.4" ECU_ADDRESS 0x400083D4
 /begin IF_DATA XCPplus 0x0102
  /begin DAQ_EVENT VARIABLE /begin AVAILABLE_EVENT_LIST EVENT 0 EVENT 1 EVENT 2 EVENT 3 /end AVAILABLE_EVENT_LIST /begin DEFAULT_EVENT_LIST EVENT 1 /end DEFAULT_EVENT_LIST /end DAQ_EVENT
 /end IF_DATA
/end MEASUREMENT
/begin MEASUREMENT taikrm "Exhaust gas temperature at manifold out of model" UBYTE temp_ub_q5_o50 1 100 -50.00 1225. FORMAT "%5.0" ECU_ADDRESS 0x400087DE
 /begin IF_DATA XCPplus 0x0102
  /begin DAQ_EVENT VARIABLE /begin AVAILABLE_EVENT_LIST EVENT 0 EVENT 1 EVENT 2 EVENT 3 /end AVAILABLE_EVENT_LIST /begin DEFAULT_EVENT_LIST EVENT 3 /end DEFAULT_EVENT_LIST /end DAQ_EVENT
 /end IF_DATA
/end MEASUREMENT
/begin MEASUREMENT taikrmab "Exhaust gas temperature at manifold out of model during engine shut off" UBYTE temp_ub_q5_o50 1 100 -50.00 1225. FORMAT "%5.0" ECU_ADDRESS 0x4000C70A
 /begin IF_DATA XCPplus 0x0102
  /begin DAQ_EVENT VARIABLE /begin AVAILABLE_EVENT_LIST EVENT 0 EVENT 1 EVENT 2 EVENT 3 /end AVAILABLE_EVENT_LIST /begin DEFAULT_EVENT_LIST EVENT 3 /end DEFAULT_EVENT_LIST /end DAQ_EVENT
 /end IF_DATA
/end MEASUREMENT
/begin MEASUREMENT taikrmmst "Exhaust gas temperature at manifold out of model during engine start" UBYTE temp_ub_q5_o50 1 100 -50.00 1225. FORMAT "%5.0" ECU_ADDRESS 0x400087DD
 /begin IF_DATA XCPplus 0x0102
  /begin DAQ_EVENT VARIABLE /begin AVAILABLE_EVENT_LIST EVENT 0 EVENT 1 EVENT 2 EVENT 3 /end AVAILABLE_EVENT_LIST /begin DEFAULT_EVENT_LIST EVENT 3 /end DEFAULT_EVENT_LIST /end DAQ_EVENT
 /end IF_DATA
/end MEASUREMENT
/begin MEASUREMENT tatmkf "exhaust gas temperature-modelled from map KFTATM" UBYTE temp_ub_q5_o50 1 100 -50.00 1225. FORMAT "%5.0" ECU_ADDRESS 0x400087E0
 /begin IF_DATA XCPplus 0x0102
  /begin DAQ_EVENT VARIABLE /begin AVAILABLE_EVENT_LIST EVENT 0 EVENT 1 EVENT 2 EVENT 3 /end AVAILABLE_EVENT_LIST /begin DEFAULT_EVENT_LIST EVENT 3 /end DEFAULT_EVENT_LIST /end DAQ_EVENT
 /end IF_DATA
/end MEASUREMENT
/begin MEASUREMENT tatmsta "exhaust gas temperature-modelled steady-state" UBYTE temp_ub_q5_o50 1 100 -50.00 1225. FORMAT "%5.0" ECU_ADDRESS 0x400087DC
 /begin IF_DATA XCPplus 0x0102
  /begin DAQ_EVENT VARIABLE /begin AVAILABLE_EVENT_LIST EVENT 0 EVENT 1 EVENT 2 EVENT 3 /end AVAILABLE_EVENT_LIST /begin DEFAULT_EVENT_LIST EVENT 3 /end DEFAULT_EVENT_LIST /end DAQ_EVENT
 /end IF_DATA
/end MEASUREMENT
/begin MEASUREMENT TDTKHNAB_TOFFV.outbit "Delay for calculating idle speed at end of catalyst heating / Output Bit" UBYTE B_TRUE 1 100 0.00 1.00000000000 BIT_MASK 0x1 FORMAT "%13.11" ECU_ADDRESS 0x40008FFC /end MEASUREMENT
/begin MEASUREMENT TDTKHNAB_TOFFV.time "Delay for calculating idle speed at end of catalyst heating / Occured Time" UWORD t_q0p1 1 100 0.00 6553.500 FORMAT "%8.3" ECU_ADDRESS 0x40008FFE /end MEASUREMENT
/begin MEASUREMENT tempamb "Ambient Temperatur in ATM" UBYTE temp_ub_q0p75_o48 1 100 -48.00 143.3 FORMAT "%5.1" ECU_ADDRESS 0x4000C709
 /begin IF_DATA XCPplus 0x0102
  /begin DAQ_EVENT VARIABLE /begin AVAILABLE_EVENT_LIST EVENT 0 EVENT 1 EVENT 2 EVENT 3 /end AVAILABLE_EVENT_LIST /begin DEFAULT_EVENT_LIST EVENT 3 /end DEFAULT_EVENT_LIST /end DAQ_EVENT
 /end IF_DATA
/end MEASUREMENT
/begin MEASUREMENT TKHNAB_ITL.memory "time for reducing idle speed at end of catalyst heating / current integrator value" SLONG fak_q4p6566Em10 1 100 -1.000000000000000 0.999999999534339 FORMAT "%17.15" ECU_ADDRESS 0x40008FF8 /end MEASUREMENT
/begin MEASUREMENT tkihkm "Bed temperature of main catalyst, modelled" UBYTE temp_ub_q5_o50 1 100 -50.00 1225. FORMAT "%5.0" ECU_ADDRESS 0x400087DB
 /begin IF_DATA XCPplus 0x0102
  /begin DAQ_EVENT VARIABLE /begin AVAILABLE_EVENT_LIST EVENT 0 EVENT 1 EVENT 2 EVENT 3 /end AVAILABLE_EVENT_LIST /begin DEFAULT_EVENT_LIST EVENT 3 /end DEFAULT_EVENT_LIST /end DAQ_EVENT
 /end IF_DATA
/end MEASUREMENT
/begin MEASUREMENT tkihkmab "Exhaust gas temperature at main catalyst out of model during engine shut off" UBYTE temp_ub_q5_o50 1 100 -50.00 1225. FORMAT "%5.0" ECU_ADDRESS 0x4000C70B
 /begin IF_DATA XCPplus 0x0102
  /begin DAQ_EVENT VARIABLE /begin AVAILABLE_EVENT_LIST EVENT 0 EVENT 1 EVENT 2 EVENT 3 /end AVAILABLE_EVENT_LIST /begin DEFAULT_EVENT_LIST EVENT 3 /end DEFAULT_EVENT_LIST /end DAQ_EVENT
 /end IF_DATA
/end MEASUREMENT
/begin MEASUREMENT tkihkmmst "Exhaust gas temperature at main catalyst out of model during engine start" UBYTE temp_ub_q5_o50 1 100 -50.00 1225. FORMAT "%5.0" ECU_ADDRESS 0x400087DA
 /begin IF_DATA XCPplus 0x0102
  /begin DAQ_EVENT VARIABLE /begin AVAILABLE_EVENT_LIST EVENT 0 EVENT 1 EVENT 2 EVENT 3 /end AVAILABLE_EVENT_LIST /begin DEFAULT_EVENT_LIST EVENT 3 /end DEFAULT_EVENT_LIST /end DAQ_EVENT
 /end IF_DATA
/end MEASUREMENT
/begin MEASUREMENT tmotfilk "filtered engine temperature" SWORD Temp_Cels 1 100 -3549.940 3003.560 FORMAT "%8.3" ECU_ADDRESS 0x40008480
 /begin IF_DATA XCPplus 0x0102
  /begin DAQ_EVENT VARIABLE /begin AVAILABLE_EVENT_LIST EVENT 0 EVENT 1 EVENT 2 EVENT 3 /end AVAILABLE_EVENT_LIST /begin DEFAULT_EVENT_LIST EVENT 2 /end DEFAULT_EVENT_LIST /end DAQ_EVENT
 /end IF_DATA
/end MEASUREMENT
/begin MEASUREMENT top06mev_w "operating time since vehicle speed failure" UWORD t6minxmin_q6 1 100 0.00 393210.0 FORMAT "%8.1" ECU_ADDRESS 0x40008F88
 /begin IF_DATA XCPplus 0x0102
  /begin DAQ_EVENT VARIABLE /begin AVAILABLE_EVENT_LIST EVENT 0 EVENT 1 EVENT 2 EVENT 3 /end AVAILABLE_EVENT_LIST /begin DEFAULT_EVENT_LIST EVENT 3 /end DEFAULT_EVENT_LIST /end DAQ_EVENT
 /end IF_DATA
/end MEASUREMENT
/begin MEASUREMENT top06m_w "operating time since powerfail (word, 6 min quant.)" UWORD t6minxmin_q6 1 100 0.00 393210.0 FORMAT "%8.1" ECU_ADDRESS 0x4000CDE2
 /begin IF_DATA XCPplus 0x0102
  /begin DAQ_EVENT VARIABLE /begin AVAILABLE_EVENT_LIST EVENT 0 EVENT 1 EVENT 2 EVENT 3 /end AVAILABLE_EVENT_LIST /begin DEFAULT_EVENT_LIST EVENT 3 /end DEFAULT_EVENT_LIST /end DAQ_EVENT
 /end IF_DATA
/end MEASUREMENT
/begin MEASUREMENT topc01m "operating time since INI (byte with 1 min quant.)" ULONG tmin_uw_q1 1 100 0.00 4294967295.00 FORMAT "%13.2" ECU_ADDRESS 0x40008F84
 /begin IF_DATA XCPplus 0x0102
  /begin DAQ_EVENT VARIABLE /begin AVAILABLE_EVENT_LIST EVENT 0 EVENT 1 EVENT 2 EVENT 3 /end AVAILABLE_EVENT_LIST /begin DEFAULT_EVENT_LIST EVENT 3 /end DEFAULT_EVENT_LIST /end DAQ_EVENT
 /end IF_DATA
/end MEASUREMENT
/begin MEASUREMENT topre1m_l "operating time since prime start with restore from EEPROM (Q=1 min) longword" ULONG tmin_uw_q1 1 100 0.00 4294967295.00 FORMAT "%13.2" ECU_ADDRESS 0x40008F80
 /begin IF_DATA XCPplus 0x0102
  /begin DAQ_EVENT VARIABLE /begin AVAILABLE_EVENT_LIST EVENT 0 EVENT 1 EVENT 2 EVENT 3 /end AVAILABLE_EVENT_LIST /begin DEFAULT_EVENT_LIST EVENT 3 /end DEFAULT_EVENT_LIST /end DAQ_EVENT
 /end IF_DATA
/end MEASUREMENT
/begin MEASUREMENT topsec "operating time trigger in seconds (byte)" UBYTE OneToOne 1 100 0.00 255.0 FORMAT "%5.1" ECU_ADDRESS 0x4000CDE0
 /begin IF_DATA XCPplus 0x0102
  /begin DAQ_EVENT VARIABLE /begin AVAILABLE_EVENT_LIST EVENT 0 EVENT 1 EVENT 2 EVENT 3 /end AVAILABLE_EVENT_LIST /begin DEFAULT_EVENT_LIST EVENT 3 /end DEFAULT_EVENT_LIST /end DAQ_EVENT
 /end IF_DATA
/end MEASUREMENT
/begin MEASUREMENT topsec_w "operating time trigger in seconds (word)" UWORD t1sxs_uw_b65535 1 100 0.00 65535.00 FORMAT "%8.2" ECU_ADDRESS 0x40008F7C
 /begin IF_DATA XCPplus 0x0102
  /begin DAQ_EVENT VARIABLE /begin AVAILABLE_EVENT_LIST EVENT 0 EVENT 1 EVENT 2 EVENT 3 /end AVAILABLE_EVENT_LIST /begin DEFAULT_EVENT_LIST EVENT 3 /end DEFAULT_EVENT_LIST /end DAQ_EVENT
 /end IF_DATA
/end MEASUREMENT
/begin MEASUREMENT ttegaph_w "Cycle time for canister purging and mixture adaptation." UWORD t100msxs_uw_b6553p6 1 100 0.00 6553.500 FORMAT "%8.3" ECU_ADDRESS 0x400083E4
 /begin IF_DATA XCPplus 0x0102
  /begin DAQ_EVENT VARIABLE /begin AVAILABLE_EVENT_LIST EVENT 0 EVENT 1 EVENT 2 EVENT 3 /end AVAILABLE_EVENT_LIST /begin DEFAULT_EVENT_LIST EVENT 2 /end DEFAULT_EVENT_LIST /end DAQ_EVENT
 /end IF_DATA
/end MEASUREMENT
/begin MEASUREMENT tvarCtr "Delay time for deactivation of anti-jerking interventions during change of gears" UBYTE t_q0p01 1 100 0.00 2.550 FORMAT "%5.3" ECU_ADDRESS 0x400087D2
 /begin IF_DATA XCPplus 0x0102
  /begin DAQ_EVENT VARIABLE /begin AVAILABLE_EVENT_LIST EVENT 0 EVENT 1 EVENT 2 EVENT 3 /end AVAILABLE_EVENT_LIST /begin DEFAULT_EVENT_LIST EVENT 0 /end DEFAULT_EVENT_LIST /end DAQ_EVENT
 /end IF_DATA
/end MEASUREMENT
/begin MEASUREMENT udssmin0_w "Voltage pressure sensor manifold pressure minimum for cylinder 0(word)" UWORD spg_uw_q0p00488 1 100 0.00 319.9951 FORMAT "%8.4" ECU_ADDRESS 0x400083C6 /end MEASUREMENT
/begin MEASUREMENT udssmin_w "Voltage pressure sensor manifold pressure minimal (word)" UWORD spg_uw_q0p00488 1 100 0.00 319.9951 FORMAT "%8.4" ECU_ADDRESS 0x400083C4 /end MEASUREMENT
/begin MEASUREMENT udsswmin_w "Minimum voltage of intake manifold pressure sensor value during window period" UWORD spg_uw_q0p00488 1 100 0.00 319.9951 FORMAT "%8.4" ECU_ADDRESS 0x400083C2 /end MEASUREMENT
/begin MEASUREMENT umsrlnfafz_w "calculation factor load to mass flow updated in 10ms for driver demand calc" UWORD m_uw_q0p0005 1 100 0.00 32.76750 FORMAT "%8.5" ECU_ADDRESS 0x4000844C
 /begin IF_DATA XCPplus 0x0102
  /begin DAQ_EVENT VARIABLE /begin AVAILABLE_EVENT_LIST EVENT 0 EVENT 1 EVENT 2 EVENT 3 /end AVAILABLE_EVENT_LIST /begin DEFAULT_EVENT_LIST EVENT 1 /end DEFAULT_EVENT_LIST /end DAQ_EVENT
 /end IF_DATA
/end MEASUREMENT
/begin MEASUREMENT umsrln_w "calculation factor load to mass flow" UWORD m_uw_q0p0005 1 100 0.00 32.76750 FORMAT "%8.5" ECU_ADDRESS 0x4000844A
 /begin IF_DATA XCPplus 0x0102
  /begin DAQ_EVENT VARIABLE /begin AVAILABLE_EVENT_LIST EVENT 0 EVENT 1 EVENT 2 EVENT 3 /end AVAILABLE_EVENT_LIST /begin DEFAULT_EVENT_LIST EVENT 0 /end DEFAULT_EVENT_LIST /end DAQ_EVENT
 /end IF_DATA
/end MEASUREMENT
/begin MEASUREMENT vardyn "Amplification of dynamic antijerking intervention" UBYTE q0p0061_pc_DIV_rpm 1 100 0.00 1.556 FORMAT "%5.3" ECU_ADDRESS 0x400087D6
 /begin IF_DATA XCPplus 0x0102
  /begin DAQ_EVENT VARIABLE /begin AVAILABLE_EVENT_LIST EVENT 0 EVENT 1 EVENT 2 EVENT 3 /end AVAILABLE_EVENT_LIST /begin DEFAULT_EVENT_LIST EVENT 1 /end DEFAULT_EVENT_LIST /end DAQ_EVENT
 /end IF_DATA
/end MEASUREMENT
/begin MEASUREMENT wingen_count "Window counter" UBYTE dez 1 100 0.00 255.0 FORMAT "%5.1" ECU_ADDRESS 0x40006446 /end MEASUREMENT
/begin MEASUREMENT ZKHABB_LT.memory "Low Pass Filter for Catalyst Heating / current lowpass value" ULONG fak_ub_b1 1 100 0.00 16777215.9961 FORMAT "%13.4" ECU_ADDRESS 0x40008FF4 /end MEASUREMENT
/begin MEASUREMENT zwmatm "counter for dew-point end not reached for heat quantity threshold" UBYTE dez 1 100 0.00 255.0 FORMAT "%5.1" ECU_ADDRESS 0x4000C708
 /begin IF_DATA XCPplus 0x0102
  /begin DAQ_EVENT VARIABLE /begin AVAILABLE_EVENT_LIST EVENT 0 EVENT 1 EVENT 2 EVENT 3 /end AVAILABLE_EVENT_LIST /begin DEFAULT_EVENT_LIST EVENT 3 /end DEFAULT_EVENT_LIST /end DAQ_EVENT
 /end IF_DATA
/end MEASUREMENT
/begin FUNCTION AEVAB "9001.11.0_1.2.0Output injection valve cut off" /begin DEF_CHARACTERISTIC CWAEVAB /end DEF_CHARACTERISTIC /begin REF_CHARACTERISTIC CWSDSTACT /end REF_CHARACTERISTIC
 /begin IN_MEASUREMENT B_evabu B_koevab B_nachlauf B_OvHEngShDwn B_sdstact B_stclfld B_tltsig Com_fuel_cut_request_rb1 devoff eevd iginjlock MoCSOP_stActvMsg OCWDA_stErrMonPtt redsol Rollovr_stRollovrDiagcErr SyC_stSub /end IN_MEASUREMENT
 /begin OUT_MEASUREMENT B_bevab B_evakt B_evzaustot evz_auscpl evz_austot InjSys_stInjFco redist /end OUT_MEASUREMENT
 FUNCTION_VERSION "9001.11.0_1.2.0" /end FUNCTION
/begin FUNCTION AgPlsCtrl_Dd "9000.1.0  Device driver for Angle based control pulse complex driver" /begin DEF_CHARACTERISTIC NMOTWINEN WINDENCYL0 WINDSTCYL0 /end DEF_CHARACTERISTIC /begin IN_MEASUREMENT B_nldg EpmSyn_stSync Epm_ctSyn nmot_w udssmn1ms_w zzyl /end IN_MEASUREMENT
 /begin OUT_MEASUREMENT B_errwind B_wind0_err udssmin0_w udssmin_w udsswmin_w wingen_count /end OUT_MEASUREMENT
 FUNCTION_VERSION "9000.1.0" /end FUNCTION
/begin FUNCTION AgPlsCtrl_Hw "9000.0.0  Hardware driver for Angle based control pulse complex driver" /begin IN_MEASUREMENT Epm_numCyl /end IN_MEASUREMENT FUNCTION_VERSION "9000.0.0" /end FUNCTION
/begin FUNCTION ApplIf "9000.6.0  Application interfaces" /begin DEF_CHARACTERISTIC CWAPPLIF CWEVAB DZWAPP DZWAPP2 FHOAPP FRKAP LAMSOLAPP /end DEF_CHARACTERISTIC /begin IN_MEASUREMENT SyC_stSub /end IN_MEASUREMENT
 /begin OUT_MEASUREMENT B_asvarap B_fvoffap B_koevab B_lamsoap B_lraofap B_lrarsap B_lroffap B_mdoffap B_rladap B_rlfgdssap B_teoffap B_tepap dzwap dzwap2 evabapp fhoap_w frkapp lamsolap /end OUT_MEASUREMENT
 FUNCTION_VERSION "9000.6.0" /end FUNCTION
/begin FUNCTION ARMD "9301.5.0  Torque based anti-jerk function"
 /begin DEF_CHARACTERISTIC CWMDARE DFGWAR DWDKFAR FGWARST KFSARDYN KFVARDYN KLTVARSDYN NARU TARNSGA TMAR TVARV TVGWAR TVKUPAR VARAO VARAU /end DEF_CHARACTERISTIC
 /begin IN_MEASUREMENT B_autget B_dash B_fvoffap B_gwhs B_kuppl B_mdein B_sab B_sabte B_stendes B_wk dwdkba_w EngDa_tEng gangi mkfanb_w nmot_w redist vfzg_w /end IN_MEASUREMENT
 /begin OUT_MEASUREMENT absnsarvar B_sar B_sarv dmar_w nmothpar nsarvar tvarCtr /end OUT_MEASUREMENT
 /begin LOC_MEASUREMENT B_ar B_gwar B_spgwhs fgwar_w nsar_w sardyn_w vardyn /end LOC_MEASUREMENT
 FUNCTION_VERSION "9301.5.0" /end FUNCTION
/begin FUNCTION ATM "9000.17.0 Exhaust temperature model"
 /begin DEF_CHARACTERISTIC ATMTANS CWATM ExhMod_flgSelFcoCpvCls_C ExhMod_numMaxColdStrtTSPS1_C ExhMod_qHeatgDewpEndTSPS1_M ExhMod_tCorrnEgMnfld_Crv ExhMod_tiDlyEgTDurgFuCutOff_C ExhMod_tRampEgMf_Crv ExhMod_tStatEgCorrnEng_T FATMRML FWMABGW KATMIEXML KFATMLA KFATMZW KFTATM KFWMABG KFWMKAT KLATMABKA KLATMABKK KLATMILAE KLFWMKAT KLKIWM KLKIWMK KLMLTPATU KLTNLATM KLWMABGKH KLWMKATKH MLMNTATU SEZ06TMUB SLM06TMUB SML06TMUW TABGMEX TAIKRMMN TATMRTPA TATMSA TATMSAE TATMWM TATMWMK TVTUMA ZATMAML ZATMIKML ZATMRML /end DEF_CHARACTERISTIC
 /begin IN_MEASUREMENT B_bevab B_kh B_nachlauf_msg B_pwf B_sa B_sabte B_stendes EngDa_tEng EngDa_tStrt etazwist lamsol ml_w nmot_w rl SyC_stSub SyC_tiPostDrv tans t_engoff_w /end IN_MEASUREMENT
 /begin OUT_MEASUREMENT B_atmtpa B_atmtpk B_atmtpkl etazwimt ExhMod_flgHeatgTspS1B1 iwmatmk_w iwmatm_w taikrm taikrmmst tatmsta tempamb tkihkm tkihkmmst zwmatm /end OUT_MEASUREMENT
 /begin LOC_MEASUREMENT B_atmrtpa B_mlmntpa B_tkihkmst ExhMod_tEgMnfldAftCorrn ExhMod_tExo ExhMod_tFcoInactv taikrmab tatmkf tkihkmab /end LOC_MEASUREMENT
 FUNCTION_VERSION "9000.17.0" /end FUNCTION
/begin FUNCTION ATS2IGN "9001.0.1  ATS interface for ignition test" /begin DEF_CHARACTERISTIC ATS_numIgnImp_C ATS_tiIgnLngth_C ATS_tiIgnPer_C /end DEF_CHARACTERISTIC /begin IN_MEASUREMENT SyC_stSub /end IN_MEASUREMENT /begin LOC_MEASUREMENT ATS_stIgnTst_u8 igntimoz1 /end LOC_MEASUREMENT FUNCTION_VERSION "9001.0.1" /end FUNCTION
/begin FUNCTION ATSADAPT "3.0.0     adapter for ATS" FUNCTION_VERSION "3.0.0" /end FUNCTION
/begin FUNCTION ATSExtd_Std "30000.0.0 Handling of actuator test demands with diagnostics extended" FUNCTION_VERSION "30000.0.0" /end FUNCTION
/begin FUNCTION ATS_Std "30000.31.0_1.1.0Handling of actuator test demands with diagnostics"
 /begin DEF_CHARACTERISTIC ATS_Standby_Disabled_C ATS_tiTstDemHeal_C ATS_tiTstDemMax_C ATS_TmrBehaviour_C ATS_TstDemMaxEngN_C ATS_TstDemMaxVSSCDV_C /end DEF_CHARACTERISTIC
 /begin REF_CHARACTERISTIC LLS_ATS_ID_ATS.LimitTypeMsk_C LLS_ATS_ID_ATS.CnvNorm_C LLS_ATS_ID_ATS.LowLim_C LLS_ATS_ID_ATS.UpLim_C LLS_ATS_ID_ATS.CnvFac_C LLS_ATS_ID_ATS.CnvOfs_C LLS_ATS_ID_ATS.DfltVal_C Strt_ATS.LimitTypeMsk_C Strt_ATS.CnvNorm_C Strt_ATS.LowLim_C Strt_ATS.UpLim_C Strt_ATS.CnvFac_C Strt_ATS.CnvOfs_C Strt_ATS.DfltVal_C /end REF_CHARACTERISTIC
 /begin IN_MEASUREMENT Epm_nEngLRes T15_st VehV_v /end IN_MEASUREMENT
 /begin OUT_MEASUREMENT ATS_ctCurRunTst ATS_stMon ATS_stMonTimeLimit /end OUT_MEASUREMENT
 /begin LOC_MEASUREMENT ATS_IntvVal_mp ATS_TstStatus_mp /end LOC_MEASUREMENT
 FUNCTION_VERSION "30000.31.0_1.1.0" /end FUNCTION
/begin FUNCTION BBGANG "386.0.0   Detection of actual gear" /begin DEF_CHARACTERISTIC NVQMNGA NVQMXGA /end DEF_CHARACTERISTIC /begin IN_MEASUREMENT nmot_w SyC_stSub vfzg_w /end IN_MEASUREMENT /begin OUT_MEASUREMENT B_gwhs gangi /end OUT_MEASUREMENT /begin LOC_MEASUREMENT galok nvquot_w /end LOC_MEASUREMENT FUNCTION_VERSION "386.0.0" /end FUNCTION
/begin FUNCTION BBKHZ "9100.10.0 Control of catalyst heating"
 /begin DEF_CHARACTERISTIC DTKH ExhMgT_tiMaxActvCatHeatg_M FHOKH FKHABMN MLSUMX NLLKHM TDTKHNAB TKHNAB ZKHABB /end DEF_CHARACTERISTIC
 /begin IN_MEASUREMENT B_st B_stendes EngDa_tEng EngDa_tStrt fho_w iml_w SyC_stSub tans tnse_w /end IN_MEASUREMENT
 /begin OUT_MEASUREMENT B_kh B_khn fkhab nllkh /end OUT_MEASUREMENT
 /begin LOC_MEASUREMENT B_khend_FF.status B_kherr B_khres B_khset B_khstc B_st_ER.buffer B_st_ER.oldSignal fkhnab TDTKHNAB_TOFFV.outbit TDTKHNAB_TOFFV.time TKHNAB_ITL.memory ZKHABB_LT.memory /end LOC_MEASUREMENT
 FUNCTION_VERSION "9100.10.0" /end FUNCTION
/begin FUNCTION BBSAWE "9000.11.0_386.0.0Conditions for fuel cut-off / cut-in"
 /begin DEF_CHARACTERISTIC CoEng_nDeltaFuCutOff_T CoEng_swtFuCutOffSeln_C DNDIA DNSAHY DNWEGN KLTVSABTE TVSABGEAR TVSABGW TVSATM /end DEF_CHARACTERISTIC
 /begin IN_MEASUREMENT B_dash B_kuppl B_ll B_neutgear B_savmd B_tatmsa B_wez EngDa_tStrt gangi nmotgfil_w nmot_w nstat SyC_stSub tnse_w /end IN_MEASUREMENT
 /begin OUT_MEASUREMENT B_sab B_sabte B_wesyn nsawe nwe /end OUT_MEASUREMENT
 /begin LOC_MEASUREMENT CoEng_nDeltaFuCutOff /end LOC_MEASUREMENT
 FUNCTION_VERSION "9000.11.0_386.0.0" /end FUNCTION
/begin FUNCTION BBTEGA "9101.4.0  Operating contitions for purge canister control fuel adaption" /begin DEF_CHARACTERISTIC CWBBTEGA FPCtl_tEngThd_C TGAMN TTEGA TTEMN TTEMX /end DEF_CHARACTERISTIC
 /begin IN_MEASUREMENT B_cpintrdy B_gae B_ll B_lr B_lra B_stendes B_teabb B_tehbx B_teoffap B_tepap EngDa_tEng lambts SyC_stSub /end IN_MEASUREMENT
 /begin OUT_MEASUREMENT B_gabr B_gamn B_te B_tebr B_tebts B_temn B_temx B_teph ttegaph_w /end OUT_MEASUREMENT
 FUNCTION_VERSION "9101.4.0" /end FUNCTION
/begin FUNCTION BGFKMS "9500.12.0 calculated value correction faktor air mass flow"
 /begin DEF_CHARACTERISTIC DOFMSDKMNQ DOFMSDKMXQ FKPVDKMN FKPVDKMX FTAFTVDK FZKMSDKT FZKPVDKT KFFKMSDK KIMSALL KLTDMSDKEN MLFKMSDKQ TDMSDKS TMOFMSDKMX TMOFMSNDKE /end DEF_CHARACTERISTIC
 /begin IN_MEASUREMENT B_ll B_llrein B_rladap B_sa Eep_EnvRamInvld EngDa_tEng fpvdt_w mlq_w msddkefq_w nmot_w rldkfil_w rlfgdss_w SyC_stSub tans wdkfawu_w /end IN_MEASUREMENT
 /begin OUT_MEASUREMENT B_fgabgl B_fkpvdk B_inimsdko B_inisabgl B_msndko dfkmsadp_w dfuelsan_w dofmsndkq_w fkmsdkk_w fkmsdk_w fkpvdk_w fpvd_w ftvdk_w msftvdk_w rlfgsb_w /end OUT_MEASUREMENT
 /begin LOC_MEASUREMENT B_dofmsndkqini B_fkpvdkini B_iniabgl /end LOC_MEASUREMENT
 FUNCTION_VERSION "9500.12.0" /end FUNCTION
/begin FUNCTION BGKMST "9000.4.0  Calculation of milage" /begin DEF_CHARACTERISTIC CWBGKMST /end DEF_CHARACTERISTIC /begin IN_MEASUREMENT B_pwf SyC_stSub vfzg_w /end IN_MEASUREMENT /begin OUT_MEASUREMENT kmstand_l ltotdist_l /end OUT_MEASUREMENT /begin LOC_MEASUREMENT distctr_w /end LOC_MEASUREMENT FUNCTION_VERSION "9000.4.0" /end FUNCTION
/begin FUNCTION BGPU "9500.10.0 Calculation value ambient pressure"
 /begin DEF_CHARACTERISTIC ANZMINPUSAMPL ANZPUTCTSYN DPUMADPTL DPUPVDK FHOE FPVDKMN FPVDKMX KLZKPUSA KWZKPUA NUMPUTLSAMP PUADAPEN RLPUADPTL TDIDSSU TMDFHO TZPUSZ VHA WDKUGDN WINDPUSAMPL /end DEF_CHARACTERISTIC
 /begin REF_CHARACTERISTIC DSSGRAD DSSOFS /end REF_CHARACTERISTIC
 /begin IN_MEASUREMENT B_edss B_engmvdb B_ll B_llrein B_nmin B_psrrg B_rladap B_sa B_synph Eep_EnvRamInvld Epm_ctSyn fhoap_w msdkrohq_w nmot_w psdss_w rl_w SyC_stSub udss_w vfzg wdkba /end IN_MEASUREMENT
 /begin OUT_MEASUREMENT B_cylcntend B_puadptlavg B_puvl B_sz B_ugd dpupvdk_w fho fhoac_w fhomp fhomp_w fhomsa_w fhomtl_w fho_w fpvdt_w pu pum_w pu_w /end OUT_MEASUREMENT
 /begin LOC_MEASUREMENT B_puadapst B_puadptl B_pucylcnten cntfhotl dfhomm_w fhomm_w fhomst_w fhomtlavg_w fhomtlsamp_a fhomvl_w fhom_w fhotlsum_w pumadptl_w /end LOC_MEASUREMENT
 FUNCTION_VERSION "9500.10.0" /end FUNCTION
/begin FUNCTION BGRL "9502.0.0  Calculation of fresh air in combustion chamber" /begin DEF_CHARACTERISTIC CWBGRL KFINTPSAN PBRINT /end DEF_CHARACTERISTIC
 /begin IN_MEASUREMENT B_edk B_edss B_rlfgdssap nmot_w psdss_w pu_w rldkfil_w rlfgdss_w rlnot_w SyC_stSub umsrln_w wdkfawu_w /end IN_MEASUREMENT
 /begin OUT_MEASUREMENT ml mlq_w ml_w ps psdk_w ps_w rl rlp_w rl_w /end OUT_MEASUREMENT
 /begin LOC_MEASUREMENT fintpsan_w /end LOC_MEASUREMENT
 FUNCTION_VERSION "9502.0.0" /end FUNCTION
/begin FUNCTION BGRL2SV "9500.0.0  Calculation rl-Reference-Values to Service" /begin IN_MEASUREMENT nmot_w rlmxs_w rl_w SyC_stSub /end IN_MEASUREMENT /begin OUT_MEASUREMENT rlabs_w rlmxsoe_w rml /end OUT_MEASUREMENT FUNCTION_VERSION "9500.0.0" /end FUNCTION
/begin FUNCTION BGRLDK "9500.14.0 Calculation of fresh air charge flow through throttle valve"
 /begin DEF_CHARACTERISTIC AirMod_IdleSuprt_C DRLDKTN DRLDKTX FPVDKTN FPVDKTX FRLDKTN FRLDKTX KFFKLLSMS KFMSOLLS KFMSWDKQ KLAFI KLFKOFMSN KUMSIRL OFMSNDKNIQ OFMSNDKTN OFMSNDKTX ZKMSDK ZKRLDK /end DEF_CHARACTERISTIC
 /begin IN_MEASUREMENT B_llrein B_stendes dofmsndkq_w fkmsdkk_w fpvd_w ftvdk_w msnte_w mste_w nmot_w olls_w psrgwind_w pu_w rlminllr_w rlmin_w SyC_stSub wdkba_w /end IN_MEASUREMENT
 /begin OUT_MEASUREMENT drldk drldkrohdyn_w fklaf_w fkllsmsdk_w ftpavd_w ftpvdcpl_w ftpvd_w msddkefq_w msdkrohq_w msfadynq_w msfawuqfz_w msllseff_w msnfawuq_w nmotfafz_w ofmsdkq_w ofmsnddkq_w ollst_w psrgwpvdk_w pvd_w rldkfil_w rldkmax_w rldkmin_w rldkroh_w rlfawu_w rlfa_w umsrlnfafz_w umsrln_w /end OUT_MEASUREMENT
 FUNCTION_VERSION "9500.14.0" /end FUNCTION
/begin FUNCTION BGRLFG "9501.1.0  calculation of fresh air charge in combustion chamber" /begin DEF_CHARACTERISTIC FHOCORR FWFTBRTA KFRLSN KLWTBR ZBRT ZBRTMOD /end DEF_CHARACTERISTIC
 /begin IN_MEASUREMENT EngDa_tEng fho_w msdkrohq_w nmot_w psrgwind_w pu_w SyC_stSub tans /end IN_MEASUREMENT
 /begin OUT_MEASUREMENT evtmod evtmodfa ftbr_w psrgsb_w psxzs_w rfgdss_w rlfgdss_w tmotfilk /end OUT_MEASUREMENT
 FUNCTION_VERSION "9501.1.0" /end FUNCTION
/begin FUNCTION BGRLMXS "9500.1.0  Calculation maximum, desired filling" /begin DEF_CHARACTERISTIC FKRLXVL KLRLMXN /end DEF_CHARACTERISTIC /begin IN_MEASUREMENT fho_w ftvdk_w nmot_w SyC_stSub /end IN_MEASUREMENT /begin OUT_MEASUREMENT rlmxs_w rlmxvl_w /end OUT_MEASUREMENT FUNCTION_VERSION "9500.1.0" /end FUNCTION
/begin FUNCTION BGRLNOT "9500.1.0  Calculation of limp home Relative air charge" /begin DEF_CHARACTERISTIC RLNOT /end DEF_CHARACTERISTIC /begin IN_MEASUREMENT nmot_w SyC_stSub /end IN_MEASUREMENT /begin OUT_MEASUREMENT rlnot_w /end OUT_MEASUREMENT FUNCTION_VERSION "9500.1.0" /end FUNCTION
/begin FUNCTION BGTOP "9000.2.0  calculated value: operating time" /begin IN_MEASUREMENT anzti_w B_enghrste B_nmot SyC_stSub syncro_ctr /end IN_MEASUREMENT
 /begin OUT_MEASUREMENT B_engHrClr engcmbstevnt_l engrevcntr_l top06mev_w top06m_w topc01m topre1m_l topsec topsec_w /end OUT_MEASUREMENT
 FUNCTION_VERSION "9000.2.0" /end FUNCTION
/begin FUNCTION BusDiag_BusOff "54.3.0_386.0.0monitoring CAN hardware"
 /begin DEF_CHARACTERISTIC BusDiag_stOpenLoadErrMskCan0_C BusDiag_tiInitFadeOutCan0_C DDRC_DurDeb.BusDiag_tiBusOffOL_Can0DebOk_C DDRC_DurDeb.BusDiag_tiBusOffOL_Can0DebDef_C DDRC_DurDeb.BusDiag_numBusOff_Can0DebOk_C DDRC_DurDeb.BusDiag_numBusOff_Can0DebDef_C DFC_CtlMsk2.DFC_BusDiagOpenLoad_Can0_C DFC_CtlMsk2.DFC_BusDiagBusOff_Can0_C DFC_DisblMsk2.DFC_BusDiagOpenLoad_Can0_C DFC_DisblMsk2.DFC_BusDiagBusOff_Can0_C /end DEF_CHARACTERISTIC
 /begin IN_MEASUREMENT SyC_stSub /end IN_MEASUREMENT
 /begin OUT_MEASUREMENT BusDiag_stCAN0_mp BusDiag_stCAN0_msg /end OUT_MEASUREMENT
 /begin LOC_MEASUREMENT BusDiag_stOpenLoadCan0_mp BusDiag_stOpenLoadCan0_msg BusDiag_stPSRCan0 /end LOC_MEASUREMENT
 FUNCTION_VERSION "54.3.0_386.0.0" /end FUNCTION
/begin COMPU_METHOD AngleStWhl "" RAT_FUNC "%6.4" "deg StWhl" COEFFS 0 32 0 0 0 1 /end COMPU_METHOD
/begin COMPU_METHOD AngleVelStWhl "" RAT_FUNC "%6.4" "deg StWhl/s" COEFFS 0 32 0 0 0 1 /end COMPU_METHOD
/begin COMPU_METHOD APPPEDLOVRDENBL_SC_Compu "" TAB_VERB "%6.3" "" COMPU_TAB_REF APPPEDLOVRDENBL_SC_Compu /end COMPU_METHOD
/begin COMPU_VTAB APPPEDLOVRDENBL_SC_Compu "" TAB_VERB 2 0 "False" 1 "True" /end COMPU_VTAB
/begin COMPU_METHOD Area_cm2 "" RAT_FUNC "%6.5" "cm*cm" COEFFS 0 1000 0 0 0 1 /end COMPU_METHOD
/begin COMPU_METHOD Area_cm2_float "" RAT_FUNC "%6.2" "cm*cm" COEFFS 0 1 0 0 0 1 /end COMPU_METHOD
/begin COMPU_METHOD Area_cm2_Low "" RAT_FUNC "%6.4" "cm*cm" COEFFS 0 250 0 0 0 1 /end COMPU_METHOD
/begin COMPU_METHOD ARVERS_SC_Compu "" TAB_VERB "%6.3" "" COMPU_TAB_REF ARVERS_SC_Compu /end COMPU_METHOD
/begin COMPU_VTAB ARVERS_SC_Compu "" TAB_VERB 3 0 "0" 1 "1" 2 "2" /end COMPU_VTAB
/begin COMPU_METHOD ASDCTL_LEADPAHFILTGENA_SC_Compu "" TAB_VERB "%6.3" "" COMPU_TAB_REF ASDCTL_LEADPAHFILTGENA_SC_Compu /end COMPU_METHOD
/begin COMPU_VTAB ASDCTL_LEADPAHFILTGENA_SC_Compu "" TAB_VERB 2 0 "False" 1 "True" /end COMPU_VTAB
/begin COMPU_METHOD AshEGMassPerTime "" RAT_FUNC "%6.5" "mg/s" COEFFS 0 2000 0 0 0 1 /end COMPU_METHOD
/begin COMPU_METHOD AshMassPerTime "" RAT_FUNC "%6.4" "mg/s" COEFFS 0 100 0 0 0 1 /end COMPU_METHOD
/begin COMPU_METHOD AshMs_g_p0q1_COMPU "" RAT_FUNC "%6.3" "g" COEFFS 0 10 0 0 0 1 /end COMPU_METHOD
/begin COMPU_METHOD AshMs_mg_p0q0016_COMPU "" RAT_FUNC "%6.4" "mg" COEFFS 0 625 0 0 0 1 /end COMPU_METHOD
/begin COMPU_METHOD ASModPrcPerSec_COMPU "" RAT_FUNC "%6.3" "%/s" COEFFS 0 1.6384 0 0 0 1 /end COMPU_METHOD
/begin COMPU_METHOD ATSENA_SC_Compu "" TAB_VERB "%6.3" "" COMPU_TAB_REF ATSENA_SC_Compu /end COMPU_METHOD
/begin COMPU_VTAB ATSENA_SC_Compu "" TAB_VERB 2 0 "False" 1 "True" /end COMPU_VTAB
/begin COMPU_METHOD ATS_BRK_APP_SC_Compu "" TAB_VERB "%6.3" "" COMPU_TAB_REF ATS_BRK_APP_SC_Compu /end COMPU_METHOD
/begin COMPU_VTAB ATS_BRK_APP_SC_Compu "" TAB_VERB 2 0 "False" 1 "True" /end COMPU_VTAB
/begin COMPU_METHOD AUTSTOP_AVL_SC_Compu "" TAB_VERB "%6.3" "" COMPU_TAB_REF AUTSTOP_AVL_SC_Compu /end COMPU_METHOD
/begin COMPU_VTAB AUTSTOP_AVL_SC_Compu "" TAB_VERB 2 0 "False" 1 "True" /end COMPU_VTAB
/begin COMPU_METHOD BBSTVE_SY_Compu "" TAB_VERB "%6.3" "" COMPU_TAB_REF BBSTVE_SY_Compu /end COMPU_METHOD
/begin COMPU_VTAB BBSTVE_SY_Compu "" TAB_VERB 2 0 "False" 1 "True" /end COMPU_VTAB
/begin COMPU_METHOD BNL6_SY_Compu "" TAB_VERB "%6.3" "" COMPU_TAB_REF BNL6_SY_Compu /end COMPU_METHOD
/begin COMPU_VTAB BNL6_SY_Compu "" TAB_VERB 2 0 "no L6" 1 "L6" /end COMPU_VTAB
/begin COMPU_METHOD BSWCPTEXCLSN_SC_Compu "" TAB_VERB "%6.3" "" COMPU_TAB_REF BSWCPTEXCLSN_SC_Compu /end COMPU_METHOD
/begin COMPU_VTAB BSWCPTEXCLSN_SC_Compu "" TAB_VERB 1 0 "EXCLUDED" /end COMPU_VTAB
/begin COMPU_METHOD BUEK_SY_Compu "" TAB_VERB "%6.3" "" COMPU_TAB_REF BUEK_SY_Compu /end COMPU_METHOD
/begin COMPU_VTAB BUEK_SY_Compu "" TAB_VERB 2 0 "False" 1 "True" /end COMPU_VTAB
/begin COMPU_METHOD BYPASS_SY_Compu "" TAB_VERB "%6.3" "" COMPU_TAB_REF BYPASS_SY_Compu /end COMPU_METHOD
/begin COMPU_VTAB BYPASS_SY_Compu "" TAB_VERB 2 0 "No Bypass" 1 "Bypass" /end COMPU_VTAB
/begin COMPU_METHOD B_TRUE "" TAB_VERB "%6.3" "" COMPU_TAB_REF B_TRUE /end COMPU_METHOD
/begin COMPU_VTAB B_TRUE "" TAB_VERB 2 0 "FALSE" 1 "TRUE" /end COMPU_VTAB
/begin COMPU_METHOD Calory "" RAT_FUNC "%6.2" "J/g" COEFFS 0 1 0 0 0 1 /end COMPU_METHOD
/begin COMPU_METHOD CalVal_q0p01 "" RAT_FUNC "%6.4" "MJ/Kg" COEFFS 0 100 0 0 0 1 /end COMPU_METHOD
/begin COMPU_METHOD CALWUP_SY_Compu "" TAB_VERB "%6.3" "" COMPU_TAB_REF CALWUP_SY_Compu /end COMPU_METHOD
/begin COMPU_VTAB CALWUP_SY_Compu "" TAB_VERB 2 0 "no calibration wake up" 1 "calibration wake up" /end COMPU_VTAB
/begin COMPU_METHOD CAMSFT_VARIINTK_SC_Compu "" TAB_VERB "%6.3" "" COMPU_TAB_REF CAMSFT_VARIINTK_SC_Compu /end COMPU_METHOD
/begin COMPU_VTAB CAMSFT_VARIINTK_SC_Compu "" TAB_VERB 3 0 "NoShft" 1 "2PtShft" 2 "ContShft" /end COMPU_VTAB
/begin COMPU_METHOD CAMSFT_VARIOUTL_SC_Compu "" TAB_VERB "%6.3" "" COMPU_TAB_REF CAMSFT_VARIOUTL_SC_Compu /end COMPU_METHOD
/begin COMPU_VTAB CAMSFT_VARIOUTL_SC_Compu "" TAB_VERB 3 0 "NoShft" 1 "2PtShft" 2 "ContShft" /end COMPU_VTAB
/begin COMPU_METHOD CANNM_SC_Compu "" TAB_VERB "%6.3" "" COMPU_TAB_REF CANNM_SC_Compu /end COMPU_METHOD
/begin COMPU_VTAB CANNM_SC_Compu "" TAB_VERB 2 0 "False" 1 "True" /end COMPU_VTAB
/begin COMPU_METHOD CANSM_SC_Compu "" TAB_VERB "%6.3" "" COMPU_TAB_REF CANSM_SC_Compu /end COMPU_METHOD
/begin COMPU_VTAB CANSM_SC_Compu "" TAB_VERB 2 0 "False" 1 "True" /end COMPU_VTAB
/begin COMPU_METHOD CANTP_SC_Compu "" TAB_VERB "%6.3" "" COMPU_TAB_REF CANTP_SC_Compu /end COMPU_METHOD
/begin COMPU_VTAB CANTP_SC_Compu "" TAB_VERB 2 0 "False" 1 "True" /end COMPU_VTAB
/begin COMPU_METHOD CASTYP_SY_Compu "" TAB_VERB "%6.3" "" COMPU_TAB_REF CASTYP_SY_Compu /end COMPU_METHOD
/begin COMPU_VTAB CASTYP_SY_Compu "" TAB_VERB 8 0 "INDIVIDUAL" 1 "CAS_GS_STD_4TOOTH" 2 "CAS_3TOOTH" 3 "CAS_PULSE" 4 "CAS_HALFMOON" 5 "CAS_5TOOH" 6 "CAS_DS_STD_3TEETH" 7 "CAS_3TOOTH_180_60" /end COMPU_VTAB
/begin COMPU_METHOD CAS_ADAP_SY_Compu "" TAB_VERB "%6.3" "" COMPU_TAB_REF CAS_ADAP_SY_Compu /end COMPU_METHOD
/begin COMPU_VTAB CAS_ADAP_SY_Compu "" TAB_VERB 4 0 "NO_ADAP" 1 "ADAP" 2 "ADAP_MNTCHK" 3 "ADAP_MNTCHK_INDEDGE" /end COMPU_VTAB
/begin COMPU_METHOD CAS_ANGLE_SY_Compu "" TAB_VERB "%6.3" "" COMPU_TAB_REF CAS_ANGLE_SY_Compu /end COMPU_METHOD
/begin COMPU_VTAB CAS_ANGLE_SY_Compu "" TAB_VERB 3 0 "NO_ANGLE" 1 "VIA_MESSAGE" 2 "VIA_SERVICE" /end COMPU_VTAB
/begin COMPU_METHOD CAS_BACKUP_SY_Compu "" TAB_VERB "%6.3" "" COMPU_TAB_REF CAS_BACKUP_SY_Compu /end COMPU_METHOD
/begin COMPU_VTAB CAS_BACKUP_SY_Compu "" TAB_VERB 5 0 "NO_BACKUP" 1 "TST_INJ" 2 "DOUBLE_IGN" 3 "TST_INJ_GDI" 4 "TST_INJ_DS" /end COMPU_VTAB
/begin COMPU_METHOD CAS_DELAY_SC_Compu "" TAB_VERB "%6.3" "" COMPU_TAB_REF CAS_DELAY_SC_Compu /end COMPU_METHOD
/begin COMPU_VTAB CAS_DELAY_SC_Compu "" TAB_VERB 2 0 "NO_DELAY" 1 "DELAY" /end COMPU_VTAB
/begin COMPU_METHOD CAS_DIAG_SY_Compu "" TAB_VERB "%6.3" "" COMPU_TAB_REF CAS_DIAG_SY_Compu /end COMPU_METHOD
/begin COMPU_VTAB CAS_DIAG_SY_Compu "" TAB_VERB 4 0 "STD" 1 "ADD_OFFS" 2 "ADD_MINMAX" 3 "ADD_IUMPR" /end COMPU_VTAB
/begin COMPU_METHOD CAS_I1_SY_Compu "" TAB_VERB "%6.3" "" COMPU_TAB_REF CAS_I1_SY_Compu /end COMPU_METHOD
/begin COMPU_VTAB CAS_I1_SY_Compu "" TAB_VERB 2 0 "NO_SIGNAL" 1 "SIGNAL_AVAILABLE" /end COMPU_VTAB
/begin COMPU_METHOD CAS_I2_SY_Compu "" TAB_VERB "%6.3" "" COMPU_TAB_REF CAS_I2_SY_Compu /end COMPU_METHOD
/begin COMPU_VTAB CAS_I2_SY_Compu "" TAB_VERB 2 0 "NO_SIGNAL" 1 "SIGNAL_AVAILABLE" /end COMPU_VTAB
/begin COMPU_METHOD CAS_O1_SY_Compu "" TAB_VERB "%6.3" "" COMPU_TAB_REF CAS_O1_SY_Compu /end COMPU_METHOD
/begin COMPU_VTAB CAS_O1_SY_Compu "" TAB_VERB 2 0 "NO_SIGNAL" 1 "SIGNAL_AVAILABLE" /end COMPU_VTAB
/begin COMPU_METHOD CAS_O2_SY_Compu "" TAB_VERB "%6.3" "" COMPU_TAB_REF CAS_O2_SY_Compu /end COMPU_METHOD
/begin COMPU_VTAB CAS_O2_SY_Compu "" TAB_VERB 2 0 "NO_SIGNAL" 1 "SIGNAL_AVAILABLE" /end COMPU_VTAB
/begin COMPU_METHOD CAS_OUT_SY_Compu "" TAB_VERB "%6.3" "" COMPU_TAB_REF CAS_OUT_SY_Compu /end COMPU_METHOD
/begin COMPU_VTAB CAS_OUT_SY_Compu "" TAB_VERB 3 0 "NO_CAS_OUTPUT" 1 "OUTPUT_VAR1" 2 "OUTPUT_VAR2" /end COMPU_VTAB
/begin COMPU_METHOD CAS_SEGCOR_SY_Compu "" TAB_VERB "%6.3" "" COMPU_TAB_REF CAS_SEGCOR_SY_Compu /end COMPU_METHOD
/begin COMPU_VTAB CAS_SEGCOR_SY_Compu "" TAB_VERB 2 0 "NO_SEGCOR" 1 "SEGCOR1" /end COMPU_VTAB
/begin COMPU_METHOD CATHEATGTYP_SC_Compu "" TAB_VERB "%6.3" "" COMPU_TAB_REF CATHEATGTYP_SC_Compu /end COMPU_METHOD
/begin COMPU_VTAB CATHEATGTYP_SC_Compu "" TAB_VERB 4 0 "No_heating" 1 "retarded_ign" 2 "sec_air" 3 "ign_sec" /end COMPU_VTAB
/begin COMPU_METHOD CDAWOSWILVLV_SC_Compu "" TAB_VERB "%6.3" "" COMPU_TAB_REF CDAWOSWILVLV_SC_Compu /end COMPU_METHOD
/begin COMPU_VTAB CDAWOSWILVLV_SC_Compu "" TAB_VERB 2 0 "False" 1 "True" /end COMPU_VTAB
/begin COMPU_METHOD CDGEN_ENV_SC_Compu "" TAB_VERB "%6.3" "" COMPU_TAB_REF CDGEN_ENV_SC_Compu /end COMPU_METHOD
/begin COMPU_VTAB CDGEN_ENV_SC_Compu "" TAB_VERB 4 0 "CDGEN_ENV_DS" 1 "CDGEN_ENV_GS" 2 "CDGEN_ENV_DGS" 3 "CDGEN_ENV_MDG" /end COMPU_VTAB
/begin COMPU_METHOD CENGDST_ATS_SY_Compu "" TAB_VERB "%6.3" "" COMPU_TAB_REF CENGDST_ATS_SY_Compu /end COMPU_METHOD
/begin COMPU_VTAB CENGDST_ATS_SY_Compu "" TAB_VERB 2 0 "False" 1 "True" /end COMPU_VTAB
/begin COMPU_METHOD CENGDST_COOLTLAMPDIAG_SC_Compu "" TAB_VERB "%6.3" "" COMPU_TAB_REF CENGDST_COOLTLAMPDIAG_SC_Compu /end COMPU_METHOD
/begin COMPU_VTAB CENGDST_COOLTLAMPDIAG_SC_Compu "" TAB_VERB 2 0 "False" 1 "True" /end COMPU_VTAB
/begin COMPU_METHOD CENGDST_ENAOVRHEATCHK_SC_Compu "" TAB_VERB "%6.3" "" COMPU_TAB_REF CENGDST_ENAOVRHEATCHK_SC_Compu /end COMPU_METHOD
/begin COMPU_VTAB CENGDST_ENAOVRHEATCHK_SC_Compu "" TAB_VERB 2 0 "No_Over_Heat_Check" 1 "Over_Heat_Check" /end COMPU_VTAB
/begin COMPU_METHOD CHDT_SY_Compu "" TAB_VERB "%6.3" "" COMPU_TAB_REF CHDT_SY_Compu /end COMPU_METHOD
/begin COMPU_VTAB CHDT_SY_Compu "" TAB_VERB 2 0 "False" 1 "True" /end COMPU_VTAB
/begin COMPU_METHOD Ch_Ah_q0p5_COMPU "" RAT_FUNC "%6.3" "Ah" COEFFS 0 2 0 0 0 1 /end COMPU_METHOD
/begin COMPU_METHOD CJ721_SC_Compu "" TAB_VERB "%6.3" "" COMPU_TAB_REF CJ721_SC_Compu /end COMPU_METHOD
/begin COMPU_VTAB CJ721_SC_Compu "" TAB_VERB 2 0 "no_Cj721" 1 "one_Cj721" /end COMPU_VTAB
/begin COMPU_METHOD CJ722_SC_Compu "" TAB_VERB "%6.3" "" COMPU_TAB_REF CJ722_SC_Compu /end COMPU_METHOD
/begin COMPU_VTAB CJ722_SC_Compu "" TAB_VERB 2 0 "no_Cj722" 1 "one_Cj722" /end COMPU_VTAB
/begin COMPU_METHOD CJ950_SY_Compu "" TAB_VERB "%6.3" "" COMPU_TAB_REF CJ950_SY_Compu /end COMPU_METHOD
/begin COMPU_VTAB CJ950_SY_Compu "" TAB_VERB 5 0 "NO_CJ950" 1 "1_CJ950" 2 "2_CJ950" 3 "3_CJ950" 4 "4_CJ950" /end COMPU_VTAB
/begin COMPU_METHOD CJ960_SC_Compu "" TAB_VERB "%6.3" "" COMPU_TAB_REF CJ960_SC_Compu /end COMPU_METHOD
/begin COMPU_VTAB CJ960_SC_Compu "" TAB_VERB 11 0 "No CJ960" 1 "1 CJ960" 2 "2 CJ960" 3 "3 CJ960" 4 "4 CJ960" 5 "5 CJ960" 6 "6 CJ960" 7 "7 CJ960" 8 "8 CJ960" 9 "9 CJ960" 10 "10 CJ960" /end COMPU_VTAB
/begin COMPU_METHOD CLUSWT_TYPAVL_SC_Compu "" TAB_VERB "%6.3" "" COMPU_TAB_REF CLUSWT_TYPAVL_SC_Compu /end COMPU_METHOD
/begin COMPU_VTAB CLUSWT_TYPAVL_SC_Compu "" TAB_VERB 2 0 "False" 1 "True" /end COMPU_VTAB
/begin COMPU_METHOD CMBEGYUTL_SC_Compu "" TAB_VERB "%6.3" "" COMPU_TAB_REF CMBEGYUTL_SC_Compu /end COMPU_METHOD
/begin COMPU_VTAB CMBEGYUTL_SC_Compu "" TAB_VERB 2 0 "Disabled" 1 "Enabled" /end COMPU_VTAB
/begin COMPU_METHOD CMBEGY_NRGAPAFT_SC_Compu "" RAT_FUNC "%6.2" "" COEFFS 0 1 0 0 0 1 /end COMPU_METHOD
/begin COMPU_METHOD CMBEGY_NRGAPBEF_SC_Compu "" RAT_FUNC "%6.2" "" COEFFS 0 1 0 0 0 1 /end COMPU_METHOD
/begin COMPU_METHOD CmbNoi "" RAT_FUNC "%6.5" "-" COEFFS 0 1024 0 0 0 1 /end COMPU_METHOD
/begin COMPU_METHOD CMBTYP_SY_Compu "" TAB_VERB "%6.3" "" COMPU_TAB_REF CMBTYP_SY_Compu /end COMPU_METHOD
/begin COMPU_VTAB CMBTYP_SY_Compu "" TAB_VERB 2 0 "CMBTYP_DS" 1 "CMBTYP_GS" /end COMPU_VTAB
/begin COMPU_METHOD Cnd_uS_DIV_Cm_q0p01_COMPU "" RAT_FUNC "%6.4" "µS/Cm" COEFFS 0 100 0 0 0 1 /end COMPU_METHOD
/begin COMPU_METHOD CnvtCoeffCatAir "" RAT_FUNC "%6.4" "J/K/s/m^2" COEFFS 0 50 0 0 0 1 /end COMPU_METHOD
/begin COMPU_METHOD CoeffA "" RAT_FUNC "%6.4" "1/(s*Nm)" COEFFS 0 204.8 0 0 0 1 /end COMPU_METHOD
/begin COMPU_METHOD COEFFVRNT_SC_Compu "" TAB_VERB "%6.3" "" COMPU_TAB_REF COEFFVRNT_SC_Compu /end COMPU_METHOD
/begin COMPU_VTAB COEFFVRNT_SC_Compu "" TAB_VERB 2 0 "False" 1 "True" /end COMPU_VTAB
/begin COMPU_METHOD CoEng_StEngs_sm_VERB "" TAB_VERB "%6.3" "" COMPU_TAB_REF CoEng_StEngs_sm_VERB /end COMPU_METHOD
/begin COMPU_VTAB CoEng_StEngs_sm_VERB "" TAB_VERB 9 0 "A_STANDBY" 1 "A_CRANKING" 2 "A_FINISH" 3 "A_READY" 4 "A_RUNNING" 5 "A_STOPPING" 6 "H_DRIVE" 7 "H_POSTDRIVE" 8 "H_PREDRIVE" /end COMPU_VTAB
/begin COMPU_METHOD CoEOMSwt "" RAT_FUNC "%10.9" "-" COEFFS 0 16384000 0 0 0 1 /end COMPU_METHOD
/begin COMPU_METHOD CoEOMSwt_S16 "" RAT_FUNC "%7.6" "-" COEFFS 0 16384 0 0 0 1 /end COMPU_METHOD
/begin COMPU_METHOD COLDSTRTHEATGCTRL_SC_Compu "" TAB_VERB "%6.3" "" COMPU_TAB_REF COLDSTRTHEATGCTRL_SC_Compu /end COMPU_METHOD
/begin COMPU_VTAB COLDSTRTHEATGCTRL_SC_Compu "" TAB_VERB 3 0 "NO_FHCU" 1 "FHCU_SER" 2 "FHCU_LIN" /end COMPU_VTAB
/begin COMPU_METHOD COMassPerTime "" RAT_FUNC "%6.4" "mg/s" COEFFS 0 20 0 0 0 1 /end COMPU_METHOD
/begin COMPU_METHOD COMDIA_BITFAIFSUPRT_SC_Compu "" TAB_VERB "%6.3" "" COMPU_TAB_REF COMDIA_BITFAIFSUPRT_SC_Compu /end COMPU_METHOD
/begin COMPU_VTAB COMDIA_BITFAIFSUPRT_SC_Compu "" TAB_VERB 2 0 "False" 1 "True" /end COMPU_VTAB
/begin COMPU_METHOD COMM_SC_Compu "" TAB_VERB "%6.3" "" COMPU_TAB_REF COMM_SC_Compu /end COMPU_METHOD
/begin COMPU_VTAB COMM_SC_Compu "" TAB_VERB 2 0 "False" 1 "True" /end COMPU_VTAB
/begin COMPU_METHOD COM_SC_Compu "" TAB_VERB "%6.3" "" COMPU_TAB_REF COM_SC_Compu /end COMPU_METHOD
/begin COMPU_VTAB COM_SC_Compu "" TAB_VERB 2 0 "False" 1 "True" /end COMPU_VTAB
/begin COMPU_METHOD COVOMVERS_SC_Compu "" TAB_VERB "%6.3" "" COMPU_TAB_REF COVOMVERS_SC_Compu /end COMPU_METHOD
/begin COMPU_VTAB COVOMVERS_SC_Compu "" TAB_VERB 2 1 "COVOMVER_1_0" 2 "COVOMVER_2_0" /end COMPU_VTAB
/begin COMPU_METHOD CppFacCylVol "" RAT_FUNC "%7.6" "-" COEFFS 0 32768 0 0 0 1 /end COMPU_METHOD
/begin COMPU_METHOD CppOfsFact "" RAT_FUNC "%6.4" "-" COEFFS 0 256 0 0 0 1 /end COMPU_METHOD
/begin COMPU_METHOD CRSSENSTYP_SY_Compu "" TAB_VERB "%6.3" "" COMPU_TAB_REF CRSSENSTYP_SY_Compu /end COMPU_METHOD
/begin COMPU_VTAB CRSSENSTYP_SY_Compu "" TAB_VERB 2 0 "STD" 1 "DGI" /end COMPU_VTAB
/begin COMPU_METHOD CRSTYP_SY_Compu "" TAB_VERB "%6.3" "" COMPU_TAB_REF CRSTYP_SY_Compu /end COMPU_METHOD
/begin COMPU_VTAB CRSTYP_SY_Compu "" TAB_VERB 4 0 "SYMMETRIC_GAP" 1 "SHORT_GAP" 2 "CODED_GAP" 3 "ASYMMETRIC_GAP" /end COMPU_VTAB
/begin COMPU_METHOD CRS_ALTPIN_SY_Compu "" TAB_VERB "%6.3" "" COMPU_TAB_REF CRS_ALTPIN_SY_Compu /end COMPU_METHOD
/begin COMPU_VTAB CRS_ALTPIN_SY_Compu "" TAB_VERB 2 0 "ONE_CRS_INPUT" 1 "TWO_CRS_INPUTS" /end COMPU_VTAB
/begin COMPU_METHOD CRS_ANGLECOR_SY_Compu "" TAB_VERB "%6.3" "" COMPU_TAB_REF CRS_ANGLECOR_SY_Compu /end COMPU_METHOD
/begin COMPU_VTAB CRS_ANGLECOR_SY_Compu "" TAB_VERB 4 0 "NO_COR" 1 "IAS" 2 "IAP" 3 "IAS_IAP" /end COMPU_VTAB
/begin COMPU_METHOD CRS_BACKUP_CASTYP_SY_Compu "" TAB_VERB "%6.3" "" COMPU_TAB_REF CRS_BACKUP_CASTYP_SY_Compu /end COMPU_METHOD
/begin COMPU_VTAB CRS_BACKUP_CASTYP_SY_Compu "" TAB_VERB 7 0 "ZN_PLUS_1_WHEEL" 1 "DS_STD_WHEEL" 2 "GS_STD_WHEEL" 3 "HALFMOON_WHEEL" 7 "CAS_3TOOTH_180_60" 8 "CAS_10PULSE_WHEEL" 12 "SWTCHCAL_DS_STD_WHEEL_GS_STD_WHEEL" /end COMPU_VTAB
/begin COMPU_METHOD DDRCTime_ms "" RAT_FUNC "%6.1" "ms" COEFFS 0 1 0 0 0 10 /end COMPU_METHOD
/begin COMPU_METHOD dez "" RAT_FUNC "%6.2" "" COEFFS 0 1 0 0 0 1 /end COMPU_METHOD
/begin COMPU_METHOD DFES_OneToOne "" RAT_FUNC "%6.2" "-" COEFFS 0 1 0 0 0 1 /end COMPU_METHOD
/begin COMPU_METHOD EngN_LRes "" RAT_FUNC "%6.1" "rpm" COEFFS 0 0.025 0 0 0 1 /end COMPU_METHOD
/begin COMPU_METHOD fak_q0p0039_op0p5 "" RAT_FUNC "%6.3" "" COEFFS 0 256 -128 0 0 1 /end COMPU_METHOD
/begin COMPU_METHOD fak_q0p2 "" RAT_FUNC "%6.3" "" COEFFS 0 1 0 0 0 0.2 /end COMPU_METHOD
/begin COMPU_METHOD fak_q4p6566Em10 "" RAT_FUNC "%18.17" "" COEFFS 0 2147483648 0 0 0 1 /end COMPU_METHOD
/begin COMPU_METHOD fak_sw_b1 "" RAT_FUNC "%7.6" "-" COEFFS 0 65536 0 0 0 2 /end COMPU_METHOD
/begin COMPU_METHOD fak_sw_b2 "" RAT_FUNC "%7.6" "-" COEFFS 0 65536 0 0 0 4 /end COMPU_METHOD
/begin COMPU_METHOD fak_ub_b1 "" RAT_FUNC "%6.4" "-" COEFFS 0 256 0 0 0 1 /end COMPU_METHOD
/begin COMPU_METHOD fak_ub_b16 "" RAT_FUNC "%6.4" "-" COEFFS 0 256 0 0 0 16 /end COMPU_METHOD
/begin COMPU_METHOD fak_ub_b2 "" RAT_FUNC "%8.5" "-" COEFFS 0 256 0 0 0 2 /end COMPU_METHOD
/begin COMPU_METHOD fak_ub_b4 "" RAT_FUNC "%6.4" "-" COEFFS 0 256 0 0 0 4 /end COMPU_METHOD
/begin COMPU_METHOD fak_uw_b1 "" RAT_FUNC "%7.6" "-" COEFFS 0 65536 0 0 0 1 /end COMPU_METHOD
/begin COMPU_METHOD fak_uw_b2 "" RAT_FUNC "%7.6" "-" COEFFS 0 65536 0 0 0 2 /end COMPU_METHOD
/begin COMPU_METHOD fak_uw_b4 "" RAT_FUNC "%7.6" "-" COEFFS 0 65536 0 0 0 4 /end COMPU_METHOD
/begin COMPU_METHOD fak_uw_b8 "" RAT_FUNC "%6.5" "-" COEFFS 0 65536 0 0 0 8 /end COMPU_METHOD
/begin COMPU_METHOD kumsrl_uw_b0p004 "" RAT_FUNC "%13.12" "(kg/h)/(1/min)(%)" COEFFS 0 16384000 0 0 0 1 /end COMPU_METHOD
/begin COMPU_METHOD kw_q1 "" RAT_FUNC "%6.2" "Grad KW" COEFFS 0 1 0 0 0 1 /end COMPU_METHOD
/begin COMPU_METHOD mk1sxs_b2560 "" RAT_FUNC "%6.1" "s/(kg/h)" COEFFS 0 0 2560 0 1 0 /end COMPU_METHOD
/begin COMPU_METHOD m_sw_q0p01 "" RAT_FUNC "%6.4" "kg/h" COEFFS 0 100 0 0 0 1 /end COMPU_METHOD
/begin COMPU_METHOD m_ub_b1020 "" RAT_FUNC "%6.2" "kg/h" COEFFS 0 1 0 0 0 4 /end COMPU_METHOD
/begin COMPU_METHOD m_uw_b23p3 "" RAT_FUNC "%6.5" "kg" COEFFS 0 2812.5 0 0 0 1 /end COMPU_METHOD
/begin COMPU_METHOD m_uw_b6553p5 "" RAT_FUNC "%6.3" "kg/h" COEFFS 0 1 0 0 0 0.1 /end COMPU_METHOD
/begin COMPU_METHOD m_uw_b655p35 "" RAT_FUNC "%6.4" "kg/h" COEFFS 0 100 0 0 0 1 /end COMPU_METHOD
/begin COMPU_METHOD m_uw_q0p0005 "" RAT_FUNC "%6.5" "kg/h" COEFFS 0 1 0 0 0 0.0005 /end COMPU_METHOD
/begin COMPU_METHOD nmot_sw_q0p25 "" RAT_FUNC "%6.3" "1/min" COEFFS 0 1 0 0 0 0.25 /end COMPU_METHOD
/begin COMPU_METHOD nmot_ub_q10 "" RAT_FUNC "%6.1" "1/min" COEFFS 0 1 0 0 0 10 /end COMPU_METHOD
/begin COMPU_METHOD nmot_ub_q40 "" RAT_FUNC "%6.1" "1/min" COEFFS 0 1 0 0 0 40 /end COMPU_METHOD
/begin COMPU_METHOD nmot_uw_q0p25 "" RAT_FUNC "%6.3" "1/min" COEFFS 0 1 0 0 0 0.25 /end COMPU_METHOD
/begin COMPU_METHOD OneToOne "" RAT_FUNC "%6.2" "-" COEFFS 0 1 0 0 0 1 /end COMPU_METHOD
/begin COMPU_METHOD p_ub_q10 "" RAT_FUNC "%6.1" "hPa" COEFFS 0 1 0 0 0 10 /end COMPU_METHOD
/begin COMPU_METHOD p_ub_q5 "" RAT_FUNC "%6.2" "hPa" COEFFS 0 1 0 0 0 5 /end COMPU_METHOD
/begin COMPU_METHOD p_uw_q0p039 "" RAT_FUNC "%6.4" "hPa" COEFFS 0 256 0 0 0 10 /end COMPU_METHOD
/begin COMPU_METHOD p_uw_q0p078 "" RAT_FUNC "%6.4" "hPa" COEFFS 0 256 0 0 0 20 /end COMPU_METHOD
/begin COMPU_METHOD q0p0061_pc_DIV_rpm "" RAT_FUNC "%6.4" "%/rpm" COEFFS 0 4096 0 0 0 25 /end COMPU_METHOD
/begin COMPU_METHOD q_q0p4551 "" RAT_FUNC "%6.3" "kJ" COEFFS 0 36000 0 0 0 16384 /end COMPU_METHOD
/begin COMPU_METHOD relDK_q0p02441 "" RAT_FUNC "%6.4" "%DK" COEFFS 0 65536 0 0 0 1600 /end COMPU_METHOD
/begin COMPU_METHOD relDK_ub_b100 "" RAT_FUNC "%6.3" "%DK" COEFFS 0 255 0 0 0 100 /end COMPU_METHOD
/begin COMPU_METHOD relDK_uw_b100 "" RAT_FUNC "%6.4" "%DK" COEFFS 0 65535 0 0 0 100 /end COMPU_METHOD
/begin COMPU_METHOD rel_sw_b100 "" RAT_FUNC "%6.4" "%" COEFFS 0 32768 0 0 0 100 /end COMPU_METHOD
/begin COMPU_METHOD rel_sw_q0p0234 "" RAT_FUNC "%6.4" "%/seg" COEFFS 0 32 0 0 0 0.75 /end COMPU_METHOD
/begin COMPU_METHOD rel_ub_b127p5 "" RAT_FUNC "%6.3" "%" COEFFS 0 2 0 0 0 1 /end COMPU_METHOD
/begin COMPU_METHOD rel_ub_b99p6 "" RAT_FUNC "%6.3" "%" COEFFS 0 256 0 0 0 100 /end COMPU_METHOD
/begin COMPU_METHOD rel_ub_q0p75 "" RAT_FUNC "%6.3" "%" COEFFS 0 1 0 0 0 0.75 /end COMPU_METHOD
/begin COMPU_METHOD rel_uw_b40 "" RAT_FUNC "%6.5" "%" COEFFS 0 65536 0 0 0 40 /end COMPU_METHOD
/begin COMPU_METHOD rel_uw_q0p0234 "" RAT_FUNC "%6.4" "%" COEFFS 0 32 0 0 0 0.75 /end COMPU_METHOD
/begin COMPU_METHOD spg_uw_q0p00488 "" RAT_FUNC "%6.4" "V" COEFFS 0 1024 0 0 0 5 /end COMPU_METHOD
/begin COMPU_METHOD s_q0p02777_m "" RAT_FUNC "%6.4" "m" COEFFS 0 36 0 0 0 1 /end COMPU_METHOD
/begin COMPU_METHOD t100msxs_uw_b6553p5 "" RAT_FUNC "%6.3" "s" COEFFS 0 1 0 0 0 0.1 /end COMPU_METHOD
/begin COMPU_METHOD t100msxs_uw_b6553p6 "" RAT_FUNC "%6.3" "s" COEFFS 0 10 0 0 0 1 /end COMPU_METHOD
/begin COMPU_METHOD t1sxs_uw_b65535 "" RAT_FUNC "%6.2" "s" COEFFS 0 1 0 0 0 1 /end COMPU_METHOD
/begin COMPU_METHOD t6minxmin_q6 "" RAT_FUNC "%6.2" "min" COEFFS 0 1 0 0 0 6 /end COMPU_METHOD
/begin COMPU_METHOD Temp_Cels "" RAT_FUNC "%6.1" "deg C" COEFFS 0 10 2731.4 0 0 1 /end COMPU_METHOD
/begin COMPU_METHOD temp_q5 "" RAT_FUNC "%6.2" "Grad C" COEFFS 0 1 0 0 0 5 /end COMPU_METHOD
/begin COMPU_METHOD temp_ub_q0p75_o48 "" RAT_FUNC "%6.2" "Grad C" COEFFS 0 1 48 0 0 0.75 /end COMPU_METHOD
/begin COMPU_METHOD temp_ub_q5_o50 "" RAT_FUNC "%6.2" "Grad C" COEFFS 0 1 50 0 0 5 /end COMPU_METHOD
/begin COMPU_METHOD Time_ms "" RAT_FUNC "%6.1" "ms" COEFFS 0 0.1 0 0 0 1 /end COMPU_METHOD
/begin COMPU_METHOD Time_s "" RAT_FUNC "%6.4" "s" COEFFS 0 100 0 0 0 1 /end COMPU_METHOD
/begin COMPU_METHOD tmin_uw_q1 "" RAT_FUNC "%6.2" "min" COEFFS 0 1 0 0 0 1 /end COMPU_METHOD
/begin COMPU_METHOD txms_uw_q0p001 "" RAT_FUNC "%6.5" "ms" COEFFS 0 1000 0 0 0 1 /end COMPU_METHOD
/begin COMPU_METHOD t_q0p001_ms "" RAT_FUNC "%6.5" "ms" COEFFS 0 1 0 0 0 0.001 /end COMPU_METHOD
/begin COMPU_METHOD t_q0p005 "" RAT_FUNC "%6.4" "s" COEFFS 0 1000 0 0 0 5 /end COMPU_METHOD
/begin COMPU_METHOD t_q0p01 "" RAT_FUNC "%6.4" "s" COEFFS 0 100 0 0 0 1 /end COMPU_METHOD
/begin COMPU_METHOD t_q0p02 "" RAT_FUNC "%6.4" "s" COEFFS 0 100 0 0 0 2 /end COMPU_METHOD
/begin COMPU_METHOD t_q0p1 "" RAT_FUNC "%6.3" "s" COEFFS 0 10 0 0 0 1 /end COMPU_METHOD
/begin COMPU_METHOD t_q0p2 "" RAT_FUNC "%6.3" "s" COEFFS 0 10 0 0 0 2 /end COMPU_METHOD
/begin COMPU_METHOD t_q1 "" RAT_FUNC "%6.2" "s" COEFFS 0 1 0 0 0 1 /end COMPU_METHOD
/begin COMPU_METHOD t_q2 "" RAT_FUNC "%6.2" "s" COEFFS 0 1 0 0 0 2 /end COMPU_METHOD
/begin COMPU_METHOD Vel "" RAT_FUNC "%6.4" "km/h" COEFFS 0 100 0 0 0 1 /end COMPU_METHOD
/begin COMPU_METHOD vfzg_ub_q1p25 "" RAT_FUNC "%6.2" "km/h" COEFFS 0 1 0 0 0 1.25 /end COMPU_METHOD
/begin COMPU_METHOD vfzg_uw_b512 "" RAT_FUNC "%6.4" "km/h" COEFFS 0 65536 0 0 0 512 /end COMPU_METHOD
/begin COMPU_METHOD zk100msxs_ub_b25p5 "" RAT_FUNC "%6.3" "s" COEFFS 0 0 256 0 10 0 /end COMPU_METHOD
/begin COMPU_METHOD zk100msxs_uw_b655 "" RAT_FUNC "%6.1" "s" COEFFS 0 0 65536 0 10 0 /end COMPU_METHOD
/begin COMPU_METHOD zk100msxs_uw_b6553 "" RAT_FUNC "%6.1" "s" COEFFS 0 0 65536 0 10 0 /end COMPU_METHOD
/begin COMPU_METHOD zk10msxs_uw_b655 "" RAT_FUNC "%6.2" "s" COEFFS 0 0 65536 0 100 0 /end COMPU_METHOD
/begin COMPU_METHOD zk1sxs_uw_b65535 "" RAT_FUNC "%6.0" "s" COEFFS 0 0 65535 0 1 0 /end COMPU_METHOD
/begin COMPU_METHOD zk200msxs_uw_b13107p2 "" RAT_FUNC "%6.0" "s" COEFFS 0 0 65536 0 5 0 /end COMPU_METHOD
/begin COMPU_METHOD zk20msxs_ub_b2p55 "" RAT_FUNC "%6.4" "s" COEFFS 0 0 2.55 0 1 0 /end COMPU_METHOD
/begin COMPU_METHOD zw_q0p1 "" RAT_FUNC "%6.3" "Grad KW" COEFFS 0 10 0 0 0 1 /end COMPU_METHOD
/begin COMPU_METHOD zw_sb_q0p75 "" RAT_FUNC "%6.3" "Grad KW" COEFFS 0 255 0 0 0 191.25 /end COMPU_METHOD
/begin RECORD_LAYOUT FklWU16 FNC_VALUES 1 UWORD COLUMN_DIR DIRECT /end RECORD_LAYOUT
/begin RECORD_LAYOUT FklWU8 FNC_VALUES 1 UBYTE COLUMN_DIR DIRECT /end RECORD_LAYOUT
/begin RECORD_LAYOUT GkfWS8 FNC_VALUES 1 SBYTE COLUMN_DIR DIRECT /end RECORD_LAYOUT
/begin RECORD_LAYOUT GklWS8 FNC_VALUES 1 SBYTE COLUMN_DIR DIRECT /end RECORD_LAYOUT
/begin RECORD_LAYOUT GklWU16 FNC_VALUES 1 UWORD COLUMN_DIR DIRECT /end RECORD_LAYOUT
/begin RECORD_LAYOUT GklWU8 FNC_VALUES 1 UBYTE COLUMN_DIR DIRECT /end RECORD_LAYOUT
/begin RECORD_LAYOUT KfAxU8AyU8SstxS16SstyS16WS16 NO_AXIS_PTS_X 1 SWORD NO_AXIS_PTS_Y 2 SWORD AXIS_PTS_X 3 SWORD INDEX_INCR DIRECT AXIS_PTS_Y 4 SWORD INDEX_INCR DIRECT FNC_VALUES 5 SWORD COLUMN_DIR DIRECT /end RECORD_LAYOUT
/begin RECORD_LAYOUT KfAxU8AyU8SstxS16SstyU16WU16 NO_AXIS_PTS_X 1 UBYTE NO_AXIS_PTS_Y 2 UBYTE AXIS_PTS_X 3 SWORD INDEX_INCR DIRECT AXIS_PTS_Y 4 UWORD INDEX_INCR DIRECT FNC_VALUES 5 UWORD COLUMN_DIR DIRECT /end RECORD_LAYOUT
/begin RECORD_LAYOUT KfAxU8AyU8SstxS16SstyU8WU16 NO_AXIS_PTS_X 1 UBYTE NO_AXIS_PTS_Y 2 UBYTE AXIS_PTS_X 3 SWORD INDEX_INCR DIRECT AXIS_PTS_Y 4 UBYTE INDEX_INCR DIRECT FNC_VALUES 5 UWORD COLUMN_DIR DIRECT /end RECORD_LAYOUT
/begin RECORD_LAYOUT KfAxU8AyU8SstxU16SstyU16WU16 NO_AXIS_PTS_X 1 UWORD NO_AXIS_PTS_Y 2 UWORD AXIS_PTS_X 3 UWORD INDEX_INCR DIRECT AXIS_PTS_Y 4 UWORD INDEX_INCR DIRECT FNC_VALUES 5 UWORD COLUMN_DIR DIRECT /end RECORD_LAYOUT
/begin RECORD_LAYOUT KfAxU8AyU8SstxU16SstyU8WU8 NO_AXIS_PTS_X 1 UBYTE NO_AXIS_PTS_Y 2 UBYTE AXIS_PTS_X 3 UWORD INDEX_INCR DIRECT AXIS_PTS_Y 4 UBYTE INDEX_INCR DIRECT FNC_VALUES 5 UBYTE COLUMN_DIR DIRECT /end RECORD_LAYOUT
/begin RECORD_LAYOUT KlAxU8SstxS16WS16 NO_AXIS_PTS_X 1 SWORD AXIS_PTS_X 2 SWORD INDEX_INCR DIRECT FNC_VALUES 3 SWORD COLUMN_DIR DIRECT /end RECORD_LAYOUT
/begin RECORD_LAYOUT KlAxU8SstxS16WU16_Static NO_AXIS_PTS_X 1 UWORD AXIS_PTS_X 2 SWORD INDEX_INCR DIRECT FNC_VALUES 3 UWORD COLUMN_DIR DIRECT STATIC_RECORD_LAYOUT /end RECORD_LAYOUT
/begin RECORD_LAYOUT KlAxU8SstxU16WU16 NO_AXIS_PTS_X 1 UWORD AXIS_PTS_X 2 UWORD INDEX_INCR DIRECT FNC_VALUES 3 UWORD COLUMN_DIR DIRECT /end RECORD_LAYOUT
/begin RECORD_LAYOUT KlAxU8SstxU16WU8_Static NO_AXIS_PTS_X 1 UWORD AXIS_PTS_X 2 UWORD INDEX_INCR DIRECT FNC_VALUES 3 UBYTE COLUMN_DIR DIRECT STATIC_RECORD_LAYOUT /end RECORD_LAYOUT
/begin RECORD_LAYOUT KlAxU8SstxU8WU16_Static NO_AXIS_PTS_X 1 UBYTE AXIS_PTS_X 2 UBYTE INDEX_INCR DIRECT FNC_VALUES 3 UWORD COLUMN_DIR DIRECT STATIC_RECORD_LAYOUT /end RECORD_LAYOUT
/begin RECORD_LAYOUT KwUw FNC_VALUES 1 UWORD COLUMN_DIR DIRECT /end RECORD_LAYOUT
/begin RECORD_LAYOUT KwWS16 FNC_VALUES 1 SWORD COLUMN_DIR DIRECT /end RECORD_LAYOUT
/begin RECORD_LAYOUT KwWS8 FNC_VALUES 1 SBYTE COLUMN_DIR DIRECT /end RECORD_LAYOUT
/begin RECORD_LAYOUT KwWU16 FNC_VALUES 1 UWORD COLUMN_DIR DIRECT /end RECORD_LAYOUT
/begin RECORD_LAYOUT KwWU32 FNC_VALUES 1 ULONG COLUMN_DIR DIRECT /end RECORD_LAYOUT
/begin RECORD_LAYOUT KwWU8 FNC_VALUES 1 UBYTE COLUMN_DIR DIRECT /end RECORD_LAYOUT
/begin RECORD_LAYOUT SstAU8SstU16 NO_AXIS_PTS_X 1 UWORD AXIS_PTS_X 2 UWORD INDEX_INCR DIRECT /end RECORD_LAYOUT
/begin RECORD_LAYOUT SstAU8SstU8 NO_AXIS_PTS_X 1 UBYTE AXIS_PTS_X 2 UBYTE INDEX_INCR DIRECT /end RECORD_LAYOUT
/begin RECORD_LAYOUT Val_Ws16 FNC_VALUES 1 SWORD COLUMN_DIR DIRECT /end RECORD_LAYOUT
/begin RECORD_LAYOUT Val_Wu16 FNC_VALUES 1 UWORD COLUMN_DIR DIRECT /end RECORD_LAYOUT
/begin RECORD_LAYOUT Val_Wu8 FNC_VALUES 1 UBYTE COLUMN_DIR DIRECT /end RECORD_LAYOUT
/end MODULE
/end PROJECT
