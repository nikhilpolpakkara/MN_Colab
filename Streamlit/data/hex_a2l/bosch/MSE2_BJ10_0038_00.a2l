ASAP2_VERSION 1 60
/begin PROJECT MSE2_BJ10_0038_00 "MDG1"
/begin HEADER "" VERSION "MSE2_BJ10_0038_00" PROJECT_NO MSE2_BJ10_0038_00 /end HEADER
/begin MODULE DIM ""
/begin MOD_COMMON "" BYTE_ORDER MSB_FIRST ALIGNMENT_BYTE 1 ALIGNMENT_WORD 2 ALIGNMENT_LONG 4 ALIGNMENT_INT64 4 ALIGNMENT_FLOAT32_IEEE 4 ALIGNMENT_FLOAT64_IEEE 4 /end MOD_COMMON
/*********** Start of merged CHARACTERISTIC blocks ***********/
/begin CHARACTERISTIC rba_CalWup_Finish_C "Leave Calibration Wakeup calibration label" VALUE 0x9083808 DefaultValueRecordLayout_uint16 65535.0 RB_RBA_Common_CentralElements_CompuMethods_Identical 0.0 65535. FORMAT "%5.0" /end CHARACTERISTIC
/begin CHARACTERISTIC rba_CalWup_WakeupEnable_C "Enable Calibration Wakeup" VALUE 0x908380A DefaultValueRecordLayout_uint16 65535.0 RB_RBA_Common_CentralElements_CompuMethods_Identical 0.0 65535. FORMAT "%5.0" /end CHARACTERISTIC
/begin CHARACTERISTIC rba_MRly_Diag_Stk_tiOkError_C "Debounce time of main relay sticky diagnosis for detecting an error" VALUE 0x9083858 DefaultValueRecordLayout_uint32 3000.0 RB_RBA_rba_MRly_BswModuleDescriptions_rba_MRly_Calibration_Common_milliseconds_CompuMethod 0.0 3000. FORMAT "%5.0" /end CHARACTERISTIC
/begin CHARACTERISTIC rba_MultiStackTrace_ThresholdLevel "Threshold level for stack monitoring" VALUE 0x908385C DefaultValueRecordLayout_uint16 65535.0 RB_RBA_rba_OsShell_CompuMethods_rba_OsShell_ResourceConversion 0.0 65535. FORMAT "%5.0" /end CHARACTERISTIC
/begin CHARACTERISTIC rba_MultiStackTrace_ResetMaxValues "Reset max stack values saved in NvM" VALUE 0x908385E DefaultValueRecordLayout_uint8 255.0 RB_RBA_Common_CentralElements_CompuMethods_Identical 0.0 255. FORMAT "%5.0" /end CHARACTERISTIC
/begin CHARACTERISTIC rba_MultiStackTrace_ThresholdSwitch "Select the Stack Limit Threshold Range from 0-5" VALUE 0x908385F DefaultValueRecordLayout_uint8 255.0 RB_RBA_Common_CentralElements_CompuMethods_Identical 0.0 255. FORMAT "%5.0" /end CHARACTERISTIC
/begin CHARACTERISTIC rba_OsShell_ResetResponseTimeValues "Reset max response time values saved in NvM" VALUE 0x9083860 DefaultValueRecordLayout_uint8 255.0 RB_RBA_Common_CentralElements_CompuMethods_Identical 0.0 255. FORMAT "%5.0" /end CHARACTERISTIC
/begin CHARACTERISTIC rba_Runtime_ResetMaxValues "Reset max runtime values saved in NvM" VALUE 0x9083861 DefaultValueRecordLayout_uint8 255.0 RB_RBA_Common_CentralElements_CompuMethods_Identical 0.0 255. FORMAT "%5.0" /end CHARACTERISTIC
/begin CHARACTERISTIC rba_Reset_xTrgId_C "calibration label for triggering a reset" VALUE 0x9083862 DefaultValueRecordLayout_uint16 65535.0 RB_RBA_Common_CentralElements_CompuMethods_Identical 0.0 65535.0 FORMAT "%5.1" /end CHARACTERISTIC
/begin CHARACTERISTIC rba_Reset_rstExtHistBuf_C "calibration label to reset the extended reset history buffer" VALUE 0x9083864 DefaultValueRecordLayout_uint8 255.0 RB_RBA_Common_CentralElements_CompuMethods_Identical 0.0 255.0 FORMAT "%5.1" /end CHARACTERISTIC
/begin CHARACTERISTIC rba_Reset_rstHistBuf_C "calibration label to reset the reset history buffer" VALUE 0x9083865 DefaultValueRecordLayout_uint8 255.0 RB_RBA_Common_CentralElements_CompuMethods_Identical 0.0 255.0 FORMAT "%5.1" /end CHARACTERISTIC
/begin CHARACTERISTIC rba_Reset_xGrpId_C "calibration label for setting the reset group for triggering a reset" VALUE 0x9083866 DefaultValueRecordLayout_uint8 255.0 RB_RBA_Common_CentralElements_CompuMethods_Identical 0.0 255.0 FORMAT "%5.1" /end CHARACTERISTIC
/begin CHARACTERISTIC rba_SyC_States_PostDrive_Begin_Timeout_C "Maximum time for Begin phase in state PostDrive in seconds" VALUE 0x908382C DefaultValueRecordLayout_uint32 4294964.0 RB_RBA_rba_SyC_BswModuleDescriptions_rba_SyC_States_Calibration_Timeout_CompuMethod 3. 4294967. FORMAT "%5.0" /end CHARACTERISTIC
/begin CHARACTERISTIC rba_SyC_States_PostDrive_End_Timeout_C "Maximum time for End phase in state PostDrive in seconds" VALUE 0x9083830 DefaultValueRecordLayout_uint32 4294966.0 RB_RBA_rba_SyC_BswModuleDescriptions_rba_SyC_States_Calibration_Timeout_CompuMethod 1. 4294967. FORMAT "%5.0" /end CHARACTERISTIC
/begin CHARACTERISTIC rba_SyC_States_PostDrive_MinimumTime_C "Minimum time for before state PostDrive is left in seconds" VALUE 0x9083834 DefaultValueRecordLayout_uint32 60.0 RB_RBA_rba_SyC_BswModuleDescriptions_rba_SyC_States_Calibration_Timeout_CompuMethod 0. 60. FORMAT "%5.0" /end CHARACTERISTIC
/begin CHARACTERISTIC rba_SyC_States_PostDrive_Network_Timeout_C "Maximum time for network phase in state PostDrive in seconds" VALUE 0x9083838 DefaultValueRecordLayout_uint32 4294964.0 RB_RBA_rba_SyC_BswModuleDescriptions_rba_SyC_States_Calibration_Timeout_CompuMethod 3. 4294967. FORMAT "%5.0" /end CHARACTERISTIC
/begin CHARACTERISTIC rba_SyC_States_PrepareShutdown_MaximumTime_C "Maximum time for Begin phase in state PrepareShutdown in seconds" VALUE 0x908383C DefaultValueRecordLayout_uint32 4294964.0 RB_RBA_rba_SyC_BswModuleDescriptions_rba_SyC_States_Calibration_Timeout_CompuMethod 3. 4294967. FORMAT "%5.0" /end CHARACTERISTIC
/begin CHARACTERISTIC rba_SyC_States_PrepareShutdown_MinimumTime_C "Minimum time for before state PrepareShutdown is left in seconds" VALUE 0x9083840 DefaultValueRecordLayout_uint32 4294967.0 RB_RBA_rba_SyC_BswModuleDescriptions_rba_SyC_States_Calibration_Timeout_CompuMethod 0.0 4294967. FORMAT "%5.0" /end CHARACTERISTIC
/begin CHARACTERISTIC rba_SyC_States_Wait_Delay_Timeout_C "Maximum time for Delay phase in state Wait in seconds" VALUE 0x9083844 DefaultValueRecordLayout_uint32 4294967.0 RB_RBA_rba_SyC_BswModuleDescriptions_rba_SyC_States_Calibration_Timeout_CompuMethod 0.0 4294967. FORMAT "%5.0" /end CHARACTERISTIC
/begin CHARACTERISTIC rba_SyC_States_Wait_MinimumTime_C "Minimum time for before state Wait is left in seconds" VALUE 0x9083848 DefaultValueRecordLayout_uint32 4294967.0 RB_RBA_rba_SyC_BswModuleDescriptions_rba_SyC_States_Calibration_Timeout_CompuMethod 0.0 4294967. FORMAT "%5.0" /end CHARACTERISTIC
/begin CHARACTERISTIC rba_SyC_States_Wait_Network_Timeout_C "Maximum time for Network phase in state Wait in seconds" VALUE 0x908384C DefaultValueRecordLayout_uint32 4294966.0 RB_RBA_rba_SyC_BswModuleDescriptions_rba_SyC_States_Calibration_Timeout_CompuMethod 1. 4294967. FORMAT "%5.0" /end CHARACTERISTIC
/begin CHARACTERISTIC rba_SyC_States_Wait_Prolong_Timeout_C "Maximum time for Prolong phase in state Wait in seconds" VALUE 0x9083850 DefaultValueRecordLayout_uint32 4294966.0 RB_RBA_rba_SyC_BswModuleDescriptions_rba_SyC_States_Calibration_Timeout_CompuMethod 1. 4294967. FORMAT "%5.0" /end CHARACTERISTIC
/begin CHARACTERISTIC rba_SyC_States_PostDrive_ClearTimeoutIndication_C "Clear the timout indication in state PostDrive by setting it to 0x42 and then to 0x88" VALUE 0x9083854 DefaultValueRecordLayout_uint8 255.0 DefaultIdenticalCompu 0.0 255. FORMAT "%5.0" /end CHARACTERISTIC
/begin CHARACTERISTIC rba_SyC_States_PrepareShutdown_ClearTimeoutIndication_C "Clear the timout indication in state PrepareShutdown by setting it to 0x42 and then to 0x88" VALUE 0x9083855 DefaultValueRecordLayout_uint8 255.0 DefaultIdenticalCompu 0.0 255. FORMAT "%5.0" /end CHARACTERISTIC
/begin CHARACTERISTIC rba_SyC_States_Wait_ClearTimeoutIndication_C "Clear the timout indication in state Wait by setting it to 0x42 and then to 0x88" VALUE 0x9083856 DefaultValueRecordLayout_uint8 255.0 DefaultIdenticalCompu 0.0 255. FORMAT "%5.0" /end CHARACTERISTIC
/begin CHARACTERISTIC rba_T15_Diag_ComInVld_tiDebPreFault_C "Debounce time of terminal 15 diagnosis ComInVld for OK to Fault" VALUE 0x908380C DefaultValueRecordLayout_uint32 1000.0 RB_RBA_rba_T15_BswModuleDescriptions_rba_T15_Diag_Calibration_CompuMethod 0.0 1000. FORMAT "%5.0" /end CHARACTERISTIC
/begin CHARACTERISTIC rba_T15_Diag_ComInVld_tiDebPreOk_C "Debounce time of terminal 15 diagnosis ComInVld for Fault to OK" VALUE 0x9083810 DefaultValueRecordLayout_uint32 1000.0 RB_RBA_rba_T15_BswModuleDescriptions_rba_T15_Diag_Calibration_CompuMethod 0.0 1000. FORMAT "%5.0" /end CHARACTERISTIC
/begin CHARACTERISTIC rba_T15_Diag_ComOff_HwOn_tiDebPreFault_C "Debounce time of terminal 15 diagnosis ComOff_HwOn for OK to Fault" VALUE 0x9083814 DefaultValueRecordLayout_uint32 1000.0 RB_RBA_rba_T15_BswModuleDescriptions_rba_T15_Diag_Calibration_CompuMethod 0.0 1000. FORMAT "%5.0" /end CHARACTERISTIC
/begin CHARACTERISTIC rba_T15_Diag_ComOff_HwOn_tiDebPreOk_C "Debounce time of terminal 15 diagnosis ComOff_HwOn for fault to OK" VALUE 0x9083818 DefaultValueRecordLayout_uint32 1000.0 RB_RBA_rba_T15_BswModuleDescriptions_rba_T15_Diag_Calibration_CompuMethod 0.0 1000. FORMAT "%5.0" /end CHARACTERISTIC
/begin CHARACTERISTIC rba_T15_Diag_ComOn_HwOff_tiDebPreFault_C "Debounce time of terminal 15 diagnosis ComOn_HwOff for OK to Fault" VALUE 0x908381C DefaultValueRecordLayout_uint32 1000.0 RB_RBA_rba_T15_BswModuleDescriptions_rba_T15_Diag_Calibration_CompuMethod 0.0 1000. FORMAT "%5.0" /end CHARACTERISTIC
/begin CHARACTERISTIC rba_T15_Diag_ComOn_HwOff_tiDebPreOk_C "Debounce time of terminal 15 diagnosis ComOn_HwOff for Fault to OK" VALUE 0x9083820 DefaultValueRecordLayout_uint32 1000.0 RB_RBA_rba_T15_BswModuleDescriptions_rba_T15_Diag_Calibration_CompuMethod 0.0 1000. FORMAT "%5.0" /end CHARACTERISTIC
/begin CHARACTERISTIC rba_T15_Signal_tiDebHiLo_C "Terminal 15 software debounce time high to low" VALUE 0x9083824 DefaultValueRecordLayout_uint32 100.0 RB_RBA_rba_T15_BswModuleDescriptions_rba_T15_Signal_Calibration_CompuMethod 0.0 100. FORMAT "%5.0" /end CHARACTERISTIC
/begin CHARACTERISTIC rba_T15_Signal_tiDebLoHi_C "Terminal 15 software debounce time Low to High" VALUE 0x9083828 DefaultValueRecordLayout_uint32 100.0 RB_RBA_rba_T15_BswModuleDescriptions_rba_T15_Signal_Calibration_CompuMethod 0.0 100. FORMAT "%5.0" /end CHARACTERISTIC
/begin CHARACTERISTIC B_FLSigErr_C "Calibration to enable Fuel level sensor signal error" VALUE 0x9083690 RB_Val_Wu8 1.00000000000 B_TRUE 0.00 1.00000000000 FORMAT "%13.11" /end CHARACTERISTIC
/begin CHARACTERISTIC B_NSP_C "Calibration to set B_nsp - condition for post injection" VALUE 0x9083691 RB_Val_Wu8 1.00000000000 B_TRUE 0.00 1.00000000000 FORMAT "%13.11" /end CHARACTERISTIC
/begin CHARACTERISTIC Com_bGbxPosDelAdptVal_C "Delete gearbox position sensor adaptation values" VALUE 0x9083692 RB_Val_Wu8 1.00000000000 B_TRUE 0.00 1.00000000000 FORMAT "%13.11" /end CHARACTERISTIC
/begin CHARACTERISTIC CstrPurg_CPVClsMinThrAg_C "cpv closing at minimum throttle angle" VALUE 0x9089CF8 KwWS16 1.999969 fak_sw_b1 -1.000000 0.9999695 FORMAT "%8.6" /end CHARACTERISTIC
/begin CHARACTERISTIC CWDMDZAG "code word DMDZAG configuration" VALUE 0x9083693 RB_Val_Wu8 255.0 OneToOne 0.00 255.0 FORMAT "%5.1" /end CHARACTERISTIC
/begin CHARACTERISTIC CWTERK "Configuration for the relative fuel part calculation in the fuel purge system" VALUE 0x9089E50 KwWU8 255.0 dez 0.00 255.0 FORMAT "%5.1" /end CHARACTERISTIC
/begin CHARACTERISTIC CWVMAXMD "Codeword speed limitation for torque structure" VALUE 0x9089E98 KwWU8 255.0 dez 0.00 255.0 FORMAT "%5.1" /end CHARACTERISTIC
/begin CHARACTERISTIC DFUCODEC "Forgetting rate for learned fuel concentration" VALUE 0x9089E51 KwWU8 1.992 fak_qn0p0078 -1.992 0.00 FORMAT "%5.3" /end CHARACTERISTIC
/begin CHARACTERISTIC DRATETE "Parameter to initialize delta purge rate" VALUE 0x9089CFA KwWU16 1.999969 fak_uw_b2 0.00 1.999969 FORMAT "%8.6" /end CHARACTERISTIC
/begin CHARACTERISTIC DRTTEO "Characteristic curve for CPV opening rate" CURVE 0x9089CFC KlAxU8SstxU16WU16 1.999969 fak_uw_b2 0.00 1.999969 FORMAT "%8.6"
 /begin AXIS_DESCR STD_AXIS ratetei_w fak_uw_b2 4 0.00 1.999969 FORMAT "%8.6" DEPOSIT ABSOLUTE /end AXIS_DESCR
/end CHARACTERISTIC
/begin CHARACTERISTIC DRTTES "Characteristic curve for CPV closing rate" CURVE 0x9089D0E KlAxU8SstxU16WU16 1.999969 fak_uw_b2 0.00 1.999969 FORMAT "%8.6"
 /begin AXIS_DESCR STD_AXIS ratetei_w fak_uw_b2 4 0.00 1.999969 FORMAT "%8.6" DEPOSIT ABSOLUTE /end AXIS_DESCR
/end CHARACTERISTIC
/begin CHARACTERISTIC DRTTESSA "characteristic curve for CPV closing at fuel cut off" CURVE 0x9089D20 KlAxU8SstxU16WU16 1.999969 fak_uw_b2 0.00 1.999969 FORMAT "%8.6"
 /begin AXIS_DESCR STD_AXIS ratetei_w fak_uw_b2 4 0.00 1.999969 FORMAT "%8.6" DEPOSIT ABSOLUTE /end AXIS_DESCR
/end CHARACTERISTIC
/begin CHARACTERISTIC FRTTEO "Correction factor curve for CPV opening rate" CURVE 0x9089D32 KlAxU8SstxU16WS16_Static 1.999969 fak_sw_b1 -1.000000 0.9999695 FORMAT "%8.6"
 /begin AXIS_DESCR STD_AXIS frm_w fak_uw_b2 8 0.00 1.999969 FORMAT "%8.6" DEPOSIT ABSOLUTE /end AXIS_DESCR
/end CHARACTERISTIC
/begin CHARACTERISTIC FTEIMSTE "Characteristic curve to limit max purge rate from accumulated purge flow" CURVE 0x9089D54 KlAxU8SstxU16WU8_Static 0.2550 fak_q0p001 0.00 0.2550 FORMAT "%6.4"
 /begin AXIS_DESCR STD_AXIS imste_w m_q0p0001085 4 0.00 7.111003 FORMAT "%8.6" DEPOSIT ABSOLUTE /end AXIS_DESCR
/end CHARACTERISTIC
/begin CHARACTERISTIC FTEWDK "Purge rate for component protection" CURVE 0x9089D62 KlAxU8SstxU8WU8 1.000 fak_ub_q0p00392 0.00 1.000 FORMAT "%5.3"
 /begin AXIS_DESCR STD_AXIS wdks relDK_ub_b100 4 0.00 100.0 FORMAT "%5.1" DEPOSIT ABSOLUTE /end AXIS_DESCR
/end CHARACTERISTIC
/begin CHARACTERISTIC FTFUCTAQ "Dutycycle when accumulated purge mass flow within the threshold" CURVE 0x9089E52 KlAxU8SstxU16WU16 15.99976 fak_uw_b16 0.00 15.99976 FORMAT "%8.5"
 /begin AXIS_DESCR STD_AXIS tatesoll_w rel_uw_b102p4 4 0.00 102.3984 FORMAT "%8.4" DEPOSIT ABSOLUTE /end AXIS_DESCR
/end CHARACTERISTIC
/begin CHARACTERISTIC FTFUCTASL "Dutycycle when accumulated purge mass flow exceeds the threshold" CURVE 0x9089E64 KlAxU8SstxU16WU16 15.99976 fak_uw_b16 0.00 15.99976 FORMAT "%8.5"
 /begin AXIS_DESCR STD_AXIS tatesoll_w rel_uw_b102p4 4 0.00 102.3984 FORMAT "%8.4" DEPOSIT ABSOLUTE /end AXIS_DESCR
/end CHARACTERISTIC
/begin CHARACTERISTIC FTLRS "Factor for time constant of fuel concentration learning integrator" VALUE 0x9089D6B KwWU8 7.969 fak_ub_b8 0.00 7.969 FORMAT "%5.3" /end CHARACTERISTIC
/begin CHARACTERISTIC FTRKTE "Time constant for low pass filter of fuel mass" VALUE 0x9089E76 KwWU16 99.99847 fak_uw_b100 0.00 99.99847 FORMAT "%8.5" /end CHARACTERISTIC
/begin CHARACTERISTIC FTVTEVTANS "Factor delay time correction by temperature of the sucked in air" CURVE 0x9089C9A KlAxU8SstxS16WS16 1.992188 fak_ub_b2 0.00 1.992188 FORMAT "%8.6" EXTENDED_LIMITS -256.0000 255.9922
 /begin AXIS_DESCR STD_AXIS tans Temp_Cels 4 -3549.940 3003.560 FORMAT "%8.3" DEPOSIT ABSOLUTE /end AXIS_DESCR
/end CHARACTERISTIC
/begin CHARACTERISTIC FUCOTEAB "Canister charge threshold for interruption of the purge phase" VALUE 0x9089D6C KwWS8 3.984 fak_sb_b2 -2.000 1.984 FORMAT "%5.3" /end CHARACTERISTIC
/begin CHARACTERISTIC FUCOTEH "High canister purge fuel concentration" VALUE 0x9089D6D KwWS8 3.984 fak_sb_b2 -2.000 1.984 FORMAT "%5.3" /end CHARACTERISTIC
/begin CHARACTERISTIC FUCOTEMN "Min value purge control adaptation" VALUE 0x9089E78 KwWS8 3.984 fak_sb_b2 -2.000 1.984 FORMAT "%5.3" /end CHARACTERISTIC
/begin CHARACTERISTIC FUCOTEMX "Max value purge control adaptation" VALUE 0x9089E79 KwWS8 3.984 fak_sb_b2 -2.000 1.984 FORMAT "%5.3" /end CHARACTERISTIC
/begin CHARACTERISTIC IMSTEAD "Thresold for accumulated purge mass" VALUE 0x9089E7A KwWU16 7.111003 m_q0p0001085 0.00 7.111003 FORMAT "%8.6" /end CHARACTERISTIC
/begin CHARACTERISTIC KFTVTE "PCV opening delay time" MAP 0x9089CAC KfAxU8AyU8SstxU8SstyU8WU8 127.5 t500usxms_ub_q0p5 0.00 127.5 FORMAT "%5.1"
 /begin AXIS_DESCR STD_AXIS puout p_ub_q5 4 0.00 1275. FORMAT "%5.0" DEPOSIT ABSOLUTE /end AXIS_DESCR
 /begin AXIS_DESCR STD_AXIS ubsq spg_q0p1 4 0.00 25.50 FORMAT "%5.2" DEPOSIT ABSOLUTE /end AXIS_DESCR
/end CHARACTERISTIC
/begin CHARACTERISTIC KLAFTEV "map flow-characteristic of PCV (incl. PCV carcoal-canister line)" CURVE 0x9089D6E KlAxU8SstxU16WU8_Static 1.992188 fak_ub_b2 0.00 1.992188 FORMAT "%8.6"
 /begin AXIS_DESCR STD_AXIS pspu_w fak_uw_b2 12 0.00 1.999969 FORMAT "%8.6" DEPOSIT ABSOLUTE /end AXIS_DESCR
/end CHARACTERISTIC
/begin CHARACTERISTIC KLFUCOTE "Learning speed correction factor for canister purge" CURVE 0x9089E7C KlAxU8SstxU16WU8_Static 127.5 fak_ub_q0p5 0.00 127.5 FORMAT "%5.1"
 /begin AXIS_DESCR STD_AXIS ratekor_w m_uw_b25p6 4 0.00 25.59961 FORMAT "%8.5" DEPOSIT ABSOLUTE /end AXIS_DESCR
/end CHARACTERISTIC
/begin CHARACTERISTIC KLTEVP "Characteristic line for period time of CPV" CURVE 0x9089CC6 FklWU8 127.0 t500usxms_ub_q0p5 0.5000 127.5 FORMAT "%5.1" EXTENDED_LIMITS 0.00 127.5
 /begin AXIS_DESCR FIX_AXIS tatesoll rel_ub_q0p5 7 2.000 98.00 FORMAT "%5.2" FIX_AXIS_PAR 4 5 7 /end AXIS_DESCR
/end CHARACTERISTIC
/begin CHARACTERISTIC KRVMX "Gain of controller for vehicle speed limitation" VALUE 0x9089E99 KwWU8 99.61 rel_ub_q0p3906 0.00 99.61 FORMAT "%5.2" /end CHARACTERISTIC
/begin CHARACTERISTIC MSNTEMX "Maximum purge mass flow" VALUE 0x9089D94 KwWU16 6553.500 m_uw_b6553p5 0.00 6553.500 FORMAT "%8.3" /end CHARACTERISTIC
/begin CHARACTERISTIC MSTEDEQ "Quick purge mass flow decrementing at open valve" VALUE 0x9089D96 KwWU8 25.50 m_q0p1_omq25p5 -25.50 0.00 FORMAT "%5.2" /end CHARACTERISTIC
/begin CHARACTERISTIC MSTEDES "Slow purge mass flow decrementing at valve closing" VALUE 0x9089D97 KwWU8 2.550 m_q0p01_omq2p55 -2.550 0.00 FORMAT "%5.3" /end CHARACTERISTIC
/begin CHARACTERISTIC NMAXVMX "Maximum engine speed in case of error vehicle speed" VALUE 0x9089E9A KwWU16 16383.75 nmot_uw_q0p25 0.00 16383.75 FORMAT "%8.2" /end CHARACTERISTIC
/begin CHARACTERISTIC NMOTREVDELTA_C "Delta for hysteresis of engine speed signal for Rev limit flag calculation" VALUE 0x9083694 RB_Val_Wu16 16383.75 nmot_uw_q0p25 0.00 16383.75 FORMAT "%8.2" /end CHARACTERISTIC
/begin CHARACTERISTIC NmotRevLim_tiT15EROffDly_C "Time delay for engine speed signal comparison with threshold for Rev limit flag calculation" VALUE 0x9083696 RB_Val_Wu16 6553.500 t_q0p1 0.00 6553.500 FORMAT "%8.3" /end CHARACTERISTIC
/begin CHARACTERISTIC NMOTREVLMPCHKTHD_c "Threshold for engine speed signal for Rev limit flag calculation" VALUE 0x9083698 RB_Val_Wu16 16383.75 nmot_uw_q0p25 0.00 16383.75 FORMAT "%8.2" /end CHARACTERISTIC
/begin CHARACTERISTIC NMOTREVTHD_C "Threshold for hysteresis of engine speed signal for Rev limit flag calculation" VALUE 0x908369A RB_Val_Wu16 16383.75 nmot_uw_q0p25 0.00 16383.75 FORMAT "%8.2" /end CHARACTERISTIC
/begin CHARACTERISTIC NMOTREVTIM "Threshold for Rev limit time counter" VALUE 0x908369C RB_Val_Wu16 655.3500 t_q0p01 0.00 655.3500 FORMAT "%8.4" /end CHARACTERISTIC
/begin CHARACTERISTIC PSPUCUR "Factor of manifold pressure by ambient pressure" CURVE 0x9089E8A KlAxU8SstxU8WU8 1.992188 fak_ub_b2 0.00 1.992188 FORMAT "%8.6"
 /begin AXIS_DESCR STD_AXIS psputmp fak_ub_b2 6 0.00 1.992188 FORMAT "%8.6" DEPOSIT ABSOLUTE /end AXIS_DESCR
/end CHARACTERISTIC
/begin CHARACTERISTIC RATETEMN "Minimum purge rate" VALUE 0x9089D98 KwWU8 1.992188 fak_ub_b2 0.00 1.992188 FORMAT "%8.6" /end CHARACTERISTIC
/begin CHARACTERISTIC RRKTEVMX "Maximum fuel share of canister purge fuel of total fuel" CURVE 0x9089D9A KlAxU8SstxU16WU8_Static 1.992188 fak_ub_b2 0.00 1.992188 FORMAT "%8.6"
 /begin AXIS_DESCR STD_AXIS ml_w m_uw_b6553p5 4 0.00 6553.500 FORMAT "%8.3" DEPOSIT ABSOLUTE /end AXIS_DESCR
/end CHARACTERISTIC
/begin CHARACTERISTIC RTEVNMOTRL "Map for limitation of purge rate" MAP 0x9089DA8 KfAxU8AyU8SstxU16SstyU16WU16 1.999969 fak_uw_b2 0.00 1.999969 FORMAT "%8.6"
 /begin AXIS_DESCR STD_AXIS nmot_w nmot_uw_q0p25 8 0.00 16383.75 FORMAT "%8.2" DEPOSIT ABSOLUTE /end AXIS_DESCR
 /begin AXIS_DESCR STD_AXIS rltev_w rel_uw_q0p0234 8 0.00 1535.977 FORMAT "%8.3" DEPOSIT ABSOLUTE /end AXIS_DESCR
/end CHARACTERISTIC
/begin CHARACTERISTIC T15_tiTurnOfDly_C "Time required to update T15_stRawTurnOfDly once T15_stRaw detected as low." VALUE 0x908134E Val_Ws16 327670.0 TimeDeb 0.00 327670.0 FORMAT "%8.1" EXTENDED_LIMITS -327680.0 327670.0 /end CHARACTERISTIC
/begin CHARACTERISTIC TATEMSN "Characteristic curve for the duty cycle of the canister purge valve (CPV) depending on the massflow" CURVE 0x9089CCE KlAxU8SstxU16WU16 102.3984 rel_uw_b102p4 0.00 102.3984 FORMAT "%8.4"
 /begin AXIS_DESCR STD_AXIS msntes_w m_uw_b25p6 10 0.00 25.59961 FORMAT "%8.5" DEPOSIT ABSOLUTE /end AXIS_DESCR
/end CHARACTERISTIC
/begin CHARACTERISTIC TDPWTROP "Delay in activation vehicle speed limitation" VALUE 0x9089E9C KwWU8 25.50 t_q0p1 0.00 25.50 FORMAT "%5.2" /end CHARACTERISTIC
/begin CHARACTERISTIC TIVMX "Time constant of integral controller for vehicle speed limitation" VALUE 0x9089E9E KwWU16 6553.4999985 zk100msxs_uw_b6553 0.10000152590 6553.6000000 FORMAT "%12.7" /end CHARACTERISTIC
/begin CHARACTERISTIC VFZGMX "Speed threshold for VMAX control" VALUE 0x9089EA0 KwWU16 511.9922 vfzg_uw_b512 0.00 511.9922 FORMAT "%8.4" /end CHARACTERISTIC
/begin CHARACTERISTIC WDKTEV "Lower Threshold for wdkba" VALUE 0x9089E4C KwWU8 100.0 relDK_ub_b100 0.00 100.0 FORMAT "%5.1" /end CHARACTERISTIC
/begin CHARACTERISTIC ZMSNT "Time constant for low pass filter for actual purge mass flow" VALUE 0x9089E4E KwWU16 1310.6999997 zk20msxs_uw_b655 0.020000305180 1310.7200000 FORMAT "%12.7" /end CHARACTERISTIC
/begin MEASUREMENT Can_MsgStatus_MP "This variable value describes the CAN message buffer status. The value is 1 if the message transmission is initiated and is reset(value 0) after the confirmation is given for the same." UBYTE DefaultIdenticalCompu 1 100 0.0 255.0 ARRAY_SIZE 22 ECU_ADDRESS 0x40002E24 /end MEASUREMENT
/begin MEASUREMENT CanIf_TxNotification_0 "Can Interface Transmit Notification" UBYTE AUTOSAR_CanIf_CompuMethods_CanIf_NotifStatusType_Enum_comp 1 100 0.0 255. FORMAT "%5.0" ARRAY_SIZE 23 ECU_ADDRESS 0x40003EDC /end MEASUREMENT
/begin MEASUREMENT CanSM_BusOff_Cntr_a "Bus-Off counter for CanSM" UBYTE RB_RBA_Common_CentralElements_CompuMethods_Identical 1 100 0.0 255. FORMAT "%5.0" ARRAY_SIZE 2 ECU_ADDRESS 0x40002D28 /end MEASUREMENT
/begin MEASUREMENT CanSM_currBOR_State_a "Current Bus-Off recovery state for CanSM" UBYTE AUTOSAR_CanSM_CompuMethods_CanSM_BusOffRecoveryStateType_Enum_comp 1 100 0.0 255. FORMAT "%5.0" ARRAY_SIZE 2 ECU_ADDRESS 0x40003F78 /end MEASUREMENT
/begin MEASUREMENT CanSM_currComM_Mode_a "current ComM mode" UBYTE AUTOSAR_CanSM_CompuMethods_CanSM_NetworkModeStateType_Enum_comp 1 100 0.0 255. FORMAT "%5.0" ARRAY_SIZE 2 ECU_ADDRESS 0x40003F80 /end MEASUREMENT
/begin MEASUREMENT CanSM_reqComM_Mode_a "stores the requested communication mode" UBYTE RB_RBA_Common_CentralElements_CompuMethods_Identical 1 100 0.0 255. FORMAT "%5.0" ARRAY_SIZE 2 ECU_ADDRESS 0x40003F64 /end MEASUREMENT
/begin MEASUREMENT CanSM_stBORMode_a "Variable to SET/RESET the BOR mode" UBYTE RB_RBA_Common_CentralElements_CompuMethods_Identical 1 100 0.0 255. FORMAT "%5.0" ARRAY_SIZE 2 ECU_ADDRESS 0x40002D24 /end MEASUREMENT
/begin MEASUREMENT CanSM_stBusOffISRPend_a "To Set the BOR ISR Pending Request to True or False" UBYTE RB_RBA_Common_CentralElements_CompuMethods_Identical 1 100 0.0 255. FORMAT "%5.0" ARRAY_SIZE 2 ECU_ADDRESS 0x40002D1C /end MEASUREMENT
/begin MEASUREMENT CanSM_stInit_a "Setting this leads to initialisation of the network" UBYTE RB_RBA_Common_CentralElements_CompuMethods_Identical 1 100 0.0 255. FORMAT "%5.0" ARRAY_SIZE 2 ECU_ADDRESS 0x40002D18 /end MEASUREMENT
/begin MEASUREMENT CanSM_stMutex_a "Used to set" UBYTE RB_RBA_Common_CentralElements_CompuMethods_Identical 1 100 0.0 255. FORMAT "%5.0" ARRAY_SIZE 2 ECU_ADDRESS 0x40002D20 /end MEASUREMENT
/begin MEASUREMENT Com_IpduBuf_CanNmUserData0 "Tx Ipdu buffer of IPdu -CanNmUserData0- as a Measurement parameter" UBYTE RB_RBA_Common_CentralElements_CompuMethods_Identical 1 100 0.0 255. FORMAT "%5.0" ARRAY_SIZE 6 ECU_ADDRESS 0x40002D64 /end MEASUREMENT
/begin MEASUREMENT Com_IpduBuf_EMS_10_TX "Tx Ipdu buffer of IPdu -EMS_10_TX- as a Measurement parameter" UBYTE RB_RBA_Common_CentralElements_CompuMethods_Identical 1 100 0.0 255. FORMAT "%5.0" ARRAY_SIZE 8 ECU_ADDRESS 0x40002DF0 /end MEASUREMENT
/begin MEASUREMENT Com_IpduBuf_EMS_11_TX "Tx Ipdu buffer of IPdu -EMS_11_TX- as a Measurement parameter" UBYTE RB_RBA_Common_CentralElements_CompuMethods_Identical 1 100 0.0 255. FORMAT "%5.0" ARRAY_SIZE 5 ECU_ADDRESS 0x40002DA4 /end MEASUREMENT
/begin MEASUREMENT Com_IpduBuf_EMS_12_TX "Tx Ipdu buffer of IPdu -EMS_12_TX- as a Measurement parameter" UBYTE RB_RBA_Common_CentralElements_CompuMethods_Identical 1 100 0.0 255. FORMAT "%5.0" ARRAY_SIZE 8 ECU_ADDRESS 0x40002D9C /end MEASUREMENT
/begin MEASUREMENT Com_IpduBuf_EMS_13_TX "Tx Ipdu buffer of IPdu -EMS_13_TX- as a Measurement parameter" UBYTE RB_RBA_Common_CentralElements_CompuMethods_Identical 1 100 0.0 255. FORMAT "%5.0" ARRAY_SIZE 8 ECU_ADDRESS 0x40002D94 /end MEASUREMENT
/begin MEASUREMENT Com_IpduBuf_EMS_14_TX "Tx Ipdu buffer of IPdu -EMS_14_TX- as a Measurement parameter" UBYTE RB_RBA_Common_CentralElements_CompuMethods_Identical 1 100 0.0 255. FORMAT "%5.0" ARRAY_SIZE 8 ECU_ADDRESS 0x40002D8C /end MEASUREMENT
/begin MEASUREMENT Com_IpduBuf_EMS_15_TX "Tx Ipdu buffer of IPdu -EMS_15_TX- as a Measurement parameter" UBYTE RB_RBA_Common_CentralElements_CompuMethods_Identical 1 100 0.0 255. FORMAT "%5.0" ARRAY_SIZE 8 ECU_ADDRESS 0x40002D84 /end MEASUREMENT
/begin MEASUREMENT Com_IpduBuf_EMS_16_TX "Tx Ipdu buffer of IPdu -EMS_16_TX- as a Measurement parameter" UBYTE RB_RBA_Common_CentralElements_CompuMethods_Identical 1 100 0.0 255. FORMAT "%5.0" ARRAY_SIZE 8 ECU_ADDRESS 0x40002D7C /end MEASUREMENT
/begin MEASUREMENT Com_IpduBuf_EMS_17_TX "Tx Ipdu buffer of IPdu -EMS_17_TX- as a Measurement parameter" UBYTE RB_RBA_Common_CentralElements_CompuMethods_Identical 1 100 0.0 255. FORMAT "%5.0" ARRAY_SIZE 8 ECU_ADDRESS 0x40002D74 /end MEASUREMENT
/begin MEASUREMENT Com_IpduBuf_EMS_18_TX "Tx Ipdu buffer of IPdu -EMS_18_TX- as a Measurement parameter" UBYTE RB_RBA_Common_CentralElements_CompuMethods_Identical 1 100 0.0 255. FORMAT "%5.0" ARRAY_SIZE 8 ECU_ADDRESS 0x40002D6C /end MEASUREMENT
/begin MEASUREMENT Com_IpduBuf_EMS_19_TX "Tx Ipdu buffer of IPdu -EMS_19_TX- as a Measurement parameter" UBYTE RB_RBA_Common_CentralElements_CompuMethods_Identical 1 100 0.0 255. FORMAT "%5.0" ARRAY_SIZE 2 ECU_ADDRESS 0x40002DEC /end MEASUREMENT
/begin MEASUREMENT Com_IpduBuf_EMS_1_TX "Tx Ipdu buffer of IPdu -EMS_1_TX- as a Measurement parameter" UBYTE RB_RBA_Common_CentralElements_CompuMethods_Identical 1 100 0.0 255. FORMAT "%5.0" ARRAY_SIZE 8 ECU_ADDRESS 0x40002DF8 /end MEASUREMENT
/begin MEASUREMENT Com_IpduBuf_EMS_2_TX "Tx Ipdu buffer of IPdu -EMS_2_TX- as a Measurement parameter" UBYTE RB_RBA_Common_CentralElements_CompuMethods_Identical 1 100 0.0 255. FORMAT "%5.0" ARRAY_SIZE 8 ECU_ADDRESS 0x40002DE4 /end MEASUREMENT
/begin MEASUREMENT Com_IpduBuf_EMS_3_TX "Tx Ipdu buffer of IPdu -EMS_3_TX- as a Measurement parameter" UBYTE RB_RBA_Common_CentralElements_CompuMethods_Identical 1 100 0.0 255. FORMAT "%5.0" ARRAY_SIZE 8 ECU_ADDRESS 0x40002DDC /end MEASUREMENT
/begin MEASUREMENT Com_IpduBuf_EMS_4_TX "Tx Ipdu buffer of IPdu -EMS_4_TX- as a Measurement parameter" UBYTE RB_RBA_Common_CentralElements_CompuMethods_Identical 1 100 0.0 255. FORMAT "%5.0" ARRAY_SIZE 8 ECU_ADDRESS 0x40002DD4 /end MEASUREMENT
/begin MEASUREMENT Com_IpduBuf_EMS_5_TX "Tx Ipdu buffer of IPdu -EMS_5_TX- as a Measurement parameter" UBYTE RB_RBA_Common_CentralElements_CompuMethods_Identical 1 100 0.0 255. FORMAT "%5.0" ARRAY_SIZE 8 ECU_ADDRESS 0x40002DCC /end MEASUREMENT
/begin MEASUREMENT Com_IpduBuf_EMS_6_TX "Tx Ipdu buffer of IPdu -EMS_6_TX- as a Measurement parameter" UBYTE RB_RBA_Common_CentralElements_CompuMethods_Identical 1 100 0.0 255. FORMAT "%5.0" ARRAY_SIZE 8 ECU_ADDRESS 0x40002DC4 /end MEASUREMENT
/begin MEASUREMENT Com_IpduBuf_EMS_7_TX "Tx Ipdu buffer of IPdu -EMS_7_TX- as a Measurement parameter" UBYTE RB_RBA_Common_CentralElements_CompuMethods_Identical 1 100 0.0 255. FORMAT "%5.0" ARRAY_SIZE 8 ECU_ADDRESS 0x40002DBC /end MEASUREMENT
/begin MEASUREMENT Com_IpduBuf_EMS_8_TX "Tx Ipdu buffer of IPdu -EMS_8_TX- as a Measurement parameter" UBYTE RB_RBA_Common_CentralElements_CompuMethods_Identical 1 100 0.0 255. FORMAT "%5.0" ARRAY_SIZE 8 ECU_ADDRESS 0x40002DB4 /end MEASUREMENT
/begin MEASUREMENT Com_IpduBuf_EMS_9_TX "Tx Ipdu buffer of IPdu -EMS_9_TX- as a Measurement parameter" UBYTE RB_RBA_Common_CentralElements_CompuMethods_Identical 1 100 0.0 255. FORMAT "%5.0" ARRAY_SIZE 8 ECU_ADDRESS 0x40002DAC /end MEASUREMENT
/begin MEASUREMENT Com_SigType_u16 "Measurement variable for Signals of type - uint16,sint16. To refer Individual element in the Buffer array, Fetch Buffer Index from Com_Cfg.c for each signal." UWORD RB_RBA_Common_CentralElements_CompuMethods_Identical 1 100 0.0 65535. FORMAT "%5.0" ARRAY_SIZE 2 ECU_ADDRESS 0x40002C80 /end MEASUREMENT
/begin MEASUREMENT Com_SigType_u8 "Measurement variable for Signals of type - uint8,sint8,boolean. To refer Individual element in the Buffer array, Fetch Buffer Index from Com_Cfg.c for each signal." UBYTE RB_RBA_Common_CentralElements_CompuMethods_Identical 1 100 0.0 255. FORMAT "%5.0" ARRAY_SIZE 4 ECU_ADDRESS 0x40002D50 /end MEASUREMENT
/begin MEASUREMENT rba_MultiStackTrace_ThresholdTable "Threshold table for Configured Limits" UWORD RB_RBA_Common_CentralElements_CompuMethods_Identical 1 100 0.0 65535. FORMAT "%5.0" ARRAY_SIZE 6 ECU_ADDRESS 0x4000267C /end MEASUREMENT
/begin MEASUREMENT rba_Reset_HistBuf_a "reset history buffer" ULONG RB_RBA_rba_Reset_CompuMethods_rba_Reset_Id_ten 1 100 0.0 4.E9 FORMAT "%5.0" ARRAY_SIZE 8 ECU_ADDRESS 0x4000F94C /end MEASUREMENT
/begin MEASUREMENT rba_Runtime_MonSystemLoadPer64k_au16 "Core Load" UWORD RB_RBA_rba_Runtime_CompuMethods_rba_Runtime_Percentage 1 100 0.0 65535. FORMAT "%5.0" ARRAY_SIZE 1 ECU_ADDRESS 0x40007D78 /end MEASUREMENT
/begin MEASUREMENT rba_SyC_States_PostDrive_Prolongers_MP "Prolongers in PostDrive State" UBYTE RB_RBA_rba_SyC_BswModuleDescriptions_rba_SyC_Prolongers_CompuMethod 1 100 0.0 255.0 ARRAY_SIZE 1 ECU_ADDRESS 0x40009EB0
 /begin ANNOTATION ANNOTATION_LABEL "Description (coming from AUTOSAR DESC field)" /begin ANNOTATION_TEXT "Prolongers in PostDrive State\r\n" /end ANNOTATION_TEXT /end ANNOTATION
/end MEASUREMENT
/begin MEASUREMENT rba_SyC_States_PrepareShutdown_Prolongers_MP "Prolongers in PrepareShutdown State" UBYTE RB_RBA_rba_SyC_BswModuleDescriptions_rba_SyC_Prolongers_CompuMethod 1 100 0.0 255.0 ARRAY_SIZE 1 ECU_ADDRESS 0x40009EB4
 /begin ANNOTATION ANNOTATION_LABEL "Description (coming from AUTOSAR DESC field)" /begin ANNOTATION_TEXT "Prolongers in PrepareShutdown State\r\n" /end ANNOTATION_TEXT /end ANNOTATION
/end MEASUREMENT
/begin MEASUREMENT rba_SyC_States_Wait_Prolongers_MP "Prolongers in Wait State" UBYTE RB_RBA_rba_SyC_BswModuleDescriptions_rba_SyC_Prolongers_CompuMethod 1 100 0.0 255.0 ARRAY_SIZE 1 ECU_ADDRESS 0x40009EBC
 /begin ANNOTATION ANNOTATION_LABEL "Description (coming from AUTOSAR DESC field)" /begin ANNOTATION_TEXT "Prolongers in Wait Stat\r\n" /end ANNOTATION_TEXT /end ANNOTATION
/end MEASUREMENT
/begin MEASUREMENT rba_SyC_User_GlobalScope_Prolongers_MP "Prolongers in Global Scope" UBYTE RB_RBA_rba_SyC_BswModuleDescriptions_rba_SyC_Prolongers_CompuMethod 1 100 0.0 255.0 ARRAY_SIZE 1 ECU_ADDRESS 0x40009ECC
 /begin ANNOTATION ANNOTATION_LABEL "Description (coming from AUTOSAR DESC field)" /begin ANNOTATION_TEXT "Prolongers in Global Scope\r\n" /end ANNOTATION_TEXT /end ANNOTATION
/end MEASUREMENT
/begin MEASUREMENT rba_SyC_User_PostDriveScope_Delayers_MP "Delayers in PostDrive Scope" UBYTE RB_RBA_rba_SyC_BswModuleDescriptions_rba_SyC_Prolongers_CompuMethod 1 100 0.0 255.0 ARRAY_SIZE 1 ECU_ADDRESS 0x40009EC4
 /begin ANNOTATION ANNOTATION_LABEL "Description (coming from AUTOSAR DESC field)" /begin ANNOTATION_TEXT "Delayers in PostDrive Scope\r\n" /end ANNOTATION_TEXT /end ANNOTATION
/end MEASUREMENT
/begin MEASUREMENT rba_SyC_User_PostDriveScope_Prolongers_MP "Prolongers in PostDrive Scope" UBYTE RB_RBA_rba_SyC_BswModuleDescriptions_rba_SyC_Prolongers_CompuMethod 1 100 0.0 255.0 ARRAY_SIZE 1 ECU_ADDRESS 0x40009ED0
 /begin ANNOTATION ANNOTATION_LABEL "Description (coming from AUTOSAR DESC field)" /begin ANNOTATION_TEXT "Prolongers in PostDrive Scope\r\n" /end ANNOTATION_TEXT /end ANNOTATION
/end MEASUREMENT
/begin MEASUREMENT rba_SyC_User_PrepareShutdownScope_Delayers_MP "Delayers in PrepareShutdown Scope" UBYTE RB_RBA_rba_SyC_BswModuleDescriptions_rba_SyC_Prolongers_CompuMethod 1 100 0.0 255.0 ARRAY_SIZE 1 ECU_ADDRESS 0x40009EC0
 /begin ANNOTATION ANNOTATION_LABEL "Description (coming from AUTOSAR DESC field)" /begin ANNOTATION_TEXT "Delayers in PrepareShutdown Scope\r\n" /end ANNOTATION_TEXT /end ANNOTATION
/end MEASUREMENT
/begin MEASUREMENT rba_SyC_User_WaitScope_Delayers_MP "Delayers in Wait Scope" UBYTE RB_RBA_rba_SyC_BswModuleDescriptions_rba_SyC_Prolongers_CompuMethod 1 100 0.0 255.0 ARRAY_SIZE 1 ECU_ADDRESS 0x40009EC8
 /begin ANNOTATION ANNOTATION_LABEL "Description (coming from AUTOSAR DESC field)" /begin ANNOTATION_TEXT "Delayers in Wait Scope\r\n" /end ANNOTATION_TEXT /end ANNOTATION
/end MEASUREMENT
/begin MEASUREMENT rba_SyC_User_WaitScope_Prolongers_MP "Prolongers in Wait Scope" UBYTE RB_RBA_rba_SyC_BswModuleDescriptions_rba_SyC_Prolongers_CompuMethod 1 100 0.0 255.0 ARRAY_SIZE 1 ECU_ADDRESS 0x40009ED4
 /begin ANNOTATION ANNOTATION_LABEL "Description (coming from AUTOSAR DESC field)" /begin ANNOTATION_TEXT "Prolongers in Wait Scope\r\n" /end ANNOTATION_TEXT /end ANNOTATION
/end MEASUREMENT
/begin MEASUREMENT ACCtl_stOut "Air condition Compressor status" UBYTE OneToOne 1 100 0.00 255.0 FORMAT "%5.1" ECU_ADDRESS 0x40008F3A /end MEASUREMENT
/begin MEASUREMENT ActMod_trqInr "Current, back-calculated inner engine torque" SWORD Trq 1 100 -3276.800 3276.700 FORMAT "%8.3" ECU_ADDRESS 0x40008F38
 /begin IF_DATA XCPplus 0x0102
  /begin DAQ_EVENT VARIABLE /begin AVAILABLE_EVENT_LIST EVENT 0 EVENT 1 EVENT 2 EVENT 3 /end AVAILABLE_EVENT_LIST /begin DEFAULT_EVENT_LIST EVENT 1 /end DEFAULT_EVENT_LIST /end DAQ_EVENT
 /end IF_DATA
/end MEASUREMENT
/begin MEASUREMENT APP_r "Standardized accelerator pedal position" SWORD Prc 1 100 -400.0000 399.9878 FORMAT "%8.4" ECU_ADDRESS 0x40005D82 /end MEASUREMENT
/begin MEASUREMENT BasSvr_bFuncTstReq "condition general function request" UBYTE B_TRUE 1 100 0.00 1.00000000000 BIT_MASK 0x1 FORMAT "%13.11" ECU_ADDRESS 0x40006387 /end MEASUREMENT
/begin MEASUREMENT BattU_facCor "Correction factor for battery voltage" SWORD Fact 1 100 0.00 3.999878 FORMAT "%8.6" ECU_ADDRESS 0x40008A7E /end MEASUREMENT
/begin MEASUREMENT BattU_u "Battery voltage" SWORD Volt_Batt 1 100 -655360.0 655340.0 FORMAT "%8.1" ECU_ADDRESS 0x40008F36
 /begin IF_DATA XCPplus 0x0102
  /begin DAQ_EVENT VARIABLE /begin AVAILABLE_EVENT_LIST EVENT 0 EVENT 1 EVENT 2 EVENT 3 /end AVAILABLE_EVENT_LIST /begin DEFAULT_EVENT_LIST EVENT 1 /end DEFAULT_EVENT_LIST /end DAQ_EVENT
 /end IF_DATA
/end MEASUREMENT
/begin MEASUREMENT B_autget "condition automatic gearbox" UBYTE B_TRUE 1 100 0.00 1.00000000000 BIT_MASK 0x1 FORMAT "%13.11" ECU_ADDRESS 0x400086FF /end MEASUREMENT
/begin MEASUREMENT B_bbinj "Request for BigBang injection active" UBYTE B_TRUE 1 100 0.00 1.00000000000 BIT_MASK 0x1 FORMAT "%13.11" ECU_ADDRESS 0x400086FE /end MEASUREMENT
/begin MEASUREMENT B_cdkat "catalyst diagnosis active per codeword CDKAT" UBYTE B_TRUE 1 100 0.00 1.00000000000 BIT_MASK 0x1 FORMAT "%13.11" ECU_ADDRESS 0x400086FD
 /begin IF_DATA XCPplus 0x0102
  /begin DAQ_EVENT VARIABLE /begin AVAILABLE_EVENT_LIST EVENT 0 EVENT 1 EVENT 2 EVENT 3 /end AVAILABLE_EVENT_LIST /begin DEFAULT_EVENT_LIST EVENT 1 /end DEFAULT_EVENT_LIST /end DAQ_EVENT
 /end IF_DATA
/end MEASUREMENT
/begin MEASUREMENT B_cpintrdy "Intermidiate bit for DTEV ready" UBYTE B_TRUE 1 100 0.00 1.00000000000 BIT_MASK 0x1 FORMAT "%13.11" ECU_ADDRESS 0x400086FC /end MEASUREMENT
/begin MEASUREMENT B_desee "Diagnosis power stage: entry conditions fulfilled" UBYTE B_TRUE 1 100 0.00 1.00000000000 BIT_MASK 0x1 FORMAT "%13.11" ECU_ADDRESS 0x400086FB
 /begin IF_DATA XCPplus 0x0102
  /begin DAQ_EVENT VARIABLE /begin AVAILABLE_EVENT_LIST EVENT 0 EVENT 1 EVENT 2 EVENT 3 /end AVAILABLE_EVENT_LIST /begin DEFAULT_EVENT_LIST EVENT 1 /end DEFAULT_EVENT_LIST /end DAQ_EVENT
 /end IF_DATA
/end MEASUREMENT
/begin MEASUREMENT B_disdpsc2 "Condition: driver torque request inhibit request" UBYTE B_TRUE 1 100 0.00 1.00000000000 BIT_MASK 0x1 FORMAT "%13.11" ECU_ADDRESS 0x400086FA /end MEASUREMENT
/begin MEASUREMENT B_dknolu "condition: limp-home operation active" UBYTE B_TRUE 1 100 0.00 1.00000000000 BIT_MASK 0x1 FORMAT "%13.11" ECU_ADDRESS 0x400086F9 /end MEASUREMENT
/begin MEASUREMENT B_dkpu "condition: safety fuel cut-off" UBYTE B_TRUE 1 100 0.00 1.00000000000 BIT_MASK 0x1 FORMAT "%13.11" ECU_ADDRESS 0x400086F8 /end MEASUREMENT
/begin MEASUREMENT B_evasldel "Condition no injection cutoff request active and all injections are ignited" UBYTE B_TRUE 1 100 0.00 1.00000000000 BIT_MASK 0x1 FORMAT "%13.11" ECU_ADDRESS 0x400086F7
 /begin IF_DATA XCPplus 0x0102
  /begin DAQ_EVENT VARIABLE /begin AVAILABLE_EVENT_LIST EVENT 0 EVENT 1 EVENT 2 EVENT 3 /end AVAILABLE_EVENT_LIST /begin DEFAULT_EVENT_LIST EVENT 0 /end DEFAULT_EVENT_LIST /end DAQ_EVENT
 /end IF_DATA
/end MEASUREMENT
/begin MEASUREMENT B_fa "condition general function request" UBYTE B_TRUE 1 100 0.00 1.00000000000 BIT_MASK 0x1 FORMAT "%13.11" ECU_ADDRESS 0x400086F6 /end MEASUREMENT
/begin MEASUREMENT B_FLSigErr "Fuel level sensor signal error" UBYTE B_TRUE 1 100 0.00 1.00000000000 BIT_MASK 0x1 FORMAT "%13.11" ECU_ADDRESS 0x400086F5 /end MEASUREMENT
/begin MEASUREMENT B_khakt "request catalyst heating by cold engine" UBYTE B_TRUE 1 100 0.00 1.00000000000 BIT_MASK 0x1 FORMAT "%13.11" ECU_ADDRESS 0x400086F4 /end MEASUREMENT
/begin MEASUREMENT B_kl15 "condition ignition switch on" UBYTE B_TRUE 1 100 0.00 1.00000000000 BIT_MASK 0x1 FORMAT "%13.11" ECU_ADDRESS 0x400086F3
 /begin IF_DATA XCPplus 0x0102
  /begin DAQ_EVENT VARIABLE /begin AVAILABLE_EVENT_LIST EVENT 0 EVENT 1 EVENT 2 EVENT 3 /end AVAILABLE_EVENT_LIST /begin DEFAULT_EVENT_LIST EVENT 1 /end DEFAULT_EVENT_LIST /end DAQ_EVENT
 /end IF_DATA
/end MEASUREMENT
/begin MEASUREMENT B_kl15_msg "condition ignition switch on" UBYTE B_TRUE 1 100 0.00 1.00000000000 BIT_MASK 0x1 FORMAT "%13.11" ECU_ADDRESS 0x4000638E
 /begin IF_DATA XCPplus 0x0102
  /begin DAQ_EVENT VARIABLE /begin AVAILABLE_EVENT_LIST EVENT 0 EVENT 1 EVENT 2 EVENT 3 /end AVAILABLE_EVENT_LIST /begin DEFAULT_EVENT_LIST EVENT 1 /end DEFAULT_EVENT_LIST /end DAQ_EVENT
 /end IF_DATA
/end MEASUREMENT
/begin MEASUREMENT B_mdkat "cat. damaging misfire rate exceeded (for deactivation of other functions)" UBYTE B_TRUE 1 100 0.00 1.00000000000 BIT_MASK 0x1 FORMAT "%13.11" ECU_ADDRESS 0x4000638D
 /begin IF_DATA XCPplus 0x0102
  /begin DAQ_EVENT VARIABLE /begin AVAILABLE_EVENT_LIST EVENT 0 EVENT 1 EVENT 2 EVENT 3 /end AVAILABLE_EVENT_LIST /begin DEFAULT_EVENT_LIST EVENT 1 /end DEFAULT_EVENT_LIST /end DAQ_EVENT
 /end IF_DATA
/end MEASUREMENT
/begin MEASUREMENT B_nachlauf "ECU control for ECU switch off delay" UBYTE B_TRUE 1 100 0.00 1.00000000000 BIT_MASK 0x1 FORMAT "%13.11" ECU_ADDRESS 0x400086F2
 /begin IF_DATA XCPplus 0x0102
  /begin DAQ_EVENT VARIABLE /begin AVAILABLE_EVENT_LIST EVENT 0 EVENT 1 EVENT 2 EVENT 3 /end AVAILABLE_EVENT_LIST /begin DEFAULT_EVENT_LIST EVENT 1 /end DEFAULT_EVENT_LIST /end DAQ_EVENT
 /end IF_DATA
/end MEASUREMENT
/begin MEASUREMENT B_nachlauf_msg "ECU control for ECU switch off delay" UBYTE B_TRUE 1 100 0.00 1.00000000000 BIT_MASK 0x1 FORMAT "%13.11" ECU_ADDRESS 0x4000638B
 /begin IF_DATA XCPplus 0x0102
  /begin DAQ_EVENT VARIABLE /begin AVAILABLE_EVENT_LIST EVENT 0 EVENT 1 EVENT 2 EVENT 3 /end AVAILABLE_EVENT_LIST /begin DEFAULT_EVENT_LIST EVENT 1 /end DEFAULT_EVENT_LIST /end DAQ_EVENT
 /end IF_DATA
/end MEASUREMENT
/begin MEASUREMENT B_nachl_msg "ECU control for ECU switch off delay" UBYTE B_TRUE 1 100 0.00 1.00000000000 BIT_MASK 0x1 FORMAT "%13.11" ECU_ADDRESS 0x4000638C
 /begin IF_DATA XCPplus 0x0102
  /begin DAQ_EVENT VARIABLE /begin AVAILABLE_EVENT_LIST EVENT 0 EVENT 1 EVENT 2 EVENT 3 /end AVAILABLE_EVENT_LIST /begin DEFAULT_EVENT_LIST EVENT 1 /end DEFAULT_EVENT_LIST /end DAQ_EVENT
 /end IF_DATA
/end MEASUREMENT
/begin MEASUREMENT B_nmotrevlim "Flag for high engine speed limitation" UBYTE B_TRUE 1 100 0.00 1.00000000000 BIT_MASK 0x1 FORMAT "%13.11" ECU_ADDRESS 0x4000638A
 /begin IF_DATA XCPplus 0x0102
  /begin DAQ_EVENT VARIABLE /begin AVAILABLE_EVENT_LIST EVENT 0 EVENT 1 EVENT 2 EVENT 3 /end AVAILABLE_EVENT_LIST /begin DEFAULT_EVENT_LIST EVENT 1 /end DEFAULT_EVENT_LIST /end DAQ_EVENT
 /end IF_DATA
/end MEASUREMENT
/begin MEASUREMENT B_norm_msg "ECU-condition normal engine management operation" UBYTE B_TRUE 1 100 0.00 1.00000000000 BIT_MASK 0x1 FORMAT "%13.11" ECU_ADDRESS 0x40006389
 /begin IF_DATA XCPplus 0x0102
  /begin DAQ_EVENT VARIABLE /begin AVAILABLE_EVENT_LIST EVENT 0 EVENT 1 EVENT 2 EVENT 3 /end AVAILABLE_EVENT_LIST /begin DEFAULT_EVENT_LIST EVENT 1 /end DEFAULT_EVENT_LIST /end DAQ_EVENT
 /end IF_DATA
/end MEASUREMENT
/begin MEASUREMENT B_nsp "condition for post-injection" UBYTE B_TRUE 1 100 0.00 1.00000000000 BIT_MASK 0x1 FORMAT "%13.11" ECU_ADDRESS 0x400086F1
 /begin IF_DATA XCPplus 0x0102
  /begin DAQ_EVENT VARIABLE /begin AVAILABLE_EVENT_LIST EVENT 0 EVENT 1 EVENT 2 EVENT 3 /end AVAILABLE_EVENT_LIST /begin DEFAULT_EVENT_LIST EVENT 0 /end DEFAULT_EVENT_LIST /end DAQ_EVENT
 /end IF_DATA
/end MEASUREMENT
/begin MEASUREMENT B_OvHLamp "Engine overheat lamp status" UBYTE B_TRUE 1 100 0.00 1.00000000000 BIT_MASK 0x1 FORMAT "%13.11" ECU_ADDRESS 0x400086F0
 /begin IF_DATA XCPplus 0x0102
  /begin DAQ_EVENT VARIABLE /begin AVAILABLE_EVENT_LIST EVENT 0 EVENT 1 EVENT 2 EVENT 3 /end AVAILABLE_EVENT_LIST /begin DEFAULT_EVENT_LIST EVENT 2 /end DEFAULT_EVENT_LIST /end DAQ_EVENT
 /end IF_DATA
/end MEASUREMENT
/begin MEASUREMENT B_poweron "Condition: Power On Reset" UBYTE B_TRUE 1 100 0.00 1.00000000000 BIT_MASK 0x1 FORMAT "%13.11" ECU_ADDRESS 0x400086EF /end MEASUREMENT
/begin MEASUREMENT B_pwf "condition for powerfail" UBYTE B_TRUE 1 100 0.00 1.00000000000 BIT_MASK 0x1 FORMAT "%13.11" ECU_ADDRESS 0x400086EE /end MEASUREMENT
/begin MEASUREMENT B_pwtrop "Clutch is pressed or neutral gear is engaged." UBYTE B_TRUE 1 100 0.00 1.00000000000 BIT_MASK 0x1 FORMAT "%13.11" ECU_ADDRESS 0x400087B5
 /begin IF_DATA XCPplus 0x0102
  /begin DAQ_EVENT VARIABLE /begin AVAILABLE_EVENT_LIST EVENT 0 EVENT 1 EVENT 2 EVENT 3 /end AVAILABLE_EVENT_LIST /begin DEFAULT_EVENT_LIST EVENT 2 /end DEFAULT_EVENT_LIST /end DAQ_EVENT
 /end IF_DATA
/end MEASUREMENT
/begin MEASUREMENT B_slv "condition for secondary air valve" UBYTE B_TRUE 1 100 0.00 1.00000000000 BIT_MASK 0x1 FORMAT "%13.11" ECU_ADDRESS 0x400086ED /end MEASUREMENT
/begin MEASUREMENT B_syn "condition synchronization succeeded" UBYTE B_TRUE 1 100 0.00 1.00000000000 BIT_MASK 0x1 FORMAT "%13.11" ECU_ADDRESS 0x400086EC
 /begin IF_DATA XCPplus 0x0102
  /begin DAQ_EVENT VARIABLE /begin AVAILABLE_EVENT_LIST EVENT 0 EVENT 1 EVENT 2 EVENT 3 /end AVAILABLE_EVENT_LIST /begin DEFAULT_EVENT_LIST EVENT 0 /end DEFAULT_EVENT_LIST /end DAQ_EVENT
 /end IF_DATA
/end MEASUREMENT
/begin MEASUREMENT B_tal "Condition: tank empty or reserve" UBYTE B_TRUE 1 100 0.00 1.00000000000 BIT_MASK 0x1 FORMAT "%13.11" ECU_ADDRESS 0x400086EB /end MEASUREMENT
/begin MEASUREMENT B_talval "condition ; bit empty tank valid" UBYTE B_TRUE 1 100 0.00 1.00000000000 BIT_MASK 0x1 FORMAT "%13.11" ECU_ADDRESS 0x400086EA /end MEASUREMENT
/begin MEASUREMENT B_teabb "Condition purge canister function ready to finish" UBYTE B_TRUE 1 100 0.00 1.00000000000 BIT_MASK 0x1 FORMAT "%13.11" ECU_ADDRESS 0x400087B2
 /begin IF_DATA XCPplus 0x0102
  /begin DAQ_EVENT VARIABLE /begin AVAILABLE_EVENT_LIST EVENT 0 EVENT 1 EVENT 2 EVENT 3 /end AVAILABLE_EVENT_LIST /begin DEFAULT_EVENT_LIST EVENT 2 /end DEFAULT_EVENT_LIST /end DAQ_EVENT
 /end IF_DATA
/end MEASUREMENT
/begin MEASUREMENT B_tehb "condition for canister purge system with high canister load" UBYTE B_TRUE 1 100 0.00 1.00000000000 BIT_MASK 0x2 FORMAT "%13.11" ECU_ADDRESS 0x400087B2
 /begin IF_DATA XCPplus 0x0102
  /begin DAQ_EVENT VARIABLE /begin AVAILABLE_EVENT_LIST EVENT 0 EVENT 1 EVENT 2 EVENT 3 /end AVAILABLE_EVENT_LIST /begin DEFAULT_EVENT_LIST EVENT 2 /end DEFAULT_EVENT_LIST /end DAQ_EVENT
 /end IF_DATA
/end MEASUREMENT
/begin MEASUREMENT B_tehbx "Condition load integrator ftead at max. limit" UBYTE B_TRUE 1 100 0.00 1.00000000000 BIT_MASK 0x4 FORMAT "%13.11" ECU_ADDRESS 0x400087B2
 /begin IF_DATA XCPplus 0x0102
  /begin DAQ_EVENT VARIABLE /begin AVAILABLE_EVENT_LIST EVENT 0 EVENT 1 EVENT 2 EVENT 3 /end AVAILABLE_EVENT_LIST /begin DEFAULT_EVENT_LIST EVENT 2 /end DEFAULT_EVENT_LIST /end DAQ_EVENT
 /end IF_DATA
/end MEASUREMENT
/begin MEASUREMENT B_wakeup_msg "ECU-condition wake up operation" UBYTE B_TRUE 1 100 0.00 1.00000000000 BIT_MASK 0x1 FORMAT "%13.11" ECU_ADDRESS 0x40006388
 /begin IF_DATA XCPplus 0x0102
  /begin DAQ_EVENT VARIABLE /begin AVAILABLE_EVENT_LIST EVENT 0 EVENT 1 EVENT 2 EVENT 3 /end AVAILABLE_EVENT_LIST /begin DEFAULT_EVENT_LIST EVENT 1 /end DEFAULT_EVENT_LIST /end DAQ_EVENT
 /end IF_DATA
/end MEASUREMENT
/begin MEASUREMENT B_wk "condition: converter lockup clutch closed" UBYTE B_TRUE 1 100 0.00 1.00000000000 BIT_MASK 0x1 FORMAT "%13.11" ECU_ADDRESS 0x400086E9 /end MEASUREMENT
/begin MEASUREMENT B_wkr "condition clutch controlled" UBYTE B_TRUE 1 100 0.00 1.00000000000 BIT_MASK 0x1 FORMAT "%13.11" ECU_ADDRESS 0x400086E8 /end MEASUREMENT
/begin MEASUREMENT CEngDsT_t "Coolant temperature at engine output" SWORD Temp_Cels 1 100 -3549.940 3003.560 FORMAT "%8.3" ECU_ADDRESS 0x40008A7C
 /begin IF_DATA XCPplus 0x0102
  /begin DAQ_EVENT VARIABLE /begin AVAILABLE_EVENT_LIST EVENT 0 EVENT 1 EVENT 2 EVENT 3 /end AVAILABLE_EVENT_LIST /begin DEFAULT_EVENT_LIST EVENT 2 /end DEFAULT_EVENT_LIST /end DAQ_EVENT
 /end IF_DATA
/end MEASUREMENT
/begin MEASUREMENT Clth_st "Debounced status of Clutch" UBYTE OneToOne 1 100 0.00 255.0 FORMAT "%5.1" ECU_ADDRESS 0x40008F35
 /begin IF_DATA XCPplus 0x0102
  /begin DAQ_EVENT VARIABLE /begin AVAILABLE_EVENT_LIST EVENT 0 EVENT 1 EVENT 2 EVENT 3 /end AVAILABLE_EVENT_LIST /begin DEFAULT_EVENT_LIST EVENT 0 /end DEFAULT_EVENT_LIST /end DAQ_EVENT
 /end IF_DATA
/end MEASUREMENT
/begin MEASUREMENT Com_bABSRollOver "Comscil variable" UBYTE B_TRUE 1 100 0.00 1.00000000000 BIT_MASK 0x1 FORMAT "%13.11" ECU_ADDRESS 0x400086E7 /end MEASUREMENT
/begin MEASUREMENT Com_bABSRollOverValidity "Comscil variable" UBYTE B_TRUE 1 100 0.00 1.00000000000 BIT_MASK 0x1 FORMAT "%13.11" ECU_ADDRESS 0x400086E6 /end MEASUREMENT
/begin MEASUREMENT Com_bGbxPosDelAdptVal "flag to indicate delete gear position sensor values routine start indication status" UBYTE B_TRUE 1 100 0.00 1.00000000000 BIT_MASK 0x1 FORMAT "%13.11" ECU_ADDRESS 0x40006282
 /begin IF_DATA XCPplus 0x0102
  /begin DAQ_EVENT VARIABLE /begin AVAILABLE_EVENT_LIST EVENT 0 EVENT 1 EVENT 2 EVENT 3 /end AVAILABLE_EVENT_LIST /begin DEFAULT_EVENT_LIST EVENT 1 /end DEFAULT_EVENT_LIST /end DAQ_EVENT
 /end IF_DATA
/end MEASUREMENT
/begin MEASUREMENT Com_fuel_cut_request_rb1 "Injection cutoff request over CAN" UBYTE OneToOne 1 100 0.00 255.0 FORMAT "%5.1" ECU_ADDRESS 0x40008F34 /end MEASUREMENT
/begin MEASUREMENT Com_tiRstrt "ComCIL variable for DASH Restart Time" UWORD Time_sec_q1_COMPU 1 100 0.00 32767.00 FORMAT "%8.2" ECU_ADDRESS 0x40005D80 /end MEASUREMENT
/begin MEASUREMENT Com_vVehWhlSpdAMT "Wheel Speed information for AMT" UWORD RBPtCel_v_0p05625_1 1 100 0.00 3686.344 FORMAT "%8.3" ECU_ADDRESS 0x40005C18
 /begin IF_DATA XCPplus 0x0102
  /begin DAQ_EVENT VARIABLE /begin AVAILABLE_EVENT_LIST EVENT 0 EVENT 1 EVENT 2 EVENT 3 /end AVAILABLE_EVENT_LIST /begin DEFAULT_EVENT_LIST EVENT 1 /end DEFAULT_EVENT_LIST /end DAQ_EVENT
 /end IF_DATA
/end MEASUREMENT
/begin MEASUREMENT CVN_label "CVN value" ULONG dez 1 100 0.00 4294967295.00 FORMAT "%13.2" ECU_ADDRESS 0x40008F30 /end MEASUREMENT
/begin MEASUREMENT devoff "injector fade out pattern at tester requirement" UBYTE dez 1 100 0.00 255.0 FORMAT "%5.1" ECU_ADDRESS 0x40008F2E /end MEASUREMENT
/begin MEASUREMENT HEGO_mAirStkHiS1B1IK_I.memory " / current integrator value" ULONG m_q1p526Em6_g 1 100 0.00 6553.59999847 FORMAT "%13.8" ECU_ADDRESS 0x40009028 /end MEASUREMENT
/begin MEASUREMENT HEGO_mAirStkLowS1B1IK_I.memory " / current integrator value" ULONG m_q1p526Em6_g 1 100 0.00 6553.59999847 FORMAT "%13.8" ECU_ADDRESS 0x40009024 /end MEASUREMENT
/begin MEASUREMENT dratete_w "CPV opening/ closing rate" SWORD fak_sw_b1 1 100 -1.000000 0.9999695 FORMAT "%8.6" ECU_ADDRESS 0x4000839C
 /begin IF_DATA XCPplus 0x0102
  /begin DAQ_EVENT VARIABLE /begin AVAILABLE_EVENT_LIST EVENT 0 EVENT 1 EVENT 2 EVENT 3 /end AVAILABLE_EVENT_LIST /begin DEFAULT_EVENT_LIST EVENT 2 /end DEFAULT_EVENT_LIST /end DAQ_EVENT
 /end IF_DATA
/end MEASUREMENT
/begin MEASUREMENT EnvP_p "env. pressure, measured or modelled" SWORD dez 1 100 -32768.00 32767.00 FORMAT "%8.2" ECU_ADDRESS 0x40008A7A
 /begin IF_DATA XCPplus 0x0102
  /begin DAQ_EVENT VARIABLE /begin AVAILABLE_EVENT_LIST EVENT 0 EVENT 1 EVENT 2 EVENT 3 /end AVAILABLE_EVENT_LIST /begin DEFAULT_EVENT_LIST EVENT 1 /end DEFAULT_EVENT_LIST /end DAQ_EVENT
 /end IF_DATA
/end MEASUREMENT
/begin MEASUREMENT EnvT_t "Environment temperature signal (with replacement reaction in case of sensor error)" SWORD Temp_Cels 1 100 -3549.940 3003.560 FORMAT "%8.3" ECU_ADDRESS 0x40008A78
 /begin IF_DATA XCPplus 0x0102
  /begin DAQ_EVENT VARIABLE /begin AVAILABLE_EVENT_LIST EVENT 0 EVENT 1 EVENT 2 EVENT 3 /end AVAILABLE_EVENT_LIST /begin DEFAULT_EVENT_LIST EVENT 2 /end DEFAULT_EVENT_LIST /end DAQ_EVENT
 /end IF_DATA
/end MEASUREMENT
/begin MEASUREMENT ffucote_w "factor for including fuel concentration in LR" SWORD fak_sw_b2 1 100 -2.000000 1.999939 FORMAT "%8.6" ECU_ADDRESS 0x400083A8
 /begin IF_DATA XCPplus 0x0102
  /begin DAQ_EVENT VARIABLE /begin AVAILABLE_EVENT_LIST EVENT 0 EVENT 1 EVENT 2 EVENT 3 /end AVAILABLE_EVENT_LIST /begin DEFAULT_EVENT_LIST EVENT 0 /end DEFAULT_EVENT_LIST /end DAQ_EVENT
 /end IF_DATA
/end MEASUREMENT
/begin MEASUREMENT flgstign_w "flagword for stimulated ignition misfires" UWORD OneToOne 1 100 0.00 65535.00 FORMAT "%8.2" ECU_ADDRESS 0x40007F8A
 /begin IF_DATA XCPplus 0x0102
  /begin DAQ_EVENT VARIABLE /begin AVAILABLE_EVENT_LIST EVENT 0 EVENT 1 EVENT 2 EVENT 3 /end AVAILABLE_EVENT_LIST /begin DEFAULT_EVENT_LIST EVENT 0 /end DEFAULT_EVENT_LIST /end DAQ_EVENT
 /end IF_DATA
/end MEASUREMENT
/begin MEASUREMENT flgstinj_w "flagword for stimulated injection misfires" UWORD OneToOne 1 100 0.00 65535.00 FORMAT "%8.2" ECU_ADDRESS 0x40007F88
 /begin IF_DATA XCPplus 0x0102
  /begin DAQ_EVENT VARIABLE /begin AVAILABLE_EVENT_LIST EVENT 0 EVENT 1 EVENT 2 EVENT 3 /end AVAILABLE_EVENT_LIST /begin DEFAULT_EVENT_LIST EVENT 0 /end DEFAULT_EVENT_LIST /end DAQ_EVENT
 /end IF_DATA
/end MEASUREMENT
/begin MEASUREMENT frhotev "Compensation for canister purge flow due to rising intake manifold pressure" UBYTE fak_ub_b4 1 100 0.00 3.984 FORMAT "%5.3" ECU_ADDRESS 0x400087B3
 /begin IF_DATA XCPplus 0x0102
  /begin DAQ_EVENT VARIABLE /begin AVAILABLE_EVENT_LIST EVENT 0 EVENT 1 EVENT 2 EVENT 3 /end AVAILABLE_EVENT_LIST /begin DEFAULT_EVENT_LIST EVENT 2 /end DEFAULT_EVENT_LIST /end DAQ_EVENT
 /end IF_DATA
/end MEASUREMENT
/begin MEASUREMENT ftrkttmp_w "filtered value of rkteroh_w" SWORD rel_sw_b1536 1 100 -1536.000 1535.953 FORMAT "%8.3" ECU_ADDRESS 0x400083AC
 /begin IF_DATA XCPplus 0x0102
  /begin DAQ_EVENT VARIABLE /begin AVAILABLE_EVENT_LIST EVENT 0 EVENT 1 EVENT 2 EVENT 3 /end AVAILABLE_EVENT_LIST /begin DEFAULT_EVENT_LIST EVENT 0 /end DEFAULT_EVENT_LIST /end DAQ_EVENT
 /end IF_DATA
/end MEASUREMENT
/begin MEASUREMENT fucotepr_w "Factor predicated fuel purge adaptation" SWORD fak_sw_b2 1 100 -2.000000 1.999939 FORMAT "%8.6" ECU_ADDRESS 0x400083AA
 /begin IF_DATA XCPplus 0x0102
  /begin DAQ_EVENT VARIABLE /begin AVAILABLE_EVENT_LIST EVENT 0 EVENT 1 EVENT 2 EVENT 3 /end AVAILABLE_EVENT_LIST /begin DEFAULT_EVENT_LIST EVENT 2 /end DEFAULT_EVENT_LIST /end DAQ_EVENT
 /end IF_DATA
/end MEASUREMENT
/begin MEASUREMENT fucote_w "fuel concentration in purge flow" SWORD fak_sw_b2 1 100 -2.000000 1.999939 FORMAT "%8.6" ECU_ADDRESS 0x400083A6
 /begin IF_DATA XCPplus 0x0102
  /begin DAQ_EVENT VARIABLE /begin AVAILABLE_EVENT_LIST EVENT 0 EVENT 1 EVENT 2 EVENT 3 /end AVAILABLE_EVENT_LIST /begin DEFAULT_EVENT_LIST EVENT 0 /end DEFAULT_EVENT_LIST /end DAQ_EVENT
 /end IF_DATA
/end MEASUREMENT
/begin MEASUREMENT Gbx_stNPos "State of Gearbox Neutral Position" UBYTE OneToOne 1 100 0.00 255.0 FORMAT "%5.1" ECU_ADDRESS 0x40008F2D
 /begin IF_DATA XCPplus 0x0102
  /begin DAQ_EVENT VARIABLE /begin AVAILABLE_EVENT_LIST EVENT 0 EVENT 1 EVENT 2 EVENT 3 /end AVAILABLE_EVENT_LIST /begin DEFAULT_EVENT_LIST EVENT 0 /end DEFAULT_EVENT_LIST /end DAQ_EVENT
 /end IF_DATA
/end MEASUREMENT
/begin MEASUREMENT GGUB_uBattFild "battery voltage (on board), conversed to standard quantization" UBYTE spg_q0p1 1 100 0.00 25.50 FORMAT "%5.2" ECU_ADDRESS 0x40008F2C
 /begin IF_DATA XCPplus 0x0102
  /begin DAQ_EVENT VARIABLE /begin AVAILABLE_EVENT_LIST EVENT 0 EVENT 1 EVENT 2 EVENT 3 /end AVAILABLE_EVENT_LIST /begin DEFAULT_EVENT_LIST EVENT 1 /end DEFAULT_EVENT_LIST /end DAQ_EVENT
 /end IF_DATA
/end MEASUREMENT
/begin MEASUREMENT GlbDa_lTotDst "total distance since first start" SLONG Length 1 100 -2147483648.00 2147483647.00 FORMAT "%13.2" ECU_ADDRESS 0x40008008
 /begin IF_DATA XCPplus 0x0102
  /begin DAQ_EVENT VARIABLE /begin AVAILABLE_EVENT_LIST EVENT 0 EVENT 1 EVENT 2 EVENT 3 /end AVAILABLE_EVENT_LIST /begin DEFAULT_EVENT_LIST EVENT 2 /end DEFAULT_EVENT_LIST /end DAQ_EVENT
 /end IF_DATA
/end MEASUREMENT
/begin MEASUREMENT HLSDem_nSetPLoDiff "LLR: difference of idle speed precontrol" SWORD EngN 1 100 -16384.00 16383.50 FORMAT "%8.2" ECU_ADDRESS 0x40008F2A
 /begin IF_DATA XCPplus 0x0102
  /begin DAQ_EVENT VARIABLE /begin AVAILABLE_EVENT_LIST EVENT 0 EVENT 1 EVENT 2 EVENT 3 /end AVAILABLE_EVENT_LIST /begin DEFAULT_EVENT_LIST EVENT 1 /end DEFAULT_EVENT_LIST /end DAQ_EVENT
 /end IF_DATA
/end MEASUREMENT
/begin MEASUREMENT imste_w "Accumulated purge mass flow" UWORD m_q0p0001085 1 100 0.00 7.111003 FORMAT "%8.6" ECU_ADDRESS 0x4000839A
 /begin IF_DATA XCPplus 0x0102
  /begin DAQ_EVENT VARIABLE /begin AVAILABLE_EVENT_LIST EVENT 0 EVENT 1 EVENT 2 EVENT 3 /end AVAILABLE_EVENT_LIST /begin DEFAULT_EVENT_LIST EVENT 2 /end DEFAULT_EVENT_LIST /end DAQ_EVENT
 /end IF_DATA
/end MEASUREMENT
/begin MEASUREMENT injddpfi_flgNoInjReq "condition: injection pulse status for upcoming cylinder (Epm_CtCyl)" UBYTE B_TRUE 1 100 0.00 1.00000000000 BIT_MASK 0x1 FORMAT "%13.11" ECU_ADDRESS 0x400086E5
 /begin IF_DATA XCPplus 0x0102
  /begin DAQ_EVENT VARIABLE /begin AVAILABLE_EVENT_LIST EVENT 0 EVENT 1 EVENT 2 EVENT 3 /end AVAILABLE_EVENT_LIST /begin DEFAULT_EVENT_LIST EVENT 0 /end DEFAULT_EVENT_LIST /end DAQ_EVENT
 /end IF_DATA
/end MEASUREMENT
/begin MEASUREMENT InjSys_flgNoInjReq "condition: injection cutoff active for next cylinder in ZOT" UBYTE B_TRUE 1 100 0.00 1.00000000000 BIT_MASK 0x1 FORMAT "%13.11" ECU_ADDRESS 0x400086E4
 /begin IF_DATA XCPplus 0x0102
  /begin DAQ_EVENT VARIABLE /begin AVAILABLE_EVENT_LIST EVENT 0 EVENT 1 EVENT 2 EVENT 3 /end AVAILABLE_EVENT_LIST /begin DEFAULT_EVENT_LIST EVENT 0 /end DEFAULT_EVENT_LIST /end DAQ_EVENT
 /end IF_DATA
/end MEASUREMENT
/begin MEASUREMENT InjSys_stActRedStg "Real cylinder cut-off step" UBYTE dez 1 100 0.00 255.0 FORMAT "%5.1" ECU_ADDRESS 0x40008A76
 /begin IF_DATA XCPplus 0x0102
  /begin DAQ_EVENT VARIABLE /begin AVAILABLE_EVENT_LIST EVENT 0 EVENT 1 EVENT 2 EVENT 3 /end AVAILABLE_EVENT_LIST /begin DEFAULT_EVENT_LIST EVENT 0 /end DEFAULT_EVENT_LIST /end DAQ_EVENT
 /end IF_DATA
/end MEASUREMENT
/begin MEASUREMENT mivmxl_w "Indicated nominal torque for VMAX control (air path)" UWORD rel_uw_b100 1 100 0.00 99.99847 FORMAT "%8.5" ECU_ADDRESS 0x400083B2
 /begin IF_DATA XCPplus 0x0102
  /begin DAQ_EVENT VARIABLE /begin AVAILABLE_EVENT_LIST EVENT 0 EVENT 1 EVENT 2 EVENT 3 /end AVAILABLE_EVENT_LIST /begin DEFAULT_EVENT_LIST EVENT 2 /end DEFAULT_EVENT_LIST /end DAQ_EVENT
 /end IF_DATA
/end MEASUREMENT
/begin MEASUREMENT mivmx_w "indicated nominal torque for VMAX control" UWORD rel_uw_b100 1 100 0.00 99.99847 FORMAT "%8.5" ECU_ADDRESS 0x400083B0
 /begin IF_DATA XCPplus 0x0102
  /begin DAQ_EVENT VARIABLE /begin AVAILABLE_EVENT_LIST EVENT 0 EVENT 1 EVENT 2 EVENT 3 /end AVAILABLE_EVENT_LIST /begin DEFAULT_EVENT_LIST EVENT 2 /end DEFAULT_EVENT_LIST /end DAQ_EVENT
 /end IF_DATA
/end MEASUREMENT
/begin MEASUREMENT msdkroh_w "fresh air over throttle blade (unfilterd)" UWORD m_uw_b6553p5 1 100 0.00 6553.500 FORMAT "%8.3" ECU_ADDRESS 0x40008F28
 /begin IF_DATA XCPplus 0x0102
  /begin DAQ_EVENT VARIABLE /begin AVAILABLE_EVENT_LIST EVENT 0 EVENT 1 EVENT 2 EVENT 3 /end AVAILABLE_EVENT_LIST /begin DEFAULT_EVENT_LIST EVENT 0 /end DEFAULT_EVENT_LIST /end DAQ_EVENT
 /end IF_DATA
/end MEASUREMENT
/begin MEASUREMENT msntes_w "standardized mass flow from canister purge control" UWORD m_uw_b25p6 1 100 0.00 25.59961 FORMAT "%8.5" ECU_ADDRESS 0x40008398
 /begin IF_DATA XCPplus 0x0102
  /begin DAQ_EVENT VARIABLE /begin AVAILABLE_EVENT_LIST EVENT 0 EVENT 1 EVENT 2 EVENT 3 /end AVAILABLE_EVENT_LIST /begin DEFAULT_EVENT_LIST EVENT 2 /end DEFAULT_EVENT_LIST /end DAQ_EVENT
 /end IF_DATA
/end MEASUREMENT
/begin MEASUREMENT msnte_w "normalized mass flow through the PCV" UWORD m_uw_b25p6 1 100 0.00 25.59961 FORMAT "%8.5" ECU_ADDRESS 0x40008F26
 /begin IF_DATA XCPplus 0x0102
  /begin DAQ_EVENT VARIABLE /begin AVAILABLE_EVENT_LIST EVENT 0 EVENT 1 EVENT 2 EVENT 3 /end AVAILABLE_EVENT_LIST /begin DEFAULT_EVENT_LIST EVENT 1 /end DEFAULT_EVENT_LIST /end DAQ_EVENT
 /end IF_DATA
/end MEASUREMENT
/begin MEASUREMENT mstes_w "standardized mass flow from canister purge control" UWORD m_uw_b25p6 1 100 0.00 25.59961 FORMAT "%8.5" ECU_ADDRESS 0x40008396
 /begin IF_DATA XCPplus 0x0102
  /begin DAQ_EVENT VARIABLE /begin AVAILABLE_EVENT_LIST EVENT 0 EVENT 1 EVENT 2 EVENT 3 /end AVAILABLE_EVENT_LIST /begin DEFAULT_EVENT_LIST EVENT 2 /end DEFAULT_EVENT_LIST /end DAQ_EVENT
 /end IF_DATA
/end MEASUREMENT
/begin MEASUREMENT mste_w "mass flow purge control into the manifold" UWORD m_uw_b25p6 1 100 0.00 25.59961 FORMAT "%8.5" ECU_ADDRESS 0x40008394
 /begin IF_DATA XCPplus 0x0102
  /begin DAQ_EVENT VARIABLE /begin AVAILABLE_EVENT_LIST EVENT 0 EVENT 1 EVENT 2 EVENT 3 /end AVAILABLE_EVENT_LIST /begin DEFAULT_EVENT_LIST EVENT 2 /end DEFAULT_EVENT_LIST /end DAQ_EVENT
 /end IF_DATA
/end MEASUREMENT
/begin MEASUREMENT nltrstdone_msg "nltrstdone_msg" UBYTE B_TRUE 1 100 0.00 1.00000000000 BIT_MASK 0x1 FORMAT "%13.11" ECU_ADDRESS 0x40006363
 /begin IF_DATA XCPplus 0x0102
  /begin DAQ_EVENT VARIABLE /begin AVAILABLE_EVENT_LIST EVENT 0 EVENT 1 EVENT 2 EVENT 3 /end AVAILABLE_EVENT_LIST /begin DEFAULT_EVENT_LIST EVENT 2 /end DEFAULT_EVENT_LIST /end DAQ_EVENT
 /end IF_DATA
/end MEASUREMENT
/begin MEASUREMENT nmaxvmx_w "Maximum engine speed for vehicle speed limitation" UWORD nmot_uw_q0p25 1 100 0.00 16383.75 FORMAT "%8.2" ECU_ADDRESS 0x400083AE
 /begin IF_DATA XCPplus 0x0102
  /begin DAQ_EVENT VARIABLE /begin AVAILABLE_EVENT_LIST EVENT 0 EVENT 1 EVENT 2 EVENT 3 /end AVAILABLE_EVENT_LIST /begin DEFAULT_EVENT_LIST EVENT 2 /end DEFAULT_EVENT_LIST /end DAQ_EVENT
 /end IF_DATA
/end MEASUREMENT
/begin MEASUREMENT nmotrevcntr "Rev limit time counter" UWORD t_q0p01 1 100 0.00 655.3500 FORMAT "%8.4" ECU_ADDRESS 0x40005C1A
 /begin IF_DATA XCPplus 0x0102
  /begin DAQ_EVENT VARIABLE /begin AVAILABLE_EVENT_LIST EVENT 0 EVENT 1 EVENT 2 EVENT 3 /end AVAILABLE_EVENT_LIST /begin DEFAULT_EVENT_LIST EVENT 1 /end DEFAULT_EVENT_LIST /end DAQ_EVENT
 /end IF_DATA
/end MEASUREMENT
/begin MEASUREMENT NmotRevLim_flgLampChk "Status flag for Engine speed revolution limit." UBYTE B_TRUE 1 100 0.00 1.00000000000 BIT_MASK 0x1 FORMAT "%13.11" ECU_ADDRESS 0x40006281
 /begin IF_DATA XCPplus 0x0102
  /begin DAQ_EVENT VARIABLE /begin AVAILABLE_EVENT_LIST EVENT 0 EVENT 1 EVENT 2 EVENT 3 /end AVAILABLE_EVENT_LIST /begin DEFAULT_EVENT_LIST EVENT 1 /end DEFAULT_EVENT_LIST /end DAQ_EVENT
 /end IF_DATA
/end MEASUREMENT
/begin MEASUREMENT PEnv_p "Ambient pressure" UWORD p_q0p039 1 100 0.00 2559.961 FORMAT "%8.3" ECU_ADDRESS 0x40007F8C
 /begin IF_DATA XCPplus 0x0102
  /begin DAQ_EVENT VARIABLE /begin AVAILABLE_EVENT_LIST EVENT 0 EVENT 1 EVENT 2 EVENT 3 /end AVAILABLE_EVENT_LIST /begin DEFAULT_EVENT_LIST EVENT 2 /end DEFAULT_EVENT_LIST /end DAQ_EVENT
 /end IF_DATA
/end MEASUREMENT
/begin MEASUREMENT PrjCon_stLamSensRrCat_b "Lambda sensor downstream functionality is enabled" UBYTE B_TRUE 1 100 0.00 1.00000000000 BIT_MASK 0x1 FORMAT "%13.11" ECU_ADDRESS 0x400086E3
 /begin IF_DATA XCPplus 0x0102
  /begin DAQ_EVENT VARIABLE /begin AVAILABLE_EVENT_LIST EVENT 0 EVENT 1 EVENT 2 EVENT 3 /end AVAILABLE_EVENT_LIST /begin DEFAULT_EVENT_LIST EVENT 1 /end DEFAULT_EVENT_LIST /end DAQ_EVENT
 /end IF_DATA
/end MEASUREMENT
/begin MEASUREMENT psputmp "ratio : manifold pressure by ambient pressure" UBYTE fak_ub_b2 1 100 0.00 1.992188 FORMAT "%8.6" ECU_ADDRESS 0x400087B4
 /begin IF_DATA XCPplus 0x0102
  /begin DAQ_EVENT VARIABLE /begin AVAILABLE_EVENT_LIST EVENT 0 EVENT 1 EVENT 2 EVENT 3 /end AVAILABLE_EVENT_LIST /begin DEFAULT_EVENT_LIST EVENT 2 /end DEFAULT_EVENT_LIST /end DAQ_EVENT
 /end IF_DATA
/end MEASUREMENT
/begin MEASUREMENT pspu_w "Ratio of manifold to ambient pressure" UWORD fak_uw_b2 1 100 0.00 1.999969 FORMAT "%8.6" ECU_ADDRESS 0x4000839E
 /begin IF_DATA XCPplus 0x0102
  /begin DAQ_EVENT VARIABLE /begin AVAILABLE_EVENT_LIST EVENT 0 EVENT 1 EVENT 2 EVENT 3 /end AVAILABLE_EVENT_LIST /begin DEFAULT_EVENT_LIST EVENT 2 /end DEFAULT_EVENT_LIST /end DAQ_EVENT
 /end IF_DATA
/end MEASUREMENT
/begin MEASUREMENT pspvdk_w "quotient: int.manif.pressure divided by pressure upstream of throttle valve" UWORD fak_uw_b2 1 100 0.00 1.999969 FORMAT "%8.6" ECU_ADDRESS 0x40008F24
 /begin IF_DATA XCPplus 0x0102
  /begin DAQ_EVENT VARIABLE /begin AVAILABLE_EVENT_LIST EVENT 0 EVENT 1 EVENT 2 EVENT 3 /end AVAILABLE_EVENT_LIST /begin DEFAULT_EVENT_LIST EVENT 0 /end DEFAULT_EVENT_LIST /end DAQ_EVENT
 /end IF_DATA
/end MEASUREMENT
/begin MEASUREMENT PthSet_stOvrRun "Condition: overrun fuel cut-off" UBYTE B_TRUE 1 100 0.00 1.00000000000 BIT_MASK 0x1 FORMAT "%13.11" ECU_ADDRESS 0x400086E2
 /begin IF_DATA XCPplus 0x0102
  /begin DAQ_EVENT VARIABLE /begin AVAILABLE_EVENT_LIST EVENT 0 EVENT 1 EVENT 2 EVENT 3 /end AVAILABLE_EVENT_LIST /begin DEFAULT_EVENT_LIST EVENT 1 /end DEFAULT_EVENT_LIST /end DAQ_EVENT
 /end IF_DATA
/end MEASUREMENT
/begin MEASUREMENT PT_bNoGrip "Grip is definitely ruled out" UBYTE B_TRUE 1 100 0.00 1.00000000000 BIT_MASK 0x1 FORMAT "%13.11" ECU_ADDRESS 0x400086E1
 /begin IF_DATA XCPplus 0x0102
  /begin DAQ_EVENT VARIABLE /begin AVAILABLE_EVENT_LIST EVENT 0 EVENT 1 EVENT 2 EVENT 3 /end AVAILABLE_EVENT_LIST /begin DEFAULT_EVENT_LIST EVENT 1 /end DEFAULT_EVENT_LIST /end DAQ_EVENT
 /end IF_DATA
/end MEASUREMENT
/begin MEASUREMENT PT_rGrip "Analogue value for the grip states." SWORD Fact100 1 100 -327.6800 327.6700 FORMAT "%8.4" ECU_ADDRESS 0x40008F22
 /begin IF_DATA XCPplus 0x0102
  /begin DAQ_EVENT VARIABLE /begin AVAILABLE_EVENT_LIST EVENT 0 EVENT 1 EVENT 2 EVENT 3 /end AVAILABLE_EVENT_LIST /begin DEFAULT_EVENT_LIST EVENT 0 /end DEFAULT_EVENT_LIST /end DAQ_EVENT
 /end IF_DATA
/end MEASUREMENT
/begin MEASUREMENT PT_rTrq "Powertrain torque ratio" SWORD TransR 1 100 -327.6800 327.6700 FORMAT "%8.4" ECU_ADDRESS 0x40008F20 /end MEASUREMENT
/begin MEASUREMENT PT_stTraShftOp "status is shift operation is active" UBYTE OneToOne 1 100 0.00 255.0 FORMAT "%5.1" ECU_ADDRESS 0x40008F04
 /begin IF_DATA XCPplus 0x0102
  /begin DAQ_EVENT VARIABLE /begin AVAILABLE_EVENT_LIST EVENT 0 EVENT 1 EVENT 2 EVENT 3 /end AVAILABLE_EVENT_LIST /begin DEFAULT_EVENT_LIST EVENT 1 /end DEFAULT_EVENT_LIST /end DAQ_EVENT
 /end IF_DATA
/end MEASUREMENT
/begin MEASUREMENT PT_stTraType "Current transmission type" UBYTE OneToOne 1 100 0.00 255.0 FORMAT "%5.1" ECU_ADDRESS 0x40008F1E /end MEASUREMENT
/begin MEASUREMENT puout "delta pressure ambient - intake manifold" UBYTE p_ub_q5 1 100 0.00 1275. FORMAT "%5.0" ECU_ADDRESS 0x400087B1
 /begin IF_DATA XCPplus 0x0102
  /begin DAQ_EVENT VARIABLE /begin AVAILABLE_EVENT_LIST EVENT 0 EVENT 1 EVENT 2 EVENT 3 /end AVAILABLE_EVENT_LIST /begin DEFAULT_EVENT_LIST EVENT 2 /end DEFAULT_EVENT_LIST /end DAQ_EVENT
 /end IF_DATA
/end MEASUREMENT
/begin MEASUREMENT ratekor_w "Corrrected purge rate" UWORD m_uw_b25p6 1 100 0.00 25.59961 FORMAT "%8.5" ECU_ADDRESS 0x40008392
 /begin IF_DATA XCPplus 0x0102
  /begin DAQ_EVENT VARIABLE /begin AVAILABLE_EVENT_LIST EVENT 0 EVENT 1 EVENT 2 EVENT 3 /end AVAILABLE_EVENT_LIST /begin DEFAULT_EVENT_LIST EVENT 2 /end DEFAULT_EVENT_LIST /end DAQ_EVENT
 /end IF_DATA
/end MEASUREMENT
/begin MEASUREMENT ratetei_w "Internal canister purge rate" UWORD fak_uw_b2 1 100 0.00 1.999969 FORMAT "%8.6" ECU_ADDRESS 0x400083A0
 /begin IF_DATA XCPplus 0x0102
  /begin DAQ_EVENT VARIABLE /begin AVAILABLE_EVENT_LIST EVENT 0 EVENT 1 EVENT 2 EVENT 3 /end AVAILABLE_EVENT_LIST /begin DEFAULT_EVENT_LIST EVENT 2 /end DEFAULT_EVENT_LIST /end DAQ_EVENT
 /end IF_DATA
/end MEASUREMENT
/begin MEASUREMENT ratetemx_w "Maximum purge rate" UWORD fak_uw_b2 1 100 0.00 1.999969 FORMAT "%8.6" ECU_ADDRESS 0x40008390
 /begin IF_DATA XCPplus 0x0102
  /begin DAQ_EVENT VARIABLE /begin AVAILABLE_EVENT_LIST EVENT 0 EVENT 1 EVENT 2 EVENT 3 /end AVAILABLE_EVENT_LIST /begin DEFAULT_EVENT_LIST EVENT 2 /end DEFAULT_EVENT_LIST /end DAQ_EVENT
 /end IF_DATA
/end MEASUREMENT
/begin MEASUREMENT ratetes_w "Desired canister purge rate" UWORD fak_uw_b2 1 100 0.00 1.999969 FORMAT "%8.6" ECU_ADDRESS 0x4000838E
 /begin IF_DATA XCPplus 0x0102
  /begin DAQ_EVENT VARIABLE /begin AVAILABLE_EVENT_LIST EVENT 0 EVENT 1 EVENT 2 EVENT 3 /end AVAILABLE_EVENT_LIST /begin DEFAULT_EVENT_LIST EVENT 2 /end DEFAULT_EVENT_LIST /end DAQ_EVENT
 /end IF_DATA
/end MEASUREMENT
/begin MEASUREMENT rkteroh_w "Corrected fuel mass" SWORD rel_sw_b1536 1 100 -1536.000 1535.953 FORMAT "%8.3" ECU_ADDRESS 0x400083A4
 /begin IF_DATA XCPplus 0x0102
  /begin DAQ_EVENT VARIABLE /begin AVAILABLE_EVENT_LIST EVENT 0 EVENT 1 EVENT 2 EVENT 3 /end AVAILABLE_EVENT_LIST /begin DEFAULT_EVENT_LIST EVENT 0 /end DEFAULT_EVENT_LIST /end DAQ_EVENT
 /end IF_DATA
/end MEASUREMENT
/begin MEASUREMENT rkte_w "relative fuel part of the purge control" SWORD rel_sw_b1536 1 100 -1536.000 1535.953 FORMAT "%8.3" ECU_ADDRESS 0x400083A2
 /begin IF_DATA XCPplus 0x0102
  /begin DAQ_EVENT VARIABLE /begin AVAILABLE_EVENT_LIST EVENT 0 EVENT 1 EVENT 2 EVENT 3 /end AVAILABLE_EVENT_LIST /begin DEFAULT_EVENT_LIST EVENT 0 /end DEFAULT_EVENT_LIST /end DAQ_EVENT
 /end IF_DATA
/end MEASUREMENT
/begin MEASUREMENT rltev_w "Input value for rl to map for limitation of purge rate" UWORD rel_uw_q0p0234 1 100 0.00 1535.977 FORMAT "%8.3" ECU_ADDRESS 0x4000838C
 /begin IF_DATA XCPplus 0x0102
  /begin DAQ_EVENT VARIABLE /begin AVAILABLE_EVENT_LIST EVENT 0 EVENT 1 EVENT 2 EVENT 3 /end AVAILABLE_EVENT_LIST /begin DEFAULT_EVENT_LIST EVENT 2 /end DEFAULT_EVENT_LIST /end DAQ_EVENT
 /end IF_DATA
/end MEASUREMENT
/begin MEASUREMENT SyC_ctDrvEnter "Global drive cycle counter which is incremented when system state DRIVE is entered" UBYTE OneToOne 1 100 0.00 255.0 FORMAT "%5.1" ECU_ADDRESS 0x400063C0 /end MEASUREMENT
/begin MEASUREMENT SyC_ctIrrSwOff "Counter for detection of irregular switch-off of the ECU" UBYTE OneToOne 1 100 0.00 255.0 FORMAT "%5.1" ECU_ADDRESS 0x400063BF /end MEASUREMENT
/begin MEASUREMENT SyC_ctPostDrvLeave "Global drive cycle counter which is incremented when system state leaves post drive" UBYTE OneToOne 1 100 0.00 255.0 FORMAT "%5.1" ECU_ADDRESS 0x400063BE /end MEASUREMENT
/begin MEASUREMENT SyC_stMn "Current system/ECU state" UBYTE ExeCon_State_01 1 100 0.00 3.00000000000 FORMAT "%13.11" ECU_ADDRESS 0x400063BD /end MEASUREMENT
/begin MEASUREMENT SyC_stMnOld "Previous system/ECU state" UBYTE ExeCon_State_01 1 100 0.00 3.00000000000 FORMAT "%13.11" ECU_ADDRESS 0x400063BC /end MEASUREMENT
/begin MEASUREMENT SyC_stPostDrv "PostDrive control state" UBYTE SyC_PostDrv_State 1 100 0.00 8.00000000000 FORMAT "%13.11" ECU_ADDRESS 0x400063BB
 /begin IF_DATA XCPplus 0x0102
  /begin DAQ_EVENT VARIABLE /begin AVAILABLE_EVENT_LIST EVENT 0 EVENT 1 EVENT 2 EVENT 3 /end AVAILABLE_EVENT_LIST /begin DEFAULT_EVENT_LIST EVENT 1 /end DEFAULT_EVENT_LIST /end DAQ_EVENT
 /end IF_DATA
/end MEASUREMENT
/begin MEASUREMENT SyC_stPostDrvDel "post-drive delay request" UBYTE OneToOne 1 100 0.00 255.0 FORMAT "%5.1" ECU_ADDRESS 0x400063A4
 /begin IF_DATA XCPplus 0x0102
  /begin DAQ_EVENT VARIABLE /begin AVAILABLE_EVENT_LIST EVENT 0 EVENT 1 EVENT 2 EVENT 3 /end AVAILABLE_EVENT_LIST /begin DEFAULT_EVENT_LIST EVENT 1 /end DEFAULT_EVENT_LIST /end DAQ_EVENT
 /end IF_DATA
/end MEASUREMENT
/begin MEASUREMENT SyC_stPreDrv "PreDrive control state" UBYTE SyC_PreDrv_State 1 100 0.00 9.00000000000 FORMAT "%13.11" ECU_ADDRESS 0x400063BA
 /begin IF_DATA XCPplus 0x0102
  /begin DAQ_EVENT VARIABLE /begin AVAILABLE_EVENT_LIST EVENT 0 EVENT 1 EVENT 2 EVENT 3 /end AVAILABLE_EVENT_LIST /begin DEFAULT_EVENT_LIST EVENT 1 /end DEFAULT_EVENT_LIST /end DAQ_EVENT
 /end IF_DATA
/end MEASUREMENT
/begin MEASUREMENT SyC_stPreDrvDel "Variable to check if predrive is prolonged or not" UBYTE OneToOne 1 100 0.00 255.0 FORMAT "%5.1" ECU_ADDRESS 0x400063A3
 /begin IF_DATA XCPplus 0x0102
  /begin DAQ_EVENT VARIABLE /begin AVAILABLE_EVENT_LIST EVENT 0 EVENT 1 EVENT 2 EVENT 3 /end AVAILABLE_EVENT_LIST /begin DEFAULT_EVENT_LIST EVENT 1 /end DEFAULT_EVENT_LIST /end DAQ_EVENT
 /end IF_DATA
/end MEASUREMENT
/begin MEASUREMENT SyC_stSub "Current system/ECU sub-state" UBYTE ExeCon_State_02 1 100 0.00 6.00000000000 FORMAT "%13.11" ECU_ADDRESS 0x400063B9 /end MEASUREMENT
/begin MEASUREMENT SyC_stSubOld "Previous system/ECU sub-state" UBYTE ExeCon_State_02 1 100 0.00 6.00000000000 FORMAT "%13.11" ECU_ADDRESS 0x400063B8 /end MEASUREMENT
/begin MEASUREMENT SyC_stSwtOn_mp "Status current reason for switching-on ECU" UBYTE OneToOne 1 100 0.00 255.0 FORMAT "%5.1" ECU_ADDRESS 0x40009E19 /end MEASUREMENT
/begin MEASUREMENT SyC_tiBoot_mp "Time from ECU switch-on until system state SYC_INI is reached" ULONG Time_usec_q1_COMPU 1 100 0.00 4294967295.00 FORMAT "%13.2" ECU_ADDRESS 0x40009C04 /end MEASUREMENT
/begin MEASUREMENT SyC_tiDrv "Time since state SYC_DRIVE was reached" ULONG Time_msec_q10_COMPU 1 100 0.00 42949672950.0 FORMAT "%13.1" ECU_ADDRESS 0x400048B0
 /begin IF_DATA XCPplus 0x0102
  /begin DAQ_EVENT VARIABLE /begin AVAILABLE_EVENT_LIST EVENT 0 EVENT 1 EVENT 2 EVENT 3 /end AVAILABLE_EVENT_LIST /begin DEFAULT_EVENT_LIST EVENT 1 /end DEFAULT_EVENT_LIST /end DAQ_EVENT
 /end IF_DATA
/end MEASUREMENT
/begin MEASUREMENT SyC_tiFrst10ms "Time from ECU boot until the first 10ms task" UWORD Time_msec_q1_COMPU 1 100 0.00 65535.00 FORMAT "%8.2" ECU_ADDRESS 0x40005D86
 /begin IF_DATA XCPplus 0x0102
  /begin DAQ_EVENT VARIABLE /begin AVAILABLE_EVENT_LIST EVENT 0 EVENT 1 EVENT 2 EVENT 3 /end AVAILABLE_EVENT_LIST /begin DEFAULT_EVENT_LIST EVENT 1 /end DEFAULT_EVENT_LIST /end DAQ_EVENT
 /end IF_DATA
/end MEASUREMENT
/begin MEASUREMENT SyC_tiIniEnd_mp "Duration of system state SYC_INIEND" UWORD Time_usec_q1_COMPU 1 100 0.00 65535.00 FORMAT "%8.2" ECU_ADDRESS 0x40009D76 /end MEASUREMENT
/begin MEASUREMENT SyC_tiIniSyn_mp "Duration of system state SYC_INISYN" UWORD Time_usec_q1_COMPU 1 100 0.00 65535.00 FORMAT "%8.2" ECU_ADDRESS 0x40009D74 /end MEASUREMENT
/begin MEASUREMENT SyC_tiIni_mp "Duration of system state SYC_INI" ULONG Time_usec_q1_COMPU 1 100 0.00 4294967295.00 FORMAT "%13.2" ECU_ADDRESS 0x40009C00 /end MEASUREMENT
/begin MEASUREMENT SyC_tiPostDrv "Time since state SYC_POSTDRIVE was reached" ULONG Time_msec_q10_COMPU 1 100 0.00 42949672950.0 FORMAT "%13.1" ECU_ADDRESS 0x400048AC
 /begin IF_DATA XCPplus 0x0102
  /begin DAQ_EVENT VARIABLE /begin AVAILABLE_EVENT_LIST EVENT 0 EVENT 1 EVENT 2 EVENT 3 /end AVAILABLE_EVENT_LIST /begin DEFAULT_EVENT_LIST EVENT 1 /end DEFAULT_EVENT_LIST /end DAQ_EVENT
 /end IF_DATA
/end MEASUREMENT
/begin MEASUREMENT SyC_tiPreDrv "Time since state SYC_PREDRIVE was reached" ULONG Time_msec_q10_COMPU 1 100 0.00 42949672950.0 FORMAT "%13.1" ECU_ADDRESS 0x400048A8
 /begin IF_DATA XCPplus 0x0102
  /begin DAQ_EVENT VARIABLE /begin AVAILABLE_EVENT_LIST EVENT 0 EVENT 1 EVENT 2 EVENT 3 /end AVAILABLE_EVENT_LIST /begin DEFAULT_EVENT_LIST EVENT 1 /end DEFAULT_EVENT_LIST /end DAQ_EVENT
 /end IF_DATA
/end MEASUREMENT
/begin MEASUREMENT syncro_ctr "EPM internal synchro counter" UBYTE dez 1 100 0.00 255.0 FORMAT "%5.1" ECU_ADDRESS 0x40008F1D
 /begin IF_DATA XCPplus 0x0102
  /begin DAQ_EVENT VARIABLE /begin AVAILABLE_EVENT_LIST EVENT 0 EVENT 1 EVENT 2 EVENT 3 /end AVAILABLE_EVENT_LIST /begin DEFAULT_EVENT_LIST EVENT 0 /end DEFAULT_EVENT_LIST /end DAQ_EVENT
 /end IF_DATA
/end MEASUREMENT
/begin MEASUREMENT T15_flgOn "Terminal 15 state" UBYTE OneToOne 1 100 0.00 1.000 BIT_MASK 0x1 FORMAT "%5.3" ECU_ADDRESS 0x400063E9 /end MEASUREMENT
/begin MEASUREMENT T15_st "Terminal 15 status after debouncing" UBYTE OneToOne 1 100 0.00 1.000 BIT_MASK 0x1 FORMAT "%5.3" ECU_ADDRESS 0x400063A2 /end MEASUREMENT
/begin MEASUREMENT T15_stDebWakeUp "debounced value of Wake Up signal input" UBYTE OneToOne 1 100 0.00 255.0 FORMAT "%5.1" ECU_ADDRESS 0x400063B7
 /begin IF_DATA XCPplus 0x0102
  /begin DAQ_EVENT VARIABLE /begin AVAILABLE_EVENT_LIST EVENT 0 EVENT 1 EVENT 2 EVENT 3 /end AVAILABLE_EVENT_LIST /begin DEFAULT_EVENT_LIST EVENT 1 /end DEFAULT_EVENT_LIST /end DAQ_EVENT
 /end IF_DATA
/end MEASUREMENT
/begin MEASUREMENT T15_stLogic_mp "State machine for T15 in the new ""Adaptation of wakeup draft""" UBYTE OneToOne 1 100 0.00 255.0 FORMAT "%5.1" ECU_ADDRESS 0x40009E18 /end MEASUREMENT
/begin MEASUREMENT T15_stRaw "Raw value of Terminal 15 status" UBYTE OneToOne 1 100 0.00 255.0 FORMAT "%5.1" ECU_ADDRESS 0x400063B6 /end MEASUREMENT
/begin MEASUREMENT T15_stRawTurnOfDly "Message updated with T15_stRaw after TurnOffDly." UBYTE OneToOne 1 100 0.00 1.000 BIT_MASK 0x1 FORMAT "%5.3" ECU_ADDRESS 0x400063A1
 /begin IF_DATA XCPplus 0x0102
  /begin DAQ_EVENT VARIABLE /begin AVAILABLE_EVENT_LIST EVENT 0 EVENT 1 EVENT 2 EVENT 3 /end AVAILABLE_EVENT_LIST /begin DEFAULT_EVENT_LIST EVENT 1 /end DEFAULT_EVENT_LIST /end DAQ_EVENT
 /end IF_DATA
/end MEASUREMENT
/begin MEASUREMENT T15_stWakeUp "Wake Up status" UBYTE OneToOne 1 100 0.00 255.0 FORMAT "%5.1" ECU_ADDRESS 0x400063B5
 /begin IF_DATA XCPplus 0x0102
  /begin DAQ_EVENT VARIABLE /begin AVAILABLE_EVENT_LIST EVENT 0 EVENT 1 EVENT 2 EVENT 3 /end AVAILABLE_EVENT_LIST /begin DEFAULT_EVENT_LIST EVENT 1 /end DEFAULT_EVENT_LIST /end DAQ_EVENT
 /end IF_DATA
/end MEASUREMENT
/begin MEASUREMENT tateout_w "output duty cycle for canister purge valve (16 bit)" UWORD rel_uw_b102p4 1 100 0.00 102.3984 FORMAT "%8.4" ECU_ADDRESS 0x4000838A
 /begin IF_DATA XCPplus 0x0102
  /begin DAQ_EVENT VARIABLE /begin AVAILABLE_EVENT_LIST EVENT 0 EVENT 1 EVENT 2 EVENT 3 /end AVAILABLE_EVENT_LIST /begin DEFAULT_EVENT_LIST EVENT 2 /end DEFAULT_EVENT_LIST /end DAQ_EVENT
 /end IF_DATA
/end MEASUREMENT
/begin MEASUREMENT tatesoll "desired duty cycle of the PCV" UBYTE rel_ub_q0p5 1 100 0.00 127.5 FORMAT "%5.1" ECU_ADDRESS 0x400087B0
 /begin IF_DATA XCPplus 0x0102
  /begin DAQ_EVENT VARIABLE /begin AVAILABLE_EVENT_LIST EVENT 0 EVENT 1 EVENT 2 EVENT 3 /end AVAILABLE_EVENT_LIST /begin DEFAULT_EVENT_LIST EVENT 2 /end DEFAULT_EVENT_LIST /end DAQ_EVENT
 /end IF_DATA
/end MEASUREMENT
/begin MEASUREMENT tatesoll_w "desired duty cycle of the PCV (16 bit)" UWORD rel_uw_b102p4 1 100 0.00 102.3984 FORMAT "%8.4" ECU_ADDRESS 0x40008388
 /begin IF_DATA XCPplus 0x0102
  /begin DAQ_EVENT VARIABLE /begin AVAILABLE_EVENT_LIST EVENT 0 EVENT 1 EVENT 2 EVENT 3 /end AVAILABLE_EVENT_LIST /begin DEFAULT_EVENT_LIST EVENT 2 /end DEFAULT_EVENT_LIST /end DAQ_EVENT
 /end IF_DATA
/end MEASUREMENT
/begin MEASUREMENT tevper "periode time of purge control valve" UBYTE t500usxms_ub_q0p5 1 100 0.00 127.5 FORMAT "%5.1" ECU_ADDRESS 0x400087AF
 /begin IF_DATA XCPplus 0x0102
  /begin DAQ_EVENT VARIABLE /begin AVAILABLE_EVENT_LIST EVENT 0 EVENT 1 EVENT 2 EVENT 3 /end AVAILABLE_EVENT_LIST /begin DEFAULT_EVENT_LIST EVENT 2 /end DEFAULT_EVENT_LIST /end DAQ_EVENT
 /end IF_DATA
/end MEASUREMENT
/begin MEASUREMENT ThrVlv_flgLimpModeB1 "Limp home driving requested" UBYTE B_TRUE 1 100 0.00 1.00000000000 BIT_MASK 0x1 FORMAT "%13.11" ECU_ADDRESS 0x400086E0 /end MEASUREMENT
/begin MEASUREMENT ThrVlv_flgReqFuCutOffB1 "Request safety fuel cut off" UBYTE B_TRUE 1 100 0.00 1.00000000000 BIT_MASK 0x1 FORMAT "%13.11" ECU_ADDRESS 0x400086DF /end MEASUREMENT
/begin MEASUREMENT ThrVlv_flgSngSensErrB1 "One throttle valve sensor faulty" UBYTE B_TRUE 1 100 0.00 1.00000000000 BIT_MASK 0x1 FORMAT "%13.11" ECU_ADDRESS 0x400086DE /end MEASUREMENT
/begin MEASUREMENT TiEngOff_stTiFirstStrt "state of engine stop time copied at the time of first engine start in the driving cycle" UBYTE OneToOne 1 100 0.00 255.0 FORMAT "%5.1" ECU_ADDRESS 0x40008F1C /end MEASUREMENT
/begin MEASUREMENT TiEngOff_ti "engine off time" SLONG Time_sec_q1_COMPU 1 100 -2147483648.00 2147483647.00 FORMAT "%13.2" ECU_ADDRESS 0x40008F18 /end MEASUREMENT
/begin MEASUREMENT tnachl_w_msg "time of ECU switch off delay" UWORD t100msxs_uw_b6553p6 1 100 0.00 6553.500 FORMAT "%8.3" ECU_ADDRESS 0x4000CDE4
 /begin IF_DATA XCPplus 0x0102
  /begin DAQ_EVENT VARIABLE /begin AVAILABLE_EVENT_LIST EVENT 0 EVENT 1 EVENT 2 EVENT 3 /end AVAILABLE_EVENT_LIST /begin DEFAULT_EVENT_LIST EVENT 2 /end DEFAULT_EVENT_LIST /end DAQ_EVENT
 /end IF_DATA
/end MEASUREMENT
/begin MEASUREMENT Tra_numGear "Current gear information" SBYTE OneToOne 1 100 -128.0 127.0 FORMAT "%5.1" ECU_ADDRESS 0x40008F17
 /begin IF_DATA XCPplus 0x0102
  /begin DAQ_EVENT VARIABLE /begin AVAILABLE_EVENT_LIST EVENT 0 EVENT 1 EVENT 2 EVENT 3 /end AVAILABLE_EVENT_LIST /begin DEFAULT_EVENT_LIST EVENT 1 /end DEFAULT_EVENT_LIST /end DAQ_EVENT
 /end IF_DATA
/end MEASUREMENT
/begin MEASUREMENT TS_stMnSwtAC "Status of air condition main switch" UBYTE OneToOne 1 100 0.00 255.0 FORMAT "%5.1" ECU_ADDRESS 0x40008F16 /end MEASUREMENT
/begin MEASUREMENT VehV_stFrntWhlErr "Vehicle front wheel error" UBYTE B_TRUE 1 100 0.00 1.00000000000 BIT_MASK 0x1 FORMAT "%13.11" ECU_ADDRESS 0x40008F15
 /begin IF_DATA XCPplus 0x0102
  /begin DAQ_EVENT VARIABLE /begin AVAILABLE_EVENT_LIST EVENT 0 EVENT 1 EVENT 2 EVENT 3 /end AVAILABLE_EVENT_LIST /begin DEFAULT_EVENT_LIST EVENT 1 /end DEFAULT_EVENT_LIST /end DAQ_EVENT
 /end IF_DATA
/end MEASUREMENT
/begin MEASUREMENT VehV_stReWhlErr "Vehicle rear wheel error" UBYTE B_TRUE 1 100 0.00 1.00000000000 BIT_MASK 0x1 FORMAT "%13.11" ECU_ADDRESS 0x40008F14
 /begin IF_DATA XCPplus 0x0102
  /begin DAQ_EVENT VARIABLE /begin AVAILABLE_EVENT_LIST EVENT 0 EVENT 1 EVENT 2 EVENT 3 /end AVAILABLE_EVENT_LIST /begin DEFAULT_EVENT_LIST EVENT 1 /end DEFAULT_EVENT_LIST /end DAQ_EVENT
 /end IF_DATA
/end MEASUREMENT
/begin MEASUREMENT VehV_vFrntWhlRaw "Unfiltered front wheel speed" UWORD vfzg_uw_b512 1 100 0.00 511.9922 FORMAT "%8.4" ECU_ADDRESS 0x40008F12
 /begin IF_DATA XCPplus 0x0102
  /begin DAQ_EVENT VARIABLE /begin AVAILABLE_EVENT_LIST EVENT 0 EVENT 1 EVENT 2 EVENT 3 /end AVAILABLE_EVENT_LIST /begin DEFAULT_EVENT_LIST EVENT 1 /end DEFAULT_EVENT_LIST /end DAQ_EVENT
 /end IF_DATA
/end MEASUREMENT
/begin MEASUREMENT VehV_vReWhlRaw "Unfiltered rear wheel speed" UWORD vfzg_uw_b512 1 100 0.00 511.9922 FORMAT "%8.4" ECU_ADDRESS 0x40008F10
 /begin IF_DATA XCPplus 0x0102
  /begin DAQ_EVENT VARIABLE /begin AVAILABLE_EVENT_LIST EVENT 0 EVENT 1 EVENT 2 EVENT 3 /end AVAILABLE_EVENT_LIST /begin DEFAULT_EVENT_LIST EVENT 1 /end DEFAULT_EVENT_LIST /end DAQ_EVENT
 /end IF_DATA
/end MEASUREMENT
/begin MEASUREMENT vsksml_w "volumetric flow of fuel in ml/s" UWORD q1p22Em3_ml_DIV_s 1 100 0.00 79.99878 FORMAT "%8.5" ECU_ADDRESS 0x40008F0E
 /begin IF_DATA XCPplus 0x0102
  /begin DAQ_EVENT VARIABLE /begin AVAILABLE_EVENT_LIST EVENT 0 EVENT 1 EVENT 2 EVENT 3 /end AVAILABLE_EVENT_LIST /begin DEFAULT_EVENT_LIST EVENT 1 /end DEFAULT_EVENT_LIST /end DAQ_EVENT
 /end IF_DATA
/end MEASUREMENT
/begin MEASUREMENT zwcalc1_ar "Ignition angle output array for the secondary channel in case of twin spark ignition" SBYTE zw_sb_q0p75 1 100 -96.00 95.25 FORMAT "%5.2" ARRAY_SIZE 1 ECU_ADDRESS 0x40008F0C
 /begin IF_DATA XCPplus 0x0102
  /begin DAQ_EVENT VARIABLE /begin AVAILABLE_EVENT_LIST EVENT 0 EVENT 1 EVENT 2 EVENT 3 /end AVAILABLE_EVENT_LIST /begin DEFAULT_EVENT_LIST EVENT 0 /end DEFAULT_EVENT_LIST /end DAQ_EVENT
 /end IF_DATA
/end MEASUREMENT
/begin MEASUREMENT zzylzuear "cylinder numbers relevant to ignition angle calculation in actual bisynchro task" UBYTE dez 1 100 0.00 255.0 FORMAT "%5.1" ARRAY_SIZE 2 ECU_ADDRESS 0x40008F08
 /begin IF_DATA XCPplus 0x0102
  /begin DAQ_EVENT VARIABLE /begin AVAILABLE_EVENT_LIST EVENT 0 EVENT 1 EVENT 2 EVENT 3 /end AVAILABLE_EVENT_LIST /begin DEFAULT_EVENT_LIST EVENT 0 /end DEFAULT_EVENT_LIST /end DAQ_EVENT
 /end IF_DATA
/end MEASUREMENT
/begin FUNCTION SWAdp "386.0.0_0040_00central SW-Adapter (legacy)"
 /begin DEF_CHARACTERISTIC B_FLSigErr_C B_NSP_C Com_bGbxPosDelAdptVal_C CWDMDZAG NMOTREVDELTA_C NmotRevLim_tiT15EROffDly_C NMOTREVLMPCHKTHD_c NMOTREVTHD_C NMOTREVTIM /end DEF_CHARACTERISTIC
 /begin IN_MEASUREMENT B_desee_msg B_evzaustot B_gwhs B_kl15_msg B_kuppl B_nachlauf_msg B_neutgear B_sawe B_tmovh Com_flgABSFrntwhlSpdVld Com_flgABSRewhlSpdVld Com_vABSFrntWhlSpd Com_vABSReWhlSpd dns Eep_EnvRamInvld EngDa_tEng Epm_ctCyl Epm_nEng Epm_stSync fpvdt_w frhotev gangi InjSys_volFuFlowmL ltotdist_l miist_w MisfDet_maskMisfStiIgn MisfDet_maskMisfStiInj MisfDet_stCatDmg msdkrohq_w mste_w nmot_w psdss_w ps_w pu_w redist tans ubsq zwcalcar1 /end IN_MEASUREMENT
 /begin OUT_MEASUREMENT ACCtl_stOut ActMod_trqInr APP_r BasSvr_bFuncTstReq BattU_facCor BattU_u B_autget B_bbinj B_cdkat B_cpintrdy B_desee B_disdpsc2 B_dknolu B_dkpu B_evasldel B_fa B_FLSigErr B_khakt B_kl15 B_mdkat B_nachlauf B_nmotrevlim B_nsp B_OvHLamp B_poweron B_pwf B_slv B_syn B_tal B_talval B_wk B_wkr CEngDsT_t Clth_st Com_bABSRollOver Com_bABSRollOverValidity Com_bGbxPosDelAdptVal Com_fuel_cut_request_rb1 Com_tiRstrt Com_vVehWhlSpdAMT CVN_label devoff EnvP_p EnvT_t flgstign_w flgstinj_w Gbx_stNPos GGUB_uBattFild GlbDa_lTotDst HLSDem_nSetPLoDiff injddpfi_flgNoInjReq InjSys_flgNoInjReq InjSys_stActRedStg msdkroh_w msnte_w NmotRevLim_flgLampChk PEnv_p PrjCon_stLamSensRrCat_b pspvdk_w PthSet_stOvrRun PT_bNoGrip PT_rGrip PT_rTrq PT_stTraShftOp PT_stTraType syncro_ctr ThrVlv_flgLimpModeB1 ThrVlv_flgReqFuCutOffB1 ThrVlv_flgSngSensErrB1 TiEngOff_stTiFirstStrt TiEngOff_ti Tra_numGear TS_stMnSwtAC VehV_stFrntWhlErr VehV_stReWhlErr VehV_vFrntWhlRaw VehV_vReWhlRaw vsksml_w zwcalc1_ar zzylzuear /end OUT_MEASUREMENT
 /begin LOC_MEASUREMENT nmotrevcntr /end LOC_MEASUREMENT
 FUNCTION_VERSION "386.0.0_0040_00" /end FUNCTION
/begin FUNCTION SyC2ME "10.2.0_1.0.0Interface Adapter System Control to ME" /begin IN_MEASUREMENT Eep_EnvRamHist Eep_EnvRamInvld SyC_stSub /end IN_MEASUREMENT
 /begin OUT_MEASUREMENT B_nachlauf_msg B_nachl_msg B_norm_msg B_wakeup_msg tnachl_w_msg /end OUT_MEASUREMENT
 /begin LOC_MEASUREMENT nltrstdone_msg /end LOC_MEASUREMENT
 FUNCTION_VERSION "10.2.0_1.0.0" /end FUNCTION
/begin FUNCTION SyC_Vld2Lcy "1.9.0     SW Adapter System Control: Mapping Valid to Legacy Interface Elements"
 /begin OUT_MEASUREMENT SyC_ctDrvEnter SyC_ctIrrSwOff SyC_ctPostDrvLeave SyC_stMn SyC_stMnOld SyC_stPostDrv SyC_stPostDrvDel SyC_stPreDrv SyC_stPreDrvDel SyC_stSub SyC_stSubOld SyC_tiDrv SyC_tiFrst10ms SyC_tiPostDrv SyC_tiPreDrv /end OUT_MEASUREMENT
 /begin LOC_MEASUREMENT SyC_stSwtOn_mp SyC_tiBoot_mp SyC_tiIniEnd_mp SyC_tiIniSyn_mp SyC_tiIni_mp /end LOC_MEASUREMENT
 FUNCTION_VERSION "1.9.0" /end FUNCTION
/begin FUNCTION T152MED "10.2.0_1.0.0Interface Adapter T15 to MED" /begin IN_MEASUREMENT T15_st /end IN_MEASUREMENT /begin OUT_MEASUREMENT B_kl15_msg /end OUT_MEASUREMENT FUNCTION_VERSION "10.2.0_1.0.0" /end FUNCTION
/begin FUNCTION T15_Vld2Lcy "1.5.0     SW Adapter Terminal15 Component Package: Mapping Valid to Legacy Interface Elements" /begin DEF_CHARACTERISTIC T15_tiTurnOfDly_C /end DEF_CHARACTERISTIC
 /begin OUT_MEASUREMENT T15_flgOn T15_st T15_stDebWakeUp T15_stRaw T15_stRawTurnOfDly T15_stWakeUp /end OUT_MEASUREMENT
 /begin LOC_MEASUREMENT T15_stLogic_mp /end LOC_MEASUREMENT
 FUNCTION_VERSION "1.5.0" /end FUNCTION
/begin FUNCTION TEATEV "9100.2.1  Calculation duty cycle and period for controlling of canister purge valve" /begin DEF_CHARACTERISTIC FTVTEVTANS KFTVTE KLTEVP TATEMSN /end DEF_CHARACTERISTIC /begin IN_MEASUREMENT msntes_w ps pu SyC_stSub tans ubsq /end IN_MEASUREMENT /begin OUT_MEASUREMENT tateout_w tatesoll tatesoll_w tevper /end OUT_MEASUREMENT /begin LOC_MEASUREMENT puout /end LOC_MEASUREMENT FUNCTION_VERSION "9100.2.1" /end FUNCTION
/begin FUNCTION TEMS "9101.5.0_386.0.0Cansister Purge Mass flow rate"
 /begin DEF_CHARACTERISTIC CstrPurg_CPVClsMinThrAg_C DRATETE DRTTEO DRTTES DRTTESSA FRTTEO FTEIMSTE FTEWDK FTLRS FUCOTEAB FUCOTEH KLAFTEV MSNTEMX MSTEDEQ MSTEDES RATETEMN RRKTEVMX RTEVNMOTRL WDKTEV ZMSNT /end DEF_CHARACTERISTIC
 /begin IN_MEASUREMENT B_sabte B_te B_tebts fho frm_w ftvdk_w fucote_w ml_w msdkroh_w nmot_w ps_w pu_w redist rl_w SyC_stSub tateout_w tlrs wdkba wdks /end IN_MEASUREMENT
 /begin OUT_MEASUREMENT B_teabb B_tehb B_tehbx dratete_w frhotev imste_w msntes_w mstes_w mste_w ratekor_w ratetemx_w ratetes_w rltev_w /end OUT_MEASUREMENT
 /begin LOC_MEASUREMENT pspu_w ratetei_w /end LOC_MEASUREMENT
 FUNCTION_VERSION "9101.5.0_386.0.0" /end FUNCTION
/begin FUNCTION TERK "9101.1.0  corrcection relative fuel-mass-flow because of purge flow"
 /begin DEF_CHARACTERISTIC CWTERK DFUCODEC FTFUCTAQ FTFUCTASL FTRKTE FUCOTEMN FUCOTEMX IMSTEAD KLFUCOTE PSPUCUR /end DEF_CHARACTERISTIC
 /begin IN_MEASUREMENT B_tebts frm_w imste_w ps pu ratekor_w rkoak_w SyC_stSub tateout_w tatesoll_w tlrs /end IN_MEASUREMENT
 /begin OUT_MEASUREMENT ffucote_w fucote_w rkteroh_w rkte_w /end OUT_MEASUREMENT
 /begin LOC_MEASUREMENT ftrkttmp_w fucotepr_w psputmp /end LOC_MEASUREMENT
 FUNCTION_VERSION "9101.1.0" /end FUNCTION
/begin FUNCTION VMAXMD "9000.1.0_386.0Torque request of Vmax regulation" /begin DEF_CHARACTERISTIC CWVMAXMD KRVMX NMAXVMX TDPWTROP TIVMX VFZGMX /end DEF_CHARACTERISTIC /begin IN_MEASUREMENT B_kuppl B_neutgear mifa_w SyC_stSub vfzg_w /end IN_MEASUREMENT /begin OUT_MEASUREMENT B_pwtrop mivmxl_w mivmx_w nmaxvmx_w /end OUT_MEASUREMENT FUNCTION_VERSION "9000.1.0_386.0" /end FUNCTION
/*********** Start of merged COMPU_METHOD blocks ***********/
/begin COMPU_METHOD RB_RBA_Common_CentralElements_CompuMethods_Identical "The internal value and the physical one are identical. No physical unit available" RAT_FUNC "%10.5" "" COEFFS 0.0 1.0 0.0 0.0 0.0 1.0 /end COMPU_METHOD
/begin COMPU_METHOD AUTOSAR_CanIf_CompuMethods_CanIf_NotifStatusType_Enum_comp "Computation method for enum type CanIf_NotifStatusType" TAB_VERB "%10.5" "" COMPU_TAB_REF AUTOSAR_CanIf_CompuMethods_CanIf_NotifStatusType_Enum_comp /end COMPU_METHOD
/begin COMPU_METHOD AUTOSAR_CanSM_CompuMethods_CanSM_BusOffRecoveryStateType_Enum_comp "Computation method for the enum CanSM_BusOffRecoveryStateType" TAB_VERB "%10.5" "" COMPU_TAB_REF AUTOSAR_CanSM_CompuMethods_CanSM_BusOffRecoveryStateType_Enum_comp /end COMPU_METHOD
/begin COMPU_METHOD AUTOSAR_CanSM_CompuMethods_CanSM_NetworkModeStateType_Enum_comp "Computation method for the enum CanSM_NetworkModeStateType" TAB_VERB "%10.5" "" COMPU_TAB_REF AUTOSAR_CanSM_CompuMethods_CanSM_NetworkModeStateType_Enum_comp /end COMPU_METHOD
/begin COMPU_METHOD RB_RBA_rba_MRly_BswModuleDescriptions_rba_MRly_Calibration_Common_milliseconds_CompuMethod "" RAT_FUNC "%10.5" "ms" COEFFS 0.0 1.0 0.0 0.0 0.0 1.0 REF_UNIT RB_RBA_rba_MRly_Units_ms /end COMPU_METHOD
/begin COMPU_METHOD RB_RBA_rba_OsShell_CompuMethods_rba_OsShell_ResourceConversion "rba_OsShell resource conversion factor" RAT_FUNC "%10.5" "%" COEFFS 0.0 -1.0 0.0 0.0 0.0 -0.01 REF_UNIT RB_RBA_rba_OsShell_Units_Perc /end COMPU_METHOD
/begin COMPU_METHOD RB_RBA_rba_Reset_CompuMethods_rba_Reset_Id_ten "CompuMethod for the Reset Ids" TAB_VERB "%10.5" "" COMPU_TAB_REF RB_RBA_rba_Reset_CompuMethods_rba_Reset_Id_ten /end COMPU_METHOD
/begin COMPU_METHOD RB_RBA_rba_Runtime_CompuMethods_rba_Runtime_Percentage "Percentage Value" RAT_FUNC "%10.5" "%" COEFFS 0.0 -1.0 0.0 0.0 0.0 -0.001525 REF_UNIT RB_RBA_rba_Runtime_Units_Perc /end COMPU_METHOD
/begin COMPU_METHOD RB_RBA_rba_SyC_BswModuleDescriptions_rba_SyC_Prolongers_CompuMethod "" RAT_FUNC "%10.5" "" COEFFS 0.0 1.0 0.0 0.0 0.0 1.0 /end COMPU_METHOD
/begin COMPU_METHOD RB_RBA_rba_SyC_BswModuleDescriptions_rba_SyC_States_Calibration_Timeout_CompuMethod "" RAT_FUNC "%10.5" "s" COEFFS 0.0 1000.0 0.0 0.0 0.0 1.0 REF_UNIT RB_RBA_rba_SyC_Units_rba_SyC_1second /end COMPU_METHOD
/begin COMPU_METHOD RB_RBA_rba_T15_BswModuleDescriptions_rba_T15_Diag_Calibration_CompuMethod "" RAT_FUNC "%10.5" "ms" COEFFS 0.0 1.0 0.0 0.0 0.0 1.0 REF_UNIT RB_RBA_rba_T15_Units_ms /end COMPU_METHOD
/begin COMPU_METHOD RB_RBA_rba_T15_BswModuleDescriptions_rba_T15_Signal_Calibration_CompuMethod "" RAT_FUNC "%10.5" "ms" COEFFS 0.0 -1.0 0.0 0.0 0.0 -10.0 REF_UNIT RB_RBA_rba_T15_Units_ms /end COMPU_METHOD
/begin COMPU_METHOD DefaultIdenticalCompu "" RAT_FUNC "%10.5" "" COEFFS 0.0 1.0 0.0 0.0 0.0 1.0 /end COMPU_METHOD
/begin COMPU_VTAB AUTOSAR_CanIf_CompuMethods_CanIf_NotifStatusType_Enum_comp "Computation method for enum type CanIf_NotifStatusType" TAB_VERB 2 0 "CANIF_NO_NOTIFICATION" 1 "CANIF_TX_RX_NOTIFICATION" /end COMPU_VTAB
/begin COMPU_VTAB AUTOSAR_CanSM_CompuMethods_CanSM_BusOffRecoveryStateType_Enum_comp "Computation method for the enum CanSM_BusOffRecoveryStateType" TAB_VERB 6 1 "CANSM_BOR_IDLE" 2 "CANSM_S_BUS_OFF_CHECK" 3 "CANSM_S_NO_BUS_OFF" 4 "CANSM_S_TX_OFF" 5 "CANSM_S_RESTART_CC" 6 "CANSM_S_RESTART_CC_WAIT" /end COMPU_VTAB
/begin COMPU_VTAB AUTOSAR_CanSM_CompuMethods_CanSM_NetworkModeStateType_Enum_comp "Computation method for the enum CanSM_NetworkModeStateType" TAB_VERB 7 0 "CANSM_BSM_S_NOCOM" 1 "CANSM_BSM_S_SILENTCOM" 2 "CANSM_BSM_S_FULLCOM" 3 "CANSM_BSM_S_NOT_INITIALIZED" 4 "CANSM_BSM_S_PRE_NOCOM" 5 "CANSM_BSM_S_PRE_FULLCOM" 6 "CANSM_BSM_S_CHANGE_BAUDRATE" /end COMPU_VTAB
/begin COMPU_VTAB RB_RBA_rba_Reset_CompuMethods_rba_Reset_Id_ten "CompuMethod for the Reset Ids" TAB_VERB 244 0 "RBA_RESET_POWERON_E" 1 "RBA_RESET_POWERON_WARM_E" 2 "RBA_RESET_POWERON_WDT_E" 3 "RBA_RESET_POWERON_KL15_E" 4 "RBA_RESET_ESR0_E" 5 "RBA_RESET_ESR1_E" 6 "RBA_RESET_WDT_E" 7 "RBA_RESET_OCDS" 8 "RBA_RESET_CB0_E" 9 "RBA_RESET_CB1_E" 10 "RBA_RESET_CB3_E" 11 "RBA_RESET_TP_E" 12 "RBA_RESET_CANWAK_E" 13 "RBA_RESET_PIN1WAK_E" 14 "RBA_RESET_PIN2WAK_E" 15 "RBA_RESET_PIN3WAK_E" 16 "RBA_RESET_STCWAK_E" 17 "RBA_RESET_HW_E" 18 "RBA_RESET_SOFTDEST_E" 19 "RBA_RESET_JTAGDEST_E" 20 "RBA_RESET_HSMDEST_E" 21 "RBA_RESET_TSRDEST_E" 22 "RBA_RESET_FCCUHARD_E" 23 "RBA_RESET_FCCUSOFT_E" 24 "RBA_RESET_JTAGFUNC_E" 25 "RBA_RESET_HSMFUNC_E" 26 "RBA_RESET_TSRFUNC_E" 27 "RBA_RESET_VORFUNC_E" 28 "RBA_RESET_NOTDEFINED_E" 29 "RBA_RESET_FFRRDEST_E" 30 "RBA_RESET_SSCMDEST_E" 31 "RBA_RESET_FLASH_E" 32 "RBA_RESET_PLL0_E" 33 "RBA_RESET_CMU_FHL0_E" 34 "RBA_RESET_CMU_OLR_E" 35 "RBA_RESET_CORE_E" 36 "RBA_RESET_CWD_E" 37 "RBA_RESET_SWT_E" 4096 "RBA_RESET_POWERON_SIMU_E" 4097 "RBA_RESET_HWRESET_SIMU_E" 4098 "RBA_RESET_RB_PROG_E" 4099 "RBA_RESET_CBPROG_E" 4100 "RBA_RESET_CBCPU_E" 4101 "RBA_RESET_RB_PROG_ILLEGAL_PATH_E" 4102 "RBA_RESET_TSW_EXIT_E" 4103 "RBA_RESET_TSW_MAGICPATTERN_E" 4104 "RBA_RESET_TRAP_IN_SB_E" 4105 "RBA_RESET_SWDESTRST_RAMVALID_E" 4106 "RBA_RESET_SWDESTRST_RAMINVALID_E" 4107 "RBA_RESET_SWDESTRST_REQ_RAMVALID_E" 4108 "RBA_RESET_OBD_SVC11_RESET_E" 4109 "RBA_RESET_PLL_LOSS_OF_LOCK_E" 4110 "RBA_RESET_DUMMY03_E" 4111 "RBA_RESET_DUMMY04_E" 4112 "RBA_RESET_DUMMY05_E" 4113 "RBA_RESET_DUMMY06_E" 4114 "RBA_RESET_DUMMY07_E" 4115 "RBA_RESET_DUMMY08_E" 4116 "RBA_RESET_DUMMY09_E" 4117 "RBA_RESET_DUMMY10_E" 12288 "ECUM_E_RESET_CONFIGURATION_DATA_INCONSISTENT" 12289 "ECUM_E_RESET_GENERAL" 12290 "ECUM_E_RESET_INVALID_PTR_RETURNED" 12291 "ECUM_E_RESET_NULL_PTR_RETURNED" 12292 "ECUM_E_RESET_RAM_CHECK_FAILED" 12293 "ECUM_E_RESET_START_CORE_FAILED" 12294 "ECUM_RESET" 12295 "MCU_RB_RESET_DTS_ERROR" 12296 "MCU_RESET_ILLEGAL_CALL_OF_MCU_PERFORM_RESET" 12297 "MCU_RESET_UNDEFINED" 12298 "RBA_EMM_EVR13OVCFG_ERROR_RESET" 12299 "RBA_EMM_EVR13UVCFG_ERROR_RESET" 12300 "RBA_EMM_EVR33OVCFG_ERROR_RESET" 12301 "RBA_EMM_EVR33UVCFG_ERROR_RESET" 12302 "RBA_EMM_EVR50OVCFG_ERROR_RESET" 12303 "RBA_EMM_EVR50UVCFG_ERROR_RESET" 12304 "RBA_EMM_INT_TEMP_MON_RESET" 12305 "RBA_EMM_INVALID_STAT_RESET" 12306 "RBA_EMM_UNEXPECTED_LOCK_RESET" 12307 "RBA_EMM_VDDMOVCFG_ERROR_RESET" 12308 "RBA_EMM_VDDMUVCFG_ERROR_RESET" 12309 "RBA_EMM_VDDPDOVCFG_ERROR_RESET" 12310 "RBA_EMM_VDDPDUVCFG_ERROR_RESET" 12311 "RBA_EMM_VEVRSBOVCFG_ERROR_RESET" 12312 "RBA_EMM_VEVRSBUVCFG_ERROR_RESET" 12313 "RBA_MPU_INVALID_ADDRESS_ALIGNMENT_RESET" 12314 "RBA_MPU_INVALID_NUMBER_REGIONS_RESET" 12315 "RBA_MPU_INVALID_REGION_ADDRESS_RESET" 12316 "RBA_MPU_REGION_START_END_ADDRESS_RESET" 12317 "RBA_MULTISTACKTRACE_UNDEROVERFLOW" 12318 "RBA_RESET_BSW_DEFAULT_E" 12319 "RBA_RESET_FIRST_SWRESET" 12320 "RBA_RESET_INFOBLK_FAULT" 12321 "RBA_RESET_MOCEMM_ECC_FAILED" 12322 "RBA_RESET_MOCEMM_INITORDER" 12323 "RBA_RESET_MOCEMM_RAMCHK_FAILED" 12324 "RBA_RESET_MOCEMM_ROMCHK_FAILED" 12325 "RBA_RESET_MOCEMM_WTCHK_FAILED" 12326 "RBA_RESET_MOCSOP_BUS_ERROR" 12327 "RBA_RESET_MOCSOP_OS_TIMEOUT_ERROR" 12328 "RBA_RESET_MOCSOP_TIRESPTIME_ERROR" 12329 "RBA_RESET_MOCSOP_WRTEST_FAILED" 12330 "RBA_RESET_RBA_BSWSRV_ADDRESS_RANGE_VIOLATION_E" 12331 "RBA_RESET_RBA_BSWSRV_INTSUSP_CORRUPTION" 12332 "RBA_RESET_RBA_BSWSRV_INTSUSP_CTR_VIOLATION_E" 12333 "RBA_RESET_RBA_BSWSRV_LOCK_CTR_VIOLATION_E" 12334 "RBA_RESET_RBA_BSWSRV_LOCK_NESTING_VIOLATION_E" 12335 "RBA_RESET_RBA_BYP_FINISH_E" 12336 "RBA_RESET_RBA_CALWUPFINISH_E" 12337 "RBA_RESET_RBA_MEMLAY_CB_SIZE_E" 12338 "RBA_RESET_SOPTEST_FAILED" 12339 "RBA_RESET_SWRST_EEPACTFIRSTINIT_E" 12340 "RBA_RESET_SWRST_EEPDELENVRAM_E" 12341 "RBA_SYC_POWERUNDERVOLTAGE_RSTID_RECOVERY_FAILED" 12342 "RBA_SYC_RESET_T15" 12343 "RESET_SWRESET_CPLCHK_FAILED" 12344 "RESET_SWRESET_ILLEGAL_SW_PATH" 12345 "RESET_SWRESET_MOCCOM_BUS_ERROR" 12346 "RESET_SWRESET_MOCCOM_CPLCHK_FAILED" 12347 "RESET_SWRESET_MOCCOM_CTSOPTST" 12348 "RESET_SWRESET_MOCCOM_OS_TIMEOUT_ERROR" 12349 "RESET_SWRESET_MOCCOM_PWR_ERROR" 12350 "RESET_SWRESET_MOCCOM_SOPTST" 12351 "RESET_SWRESET_MOCCOM_WRTEST_FAILED" 12352 "RESET_SWRESET_MOCGTM_CHKROM_FAILED" 12353 "RESET_SWRESET_MOCGTM_FAILED" 12354 "RESET_SWRESET_MOCGTM_INI_COMPLEMENT_FAILED" 12355 "RESET_SWRESET_MOCGTM_INI_FAILED" 12356 "RESET_SWRESET_MOCMEM_CHKRAM_FAILED" 12357 "RESET_SWRESET_MOCMEM_CHKROM_FAILED" 12358 "RESET_SWRESET_MOCMEM_CPLCHK_FAILED" 12359 "RESET_SWRESET_MOCMEM_NUMBLKERR_FAILED" 12360 "RESET_SWRESET_MOCMEM_WTRAM_FAILED" 12361 "RESET_SWRESET_MOCMEM_WTROM_FAILED" 12362 "RESET_SWRESET_OCWDA_WDA_MONITOR" 12363 "SWRESET_MOCADCNTP_PREICO" 12364 "SWRESET_MOCADCTST_PREICO" 12365 "SWRESET_UNEXPSYCSTSUB_E" 16384 "RBA_SYC_POWERUNDERVOLTAGE_RSTID_DIO_READ_FAILED" 16385 "RBA_SYC_POWERUNDERVOLTAGE_RSTID_UV_DETECTED" 16386 "RBA_SYC_RESET_RESTART" 16387 "RBA_SYC_RESET_WAKEUP" 20480 "RBA_RESET_CPU0_EXC_SYSRST_E" 20481 "RBA_RESET_CPU0_EXC_CRITINP_E" 20482 "RBA_RESET_CPU0_EXC_MCHK_UNKNOWN_E" 20483 "RBA_RESET_CPU0_EXC_MCHK_MCP_E" 20484 "RBA_RESET_CPU0_EXC_MCHK_IC_DPERR_E" 20485 "RBA_RESET_CPU0_EXC_MCHK_RES2_E" 20486 "RBA_RESET_CPU0_EXC_MCHK_DC_DPERR_E" 20487 "RBA_RESET_CPU0_EXC_MCHK_EXCP_ERR_E" 20488 "RBA_RESET_CPU0_EXC_MCHK_IC_TPERR_E" 20489 "RBA_RESET_CPU0_EXC_MCHK_DC_TPERR_E" 20490 "RBA_RESET_CPU0_EXC_MCHK_IC_LKERR_E" 20491 "RBA_RESET_CPU0_EXC_MCHK_DC_LKERR_E" 20492 "RBA_RESET_CPU0_EXC_MCHK_RES9_E" 20493 "RBA_RESET_CPU0_EXC_MCHK_RES10_E" 20494 "RBA_RESET_CPU0_EXC_MCHK_NMI_E" 20495 "RBA_RESET_CPU0_EXC_MCHK_MAV_E" 20496 "RBA_RESET_CPU0_EXC_MCHK_MEA_E" 20497 "RBA_RESET_CPU0_EXC_MCHK_U_E" 20498 "RBA_RESET_CPU0_EXC_MCHK_IF_E" 20499 "RBA_RESET_CPU0_EXC_MCHK_LD_E" 20500 "RBA_RESET_CPU0_EXC_MCHK_ST_E" 20501 "RBA_RESET_CPU0_EXC_MCHK_G_E" 20502 "RBA_RESET_CPU0_EXC_MCHK_RES19_E" 20503 "RBA_RESET_CPU0_EXC_MCHK_RES20_E" 20504 "RBA_RESET_CPU0_EXC_MCHK_STACK_ERR_E" 20505 "RBA_RESET_CPU0_EXC_MCHK_IMEM_PERR_E" 20506 "RBA_RESET_CPU0_EXC_MCHK_DMEM_RDPERR_E" 20507 "RBA_RESET_CPU0_EXC_MCHK_DMEM_WRPERR_E" 20508 "RBA_RESET_CPU0_EXC_MCHK_RES25_E" 20509 "RBA_RESET_CPU0_EXC_MCHK_RES26_E" 20510 "RBA_RESET_CPU0_EXC_MCHK_BUS_IRERR_E" 20511 "RBA_RESET_CPU0_EXC_MCHK_BUS_DRERR_E" 20512 "RBA_RESET_CPU0_EXC_MCHK_BUS_WRERR_E" 20513 "RBA_RESET_CPU0_EXC_MCHK_BUS_WRDSI_E" 20514 "RBA_RESET_CPU0_EXC_MCHK_RES31_E" 20515 "RBA_RESET_CPU0_EXC_DATAST_E" 20516 "RBA_RESET_CPU0_EXC_DATAST_PIL_E" 20517 "RBA_RESET_CPU0_EXC_DATAST_PPR_E" 20518 "RBA_RESET_CPU0_EXC_DATAST_PTR_E" 20519 "RBA_RESET_CPU0_EXC_DATAST_FP_E" 20520 "RBA_RESET_CPU0_EXC_DATAST_ST_E" 20521 "RBA_RESET_CPU0_EXC_DATAST_BO_E" 20522 "RBA_RESET_CPU0_EXC_DATAST_SPV_E" 20523 "RBA_RESET_CPU0_EXC_DATAST_VLEMI_E" 20524 "RBA_RESET_CPU0_EXC_INSTRST_E" 20525 "RBA_RESET_CPU0_EXC_INSTRST_PIL_E" 20526 "RBA_RESET_CPU0_EXC_INSTRST_PPR_E" 20527 "RBA_RESET_CPU0_EXC_INSTRST_PTR_E" 20528 "RBA_RESET_CPU0_EXC_INSTRST_FP_E" 20529 "RBA_RESET_CPU0_EXC_INSTRST_ST_E" 20530 "RBA_RESET_CPU0_EXC_INSTRST_BO_E" 20531 "RBA_RESET_CPU0_EXC_INSTRST_SPV_E" 20532 "RBA_RESET_CPU0_EXC_INSTRST_VLEMI_E" 20533 "RBA_RESET_CPU0_EXC_EXTINT_E" 20534 "RBA_RESET_CPU0_EXC_ALIGN_E" 20535 "RBA_RESET_CPU0_EXC_ALIGN_PIL_E" 20536 "RBA_RESET_CPU0_EXC_ALIGN_PPR_E" 20537 "RBA_RESET_CPU0_EXC_ALIGN_PTR_E" 20538 "RBA_RESET_CPU0_EXC_ALIGN_FP_E" 20539 "RBA_RESET_CPU0_EXC_ALIGN_ST_E" 20540 "RBA_RESET_CPU0_EXC_ALIGN_BO_E" 20541 "RBA_RESET_CPU0_EXC_ALIGN_SPV_E" 20542 "RBA_RESET_CPU0_EXC_ALIGN_VLEMI_E" 20543 "RBA_RESET_CPU0_EXC_PROGRAM_E" 20544 "RBA_RESET_CPU0_EXC_PROGRAM_PIL_E" 20545 "RBA_RESET_CPU0_EXC_PROGRAM_PPR_E" 20546 "RBA_RESET_CPU0_EXC_PROGRAM_PTR_E" 20547 "RBA_RESET_CPU0_EXC_PROGRAM_FP_E" 20548 "RBA_RESET_CPU0_EXC_PROGRAM_ST_E" 20549 "RBA_RESET_CPU0_EXC_PROGRAM_BO_E" 20550 "RBA_RESET_CPU0_EXC_PROGRAM_SPV_E" 20551 "RBA_RESET_CPU0_EXC_PROGRAM_VLEMI_E" 20552 "RBA_RESET_CPU0_EXC_PERFMON_E" 20553 "RBA_RESET_CPU0_EXC_SYSCALL_E" 20554 "RBA_RESET_CPU0_EXC_SYSCALL_PIL_E" 20555 "RBA_RESET_CPU0_EXC_SYSCALL_PPR_E" 20556 "RBA_RESET_CPU0_EXC_SYSCALL_PTR_E" 20557 "RBA_RESET_CPU0_EXC_SYSCALL_FP_E" 20558 "RBA_RESET_CPU0_EXC_SYSCALL_ST_E" 20559 "RBA_RESET_CPU0_EXC_SYSCALL_BO_E" 20560 "RBA_RESET_CPU0_EXC_SYSCALL_SPV_E" 20561 "RBA_RESET_CPU0_EXC_SYSCALL_VLEMI_E" 20562 "RBA_RESET_CPU0_EXC_DEBUG_E" 20563 "RBA_RESET_CPU0_EXC_EFPUDATAEXC_E" 20564 "RBA_RESET_CPU0_EXC_EFPUDATAEXC_PIL_E" 20565 "RBA_RESET_CPU0_EXC_EFPUDATAEXC_PPR_E" 20566 "RBA_RESET_CPU0_EXC_EFPUDATAEXC_PTR_E" 20567 "RBA_RESET_CPU0_EXC_EFPUDATAEXC_FP_E" 20568 "RBA_RESET_CPU0_EXC_EFPUDATAEXC_ST_E" 20569 "RBA_RESET_CPU0_EXC_EFPUDATAEXC_BO_E" 20570 "RBA_RESET_CPU0_EXC_EFPUDATAEXC_SPV_E" 20571 "RBA_RESET_CPU0_EXC_EFPUDATAEXC_VLEMI_E" 20572 "RBA_RESET_CPU0_EXC_EFPUROUNDEXC_E" 20573 "RBA_RESET_CPU0_EXC_EFPUROUNDEXC_PIL_E" 20574 "RBA_RESET_CPU0_EXC_EFPUROUNDEXC_PPR_E" 20575 "RBA_RESET_CPU0_EXC_EFPUROUNDEXC_PTR_E" 20576 "RBA_RESET_CPU0_EXC_EFPUROUNDEXC_FP_E" 20577 "RBA_RESET_CPU0_EXC_EFPUROUNDEXC_ST_E" 20578 "RBA_RESET_CPU0_EXC_EFPUROUNDEXC_BO_E" 20579 "RBA_RESET_CPU0_EXC_EFPUROUNDEXC_SPV_E" 20580 "RBA_RESET_CPU0_EXC_EFPUROUNDEXC_VLEMI_E" 20581 "RBA_RESET_CPU0_EXC_TBD_E" /end COMPU_VTAB
/begin COMPU_METHOD B_TRUE "" TAB_VERB "%6.3" "" COMPU_TAB_REF B_TRUE /end COMPU_METHOD
/begin COMPU_VTAB B_TRUE "" TAB_VERB 2 0 "FALSE" 1 "TRUE" /end COMPU_VTAB
/begin COMPU_METHOD dez "" RAT_FUNC "%6.2" "" COEFFS 0 1 0 0 0 1 /end COMPU_METHOD
/begin COMPU_METHOD EngN "" RAT_FUNC "%6.3" "rpm" COEFFS 0 2 0 0 0 1 /end COMPU_METHOD
/begin COMPU_METHOD ExeCon_State_01 "" TAB_VERB "%6.3" "" COMPU_TAB_REF ExeCon_State_01 /end COMPU_METHOD
/begin COMPU_VTAB ExeCon_State_01 "" TAB_VERB 4 0 "SYC_BOOT" 1 "SYC_PROC_INIT" 2 "SYC_PROC_EXEC" 3 "SYC_SHUTDOWN" /end COMPU_VTAB
/begin COMPU_METHOD ExeCon_State_02 "" TAB_VERB "%6.3" "" COMPU_TAB_REF ExeCon_State_02 /end COMPU_METHOD
/begin COMPU_VTAB ExeCon_State_02 "" TAB_VERB 7 0 "SYC_INI" 1 "SYC_INISYN" 2 "SYC_INIEND" 3 "SYC_PREDRIVE" 4 "SYC_DRIVE" 5 "SYC_POSTDRIVE" 6 "SYC_POST_OS_EXIT" /end COMPU_VTAB
/begin COMPU_METHOD Fact "" RAT_FUNC "%6.5" "-" COEFFS 0 8192 0 0 0 1 /end COMPU_METHOD
/begin COMPU_METHOD Fact100 "" RAT_FUNC "%6.4" "-" COEFFS 0 100 0 0 0 1 /end COMPU_METHOD
/begin COMPU_METHOD fak_q0p001 "" RAT_FUNC "%6.5" "-" COEFFS 0 1000 0 0 0 1 /end COMPU_METHOD
/begin COMPU_METHOD fak_qn0p0078 "" RAT_FUNC "%7.6" "-" COEFFS 0 -256 0 0 0 2 /end COMPU_METHOD
/begin COMPU_METHOD fak_sb_b2 "" RAT_FUNC "%6.4" "-" COEFFS 0 256 0 0 0 4 /end COMPU_METHOD
/begin COMPU_METHOD fak_sw_b1 "" RAT_FUNC "%7.6" "-" COEFFS 0 65536 0 0 0 2 /end COMPU_METHOD
/begin COMPU_METHOD fak_sw_b2 "" RAT_FUNC "%7.6" "-" COEFFS 0 65536 0 0 0 4 /end COMPU_METHOD
/begin COMPU_METHOD fak_ub_b2 "" RAT_FUNC "%8.5" "-" COEFFS 0 256 0 0 0 2 /end COMPU_METHOD
/begin COMPU_METHOD fak_ub_b4 "" RAT_FUNC "%6.4" "-" COEFFS 0 256 0 0 0 4 /end COMPU_METHOD
/begin COMPU_METHOD fak_ub_b8 "" RAT_FUNC "%6.4" "-" COEFFS 0 256 0 0 0 8 /end COMPU_METHOD
/begin COMPU_METHOD fak_ub_q0p00392 "" RAT_FUNC "%6.4" "-" COEFFS 0 255 0 0 0 1 /end COMPU_METHOD
/begin COMPU_METHOD fak_ub_q0p5 "" RAT_FUNC "%6.3" "-" COEFFS 0 1 0 0 0 0.5 /end COMPU_METHOD
/begin COMPU_METHOD fak_uw_b100 "" RAT_FUNC "%6.4" "-" COEFFS 0 65536 0 0 0 100 /end COMPU_METHOD
/begin COMPU_METHOD fak_uw_b16 "" RAT_FUNC "%6.5" "-" COEFFS 0 65536 0 0 0 16 /end COMPU_METHOD
/begin COMPU_METHOD fak_uw_b2 "" RAT_FUNC "%7.6" "-" COEFFS 0 65536 0 0 0 2 /end COMPU_METHOD
/begin COMPU_METHOD Length "" RAT_FUNC "%6.2" "m" COEFFS 0 1 0 0 0 1 /end COMPU_METHOD
/begin COMPU_METHOD m_q0p0001085 "" RAT_FUNC "%6.5" "g/s" COEFFS 0 9216 0 0 0 1 /end COMPU_METHOD
/begin COMPU_METHOD m_q0p01_omq2p55 "" RAT_FUNC "%6.3" "Kg/h" COEFFS 0 100 255 0 0 1 /end COMPU_METHOD
/begin COMPU_METHOD m_q0p1_omq25p5 "" RAT_FUNC "%6.2" "kg/ h" COEFFS 0 10 255 0 0 1 /end COMPU_METHOD
/begin COMPU_METHOD m_q1p526Em6_g "" RAT_FUNC "%8.7" "g" COEFFS 0 655360 0 0 0 1 /end COMPU_METHOD
/begin COMPU_METHOD m_uw_b25p6 "" RAT_FUNC "%6.5" "kg/h" COEFFS 0 65536 0 0 0 25.6 /end COMPU_METHOD
/begin COMPU_METHOD m_uw_b6553p5 "" RAT_FUNC "%6.3" "kg/h" COEFFS 0 1 0 0 0 0.1 /end COMPU_METHOD
/begin COMPU_METHOD nmot_uw_q0p25 "" RAT_FUNC "%6.3" "1/min" COEFFS 0 1 0 0 0 0.25 /end COMPU_METHOD
/begin COMPU_METHOD OneToOne "" RAT_FUNC "%6.2" "-" COEFFS 0 1 0 0 0 1 /end COMPU_METHOD
/begin COMPU_METHOD Prc "" RAT_FUNC "%6.4" "%" COEFFS 0 81.92 0 0 0 1 /end COMPU_METHOD
/begin COMPU_METHOD p_q0p039 "" RAT_FUNC "%6.4" "hPa" COEFFS 0 256 0 0 0 10 /end COMPU_METHOD
/begin COMPU_METHOD p_ub_q5 "" RAT_FUNC "%6.2" "hPa" COEFFS 0 1 0 0 0 5 /end COMPU_METHOD
/begin COMPU_METHOD q1p22Em3_ml_DIV_s "" RAT_FUNC "%6.4" "ml/s" COEFFS 0 8192 0 0 0 10 /end COMPU_METHOD
/begin COMPU_METHOD RBPtCel_v_0p05625_1 "" RAT_FUNC "%6.4" "km/h" COEFFS 0 640 0 0 0 36 /end COMPU_METHOD
/begin COMPU_METHOD relDK_ub_b100 "" RAT_FUNC "%6.3" "%DK" COEFFS 0 255 0 0 0 100 /end COMPU_METHOD
/begin COMPU_METHOD rel_sw_b1536 "" RAT_FUNC "%6.4" "%" COEFFS 0 65536 0 0 0 3072 /end COMPU_METHOD
/begin COMPU_METHOD rel_ub_q0p3906 "" RAT_FUNC "%6.3" "%" COEFFS 0 256 0 0 0 100 /end COMPU_METHOD
/begin COMPU_METHOD rel_ub_q0p5 "" RAT_FUNC "%6.3" "%" COEFFS 0 1 0 0 0 0.5 /end COMPU_METHOD
/begin COMPU_METHOD rel_uw_b100 "" RAT_FUNC "%6.4" "%" COEFFS 0 65536 0 0 0 100 /end COMPU_METHOD
/begin COMPU_METHOD rel_uw_b102p4 "" RAT_FUNC "%6.4" "" COEFFS 0 65536 0 0 0 102.4 /end COMPU_METHOD
/begin COMPU_METHOD rel_uw_q0p0234 "" RAT_FUNC "%6.4" "%" COEFFS 0 32 0 0 0 0.75 /end COMPU_METHOD
/begin COMPU_METHOD spg_q0p1 "" RAT_FUNC "%6.3" "V" COEFFS 0 1 0 0 0 0.1 /end COMPU_METHOD
/begin COMPU_METHOD SyC_PostDrv_State "" TAB_VERB "%6.3" "" COMPU_TAB_REF SyC_PostDrv_State /end COMPU_METHOD
/begin COMPU_VTAB SyC_PostDrv_State "" TAB_VERB 9 0 "SYC_POSTDRV_INACTV" 1 "SYC_POSTDRV_DSM_BGN" 2 "SYC_POSTDRV_EEP_BGN" 3 "SYC_POSTDRV_WAIT" 4 "SYC_POSTDRV_NWM" 5 "SYC_POSTDRV_DSM_END" 6 "SYC_POSTDRV_EEP_END" 7 "SYC_POSTDRV_MIN_TIME" 8 "SYC_POSTDRV_DONE" /end COMPU_VTAB
/begin COMPU_METHOD SyC_PreDrv_State "" TAB_VERB "%6.3" "" COMPU_TAB_REF SyC_PreDrv_State /end COMPU_METHOD
/begin COMPU_VTAB SyC_PreDrv_State "" TAB_VERB 10 0 "SYC_PREDRV_INI_DRV" 1 "SYC_PREDRV_DONE" 2 "SYC_PREDRV_INI_SHDWN" 3 "SYC_PREDRV_PROLONG" 4 "SYC_PREDRV_NWM" 5 "SYC_PREDRV_EEP" 6 "SYC_PREDRV_DSM" 7 "SYC_PREDRV_MR" 8 "SYC_PREDRV_MOM" 9 "SYC_PREDRV_EXIT" /end COMPU_VTAB
/begin COMPU_METHOD SY_DTCWCS_Compu "" TAB_VERB "%6.3" "" COMPU_TAB_REF SY_DTCWCS_Compu /end COMPU_METHOD
/begin COMPU_VTAB SY_DTCWCS_Compu "" TAB_VERB 3 0 "DISABL" 1 "NO_TABST_COUNT" 2 "TABST_COUNT" /end COMPU_VTAB
/begin COMPU_METHOD SY_DTHM_Compu "" TAB_VERB "%6.3" "" COMPU_TAB_REF SY_DTHM_Compu /end COMPU_METHOD
/begin COMPU_VTAB SY_DTHM_Compu "" TAB_VERB 2 0 "False" 1 "True" /end COMPU_VTAB
/begin COMPU_METHOD SY_DVEAIF_Compu "" TAB_VERB "%6.3" "" COMPU_TAB_REF SY_DVEAIF_Compu /end COMPU_METHOD
/begin COMPU_VTAB SY_DVEAIF_Compu "" TAB_VERB 4 0 "No anti icing functionality" 1 "Higher tolerance before starting" 2 "High tolerance before start and AI at ignition on" 3 "High tolerance before start and AI during drive" /end COMPU_VTAB
/begin COMPU_METHOD SY_DVEKOOR_Compu "" TAB_VERB "%6.3" "" COMPU_TAB_REF SY_DVEKOOR_Compu /end COMPU_METHOD
/begin COMPU_VTAB SY_DVEKOOR_Compu "" TAB_VERB 2 0 "kein eigenes DVE-Koordinatensystem" 1 "eigenes DVE-Koordinatensystem" /end COMPU_VTAB
/begin COMPU_METHOD SY_DWVNWKW_Compu "" TAB_VERB "%6.3" "" COMPU_TAB_REF SY_DWVNWKW_Compu /end COMPU_METHOD
/begin COMPU_VTAB SY_DWVNWKW_Compu "" TAB_VERB 2 0 "No OBD2 angle misalignment" 1 "OBD2 angle misalignment diagnosis installed" /end COMPU_VTAB
/begin COMPU_METHOD SY_DYNSYN_Compu "" TAB_VERB "%6.3" "" COMPU_TAB_REF SY_DYNSYN_Compu /end COMPU_METHOD
/begin COMPU_VTAB SY_DYNSYN_Compu "" TAB_VERB 2 0 "False" 1 "True" /end COMPU_VTAB
/begin COMPU_METHOD SY_EEPWRMON_Compu "" TAB_VERB "%6.3" "" COMPU_TAB_REF SY_EEPWRMON_Compu /end COMPU_METHOD
/begin COMPU_VTAB SY_EEPWRMON_Compu "" TAB_VERB 2 0 "False" 1 "True" /end COMPU_VTAB
/begin COMPU_METHOD SY_EGAS_Compu "" TAB_VERB "%6.3" "" COMPU_TAB_REF SY_EGAS_Compu /end COMPU_METHOD
/begin COMPU_VTAB SY_EGAS_Compu "" TAB_VERB 2 0 "kein E-GAS System" 1 "E-GAS System" /end COMPU_VTAB
/begin COMPU_METHOD SY_EKPABP_Compu "" TAB_VERB "%6.3" "" COMPU_TAB_REF SY_EKPABP_Compu /end COMPU_METHOD
/begin COMPU_VTAB SY_EKPABP_Compu "" TAB_VERB 2 0 "False" 1 "True" /end COMPU_VTAB
/begin COMPU_METHOD SY_EKPRMK_Compu "" TAB_VERB "%6.3" "" COMPU_TAB_REF SY_EKPRMK_Compu /end COMPU_METHOD
/begin COMPU_VTAB SY_EKPRMK_Compu "" TAB_VERB 2 0 "keine anderen mitversorgten Komponenten oder ME9" 1 "nur ME7: mit anderen mitversorgten Komponenten" /end COMPU_VTAB
/begin COMPU_METHOD SY_EKPSTA_Compu "" TAB_VERB "%6.3" "" COMPU_TAB_REF SY_EKPSTA_Compu /end COMPU_METHOD
/begin COMPU_VTAB SY_EKPSTA_Compu "" TAB_VERB 2 0 "False" 1 "True" /end COMPU_VTAB
/begin COMPU_METHOD SY_EPMPHDT_Compu "" RAT_FUNC "%6.2" "" COEFFS 0 1 0 0 0 1 /end COMPU_METHOD
/begin COMPU_METHOD SY_FABE_Compu "" TAB_VERB "%6.3" "" COMPU_TAB_REF SY_FABE_Compu /end COMPU_METHOD
/begin COMPU_VTAB SY_FABE_Compu "" TAB_VERB 2 0 "shortened EOL-test unavailable" 1 "shortened EOL-test available" /end COMPU_VTAB
/begin COMPU_METHOD SY_FAEVZUE_Compu "" TAB_VERB "%6.3" "" COMPU_TAB_REF SY_FAEVZUE_Compu /end COMPU_METHOD
/begin COMPU_VTAB SY_FAEVZUE_Compu "" TAB_VERB 2 0 "False" 1 "True" /end COMPU_VTAB
/begin COMPU_METHOD SY_FANT_Compu "" TAB_VERB "%6.3" "" COMPU_TAB_REF SY_FANT_Compu /end COMPU_METHOD
/begin COMPU_VTAB SY_FANT_Compu "" TAB_VERB 2 0 "keine Anhebung Schubabschaltedrehzahl über Testere" 1 "Anhebung Schubabschaltedrehzahl über Testereingrif" /end COMPU_VTAB
/begin COMPU_METHOD SY_FELMR_Compu "" TAB_VERB "%6.3" "" COMPU_TAB_REF SY_FELMR_Compu /end COMPU_METHOD
/begin COMPU_VTAB SY_FELMR_Compu "" TAB_VERB 2 0 "False" 1 "True" /end COMPU_VTAB
/begin COMPU_METHOD SY_FFV_Compu "" TAB_VERB "%6.3" "" COMPU_TAB_REF SY_FFV_Compu /end COMPU_METHOD
/begin COMPU_VTAB SY_FFV_Compu "" TAB_VERB 2 0 "kein flexible fuel Fahrzeug" 1 "flexible fuel Fahrzeug" /end COMPU_VTAB
/begin COMPU_METHOD SY_FFZ_Compu "" TAB_VERB "%6.3" "" COMPU_TAB_REF SY_FFZ_Compu /end COMPU_METHOD
/begin COMPU_VTAB SY_FFZ_Compu "" TAB_VERB 2 0 "keine Funkenbandzündung" 1 "Funkenbandzündung vorhanden" /end COMPU_VTAB
/begin COMPU_METHOD SY_FGR_Compu "" TAB_VERB "%6.3" "" COMPU_TAB_REF SY_FGR_Compu /end COMPU_METHOD
/begin COMPU_VTAB SY_FGR_Compu "" TAB_VERB 2 0 "0" 1 "1" /end COMPU_VTAB
/begin COMPU_METHOD SY_FLUQ_Compu "" RAT_FUNC "%6.2" "" COEFFS 0 1 0 0 0 1 /end COMPU_METHOD
/begin COMPU_METHOD SY_FPCSSP_Compu "" TAB_VERB "%6.3" "" COMPU_TAB_REF SY_FPCSSP_Compu /end COMPU_METHOD
/begin COMPU_VTAB SY_FPCSSP_Compu "" TAB_VERB 2 0 "False" 1 "True" /end COMPU_VTAB
/begin COMPU_METHOD SY_GAP2SYN_Compu "" RAT_FUNC "%6.2" "" COEFFS 0 1 0 0 0 1 /end COMPU_METHOD
/begin COMPU_METHOD SY_GAP_Compu "" TAB_VERB "%6.3" "" COMPU_TAB_REF SY_GAP_Compu /end COMPU_METHOD
/begin COMPU_VTAB SY_GAP_Compu "" TAB_VERB 3 1 "1" 2 "2" 3 "3" /end COMPU_VTAB
/begin COMPU_METHOD SY_GDIPFI_Compu "" TAB_VERB "%6.3" "" COMPU_TAB_REF SY_GDIPFI_Compu /end COMPU_METHOD
/begin COMPU_VTAB SY_GDIPFI_Compu "" TAB_VERB 2 0 "False" 1 "True" /end COMPU_VTAB
/begin COMPU_METHOD SY_HALVEZYLZA_Compu "" TAB_VERB "%6.3" "" COMPU_TAB_REF SY_HALVEZYLZA_Compu /end COMPU_METHOD
/begin COMPU_VTAB SY_HALVEZYLZA_Compu "" TAB_VERB 2 0 "False" 1 "True" /end COMPU_VTAB
/begin COMPU_METHOD SY_HEV_Compu "" TAB_VERB "%6.3" "" COMPU_TAB_REF SY_HEV_Compu /end COMPU_METHOD
/begin COMPU_VTAB SY_HEV_Compu "" TAB_VERB 8 0 "0" 1 "HEVTYP_SER" 2 "HEVTYP_SERPARL" 3 "HEVTYP_PWRSPLT" 4 "HEVTYP_PARL" 5 "HEVTYP_EAD" 6 "HEVTYP_EDCT" 7 "HEVTYP_PARLSER" /end COMPU_VTAB
/begin COMPU_METHOD SY_HFMKOMP_Compu "" TAB_VERB "%6.3" "" COMPU_TAB_REF SY_HFMKOMP_Compu /end COMPU_METHOD
/begin COMPU_VTAB SY_HFMKOMP_Compu "" TAB_VERB 8 0 "no HFM" 1 "voltage output" 2 "frequency output with correction factor" 3 "frequency output without correction factor" 4 "frequency output with double range (up to 1,6ms)" 5 "analogues voltage output with component self diag." 6 "Air flow sensor with SENT interface" 7 "Air flow sensor with SENT or PWM Interface" /end COMPU_VTAB
/begin COMPU_METHOD SY_HFM_Compu "" TAB_VERB "%6.3" "" COMPU_TAB_REF SY_HFM_Compu /end COMPU_METHOD
/begin COMPU_VTAB SY_HFM_Compu "" TAB_VERB 3 0 "kein HFM verbaut" 1 "HFM verbaut (vor Verdichter)" 2 "HFM verbaut (nach Verdichter)" /end COMPU_VTAB
/begin COMPU_METHOD SY_HIENGSPD_Compu "" TAB_VERB "%6.3" "" COMPU_TAB_REF SY_HIENGSPD_Compu /end COMPU_METHOD
/begin COMPU_VTAB SY_HIENGSPD_Compu "" TAB_VERB 2 0 "False" 1 "True" /end COMPU_VTAB
/begin COMPU_METHOD SY_HKS_Compu "" TAB_VERB "%6.3" "" COMPU_TAB_REF SY_HKS_Compu /end COMPU_METHOD
/begin COMPU_VTAB SY_HKS_Compu "" TAB_VERB 2 0 "HomogenKlopfSchutz nicht vorhanden" 1 "HomogenKlopfSchutz vorhanden" /end COMPU_VTAB
/begin COMPU_METHOD SY_HLSHFET_Compu "" TAB_VERB "%6.3" "" COMPU_TAB_REF SY_HLSHFET_Compu /end COMPU_METHOD
/begin COMPU_VTAB SY_HLSHFET_Compu "" TAB_VERB 2 0 "keine FET-Endstufe vorhanden" 1 "FET-Endstufe vorhanden" /end COMPU_VTAB
/begin COMPU_METHOD SY_HLSVFET_Compu "" TAB_VERB "%6.3" "" COMPU_TAB_REF SY_HLSVFET_Compu /end COMPU_METHOD
/begin COMPU_VTAB SY_HLSVFET_Compu "" TAB_VERB 2 0 "FALSE" 1 "TRUE" /end COMPU_VTAB
/begin COMPU_METHOD SY_HMBMBA_Compu "" TAB_VERB "%6.3" "" COMPU_TAB_REF SY_HMBMBA_Compu /end COMPU_METHOD
/begin COMPU_VTAB SY_HMBMBA_Compu "" TAB_VERB 2 0 "False" 1 "True" /end COMPU_VTAB
/begin COMPU_METHOD SY_HMB_Compu "" TAB_VERB "%6.3" "" COMPU_TAB_REF SY_HMB_Compu /end COMPU_METHOD
/begin COMPU_VTAB SY_HMB_Compu "" TAB_VERB 3 0 "No HMB" 1 "CDA" 2 "BDA" /end COMPU_VTAB
/begin COMPU_METHOD SY_HMM_Compu "" TAB_VERB "%6.3" "" COMPU_TAB_REF SY_HMM_Compu /end COMPU_METHOD
/begin COMPU_VTAB SY_HMM_Compu "" TAB_VERB 2 0 "kein HMM-Betrieb vorhanden" 1 "HMM-Betrieb vorhanden" /end COMPU_VTAB
/begin COMPU_METHOD SY_HOS_Compu "" TAB_VERB "%6.3" "" COMPU_TAB_REF SY_HOS_Compu /end COMPU_METHOD
/begin COMPU_VTAB SY_HOS_Compu "" TAB_VERB 2 0 "False" 1 "True" /end COMPU_VTAB
/begin COMPU_METHOD SY_HSP_Compu "" TAB_VERB "%6.3" "" COMPU_TAB_REF SY_HSP_Compu /end COMPU_METHOD
/begin COMPU_VTAB SY_HSP_Compu "" TAB_VERB 2 0 "FALSE" 1 "TRUE" /end COMPU_VTAB
/begin COMPU_METHOD SY_IGNABP_Compu "" TAB_VERB "%6.3" "" COMPU_TAB_REF SY_IGNABP_Compu /end COMPU_METHOD
/begin COMPU_VTAB SY_IGNABP_Compu "" TAB_VERB 2 0 "False" 1 "True" /end COMPU_VTAB
/begin COMPU_METHOD SY_INJASYN_Compu "" TAB_VERB "%6.3" "" COMPU_TAB_REF SY_INJASYN_Compu /end COMPU_METHOD
/begin COMPU_VTAB SY_INJASYN_Compu "" TAB_VERB 2 0 "False" 1 "True" /end COMPU_VTAB
/begin COMPU_METHOD SY_IPRCRSH_Compu "" TAB_VERB "%6.3" "" COMPU_TAB_REF SY_IPRCRSH_Compu /end COMPU_METHOD
/begin COMPU_VTAB SY_IPRCRSH_Compu "" TAB_VERB 2 0 "False" 1 "True" /end COMPU_VTAB
/begin COMPU_METHOD SY_ISG_Compu "" TAB_VERB "%6.3" "" COMPU_TAB_REF SY_ISG_Compu /end COMPU_METHOD
/begin COMPU_VTAB SY_ISG_Compu "" TAB_VERB 2 0 "False" 1 "True" /end COMPU_VTAB
/begin COMPU_METHOD SY_IUMPR_Compu "" TAB_VERB "%6.3" "" COMPU_TAB_REF SY_IUMPR_Compu /end COMPU_METHOD
/begin COMPU_VTAB SY_IUMPR_Compu "" TAB_VERB 2 0 "keine Auswetung der IUMPR" 1 "Auswertung der IUMPR" /end COMPU_VTAB
/begin COMPU_METHOD SY_KAC_Compu "" TAB_VERB "%6.3" "" COMPU_TAB_REF SY_KAC_Compu /end COMPU_METHOD
/begin COMPU_VTAB SY_KAC_Compu "" TAB_VERB 7 0 "ohne A/C" 1 "mit A/C Verdampfertemperaturesensor" 2 "mit A/C Drucksensor" 3 "mit Druckschalter" 4 "mit Druckschalter und Evap Temp sensor" 5 "mit A/C drucksensor und Evap Temp sensor" 6 "mit 2 Druckschalter,kein Evap Sens.,kein Drucksens" /end COMPU_VTAB
/begin COMPU_METHOD SY_KCLD_Compu "" TAB_VERB "%6.3" "" COMPU_TAB_REF SY_KCLD_Compu /end COMPU_METHOD
/begin COMPU_VTAB SY_KCLD_Compu "" TAB_VERB 2 0 "False" 1 "True" /end COMPU_VTAB
/begin COMPU_METHOD SY_KDS_Compu "" TAB_VERB "%6.3" "" COMPU_TAB_REF SY_KDS_Compu /end COMPU_METHOD
/begin COMPU_VTAB SY_KDS_Compu "" TAB_VERB 2 0 "False" 1 "True" /end COMPU_VTAB
/begin COMPU_METHOD SY_KL50_Compu "" TAB_VERB "%6.3" "" COMPU_TAB_REF SY_KL50_Compu /end COMPU_METHOD
/begin COMPU_VTAB SY_KL50_Compu "" TAB_VERB 2 0 "kein Anlasserkontakt vorhanden" 1 "Anlasserkontakt vorhanden" /end COMPU_VTAB
/begin COMPU_METHOD SY_KLAF_Compu "" TAB_VERB "%6.3" "" COMPU_TAB_REF SY_KLAF_Compu /end COMPU_METHOD
/begin COMPU_VTAB SY_KLAF_Compu "" TAB_VERB 3 0 "no_KLAF" 1 "sload_KLAF" 2 "mload_KLAF" /end COMPU_VTAB
/begin COMPU_METHOD SY_KORRZ_Compu "" RAT_FUNC "%6.2" "" COEFFS 0 1 0 0 0 1 /end COMPU_METHOD
/begin COMPU_METHOD SY_KSE_Compu "" TAB_VERB "%6.3" "" COMPU_TAB_REF SY_KSE_Compu /end COMPU_METHOD
/begin COMPU_VTAB SY_KSE_Compu "" TAB_VERB 2 0 "False" 1 "True" /end COMPU_VTAB
/begin COMPU_METHOD SY_KSZA_Compu "" TAB_VERB "%6.3" "" COMPU_TAB_REF SY_KSZA_Compu /end COMPU_METHOD
/begin COMPU_VTAB SY_KSZA_Compu "" TAB_VERB 5 0 "number of knock sensors is 0" 1 "number of knock sensors is 1" 2 "number of knock sensors is 2" 3 "number of knock sensors is 3" 4 "number of knock sensors is 4" /end COMPU_VTAB
/begin COMPU_METHOD SY_KTIGNBI_Compu "" TAB_VERB "%6.3" "" COMPU_TAB_REF SY_KTIGNBI_Compu /end COMPU_METHOD
/begin COMPU_VTAB SY_KTIGNBI_Compu "" TAB_VERB 2 0 "False" 1 "True" /end COMPU_VTAB
/begin COMPU_METHOD SY_KT_Compu "" RAT_FUNC "%6.2" "" COEFFS 0 1 0 0 0 1 /end COMPU_METHOD
/begin COMPU_METHOD SY_LAMKOP_Compu "" TAB_VERB "%6.3" "" COMPU_TAB_REF SY_LAMKOP_Compu /end COMPU_METHOD
/begin COMPU_VTAB SY_LAMKOP_Compu "" TAB_VERB 2 0 "False" 1 "True" /end COMPU_VTAB
/begin COMPU_METHOD SY_LBK_Compu "" TAB_VERB "%6.3" "" COMPU_TAB_REF SY_LBK_Compu /end COMPU_METHOD
/begin COMPU_VTAB SY_LBK_Compu "" TAB_VERB 7 0 "keine Ladungsbewegungsklappe vorhanden" 1 "Ladungsbewegungsklappe ohne Lagerückmeldung vorhan" 2 "Ladungsbewegungsklappe mit Lagerückmeldung vorhand" 3 "Ladungsbewegungsklappe kontiniuierlich mit DC Moto" 4 "Ladungsbewegungsklappe kontinuierlich mit Stepper" 5 "kontinuierliche LBK mit Lageregelung vor Ort" 6 "kontinuierliche LBK mit Lageregelung im SG" /end COMPU_VTAB
/begin COMPU_METHOD SY_LLSGSTA_Compu "" TAB_VERB "%6.3" "" COMPU_TAB_REF SY_LLSGSTA_Compu /end COMPU_METHOD
/begin COMPU_VTAB SY_LLSGSTA_Compu "" TAB_VERB 2 0 "0" 1 "1" /end COMPU_VTAB
/begin COMPU_METHOD SY_LLSKOMP_Compu "" TAB_VERB "%6.3" "" COMPU_TAB_REF SY_LLSKOMP_Compu /end COMPU_METHOD
/begin COMPU_VTAB SY_LLSKOMP_Compu "" TAB_VERB 5 0 "NO_ISA" 1 "STEPPER_MOTOR_ISA" 2 "SNGL_WINDING_COIL_ISA" 3 "DBL_WINDING_COIL_ISA" 4 "PLS_TYP_ISA" /end COMPU_VTAB
/begin COMPU_METHOD SY_LRHK_Compu "" TAB_VERB "%6.3" "" COMPU_TAB_REF SY_LRHK_Compu /end COMPU_METHOD
/begin COMPU_VTAB SY_LRHK_Compu "" TAB_VERB 2 0 "0" 1 "1" /end COMPU_VTAB
/begin COMPU_METHOD SY_LRSTA_Compu "" TAB_VERB "%6.3" "" COMPU_TAB_REF SY_LRSTA_Compu /end COMPU_METHOD
/begin COMPU_VTAB SY_LRSTA_Compu "" TAB_VERB 2 0 "False" 1 "True" /end COMPU_VTAB
/begin COMPU_METHOD SY_LSFIKR2_Compu "" TAB_VERB "%6.3" "" COMPU_TAB_REF SY_LSFIKR2_Compu /end COMPU_METHOD
/begin COMPU_VTAB SY_LSFIKR2_Compu "" TAB_VERB 2 0 "False" 1 "True" /end COMPU_VTAB
/begin COMPU_METHOD SY_LSFIKR_Compu "" TAB_VERB "%6.3" "" COMPU_TAB_REF SY_LSFIKR_Compu /end COMPU_METHOD
/begin COMPU_VTAB SY_LSFIKR_Compu "" TAB_VERB 2 0 "0" 1 "1" /end COMPU_VTAB
/begin COMPU_METHOD SY_LSFNHK2_Compu "" TAB_VERB "%6.3" "" COMPU_TAB_REF SY_LSFNHK2_Compu /end COMPU_METHOD
/begin COMPU_VTAB SY_LSFNHK2_Compu "" TAB_VERB 2 0 "keine LSF nach Hauptkat in Bank2 verbaut" 1 "LSF nach Hauptkat in Bank2 verbaut" /end COMPU_VTAB
/begin COMPU_METHOD SY_LSFNHK_Compu "" TAB_VERB "%6.3" "" COMPU_TAB_REF SY_LSFNHK_Compu /end COMPU_METHOD
/begin COMPU_VTAB SY_LSFNHK_Compu "" TAB_VERB 2 0 "keine LSF nach Hauptkat verbaut" 1 "LSF nach Hauptkat verbaut" /end COMPU_VTAB
/begin COMPU_METHOD SY_LSFNTL2_Compu "" TAB_VERB "%6.3" "" COMPU_TAB_REF SY_LSFNTL2_Compu /end COMPU_METHOD
/begin COMPU_VTAB SY_LSFNTL2_Compu "" TAB_VERB 2 0 "False" 1 "True" /end COMPU_VTAB
/begin COMPU_METHOD SY_LSFNTL_Compu "" TAB_VERB "%6.3" "" COMPU_TAB_REF SY_LSFNTL_Compu /end COMPU_METHOD
/begin COMPU_VTAB SY_LSFNTL_Compu "" TAB_VERB 2 0 "False" 1 "True" /end COMPU_VTAB
/begin COMPU_METHOD SY_LSFNVK2_Compu "" TAB_VERB "%6.3" "" COMPU_TAB_REF SY_LSFNVK2_Compu /end COMPU_METHOD
/begin COMPU_VTAB SY_LSFNVK2_Compu "" TAB_VERB 2 0 "keine Lambdasonde hinter Frontakat Bank 2" 1 "Lambdasonde hinter Frontakat Bank 2" /end COMPU_VTAB
/begin COMPU_METHOD SY_LSFNVK_Compu "" TAB_VERB "%6.3" "" COMPU_TAB_REF SY_LSFNVK_Compu /end COMPU_METHOD
/begin COMPU_VTAB SY_LSFNVK_Compu "" TAB_VERB 2 0 "keine Lambdasonde hinter dem Frontakat vorhanden" 1 "Lambdasonde hinter dem Frontakat vorhanden" /end COMPU_VTAB
/begin COMPU_METHOD SY_LSFVHK2_Compu "" TAB_VERB "%6.3" "" COMPU_TAB_REF SY_LSFVHK2_Compu /end COMPU_METHOD
/begin COMPU_VTAB SY_LSFVHK2_Compu "" TAB_VERB 2 0 "False" 1 "True" /end COMPU_VTAB
/begin COMPU_METHOD SY_LSFVHK_Compu "" TAB_VERB "%6.3" "" COMPU_TAB_REF SY_LSFVHK_Compu /end COMPU_METHOD
/begin COMPU_VTAB SY_LSFVHK_Compu "" TAB_VERB 2 0 "False" 1 "True" /end COMPU_VTAB
/begin COMPU_METHOD SY_LSFVVK2_Compu "" TAB_VERB "%6.3" "" COMPU_TAB_REF SY_LSFVVK2_Compu /end COMPU_METHOD
/begin COMPU_VTAB SY_LSFVVK2_Compu "" TAB_VERB 2 0 "keine LSF vor Vorkatalysator, Bank2 vorhanden" 1 "LSF vor Vorkatalysator, Bank2 vorhanden" /end COMPU_VTAB
/begin COMPU_METHOD SY_LSFVVK_Compu "" TAB_VERB "%6.3" "" COMPU_TAB_REF SY_LSFVVK_Compu /end COMPU_METHOD
/begin COMPU_VTAB SY_LSFVVK_Compu "" TAB_VERB 2 0 "keine LSF vor Vorkatalysator vorhanden" 1 "LSF vor Vorkatalysator vorhanden" /end COMPU_VTAB
/begin COMPU_METHOD SY_LSUIKR2_Compu "" TAB_VERB "%6.3" "" COMPU_TAB_REF SY_LSUIKR2_Compu /end COMPU_METHOD
/begin COMPU_VTAB SY_LSUIKR2_Compu "" TAB_VERB 2 0 "keine LSU im Abgaskrümmer Bank2 vorhanden" 1 "LSU im Abgaskrümmer Bank2 vorhanden" /end COMPU_VTAB
/begin COMPU_METHOD SY_LSUIKR_Compu "" TAB_VERB "%6.3" "" COMPU_TAB_REF SY_LSUIKR_Compu /end COMPU_METHOD
/begin COMPU_VTAB SY_LSUIKR_Compu "" TAB_VERB 2 0 "keine LSU im Abgaskrümmer vorhanden" 1 "LSU im Abgaskrümmer vorhanden" /end COMPU_VTAB
/begin COMPU_METHOD SY_LSUNHK2_Compu "" TAB_VERB "%6.3" "" COMPU_TAB_REF SY_LSUNHK2_Compu /end COMPU_METHOD
/begin COMPU_VTAB SY_LSUNHK2_Compu "" TAB_VERB 2 0 "LSU nicht nach Hauptkat, Bank2 verbaut" 1 "LSU nach Hauptkat, Bank2 verbaut" /end COMPU_VTAB
/begin COMPU_METHOD SY_LSUNHK_Compu "" TAB_VERB "%6.3" "" COMPU_TAB_REF SY_LSUNHK_Compu /end COMPU_METHOD
/begin COMPU_VTAB SY_LSUNHK_Compu "" TAB_VERB 2 0 "keine LSU nach Hauptkatalysator" 1 "LSU nach Hauptkatalysator" /end COMPU_VTAB
/begin COMPU_METHOD SY_LSUNTL2_Compu "" TAB_VERB "%6.3" "" COMPU_TAB_REF SY_LSUNTL2_Compu /end COMPU_METHOD
/begin COMPU_VTAB SY_LSUNTL2_Compu "" TAB_VERB 2 0 "keine LSU nach Abgasturbolader, Bank2" 1 "LSU nach Abgasturbolader, Bank2" /end COMPU_VTAB
/begin COMPU_METHOD SY_LSUNTL_Compu "" TAB_VERB "%6.3" "" COMPU_TAB_REF SY_LSUNTL_Compu /end COMPU_METHOD
/begin COMPU_VTAB SY_LSUNTL_Compu "" TAB_VERB 2 0 "keine LSU nach Abgasturbolader" 1 "LSU nach Abgasturbolader" /end COMPU_VTAB
/begin COMPU_METHOD SY_LSUNVK2_Compu "" TAB_VERB "%6.3" "" COMPU_TAB_REF SY_LSUNVK2_Compu /end COMPU_METHOD
/begin COMPU_VTAB SY_LSUNVK2_Compu "" TAB_VERB 2 0 "keine LSU nach Vorkat, Bank 2" 1 "LSU nach Vorkatalysator, Bank 2 verbaut" /end COMPU_VTAB
/begin COMPU_METHOD SY_LSUNVK_Compu "" TAB_VERB "%6.3" "" COMPU_TAB_REF SY_LSUNVK_Compu /end COMPU_METHOD
/begin COMPU_VTAB SY_LSUNVK_Compu "" TAB_VERB 2 0 "keine LSU nach Vorkatalysator" 1 "LSU nach Vorkatalysator" /end COMPU_VTAB
/begin COMPU_METHOD SY_LSUVHK2_Compu "" TAB_VERB "%6.3" "" COMPU_TAB_REF SY_LSUVHK2_Compu /end COMPU_METHOD
/begin COMPU_VTAB SY_LSUVHK2_Compu "" TAB_VERB 2 0 "keine LSU vor Hauptkatalysator, Bank 2 verbaut" 1 "LSU vor Hauptkatalysator, Bank 2 verbaut" /end COMPU_VTAB
/begin COMPU_METHOD SY_LSUVHK_Compu "" TAB_VERB "%6.3" "" COMPU_TAB_REF SY_LSUVHK_Compu /end COMPU_METHOD
/begin COMPU_VTAB SY_LSUVHK_Compu "" TAB_VERB 2 0 "keine LSU vor Hauptkatalysator" 1 "LSU vor Hauptkatalysator" /end COMPU_VTAB
/begin COMPU_METHOD SY_LSUVVK2_Compu "" TAB_VERB "%6.3" "" COMPU_TAB_REF SY_LSUVVK2_Compu /end COMPU_METHOD
/begin COMPU_VTAB SY_LSUVVK2_Compu "" TAB_VERB 2 0 "keine LSU vor Vorkatalysator, Bank2" 1 "LSU vor Vorkatalysator, Bank2" /end COMPU_VTAB
/begin COMPU_METHOD SY_LSUVVK_Compu "" TAB_VERB "%6.3" "" COMPU_TAB_REF SY_LSUVVK_Compu /end COMPU_METHOD
/begin COMPU_VTAB SY_LSUVVK_Compu "" TAB_VERB 2 0 "keine LSU vor Vorkatalysator" 1 "LSU vor Vorkatalysator" /end COMPU_VTAB
/begin COMPU_METHOD SY_LSZYVER_Compu "" TAB_VERB "%6.3" "" COMPU_TAB_REF SY_LSZYVER_Compu /end COMPU_METHOD
/begin COMPU_VTAB SY_LSZYVER_Compu "" TAB_VERB 2 0 "False" 1 "True" /end COMPU_VTAB
/begin COMPU_METHOD SY_LS_Compu "" TAB_VERB "%6.3" "" COMPU_TAB_REF SY_LS_Compu /end COMPU_METHOD
/begin COMPU_VTAB SY_LS_Compu "" TAB_VERB 2 0 "Lambda-Split nicht vorhanden" 1 "Lambda-Split vorhanden" /end COMPU_VTAB
/begin COMPU_METHOD SY_LUART_Compu "" TAB_VERB "%6.3" "" COMPU_TAB_REF SY_LUART_Compu /end COMPU_METHOD
/begin COMPU_VTAB SY_LUART_Compu "" TAB_VERB 2 0 "Lüfter gesteuert" 1 "Lüfter geschaltet" /end COMPU_VTAB
/begin COMPU_METHOD SY_LUESTA_Compu "" TAB_VERB "%6.3" "" COMPU_TAB_REF SY_LUESTA_Compu /end COMPU_METHOD
/begin COMPU_VTAB SY_LUESTA_Compu "" TAB_VERB 2 0 "False" 1 "True" /end COMPU_VTAB
/begin COMPU_METHOD SY_LUFAK_Compu "" RAT_FUNC "%6.2" "" COEFFS 0 1 0 0 0 1 /end COMPU_METHOD
/begin COMPU_METHOD SY_LUSRKR_Compu "" TAB_VERB "%6.3" "" COMPU_TAB_REF SY_LUSRKR_Compu /end COMPU_METHOD
/begin COMPU_VTAB SY_LUSRKR_Compu "" TAB_VERB 3 0 "no Scavenging" 1 "Scavenging with Inlet Cam Phasing" 2 "Scavenging with Inlet and Exhaust Cam Phasing" /end COMPU_VTAB
/begin COMPU_METHOD SY_MDBGV_Compu "" TAB_VERB "%6.3" "" COMPU_TAB_REF SY_MDBGV_Compu /end COMPU_METHOD
/begin COMPU_VTAB SY_MDBGV_Compu "" TAB_VERB 2 0 "False" 1 "True" /end COMPU_VTAB
/begin COMPU_METHOD SY_MDMXEXC_Compu "" TAB_VERB "%6.3" "" COMPU_TAB_REF SY_MDMXEXC_Compu /end COMPU_METHOD
/begin COMPU_VTAB SY_MDMXEXC_Compu "" TAB_VERB 2 0 "False" 1 "True" /end COMPU_VTAB
/begin COMPU_METHOD SY_MODE5_Compu "" TAB_VERB "%6.3" "" COMPU_TAB_REF SY_MODE5_Compu /end COMPU_METHOD
/begin COMPU_VTAB SY_MODE5_Compu "" TAB_VERB 2 0 "False" 1 "True" /end COMPU_VTAB
/begin COMPU_METHOD SY_MOROM_Compu "" TAB_VERB "%6.3" "" COMPU_TAB_REF SY_MOROM_Compu /end COMPU_METHOD
/begin COMPU_VTAB SY_MOROM_Compu "" TAB_VERB 2 0 "False" 1 "True" /end COMPU_VTAB
/begin COMPU_METHOD SY_MSGRED_Compu "" TAB_VERB "%6.3" "" COMPU_TAB_REF SY_MSGRED_Compu /end COMPU_METHOD
/begin COMPU_VTAB SY_MSGRED_Compu "" TAB_VERB 2 0 "False" 1 "True" /end COMPU_VTAB
/begin COMPU_METHOD SY_MSR_Compu "" TAB_VERB "%6.3" "" COMPU_TAB_REF SY_MSR_Compu /end COMPU_METHOD
/begin COMPU_VTAB SY_MSR_Compu "" TAB_VERB 2 0 "False" 1 "True" /end COMPU_VTAB
/begin COMPU_METHOD SY_NGFADIO_Compu "" TAB_VERB "%6.3" "" COMPU_TAB_REF SY_NGFADIO_Compu /end COMPU_METHOD
/begin COMPU_VTAB SY_NGFADIO_Compu "" TAB_VERB 2 0 "False" 1 "True" /end COMPU_VTAB
/begin COMPU_METHOD SY_NG_Compu "" TAB_VERB "%6.3" "" COMPU_TAB_REF SY_NG_Compu /end COMPU_METHOD
/begin COMPU_VTAB SY_NG_Compu "" TAB_VERB 4 0 "SY_NG_0" 1 "SY_NG_1" 2 "SY_NG_2" 3 "SY_NG_3" /end COMPU_VTAB
/begin COMPU_METHOD SY_NIGNCL_Compu "" RAT_FUNC "%6.2" "" COEFFS 0 1 0 0 0 1 /end COMPU_METHOD
/begin COMPU_METHOD SY_NLDG_Compu "" TAB_VERB "%6.3" "" COMPU_TAB_REF SY_NLDG_Compu /end COMPU_METHOD
/begin COMPU_VTAB SY_NLDG_Compu "" TAB_VERB 2 0 "keine Drehzahlgebernotlauf-Funktion aktiv" 1 "Drehzahlgebernotlauf-Funktion aktiv" /end COMPU_VTAB
/begin COMPU_METHOD SY_NLZOFF_Compu "" TAB_VERB "%6.3" "" COMPU_TAB_REF SY_NLZOFF_Compu /end COMPU_METHOD
/begin COMPU_VTAB SY_NLZOFF_Compu "" TAB_VERB 2 0 "false" 1 "true" /end COMPU_VTAB
/begin COMPU_METHOD SY_NMAXAIR_Compu "" TAB_VERB "%6.3" "" COMPU_TAB_REF SY_NMAXAIR_Compu /end COMPU_METHOD
/begin COMPU_VTAB SY_NMAXAIR_Compu "" TAB_VERB 2 0 "False" 1 "True" /end COMPU_VTAB
/begin COMPU_METHOD SY_NOHK2_Compu "" TAB_VERB "%6.3" "" COMPU_TAB_REF SY_NOHK2_Compu /end COMPU_METHOD
/begin COMPU_VTAB SY_NOHK2_Compu "" TAB_VERB 2 0 "kein NOx-Sensor hinter Kat in Bank2" 1 "NOx-Sensor hinter Kat in Bank2" /end COMPU_VTAB
/begin COMPU_METHOD SY_NOHK_Compu "" TAB_VERB "%6.3" "" COMPU_TAB_REF SY_NOHK_Compu /end COMPU_METHOD
/begin COMPU_VTAB SY_NOHK_Compu "" TAB_VERB 2 0 "kein NOx-Sensor hinter Kat" 1 "NOx-Sensor hinter Kat" /end COMPU_VTAB
/begin COMPU_METHOD SY_NSYNC_Compu "" RAT_FUNC "%6.2" "" COEFFS 0 1 0 0 0 1 /end COMPU_METHOD
/begin COMPU_METHOD SY_NUMGAP_Compu "" RAT_FUNC "%6.2" "" COEFFS 0 1 0 0 0 1 /end COMPU_METHOD
/begin COMPU_METHOD SY_NVLD_Compu "" TAB_VERB "%6.3" "" COMPU_TAB_REF SY_NVLD_Compu /end COMPU_METHOD
/begin COMPU_VTAB SY_NVLD_Compu "" TAB_VERB 2 0 "False" 1 "True" /end COMPU_VTAB
/begin COMPU_METHOD SY_NWGA2_Compu "" TAB_VERB "%6.3" "" COMPU_TAB_REF SY_NWGA2_Compu /end COMPU_METHOD
/begin COMPU_VTAB SY_NWGA2_Compu "" TAB_VERB 5 0 "kein Phasengeber auf Nockenwelle verbaut" 1 "Phasengeber 1 auf Nockenwelle Auslass 2" 2 "Phasengeber 2 auf Nockenwelle Auslass 2" 3 "Phasengeber 3 auf Nockenwelle Auslass 2" 4 "Phasengeber 4 auf Nockenwelle Auslass 2" /end COMPU_VTAB
/begin COMPU_METHOD SY_NWGA_Compu "" TAB_VERB "%6.3" "" COMPU_TAB_REF SY_NWGA_Compu /end COMPU_METHOD
/begin COMPU_VTAB SY_NWGA_Compu "" TAB_VERB 5 0 "kein Phasengeber auf Nockenwelle verbaut" 1 "Phasengeber 1 auf Nockenwelle Auslass" 2 "Phasengeber 2 auf Nockenwelle Auslass" 3 "Phasengeber 3 auf Nockenwelle Auslass" 4 "Phasengeber 4 auf Nockenwelle Auslass" /end COMPU_VTAB
/begin COMPU_METHOD SY_NWGE2_Compu "" TAB_VERB "%6.3" "" COMPU_TAB_REF SY_NWGE2_Compu /end COMPU_METHOD
/begin COMPU_VTAB SY_NWGE2_Compu "" TAB_VERB 5 0 "kein Phasengeber auf Nockenwelle verbaut" 1 "Phasengeber 1 auf Nockenwelle Einlass 2" 2 "Phasengeber 2 auf Nockenwelle Einlass 2" 3 "Phasengeber 3 auf Nockenwelle Einlass 2" 4 "Phasengeber 4 auf Nockenwelle Einlass 2" /end COMPU_VTAB
/begin COMPU_METHOD SY_NWGE_Compu "" TAB_VERB "%6.3" "" COMPU_TAB_REF SY_NWGE_Compu /end COMPU_METHOD
/begin COMPU_VTAB SY_NWGE_Compu "" TAB_VERB 5 0 "kein Phasengeber auf Nockenwelle verbaut" 1 "Phasengeber 1 auf Nockenwelle Einlass" 2 "Phasengeber 2 auf Nockenwelle Einlass" 3 "Phasengeber 3 auf Nockenwelle Einlass" 4 "Phasengeber 4 auf Nockenwelle Einlass" /end COMPU_VTAB
/begin COMPU_METHOD SY_NWSA_Compu "" TAB_VERB "%6.3" "" COMPU_TAB_REF SY_NWSA_Compu /end COMPU_METHOD
/begin COMPU_VTAB SY_NWSA_Compu "" TAB_VERB 3 0 "no outlet camshaft control" 1 "2 point outlet camshaft control" 2 "continuous outlet camshaft control" /end COMPU_VTAB
/begin COMPU_METHOD SY_NWS_Compu "" TAB_VERB "%6.3" "" COMPU_TAB_REF SY_NWS_Compu /end COMPU_METHOD
/begin COMPU_VTAB SY_NWS_Compu "" TAB_VERB 3 0 "keine Nockenwellensteuerung vorhanden" 1 "2 Punkt Nockenwellensteuerung vorhanden" 2 "kontinuierliche Nockenwellensteuerung vorhanden" /end COMPU_VTAB
/begin COMPU_METHOD SY_OVHP_Compu "" TAB_VERB "%6.3" "" COMPU_TAB_REF SY_OVHP_Compu /end COMPU_METHOD
/begin COMPU_VTAB SY_OVHP_Compu "" TAB_VERB 2 0 "False" 1 "True" /end COMPU_VTAB
/begin COMPU_METHOD SY_PGRAD2_Compu "" TAB_VERB "%6.3" "" COMPU_TAB_REF SY_PGRAD2_Compu /end COMPU_METHOD
/begin COMPU_VTAB SY_PGRAD2_Compu "" TAB_VERB 3 0 "Phasengeber 2 nicht verbaut" 1 "Phasengeber 2 Normalfunktion" 4 "Phasengeber 2 mit Schnellstart" /end COMPU_VTAB
/begin COMPU_METHOD SY_PGRAD_Compu "" TAB_VERB "%6.3" "" COMPU_TAB_REF SY_PGRAD_Compu /end COMPU_METHOD
/begin COMPU_VTAB SY_PGRAD_Compu "" TAB_VERB 3 0 "Phasengeber 1 nicht verbaut" 1 "Phasengeber 1 Normalfunktion" 4 "Phasengeber 1 mit Schnellstart" /end COMPU_VTAB
/begin COMPU_METHOD SY_PGRD01E_Compu "" TAB_VERB "%6.3" "" COMPU_TAB_REF SY_PGRD01E_Compu /end COMPU_METHOD
/begin COMPU_VTAB SY_PGRD01E_Compu "" TAB_VERB 5 0 "0" 1 "1" 2 "2" 3 "3" 4 "4" /end COMPU_VTAB
/begin COMPU_METHOD SY_PGRD04E_Compu "" RAT_FUNC "%6.2" "" COEFFS 0 1 0 0 0 1 /end COMPU_METHOD
/begin COMPU_METHOD SY_PHAS2NEG_Compu "" TAB_VERB "%6.3" "" COMPU_TAB_REF SY_PHAS2NEG_Compu /end COMPU_METHOD
/begin COMPU_VTAB SY_PHAS2NEG_Compu "" TAB_VERB 2 0 "False" 1 "True" /end COMPU_VTAB
/begin COMPU_METHOD SY_PHASNEG_Compu "" TAB_VERB "%6.3" "" COMPU_TAB_REF SY_PHASNEG_Compu /end COMPU_METHOD
/begin COMPU_VTAB SY_PHASNEG_Compu "" TAB_VERB 2 0 "False" 1 "True" /end COMPU_VTAB
/begin COMPU_METHOD SY_PHDETCALCLUTS_Compu "" TAB_VERB "%6.3" "" COMPU_TAB_REF SY_PHDETCALCLUTS_Compu /end COMPU_METHOD
/begin COMPU_VTAB SY_PHDETCALCLUTS_Compu "" TAB_VERB 2 0 "False" 1 "True" /end COMPU_VTAB
/begin COMPU_METHOD SY_PHDETMF_Compu "" TAB_VERB "%6.3" "" COMPU_TAB_REF SY_PHDETMF_Compu /end COMPU_METHOD
/begin COMPU_VTAB SY_PHDETMF_Compu "" TAB_VERB 3 0 "0" 1 "1" 2 "2" /end COMPU_VTAB
/begin COMPU_METHOD SY_PHDETSPDGRD_Compu "" TAB_VERB "%6.3" "" COMPU_TAB_REF SY_PHDETSPDGRD_Compu /end COMPU_METHOD
/begin COMPU_VTAB SY_PHDETSPDGRD_Compu "" TAB_VERB 3 0 "0" 1 "1" 2 "2" /end COMPU_VTAB
/begin COMPU_METHOD SY_PHDETZW_Compu "" TAB_VERB "%6.3" "" COMPU_TAB_REF SY_PHDETZW_Compu /end COMPU_METHOD
/begin COMPU_VTAB SY_PHDETZW_Compu "" TAB_VERB 2 0 "False" 1 "True" /end COMPU_VTAB
/begin COMPU_METHOD SY_PHDET_Compu "" TAB_VERB "%6.3" "" COMPU_TAB_REF SY_PHDET_Compu /end COMPU_METHOD
/begin COMPU_VTAB SY_PHDET_Compu "" TAB_VERB 7 0 "no_SW_phdet" 1 "ngrad_phdet" 2 "dmd_phdet_gap" 3 "dmd_phdet" 4 "ngrad_dmd_phdet_gap" 5 "ngrad_dmd_phdet" 6 "dss_phdet" /end COMPU_VTAB
/begin COMPU_METHOD SY_PHDTMAP_Compu "" TAB_VERB "%6.3" "" COMPU_TAB_REF SY_PHDTMAP_Compu /end COMPU_METHOD
/begin COMPU_VTAB SY_PHDTMAP_Compu "" TAB_VERB 3 0 "0" 1 "1" 2 "2" /end COMPU_VTAB
/begin COMPU_METHOD SY_PHFEPOS_Compu "" TAB_VERB "%6.3" "" COMPU_TAB_REF SY_PHFEPOS_Compu /end COMPU_METHOD
/begin COMPU_VTAB SY_PHFEPOS_Compu "" TAB_VERB 4 0 "BeforeGap0" 1 "AfterGap0" 2 "AtGap0" 3 "AtGap1" /end COMPU_VTAB
/begin COMPU_METHOD SY_PSTDRST_Compu "" TAB_VERB "%6.3" "" COMPU_TAB_REF SY_PSTDRST_Compu /end COMPU_METHOD
/begin COMPU_VTAB SY_PSTDRST_Compu "" TAB_VERB 2 0 "false" 1 "true" /end COMPU_VTAB
/begin COMPU_METHOD SY_PTO_Compu "" TAB_VERB "%6.3" "" COMPU_TAB_REF SY_PTO_Compu /end COMPU_METHOD
/begin COMPU_VTAB SY_PTO_Compu "" TAB_VERB 2 0 "False" 1 "True" /end COMPU_VTAB
/begin COMPU_METHOD SY_QSYN_Compu "" TAB_VERB "%6.3" "" COMPU_TAB_REF SY_QSYN_Compu /end COMPU_METHOD
/begin COMPU_VTAB SY_QSYN_Compu "" TAB_VERB 2 0 "DISABLED" 1 "ENABLED" /end COMPU_VTAB
/begin COMPU_METHOD SY_ROLLE_Compu "" TAB_VERB "%6.3" "" COMPU_TAB_REF SY_ROLLE_Compu /end COMPU_METHOD
/begin COMPU_VTAB SY_ROLLE_Compu "" TAB_VERB 2 0 "False" 1 "True" /end COMPU_VTAB
/begin COMPU_METHOD SY_ROVS_Compu "" TAB_VERB "%6.3" "" COMPU_TAB_REF SY_ROVS_Compu /end COMPU_METHOD
/begin COMPU_VTAB SY_ROVS_Compu "" TAB_VERB 2 0 "False" 1 "True" /end COMPU_VTAB
/begin COMPU_METHOD SY_SCH_Compu "" TAB_VERB "%6.3" "" COMPU_TAB_REF SY_SCH_Compu /end COMPU_METHOD
/begin COMPU_VTAB SY_SCH_Compu "" TAB_VERB 2 0 "False" 1 "True" /end COMPU_VTAB
/begin COMPU_METHOD SY_SDST_Compu "" TAB_VERB "%6.3" "" COMPU_TAB_REF SY_SDST_Compu /end COMPU_METHOD
/begin COMPU_VTAB SY_SDST_Compu "" TAB_VERB 2 0 "False" 1 "True" /end COMPU_VTAB
/begin COMPU_METHOD SY_SGANDVE_Compu "" TAB_VERB "%6.3" "" COMPU_TAB_REF SY_SGANDVE_Compu /end COMPU_METHOD
/begin COMPU_VTAB SY_SGANDVE_Compu "" TAB_VERB 2 1 "1SG pro DVE" 2 "2SG pro DVE" /end COMPU_VTAB
/begin COMPU_METHOD SY_SGANZ_Compu "" TAB_VERB "%6.3" "" COMPU_TAB_REF SY_SGANZ_Compu /end COMPU_METHOD
/begin COMPU_VTAB SY_SGANZ_Compu "" TAB_VERB 3 1 "Ein Steuergeräte Motormanagement Konzept" 2 "Zwei Steuergeräte Motormanagement Konzept" 3 "Drei Steuergeräte Motormanagement Konzept" /end COMPU_VTAB
/begin COMPU_METHOD SY_SKH_Compu "" TAB_VERB "%6.3" "" COMPU_TAB_REF SY_SKH_Compu /end COMPU_METHOD
/begin COMPU_VTAB SY_SKH_Compu "" TAB_VERB 2 0 "False" 1 "True" /end COMPU_VTAB
/begin COMPU_METHOD SY_SLS_Compu "" TAB_VERB "%6.3" "" COMPU_TAB_REF SY_SLS_Compu /end COMPU_METHOD
/begin COMPU_VTAB SY_SLS_Compu "" TAB_VERB 3 0 "keine Sekundärluftpumpe vorhanden" 1 "Sekundärluftpumpe vorhanden" 2 "GGSLSHFM vorhanden" /end COMPU_VTAB
/begin COMPU_METHOD SY_SLVANZ_Compu "" TAB_VERB "%6.3" "" COMPU_TAB_REF SY_SLVANZ_Compu /end COMPU_METHOD
/begin COMPU_VTAB SY_SLVANZ_Compu "" TAB_VERB 4 0 "kein SLV" 1 "1 SLV" 2 "2 SLV" 4 "4 SLV" /end COMPU_VTAB
/begin COMPU_METHOD SY_SSPDKP_Compu "" TAB_VERB "%6.3" "" COMPU_TAB_REF SY_SSPDKP_Compu /end COMPU_METHOD
/begin COMPU_VTAB SY_SSPDKP_Compu "" TAB_VERB 4 0 "powersupply diagnosis deactivated" 1 "Throttle sensors connected to powerstage1" 2 "Throttle sensors connected to powerstage2" 3 "Throttle sensors connected to powerstage3" /end COMPU_VTAB
/begin COMPU_METHOD SY_STASTO_Compu "" TAB_VERB "%6.3" "" COMPU_TAB_REF SY_STASTO_Compu /end COMPU_METHOD
/begin COMPU_VTAB SY_STASTO_Compu "" TAB_VERB 2 0 "Kein Start-Stopp" 1 "Start-Stop vorhanden" /end COMPU_VTAB
/begin COMPU_METHOD SY_STERVK_Compu "" TAB_VERB "%6.3" "" COMPU_TAB_REF SY_STERVK_Compu /end COMPU_METHOD
/begin COMPU_VTAB SY_STERVK_Compu "" TAB_VERB 2 0 "Mono Lambdaregelung vor KAT" 1 "Stereo Lambdaregelung vor KAT" /end COMPU_VTAB
/begin COMPU_METHOD SY_STETLR_Compu "" TAB_VERB "%6.3" "" COMPU_TAB_REF SY_STETLR_Compu /end COMPU_METHOD
/begin COMPU_VTAB SY_STETLR_Compu "" TAB_VERB 2 0 "2 Punkt Lambdaregelung vorhanden" 1 "stetige Lambdaregelung vorhanden" /end COMPU_VTAB
/begin COMPU_METHOD SY_SU_Compu "" TAB_VERB "%6.3" "" COMPU_TAB_REF SY_SU_Compu /end COMPU_METHOD
/begin COMPU_VTAB SY_SU_Compu "" TAB_VERB 3 0 "keine Saugrohrumschaltung" 1 "1 Saugrohrumschaltungsklappe" 2 "2 Saugrohrumschaltungsklappen" /end COMPU_VTAB
/begin COMPU_METHOD SY_SVBB_Compu "" TAB_VERB "%6.3" "" COMPU_TAB_REF SY_SVBB_Compu /end COMPU_METHOD
/begin COMPU_VTAB SY_SVBB_Compu "" TAB_VERB 2 0 "NOSVBB" 1 "SVBBETAS" /end COMPU_VTAB
/begin COMPU_METHOD SY_TEETH_Compu "" TAB_VERB "%6.3" "" COMPU_TAB_REF SY_TEETH_Compu /end COMPU_METHOD
/begin COMPU_VTAB SY_TEETH_Compu "" TAB_VERB 5 12 "number_of_crankshaft_wheel_teeth_is_12_minus_x" 24 "number_of_crankshaft_wheel_teeth_is_24_minus_x" 30 "number_of_crankshaft_wheel_teeth_is_30_minus_x" 36 "number of crankshaft wheel teeth is 36 minus x" 60 "number of crankshaft wheel teeth is 60 minus x" /end COMPU_VTAB
/begin COMPU_METHOD SY_TEVANZ_Compu "" TAB_VERB "%6.3" "" COMPU_TAB_REF SY_TEVANZ_Compu /end COMPU_METHOD
/begin COMPU_VTAB SY_TEVANZ_Compu "" TAB_VERB 2 1 "number of canister purge valves (TEVs) is 1" 2 "number of canister purge valves (TEVs) is 2" /end COMPU_VTAB
/begin COMPU_METHOD SY_TEVKOMP_Compu "" TAB_VERB "%6.3" "" COMPU_TAB_REF SY_TEVKOMP_Compu /end COMPU_METHOD
/begin COMPU_VTAB SY_TEVKOMP_Compu "" TAB_VERB 3 0 "0" 1 "1" 2 "2" /end COMPU_VTAB
/begin COMPU_METHOD SY_TEVPR_Compu "" TAB_VERB "%6.3" "" COMPU_TAB_REF SY_TEVPR_Compu /end COMPU_METHOD
/begin COMPU_VTAB SY_TEVPR_Compu "" TAB_VERB 2 0 "False" 1 "True" /end COMPU_VTAB
/begin COMPU_METHOD SY_TEVSTA_Compu "" TAB_VERB "%6.3" "" COMPU_TAB_REF SY_TEVSTA_Compu /end COMPU_METHOD
/begin COMPU_VTAB SY_TEVSTA_Compu "" TAB_VERB 2 0 "False" 1 "True" /end COMPU_VTAB
/begin COMPU_METHOD SY_TFAM_Compu "" TAB_VERB "%6.3" "" COMPU_TAB_REF SY_TFAM_Compu /end COMPU_METHOD
/begin COMPU_VTAB SY_TFAM_Compu "" TAB_VERB 2 0 "TASR-TANS" 1 "TAVDKM-TANS" /end COMPU_VTAB
/begin COMPU_METHOD SY_TLRARES_Compu "" TAB_VERB "%6.3" "" COMPU_TAB_REF SY_TLRARES_Compu /end COMPU_METHOD
/begin COMPU_VTAB SY_TLRARES_Compu "" TAB_VERB 2 0 "FALSE" 1 "TRUE" /end COMPU_VTAB
/begin COMPU_METHOD SY_TNSIG_Compu "" TAB_VERB "%6.3" "" COMPU_TAB_REF SY_TNSIG_Compu /end COMPU_METHOD
/begin COMPU_VTAB SY_TNSIG_Compu "" TAB_VERB 3 0 "NO_SIG" 1 "ON_OFF_PATTERN" 2 "OFF_ON_PATTERN" /end COMPU_VTAB
/begin COMPU_METHOD SY_TTFCRSFIL_Compu "" TAB_VERB "%6.3" "" COMPU_TAB_REF SY_TTFCRSFIL_Compu /end COMPU_METHOD
/begin COMPU_VTAB SY_TTFCRSFIL_Compu "" TAB_VERB 2 0 "False" 1 "True" /end COMPU_VTAB
/begin COMPU_METHOD SY_TUMG_Compu "" TAB_VERB "%6.3" "" COMPU_TAB_REF SY_TUMG_Compu /end COMPU_METHOD
/begin COMPU_VTAB SY_TUMG_Compu "" TAB_VERB 4 0 "no source, signal not available" 1 "Sensor" 2 "tans" 3 "CAN" /end COMPU_VTAB
/begin COMPU_METHOD SY_TURBO_Compu "" TAB_VERB "%6.3" "" COMPU_TAB_REF SY_TURBO_Compu /end COMPU_METHOD
/begin COMPU_VTAB SY_TURBO_Compu "" TAB_VERB 2 0 "keinTurbolader vorhanden" 1 "Turbolader vorhanden" /end COMPU_VTAB
/begin COMPU_METHOD SY_TZW_Compu "" TAB_VERB "%6.3" "" COMPU_TAB_REF SY_TZW_Compu /end COMPU_METHOD
/begin COMPU_VTAB SY_TZW_Compu "" TAB_VERB 2 0 "keine Testervorgabe Zündwinkel" 1 "Testervorgabe Zündwinkel eingebaut" /end COMPU_VTAB
/begin COMPU_METHOD SY_UBDEDIQ_Compu "" RAT_FUNC "%6.2" "" COEFFS 0 1 0 0 0 1 /end COMPU_METHOD
/begin COMPU_METHOD SY_UBDEENQ_Compu "" RAT_FUNC "%6.2" "" COEFFS 0 1 0 0 0 1 /end COMPU_METHOD
/begin COMPU_METHOD SY_UBR_Compu "" TAB_VERB "%6.3" "" COMPU_TAB_REF SY_UBR_Compu /end COMPU_METHOD
/begin COMPU_VTAB SY_UBR_Compu "" TAB_VERB 2 0 "Signal Hauptrelaisspannung nicht vorhanden" 1 "Signal Hauptrelaisspannung vorhanden" /end COMPU_VTAB
/begin COMPU_METHOD SY_VANGLE_Compu "" RAT_FUNC "%6.2" "" COEFFS 0 1 0 0 0 1 /end COMPU_METHOD
/begin COMPU_METHOD SY_VAR_Compu "" RAT_FUNC "%6.2" "" COEFFS 0 1 0 0 0 1 /end COMPU_METHOD
/begin COMPU_METHOD SY_VIRTSYN_Compu "" TAB_VERB "%6.3" "" COMPU_TAB_REF SY_VIRTSYN_Compu /end COMPU_METHOD
/begin COMPU_VTAB SY_VIRTSYN_Compu "" TAB_VERB 4 0 "NO_VIRTSYN" 1 "VIRTSYN_ON" 2 "VIRTSYN_INJ" 3 "VIRTSYN_IGN" /end COMPU_VTAB
/begin COMPU_METHOD SY_VVT_Compu "" RAT_FUNC "%6.2" "" COEFFS 0 1 0 0 0 1 /end COMPU_METHOD
/begin COMPU_METHOD SY_WFS_Compu "" RAT_FUNC "%6.2" "" COEFFS 0 1 0 0 0 1 /end COMPU_METHOD
/begin COMPU_METHOD SY_WMAX_Compu "" RAT_FUNC "%6.2" "" COEFFS 0 1 0 0 0 1 /end COMPU_METHOD
/begin COMPU_METHOD SY_WMIN_Compu "" RAT_FUNC "%6.2" "" COEFFS 0 1 0 0 0 1 /end COMPU_METHOD
/begin COMPU_METHOD SY_WNWADM_Compu "" TAB_VERB "%6.3" "" COMPU_TAB_REF SY_WNWADM_Compu /end COMPU_METHOD
/begin COMPU_VTAB SY_WNWADM_Compu "" TAB_VERB 2 0 "Correction of camshaft angles by cam adaptation" 1 "No correction of cam angles by cam adapdaptation" /end COMPU_VTAB
/begin COMPU_METHOD SY_ZAGPATTERNMX_Compu "" RAT_FUNC "%6.2" "" COEFFS 0 1 0 0 0 1 /end COMPU_METHOD
/begin COMPU_METHOD SY_ZGST_Compu "" TAB_VERB "%6.3" "" COMPU_TAB_REF SY_ZGST_Compu /end COMPU_METHOD
/begin COMPU_VTAB SY_ZGST_Compu "" TAB_VERB 3 0 "SY_ZGST_0" 1 "SY_ZGST_1" 2 "SY_ZGST_2" /end COMPU_VTAB
/begin COMPU_METHOD SY_ZNDAUS_Compu "" TAB_VERB "%6.3" "" COMPU_TAB_REF SY_ZNDAUS_Compu /end COMPU_METHOD
/begin COMPU_VTAB SY_ZNDAUS_Compu "" TAB_VERB 3 1 "Single_ended_ignition coil" 2 "Double_ended_ignition coil" 3 "Twin_spark_ignition_with2singleended_ignitioncoils" /end COMPU_VTAB
/begin COMPU_METHOD SY_ZUESTA_Compu "" TAB_VERB "%6.3" "" COMPU_TAB_REF SY_ZUESTA_Compu /end COMPU_METHOD
/begin COMPU_VTAB SY_ZUESTA_Compu "" TAB_VERB 2 0 "False" 1 "True" /end COMPU_VTAB
/begin COMPU_METHOD SY_ZYLOFFH_Compu "" RAT_FUNC "%6.2" "" COEFFS 0 1 0 0 0 1 /end COMPU_METHOD
/begin COMPU_METHOD SY_ZYLZA_Compu "" TAB_VERB "%6.3" "" COMPU_TAB_REF SY_ZYLZA_Compu /end COMPU_METHOD
/begin COMPU_VTAB SY_ZYLZA_Compu "" TAB_VERB 11 1 "1" 2 "2" 3 "3" 4 "4" 5 "5" 6 "6" 8 "8" 10 "10" 12 "12" 16 "16" 18 "18" /end COMPU_VTAB
/begin COMPU_METHOD SY_ZYLZG_Compu "" RAT_FUNC "%6.2" "" COEFFS 0 1 0 0 0 1 /end COMPU_METHOD
/begin COMPU_METHOD SY_ZZBANK_Compu "" RAT_FUNC "%6.2" "" COEFFS 0 1 0 0 0 1 /end COMPU_METHOD
/begin COMPU_METHOD SY_ZZSG_Compu "" RAT_FUNC "%6.2" "" COEFFS 0 1 0 0 0 1 /end COMPU_METHOD
/begin COMPU_METHOD t100msxs_uw_b6553p6 "" RAT_FUNC "%6.3" "s" COEFFS 0 10 0 0 0 1 /end COMPU_METHOD
/begin COMPU_METHOD T15RAWDSQENA_SC_Compu "" TAB_VERB "%6.3" "" COMPU_TAB_REF T15RAWDSQENA_SC_Compu /end COMPU_METHOD
/begin COMPU_VTAB T15RAWDSQENA_SC_Compu "" TAB_VERB 2 0 "Disabled" 1 "Enabled" /end COMPU_VTAB
/begin COMPU_METHOD T15_ATS_SY_Compu "" TAB_VERB "%6.3" "" COMPU_TAB_REF T15_ATS_SY_Compu /end COMPU_METHOD
/begin COMPU_VTAB T15_ATS_SY_Compu "" TAB_VERB 2 0 "False" 1 "True" /end COMPU_VTAB
/begin COMPU_METHOD T15_DBGMD_VD_SY_Compu "" TAB_VERB "%6.3" "" COMPU_TAB_REF T15_DBGMD_VD_SY_Compu /end COMPU_METHOD
/begin COMPU_VTAB T15_DBGMD_VD_SY_Compu "" TAB_VERB 2 0 "False" 1 "True" /end COMPU_VTAB
/begin COMPU_METHOD T15_ON_VLDT_COM_SY_Compu "" TAB_VERB "%6.3" "" COMPU_TAB_REF T15_ON_VLDT_COM_SY_Compu /end COMPU_METHOD
/begin COMPU_VTAB T15_ON_VLDT_COM_SY_Compu "" TAB_VERB 2 0 "False" 1 "True" /end COMPU_VTAB
/begin COMPU_METHOD T15_WKDETN_SC_Compu "" TAB_VERB "%6.3" "" COMPU_TAB_REF T15_WKDETN_SC_Compu /end COMPU_METHOD
/begin COMPU_VTAB T15_WKDETN_SC_Compu "" TAB_VERB 2 0 "False" 1 "True" /end COMPU_VTAB
/begin COMPU_METHOD t500usxms_ub_q0p5 "" RAT_FUNC "%6.3" "ms" COEFFS 0 1 0 0 0 0.5 /end COMPU_METHOD
/begin COMPU_METHOD T50_ATS_SY_Compu "" TAB_VERB "%6.3" "" COMPU_TAB_REF T50_ATS_SY_Compu /end COMPU_METHOD
/begin COMPU_VTAB T50_ATS_SY_Compu "" TAB_VERB 2 0 "T50_ATS_DISABLED" 1 "T50_ATS_ENABLED" /end COMPU_VTAB
/begin COMPU_METHOD T50_SY_Compu "" TAB_VERB "%6.3" "" COMPU_TAB_REF T50_SY_Compu /end COMPU_METHOD
/begin COMPU_VTAB T50_SY_Compu "" TAB_VERB 6 0 "T50NOTUSED" 1 "T50WOCY150" 2 "T50CY150" 3 "T50DIO" 4 "T50CAN" 5 "T50DIOANDCAN" /end COMPU_VTAB
/begin COMPU_METHOD TDC_ADAP_SY_Compu "" TAB_VERB "%6.3" "" COMPU_TAB_REF TDC_ADAP_SY_Compu /end COMPU_METHOD
/begin COMPU_VTAB TDC_ADAP_SY_Compu "" TAB_VERB 4 0 "NO_TDC_ADAP" 1 "TDC_ADAP" 2 "TDC_ADAP_CPP" 3 "STAT_TDC_ADAP" /end COMPU_VTAB
/begin COMPU_METHOD TDC_UNEQLGEOM_SY_Compu "" TAB_VERB "%6.3" "" COMPU_TAB_REF TDC_UNEQLGEOM_SY_Compu /end COMPU_METHOD
/begin COMPU_VTAB TDC_UNEQLGEOM_SY_Compu "" TAB_VERB 2 0 "EQL_TDC" 1 "UNEQL_TDC" /end COMPU_VTAB
/begin COMPU_METHOD Temp2Dyc_COMPU "" RAT_FUNC "%6.4" "deg C/%" COEFFS 0 100 0 0 0 1 /end COMPU_METHOD
/begin COMPU_METHOD TempC_float "" RAT_FUNC "%6.1" "deg C" COEFFS 0 1 273.14 0 0 1 /end COMPU_METHOD
/begin COMPU_METHOD TempDiff_Kelv_1K "" RAT_FUNC "%6.2" "K" COEFFS 0 1 0 0 0 1 /end COMPU_METHOD
/begin COMPU_METHOD TempK_float "" RAT_FUNC "%6.2" "K" COEFFS 0 1 0 0 0 1 /end COMPU_METHOD
/begin COMPU_METHOD Temp_Cels "" RAT_FUNC "%6.1" "deg C" COEFFS 0 10 2731.4 0 0 1 /end COMPU_METHOD
/begin COMPU_METHOD Temp_Cels1 "" RAT_FUNC "%6.1" "deg C" COEFFS 0 100 27314 0 0 1 /end COMPU_METHOD
/begin COMPU_METHOD Temp_Cels_1deg "" RAT_FUNC "%6.1" "deg C" COEFFS 0 1 273.14 0 0 1 /end COMPU_METHOD
/begin COMPU_METHOD Temp_Fahr "" RAT_FUNC "%6.1" "deg F" COEFFS 0 5.55555555555556 2553.62222222222 0 0 1 /end COMPU_METHOD
/begin COMPU_METHOD Temp_Kelv_Sec_CtT_Mon "" RAT_FUNC "%7.6" "deg C/s" COEFFS 0 40960 0 0 0 1 /end COMPU_METHOD
/begin COMPU_METHOD ThermalCoEff "" RAT_FUNC "%6.3" "W/m/m/k" COEFFS 0 10 0 0 0 1 /end COMPU_METHOD
/begin COMPU_METHOD ThmCnd "" RAT_FUNC "%6.5" "W/m/K" COEFFS 0 1000 0 0 0 1 /end COMPU_METHOD
/begin COMPU_METHOD THRVLVPROD_SY_Compu "" TAB_VERB "%6.3" "" COMPU_TAB_REF THRVLVPROD_SY_Compu /end COMPU_METHOD
/begin COMPU_VTAB THRVLVPROD_SY_Compu "" TAB_VERB 2 0 "RBTHRVLV" 1 "VISTTHRVLV" /end COMPU_VTAB
/begin COMPU_METHOD THRVLV_LIMLRNGTSTRTRIG_SC_Compu "" TAB_VERB "%6.3" "" COMPU_TAB_REF THRVLV_LIMLRNGTSTRTRIG_SC_Compu /end COMPU_METHOD
/begin COMPU_VTAB THRVLV_LIMLRNGTSTRTRIG_SC_Compu "" TAB_VERB 2 0 "False" 1 "True" /end COMPU_VTAB
/begin COMPU_METHOD THRVLV_POKAYOKE_SC_Compu "" TAB_VERB "%6.3" "" COMPU_TAB_REF THRVLV_POKAYOKE_SC_Compu /end COMPU_METHOD
/begin COMPU_VTAB THRVLV_POKAYOKE_SC_Compu "" TAB_VERB 2 0 "False" 1 "True" /end COMPU_VTAB
/begin COMPU_METHOD THRVLV_TWNCHRGCTRL_SC_Compu "" TAB_VERB "%6.3" "" COMPU_TAB_REF THRVLV_TWNCHRGCTRL_SC_Compu /end COMPU_METHOD
/begin COMPU_VTAB THRVLV_TWNCHRGCTRL_SC_Compu "" TAB_VERB 2 0 "False" 1 "True" /end COMPU_VTAB
/begin COMPU_METHOD Time100HrsEngOn "" RAT_FUNC "%6.2" "[100h]" COEFFS 0 1 0 0 0 1 /end COMPU_METHOD
/begin COMPU_METHOD Time100_us "" RAT_FUNC "%6.0" "us" COEFFS 0 0.01 0 0 0 1 /end COMPU_METHOD
/begin COMPU_METHOD TimeDeb "" RAT_FUNC "%6.1" "ms" COEFFS 0 0.1 0 0 0 1 /end COMPU_METHOD
/begin COMPU_METHOD TimeDelay_s_2 "" RAT_FUNC "%13.6" "s" COEFFS 0 0 1 0 0.0596046447753906 0 /end COMPU_METHOD
/begin COMPU_METHOD TimeDelay_s_Lin_16 "" RAT_FUNC "%6.5" "s" COEFFS 0 6553.4 0 0 0 1 /end COMPU_METHOD
/begin COMPU_METHOD TimeDT "" RAT_FUNC "%6.2" "us" COEFFS 0 1 0 0 0 1 /end COMPU_METHOD
/begin COMPU_METHOD TimeEngOn "" RAT_FUNC "%6.2" "s" COEFFS 0 1 0 0 0 1 /end COMPU_METHOD
/begin COMPU_METHOD TimeEngOnOBD "" RAT_FUNC "%6.2" "min" COEFFS 0 1 0 0 0 1 /end COMPU_METHOD
/begin COMPU_METHOD TimeHrsEngOn "" RAT_FUNC "%6.0" "[100h]" COEFFS 0 0.01 0 0 0 1 /end COMPU_METHOD
/begin COMPU_METHOD TimeRed "" RAT_FUNC "%6.3" "s" COEFFS 0 6.25 0 0 0 1 /end COMPU_METHOD
/begin COMPU_METHOD Time_1s "" RAT_FUNC "%6.2" "s" COEFFS 0 1 0 0 0 1 /end COMPU_METHOD
/begin COMPU_METHOD Time_Hr "" RAT_FUNC "%6.3" "h" COEFFS 0 2 0 0 0 1 /end COMPU_METHOD
/begin COMPU_METHOD Time_msec_q10_COMPU "" RAT_FUNC "%6.1" "ms" COEFFS 0 1 0 0 0 10 /end COMPU_METHOD
/begin COMPU_METHOD Time_msec_q1_COMPU "" RAT_FUNC "%6.2" "ms" COEFFS 0 1 0 0 0 1 /end COMPU_METHOD
/begin COMPU_METHOD Time_ms_q0p01_COMPU "" RAT_FUNC "%6.4" "ms" COEFFS 0 100 0 0 0 1 /end COMPU_METHOD
/begin COMPU_METHOD Time_PwmHigh "" RAT_FUNC "%6.4" "us" COEFFS 0 20 0 0 0 1 /end COMPU_METHOD
/begin COMPU_METHOD Time_sec_q1_COMPU "" RAT_FUNC "%6.2" "s" COEFFS 0 1 0 0 0 1 /end COMPU_METHOD
/begin COMPU_METHOD Time_s_1 "" RAT_FUNC "%6.5" "" COEFFS 0 1000 0 0 0 1 /end COMPU_METHOD
/begin COMPU_METHOD Time_s_LoRes "" RAT_FUNC "%6.2" "s" COEFFS 0 1 0 0 0 1 /end COMPU_METHOD
/begin COMPU_METHOD Time_usec_q1_COMPU "" RAT_FUNC "%6.2" "us" COEFFS 0 1 0 0 0 1 /end COMPU_METHOD
/begin COMPU_METHOD TLE7244_SC_Compu "" TAB_VERB "%6.3" "" COMPU_TAB_REF TLE7244_SC_Compu /end COMPU_METHOD
/begin COMPU_VTAB TLE7244_SC_Compu "" TAB_VERB 3 0 "No_TLE7244" 1 "One_TLE7244" 2 "Two_TLE7244" /end COMPU_VTAB
/begin COMPU_METHOD TQSTRUCT2W_SC_Compu "" TAB_VERB "%6.3" "" COMPU_TAB_REF TQSTRUCT2W_SC_Compu /end COMPU_METHOD
/begin COMPU_VTAB TQSTRUCT2W_SC_Compu "" TAB_VERB 2 0 "False" 1 "True" /end COMPU_VTAB
/begin COMPU_METHOD TransR "" RAT_FUNC "%6.4" "-" COEFFS 0 100 0 0 0 1 /end COMPU_METHOD
/begin COMPU_METHOD TRA_AT_SY_Compu "" TAB_VERB "%6.3" "" COMPU_TAB_REF TRA_AT_SY_Compu /end COMPU_METHOD
/begin COMPU_VTAB TRA_AT_SY_Compu "" TAB_VERB 3 0 "NOT_AVL" 1 "CFG" 2 "AVL" /end COMPU_VTAB
/begin COMPU_METHOD TrbChN_float "" RAT_FUNC "%6.2" "rpm" COEFFS 0 1 0 0 0 1 /end COMPU_METHOD
/begin COMPU_METHOD Trq "" RAT_FUNC "%6.3" "Nm" COEFFS 0 10 0 0 0 1 /end COMPU_METHOD
/begin COMPU_METHOD TrqInrKd "" RAT_FUNC "%8.7" "%/Nm" COEFFS 0 655360 0 0 0 1 /end COMPU_METHOD
/begin COMPU_METHOD TrqInrKd_16 "" RAT_FUNC "%7.6" "%/Nm" COEFFS 0 40960 0 0 0 1 /end COMPU_METHOD
/begin COMPU_METHOD TrqInrKi "" RAT_FUNC "%7.6" "%/(Nm*s)" COEFFS 0 21474.83648 0 0 0 1 /end COMPU_METHOD
/begin COMPU_METHOD TrqInrKi_8 "" RAT_FUNC "%6.5" "%/(Nm*s)" COEFFS 0 2684.35456 0 0 0 1 /end COMPU_METHOD
/begin COMPU_METHOD TrqInrKp "" RAT_FUNC "%8.7" "%/Nm" COEFFS 0 327680 0 0 0 1 /end COMPU_METHOD
/begin COMPU_METHOD TrqInrKp_128 "" RAT_FUNC "%6.5" "%/Nm" COEFFS 0 2560 0 0 0 1 /end COMPU_METHOD
/begin COMPU_METHOD TrqPrp "" RAT_FUNC "%6.2" "Nm" COEFFS 0 0.625 0 0 0 1 /end COMPU_METHOD
/begin COMPU_METHOD TrqPrpHigh "" RAT_FUNC "%6.3" "Nm" COEFFS 0 10 0 0 0 1 /end COMPU_METHOD
/begin COMPU_METHOD TrqToNSqr "" RAT_FUNC "%10.9" "-" COEFFS 0 10000000 0 0 0 1 /end COMPU_METHOD
/begin COMPU_METHOD TRQ_MONLIM_DIAG_SY_Compu "" TAB_VERB "%6.3" "" COMPU_TAB_REF TRQ_MONLIM_DIAG_SY_Compu /end COMPU_METHOD
/begin COMPU_VTAB TRQ_MONLIM_DIAG_SY_Compu "" TAB_VERB 2 0 "False" 1 "True" /end COMPU_VTAB
/begin COMPU_METHOD TurboN "" RAT_FUNC "%6.1" "rpm" COEFFS 0 0.1 0 0 0 1 /end COMPU_METHOD
/begin COMPU_METHOD TVAVSADIA_FRQ "" RAT_FUNC "%6.3" "Hz" COEFFS 0 10 0 0 0 1 /end COMPU_METHOD
/begin COMPU_METHOD TWCOR_HIRES_SC_Compu "" TAB_VERB "%6.3" "" COMPU_TAB_REF TWCOR_HIRES_SC_Compu /end COMPU_METHOD
/begin COMPU_VTAB TWCOR_HIRES_SC_Compu "" TAB_VERB 2 0 "RES_S8" 1 "RES_S16" /end COMPU_VTAB
/begin COMPU_METHOD TWNCHRGSYS_SC_Compu "" TAB_VERB "%6.3" "" COMPU_TAB_REF TWNCHRGSYS_SC_Compu /end COMPU_METHOD
/begin COMPU_VTAB TWNCHRGSYS_SC_Compu "" TAB_VERB 2 0 "False" 1 "True" /end COMPU_VTAB
/begin COMPU_METHOD TWOWHLCUST_SC_Compu "" TAB_VERB "%6.3" "" COMPU_TAB_REF TWOWHLCUST_SC_Compu /end COMPU_METHOD
/begin COMPU_VTAB TWOWHLCUST_SC_Compu "" TAB_VERB 7 1 "KT" 2 "TV" 3 "BAL" 4 "RE" 5 "SZE" 6 "HO" 7 "POL" /end COMPU_VTAB
/begin COMPU_METHOD TWSTSTRT_AVL_SC_Compu "" TAB_VERB "%6.3" "" COMPU_TAB_REF TWSTSTRT_AVL_SC_Compu /end COMPU_METHOD
/begin COMPU_VTAB TWSTSTRT_AVL_SC_Compu "" TAB_VERB 2 0 "False" 1 "True" /end COMPU_VTAB
/begin COMPU_METHOD t_q0p0001953 "" RAT_FUNC "%6.5" "s" COEFFS 0 25600 0 0 0 5 /end COMPU_METHOD
/begin COMPU_METHOD t_q0p01 "" RAT_FUNC "%6.4" "s" COEFFS 0 100 0 0 0 1 /end COMPU_METHOD
/begin COMPU_METHOD t_q0p1 "" RAT_FUNC "%6.3" "s" COEFFS 0 10 0 0 0 1 /end COMPU_METHOD
/begin COMPU_METHOD UART_SY_Compu "" TAB_VERB "%6.3" "" COMPU_TAB_REF UART_SY_Compu /end COMPU_METHOD
/begin COMPU_VTAB UART_SY_Compu "" TAB_VERB 2 0 "UART not used" 1 "UART used" /end COMPU_VTAB
/begin COMPU_METHOD UDPNM_SC_Compu "" TAB_VERB "%6.3" "" COMPU_TAB_REF UDPNM_SC_Compu /end COMPU_METHOD
/begin COMPU_VTAB UDPNM_SC_Compu "" TAB_VERB 2 0 "INACTIVE" 1 "ACTIVE" /end COMPU_VTAB
/begin COMPU_METHOD UEGO_ICS1B1_SY_Compu "" TAB_VERB "%6.3" "" COMPU_TAB_REF UEGO_ICS1B1_SY_Compu /end COMPU_METHOD
/begin COMPU_VTAB UEGO_ICS1B1_SY_Compu "" TAB_VERB 3 0 "0" 1 "1" 2 "2" /end COMPU_VTAB
/begin COMPU_METHOD UEGO_ICS1B2_SY_Compu "" TAB_VERB "%6.3" "" COMPU_TAB_REF UEGO_ICS1B2_SY_Compu /end COMPU_METHOD
/begin COMPU_VTAB UEGO_ICS1B2_SY_Compu "" TAB_VERB 3 0 "0" 1 "1" 2 "2" /end COMPU_VTAB
/begin COMPU_METHOD VEHTYP_SC_Compu "" TAB_VERB "%6.3" "" COMPU_TAB_REF VEHTYP_SC_Compu /end COMPU_METHOD
/begin COMPU_VTAB VEHTYP_SC_Compu "" TAB_VERB 2 1 "Two_Wheeler" 2 "Four_Wheeler" /end COMPU_VTAB
/begin COMPU_METHOD VEHVCANSRC_SC_Compu "" TAB_VERB "%6.3" "" COMPU_TAB_REF VEHVCANSRC_SC_Compu /end COMPU_METHOD
/begin COMPU_VTAB VEHVCANSRC_SC_Compu "" TAB_VERB 2 0 "False" 1 "True" /end COMPU_VTAB
/begin COMPU_METHOD VEHVSRC_SY_Compu "" TAB_VERB "%6.3" "" COMPU_TAB_REF VEHVSRC_SY_Compu /end COMPU_METHOD
/begin COMPU_VTAB VEHVSRC_SY_Compu "" TAB_VERB 3 0 "0" 1 "1" 2 "2" /end COMPU_VTAB
/begin COMPU_METHOD VEHV_SGLWHLDIAG_SY_Compu "" TAB_VERB "%6.3" "" COMPU_TAB_REF VEHV_SGLWHLDIAG_SY_Compu /end COMPU_METHOD
/begin COMPU_VTAB VEHV_SGLWHLDIAG_SY_Compu "" TAB_VERB 3 0 "0" 1 "1" 2 "2" /end COMPU_VTAB
/begin COMPU_METHOD Velocity "" RAT_FUNC "%6.4" "m/s" COEFFS 0 178.571428571429 0 0 0 1 /end COMPU_METHOD
/begin COMPU_METHOD Vel_SI "" RAT_FUNC "%6.4" "m/s" COEFFS 0 360 0 0 0 1 /end COMPU_METHOD
/begin COMPU_METHOD VERSSTOPMISFGDETNBYINJ_SY_Compu "" TAB_VERB "%6.3" "" COMPU_TAB_REF VERSSTOPMISFGDETNBYINJ_SY_Compu /end COMPU_METHOD
/begin COMPU_VTAB VERSSTOPMISFGDETNBYINJ_SY_Compu "" TAB_VERB 2 0 "0" 1 "1" /end COMPU_VTAB
/begin COMPU_METHOD VFG_SC_Compu "" TAB_VERB "%6.3" "" COMPU_TAB_REF VFG_SC_Compu /end COMPU_METHOD
/begin COMPU_VTAB VFG_SC_Compu "" TAB_VERB 2 0 "False" 1 "True" /end COMPU_VTAB
/begin COMPU_METHOD vfzg_q1p25 "" RAT_FUNC "%6.2" "km/h" COEFFS 0 4 0 0 0 5 /end COMPU_METHOD
/begin COMPU_METHOD vfzg_uw_b512 "" RAT_FUNC "%6.4" "km/h" COEFFS 0 65536 0 0 0 512 /end COMPU_METHOD
/begin COMPU_METHOD VNQ6040_SC_Compu "" TAB_VERB "%6.3" "" COMPU_TAB_REF VNQ6040_SC_Compu /end COMPU_METHOD
/begin COMPU_VTAB VNQ6040_SC_Compu "" TAB_VERB 4 0 "NoneASIC" 1 "OneASIC" 2 "TwoASICs" 3 "ThreeASICs" /end COMPU_VTAB
/begin COMPU_METHOD Vol "" RAT_FUNC "%6.4" "l" COEFFS 0 100 0 0 0 1 /end COMPU_METHOD
/begin COMPU_METHOD Vol1 "" RAT_FUNC "%9.8" "l" COEFFS 0 3600000 0 0 0 1 /end COMPU_METHOD
/begin COMPU_METHOD volAdd_ml "" RAT_FUNC "%6.3" "ml" COEFFS 0 10 0 0 0 1 /end COMPU_METHOD
/begin COMPU_METHOD volAdd_ml_fine "" RAT_FUNC "%6.5" "ml" COEFFS 0 1000 0 0 0 1 /end COMPU_METHOD
/begin COMPU_METHOD VolEngCap_COMPU "" RAT_FUNC "%9.8" "m^3" COEFFS 0 1000000 0 0 0 1 /end COMPU_METHOD
/begin COMPU_METHOD volFilgLvl_ml "" RAT_FUNC "%6.2" "ml" COEFFS 0 1 0 0 0 1 /end COMPU_METHOD
/begin COMPU_METHOD VolFine "" RAT_FUNC "%7.6" "m^3" COEFFS 0 10000 0 0 0 1 /end COMPU_METHOD
/begin COMPU_METHOD Volt "" RAT_FUNC "%6.3" "mV" COEFFS 0 5 0 0 0 1 /end COMPU_METHOD
/begin COMPU_METHOD VoltPres "" RAT_FUNC "%6.3" "mV*hPa" COEFFS 0 10 0 0 0 1 /end COMPU_METHOD
/begin COMPU_METHOD VoltPres_HiRes "" RAT_FUNC "%6.4" "mV*hPa" COEFFS 0 100 0 0 0 1 /end COMPU_METHOD
/begin COMPU_METHOD Volt_Batt "" RAT_FUNC "%6.1" "mV" COEFFS 0 0.05 0 0 0 1 /end COMPU_METHOD
/begin COMPU_METHOD Volt_FnReso1 "" RAT_FUNC "%6.3" "mV" COEFFS 0 10 0 0 0 1 /end COMPU_METHOD
/begin COMPU_METHOD Volt_FnReso2 "" RAT_FUNC "%6.5" "mV" COEFFS 0 1000 0 0 0 1 /end COMPU_METHOD
/begin COMPU_METHOD Volt_per_Pres "" RAT_FUNC "%6.5" "mV/hPa" COEFFS 0 1000 0 0 0 1 /end COMPU_METHOD
/begin COMPU_METHOD Volt_q0p002_COMPU "" RAT_FUNC "%6.4" "V" COEFFS 0 500 0 0 0 1 /end COMPU_METHOD
/begin COMPU_METHOD Volt_Sq_HiRes "" RAT_FUNC "%6.3" "mV*mV" COEFFS 0 10 0 0 0 1 /end COMPU_METHOD
/begin COMPU_METHOD Vol_NSC "" RAT_FUNC "%7.6" "L" COEFFS 0 10000 0 0 0 1 /end COMPU_METHOD
/begin COMPU_METHOD WaterMsPrHr "" RAT_FUNC "%6.5" "Kg/h" COEFFS 0 1000 0 0 0 1 /end COMPU_METHOD
/begin COMPU_METHOD WDGS_CFGADPR_SC_Compu "" TAB_VERB "%6.3" "" COMPU_TAB_REF WDGS_CFGADPR_SC_Compu /end COMPU_METHOD
/begin COMPU_VTAB WDGS_CFGADPR_SC_Compu "" TAB_VERB 2 0 "False" 1 "True" /end COMPU_VTAB
/begin COMPU_METHOD WHLSPDINPTYP_SC_Compu "" TAB_VERB "%6.3" "" COMPU_TAB_REF WHLSPDINPTYP_SC_Compu /end COMPU_METHOD
/begin COMPU_VTAB WHLSPDINPTYP_SC_Compu "" TAB_VERB 3 0 "HW" 1 "CAN" 2 "HW_CAN" /end COMPU_VTAB
/begin COMPU_METHOD WHLSPDSENS_SC_Compu "" TAB_VERB "%6.3" "" COMPU_TAB_REF WHLSPDSENS_SC_Compu /end COMPU_METHOD
/begin COMPU_VTAB WHLSPDSENS_SC_Compu "" TAB_VERB 2 0 "False" 1 "True" /end COMPU_VTAB
/begin COMPU_METHOD wink_q0p03125_deg "" RAT_FUNC "%6.4" "deg" COEFFS 0 32 0 0 0 1 /end COMPU_METHOD
/begin COMPU_METHOD XCPVERS_SC_Compu "" TAB_VERB "%6.3" "" COMPU_TAB_REF XCPVERS_SC_Compu /end COMPU_METHOD
/begin COMPU_VTAB XCPVERS_SC_Compu "" TAB_VERB 3 1 "XCP_1_0" 2 "XCP_1_1" 3 "XCP_1_2" /end COMPU_VTAB
/begin COMPU_METHOD XCP_SY_Compu "" TAB_VERB "%6.3" "" COMPU_TAB_REF XCP_SY_Compu /end COMPU_METHOD
/begin COMPU_VTAB XCP_SY_Compu "" TAB_VERB 2 0 "No XCP" 1 "XCP" /end COMPU_VTAB
/begin COMPU_METHOD XDI_SC_Compu "" TAB_VERB "%6.3" "" COMPU_TAB_REF XDI_SC_Compu /end COMPU_METHOD
/begin COMPU_VTAB XDI_SC_Compu "" TAB_VERB 2 0 "False" 1 "True" /end COMPU_VTAB
/begin COMPU_METHOD ZFC_SY_Compu "" TAB_VERB "%6.3" "" COMPU_TAB_REF ZFC_SY_Compu /end COMPU_METHOD
/begin COMPU_VTAB ZFC_SY_Compu "" TAB_VERB 2 0 "FALSE" 1 "TRUE" /end COMPU_VTAB
/begin COMPU_METHOD zk100msxs_uw_b6553 "" RAT_FUNC "%6.1" "s" COEFFS 0 0 65536 0 10 0 /end COMPU_METHOD
/begin COMPU_METHOD zk20msxs_uw_b655 "" RAT_FUNC "%6.1" "s" COEFFS 0 0 65536 0 50 0 /end COMPU_METHOD
/begin COMPU_METHOD zw_sb_q0p75 "" RAT_FUNC "%6.3" "Grad KW" COEFFS 0 255 0 0 0 191.25 /end COMPU_METHOD
/*********** Start of merged RECORD_LAYOUT blocks ***********/
/begin RECORD_LAYOUT DefaultValueRecordLayout_uint16 FNC_VALUES 1 UWORD COLUMN_DIR DIRECT STATIC_RECORD_LAYOUT /end RECORD_LAYOUT
/begin RECORD_LAYOUT DefaultValueRecordLayout_uint32 FNC_VALUES 1 ULONG COLUMN_DIR DIRECT STATIC_RECORD_LAYOUT /end RECORD_LAYOUT
/begin RECORD_LAYOUT DefaultValueRecordLayout_uint8 FNC_VALUES 1 UBYTE COLUMN_DIR DIRECT STATIC_RECORD_LAYOUT /end RECORD_LAYOUT
/begin RECORD_LAYOUT FklWU8 FNC_VALUES 1 UBYTE COLUMN_DIR DIRECT /end RECORD_LAYOUT
/begin RECORD_LAYOUT KfAxU8AyU8SstxU16SstyU16WU16 NO_AXIS_PTS_X 1 UWORD NO_AXIS_PTS_Y 2 UWORD AXIS_PTS_X 3 UWORD INDEX_INCR DIRECT AXIS_PTS_Y 4 UWORD INDEX_INCR DIRECT FNC_VALUES 5 UWORD COLUMN_DIR DIRECT /end RECORD_LAYOUT
/begin RECORD_LAYOUT KfAxU8AyU8SstxU8SstyU8WU8 NO_AXIS_PTS_X 1 UBYTE NO_AXIS_PTS_Y 2 UBYTE AXIS_PTS_X 3 UBYTE INDEX_INCR DIRECT AXIS_PTS_Y 4 UBYTE INDEX_INCR DIRECT FNC_VALUES 5 UBYTE COLUMN_DIR DIRECT /end RECORD_LAYOUT
/begin RECORD_LAYOUT KlAxU8SstxS16WS16 NO_AXIS_PTS_X 1 SWORD AXIS_PTS_X 2 SWORD INDEX_INCR DIRECT FNC_VALUES 3 SWORD COLUMN_DIR DIRECT /end RECORD_LAYOUT
/begin RECORD_LAYOUT KlAxU8SstxU16WS16_Static NO_AXIS_PTS_X 1 UWORD AXIS_PTS_X 2 UWORD INDEX_INCR DIRECT FNC_VALUES 3 SWORD COLUMN_DIR DIRECT STATIC_RECORD_LAYOUT /end RECORD_LAYOUT
/begin RECORD_LAYOUT KlAxU8SstxU16WU16 NO_AXIS_PTS_X 1 UWORD AXIS_PTS_X 2 UWORD INDEX_INCR DIRECT FNC_VALUES 3 UWORD COLUMN_DIR DIRECT /end RECORD_LAYOUT
/begin RECORD_LAYOUT KlAxU8SstxU16WU8_Static NO_AXIS_PTS_X 1 UWORD AXIS_PTS_X 2 UWORD INDEX_INCR DIRECT FNC_VALUES 3 UBYTE COLUMN_DIR DIRECT STATIC_RECORD_LAYOUT /end RECORD_LAYOUT
/begin RECORD_LAYOUT KlAxU8SstxU8WU8 NO_AXIS_PTS_X 1 UBYTE AXIS_PTS_X 2 UBYTE INDEX_INCR DIRECT FNC_VALUES 3 UBYTE COLUMN_DIR DIRECT /end RECORD_LAYOUT
/begin RECORD_LAYOUT KwWS16 FNC_VALUES 1 SWORD COLUMN_DIR DIRECT /end RECORD_LAYOUT
/begin RECORD_LAYOUT KwWS8 FNC_VALUES 1 SBYTE COLUMN_DIR DIRECT /end RECORD_LAYOUT
/begin RECORD_LAYOUT KwWU16 FNC_VALUES 1 UWORD COLUMN_DIR DIRECT /end RECORD_LAYOUT
/begin RECORD_LAYOUT KwWU8 FNC_VALUES 1 UBYTE COLUMN_DIR DIRECT /end RECORD_LAYOUT
/begin RECORD_LAYOUT Mo_DataCurveSstS16WS16 NO_AXIS_PTS_X 1 SWORD AXIS_PTS_X 2 SWORD INDEX_INCR DIRECT FNC_VALUES 3 SWORD COLUMN_DIR DIRECT /end RECORD_LAYOUT
/begin RECORD_LAYOUT RB_Val_Wu16 FNC_VALUES 1 UWORD COLUMN_DIR DIRECT /end RECORD_LAYOUT
/begin RECORD_LAYOUT RB_Val_Wu8 FNC_VALUES 1 UBYTE COLUMN_DIR DIRECT /end RECORD_LAYOUT
/begin RECORD_LAYOUT Val_Ws16 FNC_VALUES 1 SWORD COLUMN_DIR DIRECT /end RECORD_LAYOUT
/*********** Start of merged UNIT blocks ***********/
/begin UNIT AUTOSAR_CanIf_Units_NoUnit "" "noUnit" EXTENDED_SI SI_EXPONENTS 0 0 0 0 0 0 0 /end UNIT
/begin UNIT AUTOSAR_CanSM_Units_NoUnit "" "noUnit" EXTENDED_SI SI_EXPONENTS 0 0 0 0 0 0 0 /end UNIT
/begin UNIT AUTOSAR_Com_Units_NoUnit "" "noUnit" EXTENDED_SI SI_EXPONENTS 0 0 0 0 0 0 0 /end UNIT
/begin UNIT AUTOSAR_ComM_Units_NoUnit "" "noUnit" EXTENDED_SI SI_EXPONENTS 0 0 0 0 0 0 0 /end UNIT
/begin UNIT RB_RBA_rba_MRly_Units_ms "" "ms" EXTENDED_SI /end UNIT
/begin UNIT RB_RBA_rba_OsShell_Units_Perc "Percent" "%" EXTENDED_SI /end UNIT
/begin UNIT RB_RBA_rba_Runtime_Units_Perc "Percent" "%" EXTENDED_SI SI_EXPONENTS 0 0 0 0 0 0 0 /end UNIT
/begin UNIT RB_RBA_rba_SyC_Units_rba_SyC_1second "Seconds" "s" EXTENDED_SI /end UNIT
/begin UNIT RB_RBA_rba_T15_Units_ms "" "ms" EXTENDED_SI /end UNIT
/end MODULE
/end PROJECT
