ASAP2_VERSION 1 60
/begin PROJECT MSE2_BJ10_0038_00 "MDG1"
/begin HEADER "" VERSION "MSE2_BJ10_0038_00" PROJECT_NO MSE2_BJ10_0038_00 /end HEADER
/begin MODULE DIM ""
/begin MOD_COMMON "" BYTE_ORDER MSB_FIRST ALIGNMENT_BYTE 1 ALIGNMENT_WORD 2 ALIGNMENT_LONG 4 ALIGNMENT_INT64 4 ALIGNMENT_FLOAT32_IEEE 4 ALIGNMENT_FLOAT64_IEEE 4 /end MOD_COMMON
/begin CHARACTERISTIC CWDHLS "Codeword for Diagnosis Heating" VALUE 0x9084F06 KwUb 255.0 dez 0.00 255.0 FORMAT "%5.1" /end CHARACTERISTIC
/begin CHARACTERISTIC CWDHLSEN "Codeword for DIagnosis enabling" VALUE 0x9084F07 KwUb 255.0 dez 0.00 255.0 FORMAT "%5.1" /end CHARACTERISTIC
/begin CHARACTERISTIC CWPSHSHE "code word for power stage diagnosis O2-heating downstream cat." VALUE 0x9084F03 KwWU8 255.0 dez 0.00 255.0 FORMAT "%5.1" /end CHARACTERISTIC
/begin CHARACTERISTIC CWPSHSVE "code word for power stage diagnosis O2-heating upstream cat." VALUE 0x9084F04 KwWU8 255.0 dez 0.00 255.0 FORMAT "%5.1" /end CHARACTERISTIC
/begin CHARACTERISTIC DFC_CtlMsk2.DFC_HSH_C "Behaviour control mask / Behaviour control masks of check DFC_HSH" VALUE 0x90803EE Val_Wu8 255.0 DFES_OneToOne 0.00 255.0 FORMAT "%5.1" /end CHARACTERISTIC
/begin CHARACTERISTIC DFC_CtlMsk2.DFC_HSHEmax_C "Behaviour control mask / Behaviour control masks of check DFC_HSHEmax" VALUE 0x90803EF Val_Wu8 255.0 DFES_OneToOne 0.00 255.0 FORMAT "%5.1" /end CHARACTERISTIC
/begin CHARACTERISTIC DFC_CtlMsk2.DFC_HSHEmin_C "Behaviour control mask / Behaviour control masks of check DFC_HSHEmin" VALUE 0x90803F0 Val_Wu8 255.0 DFES_OneToOne 0.00 255.0 FORMAT "%5.1" /end CHARACTERISTIC
/begin CHARACTERISTIC DFC_CtlMsk2.DFC_HSHEsig_C "Behaviour control mask / Behaviour control masks of check DFC_HSHEsig" VALUE 0x90803F1 Val_Wu8 255.0 DFES_OneToOne 0.00 255.0 FORMAT "%5.1" /end CHARACTERISTIC
/begin CHARACTERISTIC DFC_CtlMsk2.DFC_HSV_C "Behaviour control mask / Behaviour control masks of check DFC_HSV" VALUE 0x90803F2 Val_Wu8 255.0 DFES_OneToOne 0.00 255.0 FORMAT "%5.1" /end CHARACTERISTIC
/begin CHARACTERISTIC DFC_CtlMsk2.DFC_HSVEmax_C "Behaviour control mask / Behaviour control masks of check DFC_HSVEmax" VALUE 0x90803F3 Val_Wu8 255.0 DFES_OneToOne 0.00 255.0 FORMAT "%5.1" /end CHARACTERISTIC
/begin CHARACTERISTIC DFC_CtlMsk2.DFC_HSVEmin_C "Behaviour control mask / Behaviour control masks of check DFC_HSVEmin" VALUE 0x90803F4 Val_Wu8 255.0 DFES_OneToOne 0.00 255.0 FORMAT "%5.1" /end CHARACTERISTIC
/begin CHARACTERISTIC DFC_CtlMsk2.DFC_HSVEsig_C "Behaviour control mask / Behaviour control masks of check DFC_HSVEsig" VALUE 0x90803F5 Val_Wu8 255.0 DFES_OneToOne 0.00 255.0 FORMAT "%5.1" /end CHARACTERISTIC
/begin CHARACTERISTIC DFC_DisblMsk2.DFC_HSH_C "disable mask / Disable masks of check DFC_HSH" VALUE 0x9080DBE Val_Wu8 255.0 DFES_OneToOne 0.00 255.0 FORMAT "%5.1" /end CHARACTERISTIC
/begin CHARACTERISTIC DFC_DisblMsk2.DFC_HSHEmax_C "disable mask / Disable masks of check DFC_HSHEmax" VALUE 0x9080DBF Val_Wu8 255.0 DFES_OneToOne 0.00 255.0 FORMAT "%5.1" /end CHARACTERISTIC
/begin CHARACTERISTIC DFC_DisblMsk2.DFC_HSHEmin_C "disable mask / Disable masks of check DFC_HSHEmin" VALUE 0x9080DC0 Val_Wu8 255.0 DFES_OneToOne 0.00 255.0 FORMAT "%5.1" /end CHARACTERISTIC
/begin CHARACTERISTIC DFC_DisblMsk2.DFC_HSHEsig_C "disable mask / Disable masks of check DFC_HSHEsig" VALUE 0x9080DC1 Val_Wu8 255.0 DFES_OneToOne 0.00 255.0 FORMAT "%5.1" /end CHARACTERISTIC
/begin CHARACTERISTIC DFC_DisblMsk2.DFC_HSV_C "disable mask / Disable masks of check DFC_HSV" VALUE 0x9080DC2 Val_Wu8 255.0 DFES_OneToOne 0.00 255.0 FORMAT "%5.1" /end CHARACTERISTIC
/begin CHARACTERISTIC DFC_DisblMsk2.DFC_HSVEmax_C "disable mask / Disable masks of check DFC_HSVEmax" VALUE 0x9080DC3 Val_Wu8 255.0 DFES_OneToOne 0.00 255.0 FORMAT "%5.1" /end CHARACTERISTIC
/begin CHARACTERISTIC DFC_DisblMsk2.DFC_HSVEmin_C "disable mask / Disable masks of check DFC_HSVEmin" VALUE 0x9080DC4 Val_Wu8 255.0 DFES_OneToOne 0.00 255.0 FORMAT "%5.1" /end CHARACTERISTIC
/begin CHARACTERISTIC DFC_DisblMsk2.DFC_HSVEsig_C "disable mask / Disable masks of check DFC_HSVEsig" VALUE 0x9080DC5 Val_Wu8 255.0 DFES_OneToOne 0.00 255.0 FORMAT "%5.1" /end CHARACTERISTIC
/begin CHARACTERISTIC DFES_Cls.DFC_Unused_C "fault class per DFC / " VALUE 0x908043C Val_Wu8 21.00 DFES_OneToOne 0.00 21.00 FORMAT "%5.2" EXTENDED_LIMITS 0.00 255.0 READ_ONLY /end CHARACTERISTIC
/begin CHARACTERISTIC DFES_Cls.DFC_BusDiagOpenLoad_Can0_C "fault class per DFC / Fault class for check DFC_BusDiagOpenLoad_Can0" VALUE 0x908043D Val_Wu8 21.00 DFES_OneToOne 0.00 21.00 FORMAT "%5.2" EXTENDED_LIMITS 0.00 255.0 /end CHARACTERISTIC
/begin CHARACTERISTIC DFES_Cls.DFC_Com_ABSInfo_DLC_C "fault class per DFC / Fault class for check DFC_Com_ABSInfo_DLC" VALUE 0x908043E Val_Wu8 21.00 DFES_OneToOne 0.00 21.00 FORMAT "%5.2" EXTENDED_LIMITS 0.00 255.0 /end CHARACTERISTIC
/begin CHARACTERISTIC DFES_Cls.DFC_Com_ABSInfo_TO_C "fault class per DFC / Fault class for check DFC_Com_ABSInfo_TO" VALUE 0x908043F Val_Wu8 21.00 DFES_OneToOne 0.00 21.00 FORMAT "%5.2" EXTENDED_LIMITS 0.00 255.0 /end CHARACTERISTIC
/begin CHARACTERISTIC DFES_Cls.DFC_BusDiagBusOff_Can0_C "fault class per DFC / Fault class for check DFC_BusDiagBusOff_Can0" VALUE 0x9080440 Val_Wu8 21.00 DFES_OneToOne 0.00 21.00 FORMAT "%5.2" EXTENDED_LIMITS 0.00 255.0 /end CHARACTERISTIC
/begin CHARACTERISTIC DFES_Cls.DFC_DevLibBattUHi_C "fault class per DFC / Fault class for check DFC_DevLibBattUHi" VALUE 0x9080441 Val_Wu8 21.00 DFES_OneToOne 0.00 21.00 FORMAT "%5.2" EXTENDED_LIMITS 0.00 255.0 /end CHARACTERISTIC
/begin CHARACTERISTIC DFES_Cls.DFC_DevLibBattULo_C "fault class per DFC / Fault class for check DFC_DevLibBattULo" VALUE 0x9080442 Val_Wu8 21.00 DFES_OneToOne 0.00 21.00 FORMAT "%5.2" EXTENDED_LIMITS 0.00 255.0 /end CHARACTERISTIC
/begin CHARACTERISTIC DFES_Cls.DFC_StrtOL_C "fault class per DFC / Fault class for check DFC_StrtOL" VALUE 0x9080443 Val_Wu8 21.00 DFES_OneToOne 0.00 21.00 FORMAT "%5.2" EXTENDED_LIMITS 0.00 255.0 /end CHARACTERISTIC
/begin CHARACTERISTIC DFES_Cls.DFC_StrtOvrTemp_C "fault class per DFC / Fault class for check DFC_StrtOvrTemp" VALUE 0x9080444 Val_Wu8 21.00 DFES_OneToOne 0.00 21.00 FORMAT "%5.2" EXTENDED_LIMITS 0.00 255.0 /end CHARACTERISTIC
/begin CHARACTERISTIC DFES_Cls.DFC_StrtSCB_C "fault class per DFC / Fault class for check DFC_StrtSCB" VALUE 0x9080445 Val_Wu8 21.00 DFES_OneToOne 0.00 21.00 FORMAT "%5.2" EXTENDED_LIMITS 0.00 255.0 /end CHARACTERISTIC
/begin CHARACTERISTIC DFES_Cls.DFC_StrtSCG_C "fault class per DFC / Fault class for check DFC_StrtSCG" VALUE 0x9080446 Val_Wu8 21.00 DFES_OneToOne 0.00 21.00 FORMAT "%5.2" EXTENDED_LIMITS 0.00 255.0 /end CHARACTERISTIC
/begin CHARACTERISTIC DFES_Cls.DFC_MILLmpOL_C "fault class per DFC / Fault class for check DFC_MILLmpOL" VALUE 0x9080447 Val_Wu8 21.00 DFES_OneToOne 0.00 21.00 FORMAT "%5.2" EXTENDED_LIMITS 0.00 255.0 /end CHARACTERISTIC
/begin CHARACTERISTIC DFES_Cls.DFC_MILLmpOT_C "fault class per DFC / Fault class for check DFC_MILLmpOT" VALUE 0x9080448 Val_Wu8 21.00 DFES_OneToOne 0.00 21.00 FORMAT "%5.2" EXTENDED_LIMITS 0.00 255.0 /end CHARACTERISTIC
/begin CHARACTERISTIC DFES_Cls.DFC_MILLmpSCB_C "fault class per DFC / Fault class for check DFC_MILLmpSCB" VALUE 0x9080449 Val_Wu8 21.00 DFES_OneToOne 0.00 21.00 FORMAT "%5.2" EXTENDED_LIMITS 0.00 255.0 /end CHARACTERISTIC
/begin CHARACTERISTIC DFES_Cls.DFC_MILLmpSCG_C "fault class per DFC / Fault class for check DFC_MILLmpSCG" VALUE 0x908044A Val_Wu8 21.00 DFES_OneToOne 0.00 21.00 FORMAT "%5.2" EXTENDED_LIMITS 0.00 255.0 /end CHARACTERISTIC
/begin CHARACTERISTIC DFES_Cls.DFC_EV1max_C "fault class per DFC / Fault class for check DFC_EV1max" VALUE 0x908044B Val_Wu8 21.00 DFES_OneToOne 0.00 21.00 FORMAT "%5.2" EXTENDED_LIMITS 0.00 255.0 /end CHARACTERISTIC
/begin CHARACTERISTIC DFES_Cls.DFC_EV1min_C "fault class per DFC / Fault class for check DFC_EV1min" VALUE 0x908044C Val_Wu8 21.00 DFES_OneToOne 0.00 21.00 FORMAT "%5.2" EXTENDED_LIMITS 0.00 255.0 /end CHARACTERISTIC
/begin CHARACTERISTIC DFES_Cls.DFC_EV1sig_C "fault class per DFC / Fault class for check DFC_EV1sig" VALUE 0x908044D Val_Wu8 21.00 DFES_OneToOne 0.00 21.00 FORMAT "%5.2" EXTENDED_LIMITS 0.00 255.0 /end CHARACTERISTIC
/begin CHARACTERISTIC DFES_Cls.DFC_CEngDsTPlausSTC_C "fault class per DFC / Fault class for check DFC_CEngDsTPlausSTC" VALUE 0x908044E Val_Wu8 21.00 DFES_OneToOne 0.00 21.00 FORMAT "%5.2" EXTENDED_LIMITS 0.00 255.0 /end CHARACTERISTIC
/begin CHARACTERISTIC DFES_Cls.DFC_ClthStkOpn_C "fault class per DFC / Fault class for check DFC_ClthStkOpn" VALUE 0x908044F Val_Wu8 21.00 DFES_OneToOne 0.00 21.00 FORMAT "%5.2" EXTENDED_LIMITS 0.00 255.0 /end CHARACTERISTIC
/begin CHARACTERISTIC DFES_Cls.DFC_EVX_C "fault class per DFC / Fault class for check DFC_EVX" VALUE 0x9080450 Val_Wu8 21.00 DFES_OneToOne 0.00 21.00 FORMAT "%5.2" EXTENDED_LIMITS 0.00 255.0 /end CHARACTERISTIC
/begin CHARACTERISTIC DFES_Cls.DFC_IntkAirTAirFltDsSTC_C "fault class per DFC / Fault class for check DFC_IntkAirTAirFltDsSTC" VALUE 0x9080451 Val_Wu8 21.00 DFES_OneToOne 0.00 21.00 FORMAT "%5.2" EXTENDED_LIMITS 0.00 255.0 /end CHARACTERISTIC
/begin CHARACTERISTIC DFES_Cls.DFC_RoughRoad_C "fault class per DFC / Fault class for check DFC_RoughRoad" VALUE 0x9080452 Val_Wu8 21.00 DFES_OneToOne 0.00 21.00 FORMAT "%5.2" EXTENDED_LIMITS 0.00 255.0 /end CHARACTERISTIC
/begin CHARACTERISTIC DFES_Cls.DFC_SSpMon1_C "fault class per DFC / Fault class for check DFC_SSpMon1" VALUE 0x9080453 Val_Wu8 21.00 DFES_OneToOne 0.00 21.00 FORMAT "%5.2" EXTENDED_LIMITS 0.00 255.0 /end CHARACTERISTIC
/begin CHARACTERISTIC DFES_Cls.DFC_SSpMon1OT_C "fault class per DFC / Fault class for check DFC_SSpMon1OT" VALUE 0x9080454 Val_Wu8 21.00 DFES_OneToOne 0.00 21.00 FORMAT "%5.2" EXTENDED_LIMITS 0.00 255.0 /end CHARACTERISTIC
/begin CHARACTERISTIC DFES_Cls.DFC_SSpMon1OV_C "fault class per DFC / Fault class for check DFC_SSpMon1OV" VALUE 0x9080455 Val_Wu8 21.00 DFES_OneToOne 0.00 21.00 FORMAT "%5.2" EXTENDED_LIMITS 0.00 255.0 /end CHARACTERISTIC
/begin CHARACTERISTIC DFES_Cls.DFC_SSpMon1SCG_C "fault class per DFC / Fault class for check DFC_SSpMon1SCG" VALUE 0x9080456 Val_Wu8 21.00 DFES_OneToOne 0.00 21.00 FORMAT "%5.2" EXTENDED_LIMITS 0.00 255.0 /end CHARACTERISTIC
/begin CHARACTERISTIC DFES_Cls.DFC_SSpMon1UV_C "fault class per DFC / Fault class for check DFC_SSpMon1UV" VALUE 0x9080457 Val_Wu8 21.00 DFES_OneToOne 0.00 21.00 FORMAT "%5.2" EXTENDED_LIMITS 0.00 255.0 /end CHARACTERISTIC
/begin CHARACTERISTIC DFES_Cls.DFC_SSpMon2_C "fault class per DFC / Fault class for check DFC_SSpMon2" VALUE 0x9080458 Val_Wu8 21.00 DFES_OneToOne 0.00 21.00 FORMAT "%5.2" EXTENDED_LIMITS 0.00 255.0 /end CHARACTERISTIC
/begin CHARACTERISTIC DFES_Cls.DFC_SSpMon2OT_C "fault class per DFC / Fault class for check DFC_SSpMon2OT" VALUE 0x9080459 Val_Wu8 21.00 DFES_OneToOne 0.00 21.00 FORMAT "%5.2" EXTENDED_LIMITS 0.00 255.0 /end CHARACTERISTIC
/begin CHARACTERISTIC DFES_Cls.DFC_SSpMon2OV_C "fault class per DFC / Fault class for check DFC_SSpMon2OV" VALUE 0x908045A Val_Wu8 21.00 DFES_OneToOne 0.00 21.00 FORMAT "%5.2" EXTENDED_LIMITS 0.00 255.0 /end CHARACTERISTIC
/begin CHARACTERISTIC DFES_Cls.DFC_SSpMon2SCG_C "fault class per DFC / Fault class for check DFC_SSpMon2SCG" VALUE 0x908045B Val_Wu8 21.00 DFES_OneToOne 0.00 21.00 FORMAT "%5.2" EXTENDED_LIMITS 0.00 255.0 /end CHARACTERISTIC
/begin CHARACTERISTIC DFES_Cls.DFC_SSpMon2UV_C "fault class per DFC / Fault class for check DFC_SSpMon2UV" VALUE 0x908045C Val_Wu8 21.00 DFES_OneToOne 0.00 21.00 FORMAT "%5.2" EXTENDED_LIMITS 0.00 255.0 /end CHARACTERISTIC
/begin CHARACTERISTIC DFES_Cls.DFC_CANIF_E_CTRL_NOT_SLEEP_ERROR_VALUE_C "fault class per DFC / Fault class for check DFC_CANIF_E_CTRL_NOT_SLEEP_ERROR_VALUE" VALUE 0x908045D Val_Wu8 21.00 DFES_OneToOne 0.00 21.00 FORMAT "%5.2" EXTENDED_LIMITS 0.00 255.0 /end CHARACTERISTIC
/begin CHARACTERISTIC DFES_Cls.DFC_CANIF_E_CTRL_STOPPED_ERROR_VALUE_C "fault class per DFC / Fault class for check DFC_CANIF_E_CTRL_STOPPED_ERROR_VALUE" VALUE 0x908045E Val_Wu8 21.00 DFES_OneToOne 0.00 21.00 FORMAT "%5.2" EXTENDED_LIMITS 0.00 255.0 /end CHARACTERISTIC
/begin CHARACTERISTIC DFES_Cls.DFC_CANIF_E_INVALID_DLC_ERROR_C "fault class per DFC / Fault class for check DFC_CANIF_E_INVALID_DLC_ERROR" VALUE 0x908045F Val_Wu8 21.00 DFES_OneToOne 0.00 21.00 FORMAT "%5.2" EXTENDED_LIMITS 0.00 255.0 /end CHARACTERISTIC
/begin CHARACTERISTIC DFES_Cls.DFC_CANNM_E_CANIF_TRANSMIT_ERROR_C "fault class per DFC / Fault class for check DFC_CANNM_E_CANIF_TRANSMIT_ERROR" VALUE 0x9080460 Val_Wu8 21.00 DFES_OneToOne 0.00 21.00 FORMAT "%5.2" EXTENDED_LIMITS 0.00 255.0 /end CHARACTERISTIC
/begin CHARACTERISTIC DFES_Cls.DFC_CANNM_E_INIT_FAILED_C "fault class per DFC / Fault class for check DFC_CANNM_E_INIT_FAILED" VALUE 0x9080461 Val_Wu8 21.00 DFES_OneToOne 0.00 21.00 FORMAT "%5.2" EXTENDED_LIMITS 0.00 255.0 /end CHARACTERISTIC
/begin CHARACTERISTIC DFES_Cls.DFC_CANNM_E_NETWORK_TIMEOUT_C "fault class per DFC / Fault class for check DFC_CANNM_E_NETWORK_TIMEOUT" VALUE 0x9080462 Val_Wu8 21.00 DFES_OneToOne 0.00 21.00 FORMAT "%5.2" EXTENDED_LIMITS 0.00 255.0 /end CHARACTERISTIC
/begin CHARACTERISTIC DFES_Cls.DFC_CAN_E_TIMEOUT_C "fault class per DFC / Fault class for check DFC_CAN_E_TIMEOUT" VALUE 0x9080463 Val_Wu8 21.00 DFES_OneToOne 0.00 21.00 FORMAT "%5.2" EXTENDED_LIMITS 0.00 255.0 /end CHARACTERISTIC
/begin CHARACTERISTIC DFES_Cls.DFC_COMM_E_NET_START_IND_CHANNEL_0_C "fault class per DFC / Fault class for check DFC_COMM_E_NET_START_IND_CHANNEL_0" VALUE 0x9080464 Val_Wu8 21.00 DFES_OneToOne 0.00 21.00 FORMAT "%5.2" EXTENDED_LIMITS 0.00 255.0 /end CHARACTERISTIC
/begin CHARACTERISTIC DFES_Cls.DFC_COMM_E_NET_START_IND_CHANNEL_1_C "fault class per DFC / Fault class for check DFC_COMM_E_NET_START_IND_CHANNEL_1" VALUE 0x9080465 Val_Wu8 21.00 DFES_OneToOne 0.00 21.00 FORMAT "%5.2" EXTENDED_LIMITS 0.00 255.0 /end CHARACTERISTIC
/begin CHARACTERISTIC DFES_Cls.DFC_COMM_E_NET_START_IND_CHANNEL_2_C "fault class per DFC / Fault class for check DFC_COMM_E_NET_START_IND_CHANNEL_2" VALUE 0x9080466 Val_Wu8 21.00 DFES_OneToOne 0.00 21.00 FORMAT "%5.2" EXTENDED_LIMITS 0.00 255.0 /end CHARACTERISTIC
/begin CHARACTERISTIC DFES_Cls.DFC_COMM_E_NET_START_IND_CHANNEL_3_C "fault class per DFC / Fault class for check DFC_COMM_E_NET_START_IND_CHANNEL_3" VALUE 0x9080467 Val_Wu8 21.00 DFES_OneToOne 0.00 21.00 FORMAT "%5.2" EXTENDED_LIMITS 0.00 255.0 /end CHARACTERISTIC
/begin CHARACTERISTIC DFES_Cls.DFC_COMM_E_NET_START_IND_CHANNEL_4_C "fault class per DFC / Fault class for check DFC_COMM_E_NET_START_IND_CHANNEL_4" VALUE 0x9080468 Val_Wu8 21.00 DFES_OneToOne 0.00 21.00 FORMAT "%5.2" EXTENDED_LIMITS 0.00 255.0 /end CHARACTERISTIC
/begin CHARACTERISTIC DFES_Cls.DFC_COMM_E_NET_START_IND_CHANNEL_5_C "fault class per DFC / Fault class for check DFC_COMM_E_NET_START_IND_CHANNEL_5" VALUE 0x9080469 Val_Wu8 21.00 DFES_OneToOne 0.00 21.00 FORMAT "%5.2" EXTENDED_LIMITS 0.00 255.0 /end CHARACTERISTIC
/begin CHARACTERISTIC DFES_Cls.DFC_PDUR_E_INIT_FAILED_C "fault class per DFC / Fault class for check DFC_PDUR_E_INIT_FAILED" VALUE 0x908046A Val_Wu8 21.00 DFES_OneToOne 0.00 21.00 FORMAT "%5.2" EXTENDED_LIMITS 0.00 255.0 /end CHARACTERISTIC
/begin CHARACTERISTIC DFES_Cls.DFC_PDUR_E_PDU_INSTANCE_LOST_C "fault class per DFC / Fault class for check DFC_PDUR_E_PDU_INSTANCE_LOST" VALUE 0x908046B Val_Wu8 21.00 DFES_OneToOne 0.00 21.00 FORMAT "%5.2" EXTENDED_LIMITS 0.00 255.0 /end CHARACTERISTIC
/begin CHARACTERISTIC DFES_Cls.DFC_RBA_IOEXTLIB_KEEPALIVE_DRV_C "fault class per DFC / Fault class for check DFC_RBA_IOEXTLIB_KEEPALIVE_DRV" VALUE 0x908046C Val_Wu8 21.00 DFES_OneToOne 0.00 21.00 FORMAT "%5.2" EXTENDED_LIMITS 0.00 255.0 /end CHARACTERISTIC
/begin CHARACTERISTIC DFES_Cls.DFC_RBA_IOEXTLIB_KEEPALIVE_INI_C "fault class per DFC / Fault class for check DFC_RBA_IOEXTLIB_KEEPALIVE_INI" VALUE 0x908046D Val_Wu8 21.00 DFES_OneToOne 0.00 21.00 FORMAT "%5.2" EXTENDED_LIMITS 0.00 255.0 /end CHARACTERISTIC
/begin CHARACTERISTIC DFES_Cls.DFC_rba_IoSigRtc_StopCounter_C "fault class per DFC / Fault class for check DFC_rba_IoSigRtc_StopCounter" VALUE 0x908046E Val_Wu8 21.00 DFES_OneToOne 0.00 21.00 FORMAT "%5.2" EXTENDED_LIMITS 0.00 255.0 /end CHARACTERISTIC
/begin CHARACTERISTIC DFES_Cls.DFC_rba_MultiStackTrace_Threshold_C "fault class per DFC / Fault class for check DFC_rba_MultiStackTrace_Threshold" VALUE 0x908046F Val_Wu8 21.00 DFES_OneToOne 0.00 21.00 FORMAT "%5.2" EXTENDED_LIMITS 0.00 255.0 /end CHARACTERISTIC
/begin CHARACTERISTIC DFES_Cls.DFC_rba_MRly_Diag_Stk_Event_C "fault class per DFC / Fault class for check DFC_rba_MRly_Diag_Stk_Event" VALUE 0x9080470 Val_Wu8 21.00 DFES_OneToOne 0.00 21.00 FORMAT "%5.2" EXTENDED_LIMITS 0.00 255.0 /end CHARACTERISTIC
/begin CHARACTERISTIC DFES_Cls.DFC_rba_SyC_IrrSwOffTrigEngRun_Event_C "fault class per DFC / Fault class for check DFC_rba_SyC_IrrSwOffTrigEngRun_Event" VALUE 0x9080471 Val_Wu8 21.00 DFES_OneToOne 0.00 21.00 FORMAT "%5.2" EXTENDED_LIMITS 0.00 255.0 /end CHARACTERISTIC
/begin CHARACTERISTIC DFES_Cls.DFC_rba_T15_Diag_ComInVld_Event_C "fault class per DFC / Fault class for check DFC_rba_T15_Diag_ComInVld_Event" VALUE 0x9080472 Val_Wu8 21.00 DFES_OneToOne 0.00 21.00 FORMAT "%5.2" EXTENDED_LIMITS 0.00 255.0 /end CHARACTERISTIC
/begin CHARACTERISTIC DFES_Cls.DFC_rba_T15_Diag_ComOff_HwOn_Event_C "fault class per DFC / Fault class for check DFC_rba_T15_Diag_ComOff_HwOn_Event" VALUE 0x9080473 Val_Wu8 21.00 DFES_OneToOne 0.00 21.00 FORMAT "%5.2" EXTENDED_LIMITS 0.00 255.0 /end CHARACTERISTIC
/begin CHARACTERISTIC DFES_Cls.DFC_rba_T15_Diag_ComOn_HwOff_Event_C "fault class per DFC / Fault class for check DFC_rba_T15_Diag_ComOn_HwOff_Event" VALUE 0x9080474 Val_Wu8 21.00 DFES_OneToOne 0.00 21.00 FORMAT "%5.2" EXTENDED_LIMITS 0.00 255.0 /end CHARACTERISTIC
/begin CHARACTERISTIC DFES_Cls.DFC_BypAirActrOcCoil1_C "fault class per DFC / Fault class for check DFC_BypAirActrOcCoil1" VALUE 0x9080475 Val_Wu8 21.00 DFES_OneToOne 0.00 21.00 FORMAT "%5.2" EXTENDED_LIMITS 0.00 255.0 /end CHARACTERISTIC
/begin CHARACTERISTIC DFES_Cls.DFC_BypAirActrOcCoil2_C "fault class per DFC / Fault class for check DFC_BypAirActrOcCoil2" VALUE 0x9080476 Val_Wu8 21.00 DFES_OneToOne 0.00 21.00 FORMAT "%5.2" EXTENDED_LIMITS 0.00 255.0 /end CHARACTERISTIC
/begin CHARACTERISTIC DFES_Cls.DFC_BypAirActrOlCoil1_C "fault class per DFC / Fault class for check DFC_BypAirActrOlCoil1" VALUE 0x9080477 Val_Wu8 21.00 DFES_OneToOne 0.00 21.00 FORMAT "%5.2" EXTENDED_LIMITS 0.00 255.0 /end CHARACTERISTIC
/begin CHARACTERISTIC DFES_Cls.DFC_BypAirActrOlCoil2_C "fault class per DFC / Fault class for check DFC_BypAirActrOlCoil2" VALUE 0x9080478 Val_Wu8 21.00 DFES_OneToOne 0.00 21.00 FORMAT "%5.2" EXTENDED_LIMITS 0.00 255.0 /end CHARACTERISTIC
/begin CHARACTERISTIC DFES_Cls.DFC_BypAirActrOt_C "fault class per DFC / Fault class for check DFC_BypAirActrOt" VALUE 0x9080479 Val_Wu8 21.00 DFES_OneToOne 0.00 21.00 FORMAT "%5.2" EXTENDED_LIMITS 0.00 255.0 /end CHARACTERISTIC
/begin CHARACTERISTIC DFES_Cls.DFC_BypAirActrScbCoil1_C "fault class per DFC / Fault class for check DFC_BypAirActrScbCoil1" VALUE 0x908047A Val_Wu8 21.00 DFES_OneToOne 0.00 21.00 FORMAT "%5.2" EXTENDED_LIMITS 0.00 255.0 /end CHARACTERISTIC
/begin CHARACTERISTIC DFES_Cls.DFC_BypAirActrScbCoil2_C "fault class per DFC / Fault class for check DFC_BypAirActrScbCoil2" VALUE 0x908047B Val_Wu8 21.00 DFES_OneToOne 0.00 21.00 FORMAT "%5.2" EXTENDED_LIMITS 0.00 255.0 /end CHARACTERISTIC
/begin CHARACTERISTIC DFES_Cls.DFC_BypAirActrScgCoil1_C "fault class per DFC / Fault class for check DFC_BypAirActrScgCoil1" VALUE 0x908047C Val_Wu8 21.00 DFES_OneToOne 0.00 21.00 FORMAT "%5.2" EXTENDED_LIMITS 0.00 255.0 /end CHARACTERISTIC
/begin CHARACTERISTIC DFES_Cls.DFC_BypAirActrScgCoil2_C "fault class per DFC / Fault class for check DFC_BypAirActrScgCoil2" VALUE 0x908047D Val_Wu8 21.00 DFES_OneToOne 0.00 21.00 FORMAT "%5.2" EXTENDED_LIMITS 0.00 255.0 /end CHARACTERISTIC
/begin CHARACTERISTIC DFES_Cls.DFC_CEngDsTPhysRngHi_C "fault class per DFC / Fault class for check DFC_CEngDsTPhysRngHi" VALUE 0x908047E Val_Wu8 21.00 DFES_OneToOne 0.00 21.00 FORMAT "%5.2" EXTENDED_LIMITS 0.00 255.0 /end CHARACTERISTIC
/begin CHARACTERISTIC DFES_Cls.DFC_CEngDsTPhysRngLo_C "fault class per DFC / Fault class for check DFC_CEngDsTPhysRngLo" VALUE 0x908047F Val_Wu8 21.00 DFES_OneToOne 0.00 21.00 FORMAT "%5.2" EXTENDED_LIMITS 0.00 255.0 /end CHARACTERISTIC
/begin CHARACTERISTIC DFES_Cls.DFC_CEngDsTSRCMax_C "fault class per DFC / Fault class for check DFC_CEngDsTSRCMax" VALUE 0x9080480 Val_Wu8 21.00 DFES_OneToOne 0.00 21.00 FORMAT "%5.2" EXTENDED_LIMITS 0.00 255.0 /end CHARACTERISTIC
/begin CHARACTERISTIC DFES_Cls.DFC_CEngDsTSRCMin_C "fault class per DFC / Fault class for check DFC_CEngDsTSRCMin" VALUE 0x9080481 Val_Wu8 21.00 DFES_OneToOne 0.00 21.00 FORMAT "%5.2" EXTENDED_LIMITS 0.00 255.0 /end CHARACTERISTIC
/begin CHARACTERISTIC DFES_Cls.DFC_DKmax_C "fault class per DFC / Fault class for check DFC_DKmax" VALUE 0x9080482 Val_Wu8 21.00 DFES_OneToOne 0.00 21.00 FORMAT "%5.2" EXTENDED_LIMITS 0.00 255.0 /end CHARACTERISTIC
/begin CHARACTERISTIC DFES_Cls.DFC_DKmin_C "fault class per DFC / Fault class for check DFC_DKmin" VALUE 0x9080483 Val_Wu8 21.00 DFES_OneToOne 0.00 21.00 FORMAT "%5.2" EXTENDED_LIMITS 0.00 255.0 /end CHARACTERISTIC
/begin CHARACTERISTIC DFES_Cls.DFC_DLLRmax_C "fault class per DFC / Fault class for check DFC_DLLRmax" VALUE 0x9080484 Val_Wu8 21.00 DFES_OneToOne 0.00 21.00 FORMAT "%5.2" EXTENDED_LIMITS 0.00 255.0 /end CHARACTERISTIC
/begin CHARACTERISTIC DFES_Cls.DFC_DLLRmin_C "fault class per DFC / Fault class for check DFC_DLLRmin" VALUE 0x9080485 Val_Wu8 21.00 DFES_OneToOne 0.00 21.00 FORMAT "%5.2" EXTENDED_LIMITS 0.00 255.0 /end CHARACTERISTIC
/begin CHARACTERISTIC DFES_Cls.DFC_DLLRnpl_C "fault class per DFC / Fault class for check DFC_DLLRnpl" VALUE 0x9080486 Val_Wu8 21.00 DFES_OneToOne 0.00 21.00 FORMAT "%5.2" EXTENDED_LIMITS 0.00 255.0 /end CHARACTERISTIC
/begin CHARACTERISTIC DFES_Cls.DFC_DSSRngMax_C "fault class per DFC / Fault class for check DFC_DSSRngMax" VALUE 0x9080487 Val_Wu8 21.00 DFES_OneToOne 0.00 21.00 FORMAT "%5.2" EXTENDED_LIMITS 0.00 255.0 /end CHARACTERISTIC
/begin CHARACTERISTIC DFES_Cls.DFC_DSSRngMin_C "fault class per DFC / Fault class for check DFC_DSSRngMin" VALUE 0x9080488 Val_Wu8 21.00 DFES_OneToOne 0.00 21.00 FORMAT "%5.2" EXTENDED_LIMITS 0.00 255.0 /end CHARACTERISTIC
/begin CHARACTERISTIC DFES_Cls.DFC_DSSmax_C "fault class per DFC / Fault class for check DFC_DSSmax" VALUE 0x9080489 Val_Wu8 21.00 DFES_OneToOne 0.00 21.00 FORMAT "%5.2" EXTENDED_LIMITS 0.00 255.0 /end CHARACTERISTIC
/begin CHARACTERISTIC DFES_Cls.DFC_DSSmin_C "fault class per DFC / Fault class for check DFC_DSSmin" VALUE 0x908048A Val_Wu8 21.00 DFES_OneToOne 0.00 21.00 FORMAT "%5.2" EXTENDED_LIMITS 0.00 255.0 /end CHARACTERISTIC
/begin CHARACTERISTIC DFES_Cls.DFC_DSSnpl_C "fault class per DFC / Fault class for check DFC_DSSnpl" VALUE 0x908048B Val_Wu8 21.00 DFES_OneToOne 0.00 21.00 FORMAT "%5.2" EXTENDED_LIMITS 0.00 255.0 /end CHARACTERISTIC
/begin CHARACTERISTIC DFES_Cls.DFC_DSSnplMax_C "fault class per DFC / Fault class for check DFC_DSSnplMax" VALUE 0x908048C Val_Wu8 21.00 DFES_OneToOne 0.00 21.00 FORMAT "%5.2" EXTENDED_LIMITS 0.00 255.0 /end CHARACTERISTIC
/begin CHARACTERISTIC DFES_Cls.DFC_DSSnplMin_C "fault class per DFC / Fault class for check DFC_DSSnplMin" VALUE 0x908048D Val_Wu8 21.00 DFES_OneToOne 0.00 21.00 FORMAT "%5.2" EXTENDED_LIMITS 0.00 255.0 /end CHARACTERISTIC
/begin CHARACTERISTIC DFES_Cls.DFC_DSSsig_C "fault class per DFC / Fault class for check DFC_DSSsig" VALUE 0x908048E Val_Wu8 21.00 DFES_OneToOne 0.00 21.00 FORMAT "%5.2" EXTENDED_LIMITS 0.00 255.0 /end CHARACTERISTIC
/begin CHARACTERISTIC DFES_Cls.DFC_EpmCrSErrSig_C "fault class per DFC / Fault class for check DFC_EpmCrSErrSig" VALUE 0x908048F Val_Wu8 21.00 DFES_OneToOne 0.00 21.00 FORMAT "%5.2" EXTENDED_LIMITS 0.00 255.0 /end CHARACTERISTIC
/begin CHARACTERISTIC DFES_Cls.DFC_EpmCrSNoSig_C "fault class per DFC / Fault class for check DFC_EpmCrSNoSig" VALUE 0x9080490 Val_Wu8 21.00 DFES_OneToOne 0.00 21.00 FORMAT "%5.2" EXTENDED_LIMITS 0.00 255.0 /end CHARACTERISTIC
/begin CHARACTERISTIC DFES_Cls.DFC_HEGOS1B1ElecNpl_C "fault class per DFC / Fault class for check DFC_HEGOS1B1ElecNpl" VALUE 0x9080491 Val_Wu8 21.00 DFES_OneToOne 0.00 21.00 FORMAT "%5.2" EXTENDED_LIMITS 0.00 255.0 /end CHARACTERISTIC
/begin CHARACTERISTIC DFES_Cls.DFC_HSH_C "fault class per DFC / Fault class for check DFC_HSH" VALUE 0x9080492 Val_Wu8 21.00 DFES_OneToOne 0.00 21.00 FORMAT "%5.2" EXTENDED_LIMITS 0.00 255.0 /end CHARACTERISTIC
/begin CHARACTERISTIC DFES_Cls.DFC_HSHEmax_C "fault class per DFC / Fault class for check DFC_HSHEmax" VALUE 0x9080493 Val_Wu8 21.00 DFES_OneToOne 0.00 21.00 FORMAT "%5.2" EXTENDED_LIMITS 0.00 255.0 /end CHARACTERISTIC
/begin CHARACTERISTIC DFES_Cls.DFC_HSHEmin_C "fault class per DFC / Fault class for check DFC_HSHEmin" VALUE 0x9080494 Val_Wu8 21.00 DFES_OneToOne 0.00 21.00 FORMAT "%5.2" EXTENDED_LIMITS 0.00 255.0 /end CHARACTERISTIC
/begin CHARACTERISTIC DFES_Cls.DFC_HSHEsig_C "fault class per DFC / Fault class for check DFC_HSHEsig" VALUE 0x9080495 Val_Wu8 21.00 DFES_OneToOne 0.00 21.00 FORMAT "%5.2" EXTENDED_LIMITS 0.00 255.0 /end CHARACTERISTIC
/begin CHARACTERISTIC DFES_Cls.DFC_HSV_C "fault class per DFC / Fault class for check DFC_HSV" VALUE 0x9080496 Val_Wu8 21.00 DFES_OneToOne 0.00 21.00 FORMAT "%5.2" EXTENDED_LIMITS 0.00 255.0 /end CHARACTERISTIC
/begin CHARACTERISTIC DFES_Cls.DFC_HSVEmax_C "fault class per DFC / Fault class for check DFC_HSVEmax" VALUE 0x9080497 Val_Wu8 21.00 DFES_OneToOne 0.00 21.00 FORMAT "%5.2" EXTENDED_LIMITS 0.00 255.0 /end CHARACTERISTIC
/begin CHARACTERISTIC DFES_Cls.DFC_HSVEmin_C "fault class per DFC / Fault class for check DFC_HSVEmin" VALUE 0x9080498 Val_Wu8 21.00 DFES_OneToOne 0.00 21.00 FORMAT "%5.2" EXTENDED_LIMITS 0.00 255.0 /end CHARACTERISTIC
/begin CHARACTERISTIC DFES_Cls.DFC_HSVEsig_C "fault class per DFC / Fault class for check DFC_HSVEsig" VALUE 0x9080499 Val_Wu8 21.00 DFES_OneToOne 0.00 21.00 FORMAT "%5.2" EXTENDED_LIMITS 0.00 255.0 /end CHARACTERISTIC
/begin CHARACTERISTIC DFES_Cls.DFC_HdLampMax_C "fault class per DFC / Fault class for check DFC_HdLampMax" VALUE 0x908049A Val_Wu8 21.00 DFES_OneToOne 0.00 21.00 FORMAT "%5.2" EXTENDED_LIMITS 0.00 255.0 /end CHARACTERISTIC
/begin CHARACTERISTIC DFES_Cls.DFC_HdLampMin_C "fault class per DFC / Fault class for check DFC_HdLampMin" VALUE 0x908049B Val_Wu8 21.00 DFES_OneToOne 0.00 21.00 FORMAT "%5.2" EXTENDED_LIMITS 0.00 255.0 /end CHARACTERISTIC
/begin CHARACTERISTIC DFES_Cls.DFC_HdLampSig_C "fault class per DFC / Fault class for check DFC_HdLampSig" VALUE 0x908049C Val_Wu8 21.00 DFES_OneToOne 0.00 21.00 FORMAT "%5.2" EXTENDED_LIMITS 0.00 255.0 /end CHARACTERISTIC
/begin CHARACTERISTIC DFES_Cls.DFC_IgnCoil1Err_C "fault class per DFC / Fault class for check DFC_IgnCoil1Err" VALUE 0x908049D Val_Wu8 21.00 DFES_OneToOne 0.00 21.00 FORMAT "%5.2" EXTENDED_LIMITS 0.00 255.0 /end CHARACTERISTIC
/begin CHARACTERISTIC DFES_Cls.DFC_IgnCoil2Err_C "fault class per DFC / Fault class for check DFC_IgnCoil2Err" VALUE 0x908049E Val_Wu8 21.00 DFES_OneToOne 0.00 21.00 FORMAT "%5.2" EXTENDED_LIMITS 0.00 255.0 /end CHARACTERISTIC
/begin CHARACTERISTIC DFES_Cls.DFC_IgnIgbtDiagSCG_0_C "fault class per DFC / Fault class for check DFC_IgnIgbtDiagSCG_0" VALUE 0x908049F Val_Wu8 21.00 DFES_OneToOne 0.00 21.00 FORMAT "%5.2" EXTENDED_LIMITS 0.00 255.0 /end CHARACTERISTIC
/begin CHARACTERISTIC DFES_Cls.DFC_IgnIgbtDiagSCG_1_C "fault class per DFC / Fault class for check DFC_IgnIgbtDiagSCG_1" VALUE 0x90804A0 Val_Wu8 21.00 DFES_OneToOne 0.00 21.00 FORMAT "%5.2" EXTENDED_LIMITS 0.00 255.0 /end CHARACTERISTIC
/begin CHARACTERISTIC DFES_Cls.DFC_IntkAirTAirFltDsPRCMax_C "fault class per DFC / Fault class for check DFC_IntkAirTAirFltDsPRCMax" VALUE 0x90804A1 Val_Wu8 21.00 DFES_OneToOne 0.00 21.00 FORMAT "%5.2" EXTENDED_LIMITS 0.00 255.0 /end CHARACTERISTIC
/begin CHARACTERISTIC DFES_Cls.DFC_IntkAirTAirFltDsPRCMin_C "fault class per DFC / Fault class for check DFC_IntkAirTAirFltDsPRCMin" VALUE 0x90804A2 Val_Wu8 21.00 DFES_OneToOne 0.00 21.00 FORMAT "%5.2" EXTENDED_LIMITS 0.00 255.0 /end CHARACTERISTIC
/begin CHARACTERISTIC DFES_Cls.DFC_IntkAirTAirFltDsSRCMax_C "fault class per DFC / Fault class for check DFC_IntkAirTAirFltDsSRCMax" VALUE 0x90804A3 Val_Wu8 21.00 DFES_OneToOne 0.00 21.00 FORMAT "%5.2" EXTENDED_LIMITS 0.00 255.0 /end CHARACTERISTIC
/begin CHARACTERISTIC DFES_Cls.DFC_IntkAirTAirFltDsSRCMin_C "fault class per DFC / Fault class for check DFC_IntkAirTAirFltDsSRCMin" VALUE 0x90804A4 Val_Wu8 21.00 DFES_OneToOne 0.00 21.00 FORMAT "%5.2" EXTENDED_LIMITS 0.00 255.0 /end CHARACTERISTIC
/begin CHARACTERISTIC DFES_Cls.DFC_IntkMnfldPNoSyn_C "fault class per DFC / Fault class for check DFC_IntkMnfldPNoSyn" VALUE 0x90804A5 Val_Wu8 21.00 DFES_OneToOne 0.00 21.00 FORMAT "%5.2" EXTENDED_LIMITS 0.00 255.0 /end CHARACTERISTIC
/begin CHARACTERISTIC DFES_Cls.DFC_KAT_C "fault class per DFC / Fault class for check DFC_KAT" VALUE 0x90804A6 Val_Wu8 21.00 DFES_OneToOne 0.00 21.00 FORMAT "%5.2" EXTENDED_LIMITS 0.00 255.0 /end CHARACTERISTIC
/begin CHARACTERISTIC DFES_Cls.DFC_KPEmax_C "fault class per DFC / Fault class for check DFC_KPEmax" VALUE 0x90804A7 Val_Wu8 21.00 DFES_OneToOne 0.00 21.00 FORMAT "%5.2" EXTENDED_LIMITS 0.00 255.0 /end CHARACTERISTIC
/begin CHARACTERISTIC DFES_Cls.DFC_KPEmin_C "fault class per DFC / Fault class for check DFC_KPEmin" VALUE 0x90804A8 Val_Wu8 21.00 DFES_OneToOne 0.00 21.00 FORMAT "%5.2" EXTENDED_LIMITS 0.00 255.0 /end CHARACTERISTIC
/begin CHARACTERISTIC DFES_Cls.DFC_KPEsig_C "fault class per DFC / Fault class for check DFC_KPEsig" VALUE 0x90804A9 Val_Wu8 21.00 DFES_OneToOne 0.00 21.00 FORMAT "%5.2" EXTENDED_LIMITS 0.00 255.0 /end CHARACTERISTIC
/begin CHARACTERISTIC DFES_Cls.DFC_KVSFmax_C "fault class per DFC / Fault class for check DFC_KVSFmax" VALUE 0x90804AA Val_Wu8 21.00 DFES_OneToOne 0.00 21.00 FORMAT "%5.2" EXTENDED_LIMITS 0.00 255.0 /end CHARACTERISTIC
/begin CHARACTERISTIC DFES_Cls.DFC_KVSFmin_C "fault class per DFC / Fault class for check DFC_KVSFmin" VALUE 0x90804AB Val_Wu8 21.00 DFES_OneToOne 0.00 21.00 FORMAT "%5.2" EXTENDED_LIMITS 0.00 255.0 /end CHARACTERISTIC
/begin CHARACTERISTIC DFES_Cls.DFC_KVSOmax_C "fault class per DFC / Fault class for check DFC_KVSOmax" VALUE 0x90804AC Val_Wu8 21.00 DFES_OneToOne 0.00 21.00 FORMAT "%5.2" EXTENDED_LIMITS 0.00 255.0 /end CHARACTERISTIC
/begin CHARACTERISTIC DFES_Cls.DFC_KVSOmin_C "fault class per DFC / Fault class for check DFC_KVSOmin" VALUE 0x90804AD Val_Wu8 21.00 DFES_OneToOne 0.00 21.00 FORMAT "%5.2" EXTENDED_LIMITS 0.00 255.0 /end CHARACTERISTIC
/begin CHARACTERISTIC DFES_Cls.DFC_LASHmn_C "fault class per DFC / Fault class for check DFC_LASHmn" VALUE 0x90804AE Val_Wu8 21.00 DFES_OneToOne 0.00 21.00 FORMAT "%5.2" EXTENDED_LIMITS 0.00 255.0 /end CHARACTERISTIC
/begin CHARACTERISTIC DFES_Cls.DFC_LASHmx_C "fault class per DFC / Fault class for check DFC_LASHmx" VALUE 0x90804AF Val_Wu8 21.00 DFES_OneToOne 0.00 21.00 FORMAT "%5.2" EXTENDED_LIMITS 0.00 255.0 /end CHARACTERISTIC
/begin CHARACTERISTIC DFES_Cls.DFC_LATP_C "fault class per DFC / Fault class for check DFC_LATP" VALUE 0x90804B0 Val_Wu8 21.00 DFES_OneToOne 0.00 21.00 FORMAT "%5.2" EXTENDED_LIMITS 0.00 255.0 /end CHARACTERISTIC
/begin CHARACTERISTIC DFES_Cls.DFC_LDLAHI_C "fault class per DFC / Fault class for check DFC_LDLAHI" VALUE 0x90804B1 Val_Wu8 21.00 DFES_OneToOne 0.00 21.00 FORMAT "%5.2" EXTENDED_LIMITS 0.00 255.0 /end CHARACTERISTIC
/begin CHARACTERISTIC DFES_Cls.DFC_LFS1Max_C "fault class per DFC / Fault class for check DFC_LFS1Max" VALUE 0x90804B2 Val_Wu8 21.00 DFES_OneToOne 0.00 21.00 FORMAT "%5.2" EXTENDED_LIMITS 0.00 255.0 /end CHARACTERISTIC
/begin CHARACTERISTIC DFES_Cls.DFC_LFS1Min_C "fault class per DFC / Fault class for check DFC_LFS1Min" VALUE 0x90804B3 Val_Wu8 21.00 DFES_OneToOne 0.00 21.00 FORMAT "%5.2" EXTENDED_LIMITS 0.00 255.0 /end CHARACTERISTIC
/begin CHARACTERISTIC DFES_Cls.DFC_LFS1Sig_C "fault class per DFC / Fault class for check DFC_LFS1Sig" VALUE 0x90804B4 Val_Wu8 21.00 DFES_OneToOne 0.00 21.00 FORMAT "%5.2" EXTENDED_LIMITS 0.00 255.0 /end CHARACTERISTIC
/begin CHARACTERISTIC DFES_Cls.DFC_LSHmax_C "fault class per DFC / Fault class for check DFC_LSHmax" VALUE 0x90804B5 Val_Wu8 21.00 DFES_OneToOne 0.00 21.00 FORMAT "%5.2" EXTENDED_LIMITS 0.00 255.0 /end CHARACTERISTIC
/begin CHARACTERISTIC DFES_Cls.DFC_LSHmin_C "fault class per DFC / Fault class for check DFC_LSHmin" VALUE 0x90804B6 Val_Wu8 21.00 DFES_OneToOne 0.00 21.00 FORMAT "%5.2" EXTENDED_LIMITS 0.00 255.0 /end CHARACTERISTIC
/begin CHARACTERISTIC DFES_Cls.DFC_LSHnpl_C "fault class per DFC / Fault class for check DFC_LSHnpl" VALUE 0x90804B7 Val_Wu8 21.00 DFES_OneToOne 0.00 21.00 FORMAT "%5.2" EXTENDED_LIMITS 0.00 255.0 /end CHARACTERISTIC
/begin CHARACTERISTIC DFES_Cls.DFC_LSHsig_C "fault class per DFC / Fault class for check DFC_LSHsig" VALUE 0x90804B8 Val_Wu8 21.00 DFES_OneToOne 0.00 21.00 FORMAT "%5.2" EXTENDED_LIMITS 0.00 255.0 /end CHARACTERISTIC
/begin CHARACTERISTIC DFES_Cls.DFC_LSVmax_C "fault class per DFC / Fault class for check DFC_LSVmax" VALUE 0x90804B9 Val_Wu8 21.00 DFES_OneToOne 0.00 21.00 FORMAT "%5.2" EXTENDED_LIMITS 0.00 255.0 /end CHARACTERISTIC
/begin CHARACTERISTIC DFES_Cls.DFC_LSVmin_C "fault class per DFC / Fault class for check DFC_LSVmin" VALUE 0x90804BA Val_Wu8 21.00 DFES_OneToOne 0.00 21.00 FORMAT "%5.2" EXTENDED_LIMITS 0.00 255.0 /end CHARACTERISTIC
/begin CHARACTERISTIC DFES_Cls.DFC_LSVnpl_C "fault class per DFC / Fault class for check DFC_LSVnpl" VALUE 0x90804BB Val_Wu8 21.00 DFES_OneToOne 0.00 21.00 FORMAT "%5.2" EXTENDED_LIMITS 0.00 255.0 /end CHARACTERISTIC
/begin CHARACTERISTIC DFES_Cls.DFC_LSVsig_C "fault class per DFC / Fault class for check DFC_LSVsig" VALUE 0x90804BC Val_Wu8 21.00 DFES_OneToOne 0.00 21.00 FORMAT "%5.2" EXTENDED_LIMITS 0.00 255.0 /end CHARACTERISTIC
/begin CHARACTERISTIC DFES_Cls.DFC_MDCat_C "fault class per DFC / Fault class for check DFC_MDCat" VALUE 0x90804BD Val_Wu8 21.00 DFES_OneToOne 0.00 21.00 FORMAT "%5.2" EXTENDED_LIMITS 0.00 255.0 /end CHARACTERISTIC
/begin CHARACTERISTIC DFES_Cls.DFC_MDCatCurr_C "fault class per DFC / Fault class for check DFC_MDCatCurr" VALUE 0x90804BE Val_Wu8 21.00 DFES_OneToOne 0.00 21.00 FORMAT "%5.2" EXTENDED_LIMITS 0.00 255.0 /end CHARACTERISTIC
/begin CHARACTERISTIC DFES_Cls.DFC_MDCyl_C "fault class per DFC / Fault class for check DFC_MDCyl" VALUE 0x90804BF Val_Wu8 21.00 DFES_OneToOne 0.00 21.00 FORMAT "%5.2" EXTENDED_LIMITS 0.00 255.0 /end CHARACTERISTIC
/begin CHARACTERISTIC DFES_Cls.DFC_MDEmi_C "fault class per DFC / Fault class for check DFC_MDEmi" VALUE 0x90804C0 Val_Wu8 21.00 DFES_OneToOne 0.00 21.00 FORMAT "%5.2" EXTENDED_LIMITS 0.00 255.0 /end CHARACTERISTIC
/begin CHARACTERISTIC DFES_Cls.DFC_MDEmiStrt_C "fault class per DFC / Fault class for check DFC_MDEmiStrt" VALUE 0x90804C1 Val_Wu8 21.00 DFES_OneToOne 0.00 21.00 FORMAT "%5.2" EXTENDED_LIMITS 0.00 255.0 /end CHARACTERISTIC
/begin CHARACTERISTIC DFES_Cls.DFC_MDMpl_C "fault class per DFC / Fault class for check DFC_MDMpl" VALUE 0x90804C2 Val_Wu8 21.00 DFES_OneToOne 0.00 21.00 FORMAT "%5.2" EXTENDED_LIMITS 0.00 255.0 /end CHARACTERISTIC
/begin CHARACTERISTIC DFES_Cls.DFC_MoCADCNTP_C "fault class per DFC / Fault class for check DFC_MoCADCNTP" VALUE 0x90804C3 Val_Wu8 21.00 DFES_OneToOne 0.00 21.00 FORMAT "%5.2" EXTENDED_LIMITS 0.00 255.0 /end CHARACTERISTIC
/begin CHARACTERISTIC DFES_Cls.DFC_MoCADCTst_C "fault class per DFC / Fault class for check DFC_MoCADCTst" VALUE 0x90804C4 Val_Wu8 21.00 DFES_OneToOne 0.00 21.00 FORMAT "%5.2" EXTENDED_LIMITS 0.00 255.0 /end CHARACTERISTIC
/begin CHARACTERISTIC DFES_Cls.DFC_MoFSidst_C "fault class per DFC / Fault class for check DFC_MoFSidst" VALUE 0x90804C5 Val_Wu8 21.00 DFES_OneToOne 0.00 21.00 FORMAT "%5.2" EXTENDED_LIMITS 0.00 255.0 /end CHARACTERISTIC
/begin CHARACTERISTIC DFES_Cls.DFC_OCWDACom_C "fault class per DFC / Fault class for check DFC_OCWDACom" VALUE 0x90804C6 Val_Wu8 21.00 DFES_OneToOne 0.00 21.00 FORMAT "%5.2" EXTENDED_LIMITS 0.00 255.0 /end CHARACTERISTIC
/begin CHARACTERISTIC DFES_Cls.DFC_OilPPSSwtMax_C "fault class per DFC / Fault class for check DFC_OilPPSSwtMax" VALUE 0x90804C7 Val_Wu8 21.00 DFES_OneToOne 0.00 21.00 FORMAT "%5.2" EXTENDED_LIMITS 0.00 255.0 /end CHARACTERISTIC
/begin CHARACTERISTIC DFES_Cls.DFC_OilPPSSwtMin_C "fault class per DFC / Fault class for check DFC_OilPPSSwtMin" VALUE 0x90804C8 Val_Wu8 21.00 DFES_OneToOne 0.00 21.00 FORMAT "%5.2" EXTENDED_LIMITS 0.00 255.0 /end CHARACTERISTIC
/begin CHARACTERISTIC DFES_Cls.DFC_OilPPSSwtSig_C "fault class per DFC / Fault class for check DFC_OilPPSSwtSig" VALUE 0x90804C9 Val_Wu8 21.00 DFES_OneToOne 0.00 21.00 FORMAT "%5.2" EXTENDED_LIMITS 0.00 255.0 /end CHARACTERISTIC
/begin CHARACTERISTIC DFES_Cls.DFC_OvHEngSpdLimr_C "fault class per DFC / Fault class for check DFC_OvHEngSpdLimr" VALUE 0x90804CA Val_Wu8 21.00 DFES_OneToOne 0.00 21.00 FORMAT "%5.2" EXTENDED_LIMITS 0.00 255.0 /end CHARACTERISTIC
/begin CHARACTERISTIC DFES_Cls.DFC_RoVComVld_C "fault class per DFC / Fault class for check DFC_RoVComVld" VALUE 0x90804CB Val_Wu8 21.00 DFES_OneToOne 0.00 21.00 FORMAT "%5.2" EXTENDED_LIMITS 0.00 255.0 /end CHARACTERISTIC
/begin CHARACTERISTIC DFES_Cls.DFC_RoVSNpl_C "fault class per DFC / Fault class for check DFC_RoVSNpl" VALUE 0x90804CC Val_Wu8 21.00 DFES_OneToOne 0.00 21.00 FORMAT "%5.2" EXTENDED_LIMITS 0.00 255.0 /end CHARACTERISTIC
/begin CHARACTERISTIC DFES_Cls.DFC_RoVSOL_C "fault class per DFC / Fault class for check DFC_RoVSOL" VALUE 0x90804CD Val_Wu8 21.00 DFES_OneToOne 0.00 21.00 FORMAT "%5.2" EXTENDED_LIMITS 0.00 255.0 /end CHARACTERISTIC
/begin CHARACTERISTIC DFES_Cls.DFC_RoVSSCB_C "fault class per DFC / Fault class for check DFC_RoVSSCB" VALUE 0x90804CE Val_Wu8 21.00 DFES_OneToOne 0.00 21.00 FORMAT "%5.2" EXTENDED_LIMITS 0.00 255.0 /end CHARACTERISTIC
/begin CHARACTERISTIC DFES_Cls.DFC_RoVSSCG_C "fault class per DFC / Fault class for check DFC_RoVSSCG" VALUE 0x90804CF Val_Wu8 21.00 DFES_OneToOne 0.00 21.00 FORMAT "%5.2" EXTENDED_LIMITS 0.00 255.0 /end CHARACTERISTIC
/begin CHARACTERISTIC DFES_Cls.DFC_SdSTNpl_C "fault class per DFC / Fault class for check DFC_SdSTNpl" VALUE 0x90804D0 Val_Wu8 21.00 DFES_OneToOne 0.00 21.00 FORMAT "%5.2" EXTENDED_LIMITS 0.00 255.0 /end CHARACTERISTIC
/begin CHARACTERISTIC DFES_Cls.DFC_SdSTSCB_C "fault class per DFC / Fault class for check DFC_SdSTSCB" VALUE 0x90804D1 Val_Wu8 21.00 DFES_OneToOne 0.00 21.00 FORMAT "%5.2" EXTENDED_LIMITS 0.00 255.0 /end CHARACTERISTIC
/begin CHARACTERISTIC DFES_Cls.DFC_SdSTSCG_C "fault class per DFC / Fault class for check DFC_SdSTSCG" VALUE 0x90804D2 Val_Wu8 21.00 DFES_OneToOne 0.00 21.00 FORMAT "%5.2" EXTENDED_LIMITS 0.00 255.0 /end CHARACTERISTIC
/begin CHARACTERISTIC DFES_Cls.DFC_SdSTSOL_C "fault class per DFC / Fault class for check DFC_SdSTSOL" VALUE 0x90804D3 Val_Wu8 21.00 DFES_OneToOne 0.00 21.00 FORMAT "%5.2" EXTENDED_LIMITS 0.00 255.0 /end CHARACTERISTIC
/begin CHARACTERISTIC DFES_Cls.DFC_TEVEmax_C "fault class per DFC / Fault class for check DFC_TEVEmax" VALUE 0x90804D4 Val_Wu8 21.00 DFES_OneToOne 0.00 21.00 FORMAT "%5.2" EXTENDED_LIMITS 0.00 255.0 /end CHARACTERISTIC
/begin CHARACTERISTIC DFES_Cls.DFC_TEVEmin_C "fault class per DFC / Fault class for check DFC_TEVEmin" VALUE 0x90804D5 Val_Wu8 21.00 DFES_OneToOne 0.00 21.00 FORMAT "%5.2" EXTENDED_LIMITS 0.00 255.0 /end CHARACTERISTIC
/begin CHARACTERISTIC DFES_Cls.DFC_TEVEsig_C "fault class per DFC / Fault class for check DFC_TEVEsig" VALUE 0x90804D6 Val_Wu8 21.00 DFES_OneToOne 0.00 21.00 FORMAT "%5.2" EXTENDED_LIMITS 0.00 255.0 /end CHARACTERISTIC
/begin CHARACTERISTIC DFES_Cls.DFC_TMnpl_C "fault class per DFC / Fault class for check DFC_TMnpl" VALUE 0x90804D7 Val_Wu8 21.00 DFES_OneToOne 0.00 21.00 FORMAT "%5.2" EXTENDED_LIMITS 0.00 255.0 /end CHARACTERISTIC
/begin CHARACTERISTIC DFES_Cls.DFC_UBmax_C "fault class per DFC / Fault class for check DFC_UBmax" VALUE 0x90804D8 Val_Wu8 21.00 DFES_OneToOne 0.00 21.00 FORMAT "%5.2" EXTENDED_LIMITS 0.00 255.0 /end CHARACTERISTIC
/begin CHARACTERISTIC DFES_Cls.DFC_UBmin_C "fault class per DFC / Fault class for check DFC_UBmin" VALUE 0x90804D9 Val_Wu8 21.00 DFES_OneToOne 0.00 21.00 FORMAT "%5.2" EXTENDED_LIMITS 0.00 255.0 /end CHARACTERISTIC
/begin CHARACTERISTIC DFES_Cls.DFC_UBnpl_C "fault class per DFC / Fault class for check DFC_UBnpl" VALUE 0x90804DA Val_Wu8 21.00 DFES_OneToOne 0.00 21.00 FORMAT "%5.2" EXTENDED_LIMITS 0.00 255.0 /end CHARACTERISTIC
/begin CHARACTERISTIC DFES_Cls.DFC_VFZsig_C "fault class per DFC / Fault class for check DFC_VFZsig" VALUE 0x90804DB Val_Wu8 21.00 DFES_OneToOne 0.00 21.00 FORMAT "%5.2" EXTENDED_LIMITS 0.00 255.0 /end CHARACTERISTIC
/begin CHARACTERISTIC DFES_Cls.DFC_VFZsig2_C "fault class per DFC / Fault class for check DFC_VFZsig2" VALUE 0x90804DC Val_Wu8 21.00 DFES_OneToOne 0.00 21.00 FORMAT "%5.2" EXTENDED_LIMITS 0.00 255.0 /end CHARACTERISTIC
/begin CHARACTERISTIC DFES_DbLv_C "Debounce level limit for creating fault entry (valid for all DFCs)" VALUE 0x90804DD Val_Wu8 15.00 DFES_OneToOne 0.00 15.00 FORMAT "%5.2" EXTENDED_LIMITS 0.00 255.0 /end CHARACTERISTIC
/begin CHARACTERISTIC DFES_DTCO.DFC_Unused_C "OBD specific trouble code / " VALUE 0x9081200 Val_Wu16 65535.00 DFES_OneToOne 0.00 65535.00 FORMAT "%8.2" READ_ONLY /end CHARACTERISTIC
/begin CHARACTERISTIC DFES_DTCO.DFC_BusDiagOpenLoad_Can0_C "OBD specific trouble code / OBD specific diagnostic trouble code for check DFC_BusDiagOpenLoad_Can0" VALUE 0x9081202 Val_Wu16 65535.00 DFES_OneToOne 0.00 65535.00 FORMAT "%8.2" /end CHARACTERISTIC
/begin CHARACTERISTIC DFES_DTCO.DFC_Com_ABSInfo_DLC_C "OBD specific trouble code / OBD specific diagnostic trouble code for check DFC_Com_ABSInfo_DLC" VALUE 0x9081204 Val_Wu16 65535.00 DFES_OneToOne 0.00 65535.00 FORMAT "%8.2" /end CHARACTERISTIC
/begin CHARACTERISTIC DFES_DTCO.DFC_Com_ABSInfo_TO_C "OBD specific trouble code / OBD specific diagnostic trouble code for check DFC_Com_ABSInfo_TO" VALUE 0x9081206 Val_Wu16 65535.00 DFES_OneToOne 0.00 65535.00 FORMAT "%8.2" /end CHARACTERISTIC
/begin CHARACTERISTIC DFES_DTCO.DFC_BusDiagBusOff_Can0_C "OBD specific trouble code / OBD specific diagnostic trouble code for check DFC_BusDiagBusOff_Can0" VALUE 0x9081208 Val_Wu16 65535.00 DFES_OneToOne 0.00 65535.00 FORMAT "%8.2" /end CHARACTERISTIC
/begin CHARACTERISTIC DFES_DTCO.DFC_DevLibBattUHi_C "OBD specific trouble code / OBD specific diagnostic trouble code for check DFC_DevLibBattUHi" VALUE 0x908120A Val_Wu16 65535.00 DFES_OneToOne 0.00 65535.00 FORMAT "%8.2" /end CHARACTERISTIC
/begin CHARACTERISTIC DFES_DTCO.DFC_DevLibBattULo_C "OBD specific trouble code / OBD specific diagnostic trouble code for check DFC_DevLibBattULo" VALUE 0x908120C Val_Wu16 65535.00 DFES_OneToOne 0.00 65535.00 FORMAT "%8.2" /end CHARACTERISTIC
/begin CHARACTERISTIC DFES_DTCO.DFC_StrtOL_C "OBD specific trouble code / OBD specific diagnostic trouble code for check DFC_StrtOL" VALUE 0x908120E Val_Wu16 65535.00 DFES_OneToOne 0.00 65535.00 FORMAT "%8.2" /end CHARACTERISTIC
/begin CHARACTERISTIC DFES_DTCO.DFC_StrtOvrTemp_C "OBD specific trouble code / OBD specific diagnostic trouble code for check DFC_StrtOvrTemp" VALUE 0x9081210 Val_Wu16 65535.00 DFES_OneToOne 0.00 65535.00 FORMAT "%8.2" /end CHARACTERISTIC
/begin CHARACTERISTIC DFES_DTCO.DFC_StrtSCB_C "OBD specific trouble code / OBD specific diagnostic trouble code for check DFC_StrtSCB" VALUE 0x9081212 Val_Wu16 65535.00 DFES_OneToOne 0.00 65535.00 FORMAT "%8.2" /end CHARACTERISTIC
/begin CHARACTERISTIC DFES_DTCO.DFC_StrtSCG_C "OBD specific trouble code / OBD specific diagnostic trouble code for check DFC_StrtSCG" VALUE 0x9081214 Val_Wu16 65535.00 DFES_OneToOne 0.00 65535.00 FORMAT "%8.2" /end CHARACTERISTIC
/begin CHARACTERISTIC DFES_DTCO.DFC_MILLmpOL_C "OBD specific trouble code / OBD specific diagnostic trouble code for check DFC_MILLmpOL" VALUE 0x9081216 Val_Wu16 65535.00 DFES_OneToOne 0.00 65535.00 FORMAT "%8.2" /end CHARACTERISTIC
/begin CHARACTERISTIC DFES_DTCO.DFC_MILLmpOT_C "OBD specific trouble code / OBD specific diagnostic trouble code for check DFC_MILLmpOT" VALUE 0x9081218 Val_Wu16 65535.00 DFES_OneToOne 0.00 65535.00 FORMAT "%8.2" /end CHARACTERISTIC
/begin CHARACTERISTIC DFES_DTCO.DFC_MILLmpSCB_C "OBD specific trouble code / OBD specific diagnostic trouble code for check DFC_MILLmpSCB" VALUE 0x908121A Val_Wu16 65535.00 DFES_OneToOne 0.00 65535.00 FORMAT "%8.2" /end CHARACTERISTIC
/begin CHARACTERISTIC DFES_DTCO.DFC_MILLmpSCG_C "OBD specific trouble code / OBD specific diagnostic trouble code for check DFC_MILLmpSCG" VALUE 0x908121C Val_Wu16 65535.00 DFES_OneToOne 0.00 65535.00 FORMAT "%8.2" /end CHARACTERISTIC
/begin CHARACTERISTIC DFES_DTCO.DFC_EV1max_C "OBD specific trouble code / OBD specific diagnostic trouble code for check DFC_EV1max" VALUE 0x908121E Val_Wu16 65535.00 DFES_OneToOne 0.00 65535.00 FORMAT "%8.2" /end CHARACTERISTIC
/begin CHARACTERISTIC DFES_DTCO.DFC_EV1min_C "OBD specific trouble code / OBD specific diagnostic trouble code for check DFC_EV1min" VALUE 0x9081220 Val_Wu16 65535.00 DFES_OneToOne 0.00 65535.00 FORMAT "%8.2" /end CHARACTERISTIC
/begin CHARACTERISTIC DFES_DTCO.DFC_EV1sig_C "OBD specific trouble code / OBD specific diagnostic trouble code for check DFC_EV1sig" VALUE 0x9081222 Val_Wu16 65535.00 DFES_OneToOne 0.00 65535.00 FORMAT "%8.2" /end CHARACTERISTIC
/begin CHARACTERISTIC DFES_DTCO.DFC_CEngDsTPlausSTC_C "OBD specific trouble code / OBD specific diagnostic trouble code for check DFC_CEngDsTPlausSTC" VALUE 0x9081224 Val_Wu16 65535.00 DFES_OneToOne 0.00 65535.00 FORMAT "%8.2" /end CHARACTERISTIC
/begin CHARACTERISTIC DFES_DTCO.DFC_ClthStkOpn_C "OBD specific trouble code / OBD specific diagnostic trouble code for check DFC_ClthStkOpn" VALUE 0x9081226 Val_Wu16 65535.00 DFES_OneToOne 0.00 65535.00 FORMAT "%8.2" /end CHARACTERISTIC
/begin CHARACTERISTIC DFES_DTCO.DFC_EVX_C "OBD specific trouble code / OBD specific diagnostic trouble code for check DFC_EVX" VALUE 0x9081228 Val_Wu16 65535.00 DFES_OneToOne 0.00 65535.00 FORMAT "%8.2" /end CHARACTERISTIC
/begin CHARACTERISTIC DFES_DTCO.DFC_IntkAirTAirFltDsSTC_C "OBD specific trouble code / OBD specific diagnostic trouble code for check DFC_IntkAirTAirFltDsSTC" VALUE 0x908122A Val_Wu16 65535.00 DFES_OneToOne 0.00 65535.00 FORMAT "%8.2" /end CHARACTERISTIC
/begin CHARACTERISTIC DFES_DTCO.DFC_RoughRoad_C "OBD specific trouble code / OBD specific diagnostic trouble code for check DFC_RoughRoad" VALUE 0x908122C Val_Wu16 65535.00 DFES_OneToOne 0.00 65535.00 FORMAT "%8.2" /end CHARACTERISTIC
/begin CHARACTERISTIC DFES_DTCO.DFC_SSpMon1_C "OBD specific trouble code / OBD specific diagnostic trouble code for check DFC_SSpMon1" VALUE 0x908122E Val_Wu16 65535.00 DFES_OneToOne 0.00 65535.00 FORMAT "%8.2" /end CHARACTERISTIC
/begin CHARACTERISTIC DFES_DTCO.DFC_SSpMon1OT_C "OBD specific trouble code / OBD specific diagnostic trouble code for check DFC_SSpMon1OT" VALUE 0x9081230 Val_Wu16 65535.00 DFES_OneToOne 0.00 65535.00 FORMAT "%8.2" /end CHARACTERISTIC
/begin CHARACTERISTIC DFES_DTCO.DFC_SSpMon1OV_C "OBD specific trouble code / OBD specific diagnostic trouble code for check DFC_SSpMon1OV" VALUE 0x9081232 Val_Wu16 65535.00 DFES_OneToOne 0.00 65535.00 FORMAT "%8.2" /end CHARACTERISTIC
/begin CHARACTERISTIC DFES_DTCO.DFC_SSpMon1SCG_C "OBD specific trouble code / OBD specific diagnostic trouble code for check DFC_SSpMon1SCG" VALUE 0x9081234 Val_Wu16 65535.00 DFES_OneToOne 0.00 65535.00 FORMAT "%8.2" /end CHARACTERISTIC
/begin CHARACTERISTIC DFES_DTCO.DFC_SSpMon1UV_C "OBD specific trouble code / OBD specific diagnostic trouble code for check DFC_SSpMon1UV" VALUE 0x9081236 Val_Wu16 65535.00 DFES_OneToOne 0.00 65535.00 FORMAT "%8.2" /end CHARACTERISTIC
/begin CHARACTERISTIC DFES_DTCO.DFC_SSpMon2_C "OBD specific trouble code / OBD specific diagnostic trouble code for check DFC_SSpMon2" VALUE 0x9081238 Val_Wu16 65535.00 DFES_OneToOne 0.00 65535.00 FORMAT "%8.2" /end CHARACTERISTIC
/begin CHARACTERISTIC DFES_DTCO.DFC_SSpMon2OT_C "OBD specific trouble code / OBD specific diagnostic trouble code for check DFC_SSpMon2OT" VALUE 0x908123A Val_Wu16 65535.00 DFES_OneToOne 0.00 65535.00 FORMAT "%8.2" /end CHARACTERISTIC
/begin CHARACTERISTIC DFES_DTCO.DFC_SSpMon2OV_C "OBD specific trouble code / OBD specific diagnostic trouble code for check DFC_SSpMon2OV" VALUE 0x908123C Val_Wu16 65535.00 DFES_OneToOne 0.00 65535.00 FORMAT "%8.2" /end CHARACTERISTIC
/begin CHARACTERISTIC DFES_DTCO.DFC_SSpMon2SCG_C "OBD specific trouble code / OBD specific diagnostic trouble code for check DFC_SSpMon2SCG" VALUE 0x908123E Val_Wu16 65535.00 DFES_OneToOne 0.00 65535.00 FORMAT "%8.2" /end CHARACTERISTIC
/begin CHARACTERISTIC DFES_DTCO.DFC_SSpMon2UV_C "OBD specific trouble code / OBD specific diagnostic trouble code for check DFC_SSpMon2UV" VALUE 0x9081240 Val_Wu16 65535.00 DFES_OneToOne 0.00 65535.00 FORMAT "%8.2" /end CHARACTERISTIC
/begin CHARACTERISTIC DFES_DTCO.DFC_CANIF_E_CTRL_NOT_SLEEP_ERROR_VALUE_C "OBD specific trouble code / OBD specific diagnostic trouble code for check DFC_CANIF_E_CTRL_NOT_SLEEP_ERROR_VALUE" VALUE 0x9081242 Val_Wu16 65535.00 DFES_OneToOne 0.00 65535.00 FORMAT "%8.2" /end CHARACTERISTIC
/begin CHARACTERISTIC DFES_DTCO.DFC_CANIF_E_CTRL_STOPPED_ERROR_VALUE_C "OBD specific trouble code / OBD specific diagnostic trouble code for check DFC_CANIF_E_CTRL_STOPPED_ERROR_VALUE" VALUE 0x9081244 Val_Wu16 65535.00 DFES_OneToOne 0.00 65535.00 FORMAT "%8.2" /end CHARACTERISTIC
/begin CHARACTERISTIC DFES_DTCO.DFC_CANIF_E_INVALID_DLC_ERROR_C "OBD specific trouble code / OBD specific diagnostic trouble code for check DFC_CANIF_E_INVALID_DLC_ERROR" VALUE 0x9081246 Val_Wu16 65535.00 DFES_OneToOne 0.00 65535.00 FORMAT "%8.2" /end CHARACTERISTIC
/begin CHARACTERISTIC DFES_DTCO.DFC_CANNM_E_CANIF_TRANSMIT_ERROR_C "OBD specific trouble code / OBD specific diagnostic trouble code for check DFC_CANNM_E_CANIF_TRANSMIT_ERROR" VALUE 0x9081248 Val_Wu16 65535.00 DFES_OneToOne 0.00 65535.00 FORMAT "%8.2" /end CHARACTERISTIC
/begin CHARACTERISTIC DFES_DTCO.DFC_CANNM_E_INIT_FAILED_C "OBD specific trouble code / OBD specific diagnostic trouble code for check DFC_CANNM_E_INIT_FAILED" VALUE 0x908124A Val_Wu16 65535.00 DFES_OneToOne 0.00 65535.00 FORMAT "%8.2" /end CHARACTERISTIC
/begin CHARACTERISTIC DFES_DTCO.DFC_CANNM_E_NETWORK_TIMEOUT_C "OBD specific trouble code / OBD specific diagnostic trouble code for check DFC_CANNM_E_NETWORK_TIMEOUT" VALUE 0x908124C Val_Wu16 65535.00 DFES_OneToOne 0.00 65535.00 FORMAT "%8.2" /end CHARACTERISTIC
/begin CHARACTERISTIC DFES_DTCO.DFC_CAN_E_TIMEOUT_C "OBD specific trouble code / OBD specific diagnostic trouble code for check DFC_CAN_E_TIMEOUT" VALUE 0x908124E Val_Wu16 65535.00 DFES_OneToOne 0.00 65535.00 FORMAT "%8.2" /end CHARACTERISTIC
/begin CHARACTERISTIC DFES_DTCO.DFC_COMM_E_NET_START_IND_CHANNEL_0_C "OBD specific trouble code / OBD specific diagnostic trouble code for check DFC_COMM_E_NET_START_IND_CHANNEL_0" VALUE 0x9081250 Val_Wu16 65535.00 DFES_OneToOne 0.00 65535.00 FORMAT "%8.2" /end CHARACTERISTIC
/begin CHARACTERISTIC DFES_DTCO.DFC_COMM_E_NET_START_IND_CHANNEL_1_C "OBD specific trouble code / OBD specific diagnostic trouble code for check DFC_COMM_E_NET_START_IND_CHANNEL_1" VALUE 0x9081252 Val_Wu16 65535.00 DFES_OneToOne 0.00 65535.00 FORMAT "%8.2" /end CHARACTERISTIC
/begin CHARACTERISTIC DFES_DTCO.DFC_COMM_E_NET_START_IND_CHANNEL_2_C "OBD specific trouble code / OBD specific diagnostic trouble code for check DFC_COMM_E_NET_START_IND_CHANNEL_2" VALUE 0x9081254 Val_Wu16 65535.00 DFES_OneToOne 0.00 65535.00 FORMAT "%8.2" /end CHARACTERISTIC
/begin CHARACTERISTIC DFES_DTCO.DFC_COMM_E_NET_START_IND_CHANNEL_3_C "OBD specific trouble code / OBD specific diagnostic trouble code for check DFC_COMM_E_NET_START_IND_CHANNEL_3" VALUE 0x9081256 Val_Wu16 65535.00 DFES_OneToOne 0.00 65535.00 FORMAT "%8.2" /end CHARACTERISTIC
/begin CHARACTERISTIC DFES_DTCO.DFC_COMM_E_NET_START_IND_CHANNEL_4_C "OBD specific trouble code / OBD specific diagnostic trouble code for check DFC_COMM_E_NET_START_IND_CHANNEL_4" VALUE 0x9081258 Val_Wu16 65535.00 DFES_OneToOne 0.00 65535.00 FORMAT "%8.2" /end CHARACTERISTIC
/begin CHARACTERISTIC DFES_DTCO.DFC_COMM_E_NET_START_IND_CHANNEL_5_C "OBD specific trouble code / OBD specific diagnostic trouble code for check DFC_COMM_E_NET_START_IND_CHANNEL_5" VALUE 0x908125A Val_Wu16 65535.00 DFES_OneToOne 0.00 65535.00 FORMAT "%8.2" /end CHARACTERISTIC
/begin CHARACTERISTIC DFES_DTCO.DFC_PDUR_E_INIT_FAILED_C "OBD specific trouble code / OBD specific diagnostic trouble code for check DFC_PDUR_E_INIT_FAILED" VALUE 0x908125C Val_Wu16 65535.00 DFES_OneToOne 0.00 65535.00 FORMAT "%8.2" /end CHARACTERISTIC
/begin CHARACTERISTIC DFES_DTCO.DFC_PDUR_E_PDU_INSTANCE_LOST_C "OBD specific trouble code / OBD specific diagnostic trouble code for check DFC_PDUR_E_PDU_INSTANCE_LOST" VALUE 0x908125E Val_Wu16 65535.00 DFES_OneToOne 0.00 65535.00 FORMAT "%8.2" /end CHARACTERISTIC
/begin CHARACTERISTIC DFES_DTCO.DFC_RBA_IOEXTLIB_KEEPALIVE_DRV_C "OBD specific trouble code / OBD specific diagnostic trouble code for check DFC_RBA_IOEXTLIB_KEEPALIVE_DRV" VALUE 0x9081260 Val_Wu16 65535.00 DFES_OneToOne 0.00 65535.00 FORMAT "%8.2" /end CHARACTERISTIC
/begin CHARACTERISTIC DFES_DTCO.DFC_RBA_IOEXTLIB_KEEPALIVE_INI_C "OBD specific trouble code / OBD specific diagnostic trouble code for check DFC_RBA_IOEXTLIB_KEEPALIVE_INI" VALUE 0x9081262 Val_Wu16 65535.00 DFES_OneToOne 0.00 65535.00 FORMAT "%8.2" /end CHARACTERISTIC
/begin CHARACTERISTIC DFES_DTCO.DFC_rba_IoSigRtc_StopCounter_C "OBD specific trouble code / OBD specific diagnostic trouble code for check DFC_rba_IoSigRtc_StopCounter" VALUE 0x9081264 Val_Wu16 65535.00 DFES_OneToOne 0.00 65535.00 FORMAT "%8.2" /end CHARACTERISTIC
/begin CHARACTERISTIC DFES_DTCO.DFC_rba_MultiStackTrace_Threshold_C "OBD specific trouble code / OBD specific diagnostic trouble code for check DFC_rba_MultiStackTrace_Threshold" VALUE 0x9081266 Val_Wu16 65535.00 DFES_OneToOne 0.00 65535.00 FORMAT "%8.2" /end CHARACTERISTIC
/begin CHARACTERISTIC DFES_DTCO.DFC_rba_MRly_Diag_Stk_Event_C "OBD specific trouble code / OBD specific diagnostic trouble code for check DFC_rba_MRly_Diag_Stk_Event" VALUE 0x9081268 Val_Wu16 65535.00 DFES_OneToOne 0.00 65535.00 FORMAT "%8.2" /end CHARACTERISTIC
/begin CHARACTERISTIC DFES_DTCO.DFC_rba_SyC_IrrSwOffTrigEngRun_Event_C "OBD specific trouble code / OBD specific diagnostic trouble code for check DFC_rba_SyC_IrrSwOffTrigEngRun_Event" VALUE 0x908126A Val_Wu16 65535.00 DFES_OneToOne 0.00 65535.00 FORMAT "%8.2" /end CHARACTERISTIC
/begin CHARACTERISTIC DFES_DTCO.DFC_rba_T15_Diag_ComInVld_Event_C "OBD specific trouble code / OBD specific diagnostic trouble code for check DFC_rba_T15_Diag_ComInVld_Event" VALUE 0x908126C Val_Wu16 65535.00 DFES_OneToOne 0.00 65535.00 FORMAT "%8.2" /end CHARACTERISTIC
/begin CHARACTERISTIC DFES_DTCO.DFC_rba_T15_Diag_ComOff_HwOn_Event_C "OBD specific trouble code / OBD specific diagnostic trouble code for check DFC_rba_T15_Diag_ComOff_HwOn_Event" VALUE 0x908126E Val_Wu16 65535.00 DFES_OneToOne 0.00 65535.00 FORMAT "%8.2" /end CHARACTERISTIC
/begin CHARACTERISTIC DFES_DTCO.DFC_rba_T15_Diag_ComOn_HwOff_Event_C "OBD specific trouble code / OBD specific diagnostic trouble code for check DFC_rba_T15_Diag_ComOn_HwOff_Event" VALUE 0x9081270 Val_Wu16 65535.00 DFES_OneToOne 0.00 65535.00 FORMAT "%8.2" /end CHARACTERISTIC
/begin CHARACTERISTIC DFES_DTCO.DFC_BypAirActrOcCoil1_C "OBD specific trouble code / OBD specific diagnostic trouble code for check DFC_BypAirActrOcCoil1" VALUE 0x9081272 Val_Wu16 65535.00 DFES_OneToOne 0.00 65535.00 FORMAT "%8.2" /end CHARACTERISTIC
/begin CHARACTERISTIC DFES_DTCO.DFC_BypAirActrOcCoil2_C "OBD specific trouble code / OBD specific diagnostic trouble code for check DFC_BypAirActrOcCoil2" VALUE 0x9081274 Val_Wu16 65535.00 DFES_OneToOne 0.00 65535.00 FORMAT "%8.2" /end CHARACTERISTIC
/begin CHARACTERISTIC DFES_DTCO.DFC_BypAirActrOlCoil1_C "OBD specific trouble code / OBD specific diagnostic trouble code for check DFC_BypAirActrOlCoil1" VALUE 0x9081276 Val_Wu16 65535.00 DFES_OneToOne 0.00 65535.00 FORMAT "%8.2" /end CHARACTERISTIC
/begin CHARACTERISTIC DFES_DTCO.DFC_BypAirActrOlCoil2_C "OBD specific trouble code / OBD specific diagnostic trouble code for check DFC_BypAirActrOlCoil2" VALUE 0x9081278 Val_Wu16 65535.00 DFES_OneToOne 0.00 65535.00 FORMAT "%8.2" /end CHARACTERISTIC
/begin CHARACTERISTIC DFES_DTCO.DFC_BypAirActrOt_C "OBD specific trouble code / OBD specific diagnostic trouble code for check DFC_BypAirActrOt" VALUE 0x908127A Val_Wu16 65535.00 DFES_OneToOne 0.00 65535.00 FORMAT "%8.2" /end CHARACTERISTIC
/begin CHARACTERISTIC DFES_DTCO.DFC_BypAirActrScbCoil1_C "OBD specific trouble code / OBD specific diagnostic trouble code for check DFC_BypAirActrScbCoil1" VALUE 0x908127C Val_Wu16 65535.00 DFES_OneToOne 0.00 65535.00 FORMAT "%8.2" /end CHARACTERISTIC
/begin CHARACTERISTIC DFES_DTCO.DFC_BypAirActrScbCoil2_C "OBD specific trouble code / OBD specific diagnostic trouble code for check DFC_BypAirActrScbCoil2" VALUE 0x908127E Val_Wu16 65535.00 DFES_OneToOne 0.00 65535.00 FORMAT "%8.2" /end CHARACTERISTIC
/begin CHARACTERISTIC DFES_DTCO.DFC_BypAirActrScgCoil1_C "OBD specific trouble code / OBD specific diagnostic trouble code for check DFC_BypAirActrScgCoil1" VALUE 0x9081280 Val_Wu16 65535.00 DFES_OneToOne 0.00 65535.00 FORMAT "%8.2" /end CHARACTERISTIC
/begin CHARACTERISTIC DFES_DTCO.DFC_BypAirActrScgCoil2_C "OBD specific trouble code / OBD specific diagnostic trouble code for check DFC_BypAirActrScgCoil2" VALUE 0x9081282 Val_Wu16 65535.00 DFES_OneToOne 0.00 65535.00 FORMAT "%8.2" /end CHARACTERISTIC
/begin CHARACTERISTIC DFES_DTCO.DFC_CEngDsTPhysRngHi_C "OBD specific trouble code / OBD specific diagnostic trouble code for check DFC_CEngDsTPhysRngHi" VALUE 0x9081284 Val_Wu16 65535.00 DFES_OneToOne 0.00 65535.00 FORMAT "%8.2" /end CHARACTERISTIC
/begin CHARACTERISTIC DFES_DTCO.DFC_CEngDsTPhysRngLo_C "OBD specific trouble code / OBD specific diagnostic trouble code for check DFC_CEngDsTPhysRngLo" VALUE 0x9081286 Val_Wu16 65535.00 DFES_OneToOne 0.00 65535.00 FORMAT "%8.2" /end CHARACTERISTIC
/begin CHARACTERISTIC DFES_DTCO.DFC_CEngDsTSRCMax_C "OBD specific trouble code / OBD specific diagnostic trouble code for check DFC_CEngDsTSRCMax" VALUE 0x9081288 Val_Wu16 65535.00 DFES_OneToOne 0.00 65535.00 FORMAT "%8.2" /end CHARACTERISTIC
/begin CHARACTERISTIC DFES_DTCO.DFC_CEngDsTSRCMin_C "OBD specific trouble code / OBD specific diagnostic trouble code for check DFC_CEngDsTSRCMin" VALUE 0x908128A Val_Wu16 65535.00 DFES_OneToOne 0.00 65535.00 FORMAT "%8.2" /end CHARACTERISTIC
/begin CHARACTERISTIC DFES_DTCO.DFC_DKmax_C "OBD specific trouble code / OBD specific diagnostic trouble code for check DFC_DKmax" VALUE 0x908128C Val_Wu16 65535.00 DFES_OneToOne 0.00 65535.00 FORMAT "%8.2" /end CHARACTERISTIC
/begin CHARACTERISTIC DFES_DTCO.DFC_DKmin_C "OBD specific trouble code / OBD specific diagnostic trouble code for check DFC_DKmin" VALUE 0x908128E Val_Wu16 65535.00 DFES_OneToOne 0.00 65535.00 FORMAT "%8.2" /end CHARACTERISTIC
/begin CHARACTERISTIC DFES_DTCO.DFC_DLLRmax_C "OBD specific trouble code / OBD specific diagnostic trouble code for check DFC_DLLRmax" VALUE 0x9081290 Val_Wu16 65535.00 DFES_OneToOne 0.00 65535.00 FORMAT "%8.2" /end CHARACTERISTIC
/begin CHARACTERISTIC DFES_DTCO.DFC_DLLRmin_C "OBD specific trouble code / OBD specific diagnostic trouble code for check DFC_DLLRmin" VALUE 0x9081292 Val_Wu16 65535.00 DFES_OneToOne 0.00 65535.00 FORMAT "%8.2" /end CHARACTERISTIC
/begin CHARACTERISTIC DFES_DTCO.DFC_DLLRnpl_C "OBD specific trouble code / OBD specific diagnostic trouble code for check DFC_DLLRnpl" VALUE 0x9081294 Val_Wu16 65535.00 DFES_OneToOne 0.00 65535.00 FORMAT "%8.2" /end CHARACTERISTIC
/begin CHARACTERISTIC DFES_DTCO.DFC_DSSRngMax_C "OBD specific trouble code / OBD specific diagnostic trouble code for check DFC_DSSRngMax" VALUE 0x9081296 Val_Wu16 65535.00 DFES_OneToOne 0.00 65535.00 FORMAT "%8.2" /end CHARACTERISTIC
/begin CHARACTERISTIC DFES_DTCO.DFC_DSSRngMin_C "OBD specific trouble code / OBD specific diagnostic trouble code for check DFC_DSSRngMin" VALUE 0x9081298 Val_Wu16 65535.00 DFES_OneToOne 0.00 65535.00 FORMAT "%8.2" /end CHARACTERISTIC
/begin CHARACTERISTIC DFES_DTCO.DFC_DSSmax_C "OBD specific trouble code / OBD specific diagnostic trouble code for check DFC_DSSmax" VALUE 0x908129A Val_Wu16 65535.00 DFES_OneToOne 0.00 65535.00 FORMAT "%8.2" /end CHARACTERISTIC
/begin CHARACTERISTIC DFES_DTCO.DFC_DSSmin_C "OBD specific trouble code / OBD specific diagnostic trouble code for check DFC_DSSmin" VALUE 0x908129C Val_Wu16 65535.00 DFES_OneToOne 0.00 65535.00 FORMAT "%8.2" /end CHARACTERISTIC
/begin CHARACTERISTIC DFES_DTCO.DFC_DSSnpl_C "OBD specific trouble code / OBD specific diagnostic trouble code for check DFC_DSSnpl" VALUE 0x908129E Val_Wu16 65535.00 DFES_OneToOne 0.00 65535.00 FORMAT "%8.2" /end CHARACTERISTIC
/begin CHARACTERISTIC DFES_DTCO.DFC_DSSnplMax_C "OBD specific trouble code / OBD specific diagnostic trouble code for check DFC_DSSnplMax" VALUE 0x90812A0 Val_Wu16 65535.00 DFES_OneToOne 0.00 65535.00 FORMAT "%8.2" /end CHARACTERISTIC
/begin CHARACTERISTIC DFES_DTCO.DFC_DSSnplMin_C "OBD specific trouble code / OBD specific diagnostic trouble code for check DFC_DSSnplMin" VALUE 0x90812A2 Val_Wu16 65535.00 DFES_OneToOne 0.00 65535.00 FORMAT "%8.2" /end CHARACTERISTIC
/begin CHARACTERISTIC DFES_DTCO.DFC_DSSsig_C "OBD specific trouble code / OBD specific diagnostic trouble code for check DFC_DSSsig" VALUE 0x90812A4 Val_Wu16 65535.00 DFES_OneToOne 0.00 65535.00 FORMAT "%8.2" /end CHARACTERISTIC
/begin CHARACTERISTIC DFES_DTCO.DFC_EpmCrSErrSig_C "OBD specific trouble code / OBD specific diagnostic trouble code for check DFC_EpmCrSErrSig" VALUE 0x90812A6 Val_Wu16 65535.00 DFES_OneToOne 0.00 65535.00 FORMAT "%8.2" /end CHARACTERISTIC
/begin CHARACTERISTIC DFES_DTCO.DFC_EpmCrSNoSig_C "OBD specific trouble code / OBD specific diagnostic trouble code for check DFC_EpmCrSNoSig" VALUE 0x90812A8 Val_Wu16 65535.00 DFES_OneToOne 0.00 65535.00 FORMAT "%8.2" /end CHARACTERISTIC
/begin CHARACTERISTIC DFES_DTCO.DFC_HEGOS1B1ElecNpl_C "OBD specific trouble code / OBD specific diagnostic trouble code for check DFC_HEGOS1B1ElecNpl" VALUE 0x90812AA Val_Wu16 65535.00 DFES_OneToOne 0.00 65535.00 FORMAT "%8.2" /end CHARACTERISTIC
/begin CHARACTERISTIC DFES_DTCO.DFC_HSH_C "OBD specific trouble code / OBD specific diagnostic trouble code for check DFC_HSH" VALUE 0x90812AC Val_Wu16 65535.00 DFES_OneToOne 0.00 65535.00 FORMAT "%8.2" /end CHARACTERISTIC
/begin CHARACTERISTIC DFES_DTCO.DFC_HSHEmax_C "OBD specific trouble code / OBD specific diagnostic trouble code for check DFC_HSHEmax" VALUE 0x90812AE Val_Wu16 65535.00 DFES_OneToOne 0.00 65535.00 FORMAT "%8.2" /end CHARACTERISTIC
/begin CHARACTERISTIC DFES_DTCO.DFC_HSHEmin_C "OBD specific trouble code / OBD specific diagnostic trouble code for check DFC_HSHEmin" VALUE 0x90812B0 Val_Wu16 65535.00 DFES_OneToOne 0.00 65535.00 FORMAT "%8.2" /end CHARACTERISTIC
/begin CHARACTERISTIC DFES_DTCO.DFC_HSHEsig_C "OBD specific trouble code / OBD specific diagnostic trouble code for check DFC_HSHEsig" VALUE 0x90812B2 Val_Wu16 65535.00 DFES_OneToOne 0.00 65535.00 FORMAT "%8.2" /end CHARACTERISTIC
/begin CHARACTERISTIC DFES_DTCO.DFC_HSV_C "OBD specific trouble code / OBD specific diagnostic trouble code for check DFC_HSV" VALUE 0x90812B4 Val_Wu16 65535.00 DFES_OneToOne 0.00 65535.00 FORMAT "%8.2" /end CHARACTERISTIC
/begin CHARACTERISTIC DFES_DTCO.DFC_HSVEmax_C "OBD specific trouble code / OBD specific diagnostic trouble code for check DFC_HSVEmax" VALUE 0x90812B6 Val_Wu16 65535.00 DFES_OneToOne 0.00 65535.00 FORMAT "%8.2" /end CHARACTERISTIC
/begin CHARACTERISTIC DFES_DTCO.DFC_HSVEmin_C "OBD specific trouble code / OBD specific diagnostic trouble code for check DFC_HSVEmin" VALUE 0x90812B8 Val_Wu16 65535.00 DFES_OneToOne 0.00 65535.00 FORMAT "%8.2" /end CHARACTERISTIC
/begin CHARACTERISTIC DFES_DTCO.DFC_HSVEsig_C "OBD specific trouble code / OBD specific diagnostic trouble code for check DFC_HSVEsig" VALUE 0x90812BA Val_Wu16 65535.00 DFES_OneToOne 0.00 65535.00 FORMAT "%8.2" /end CHARACTERISTIC
/begin CHARACTERISTIC DFES_DTCO.DFC_HdLampMax_C "OBD specific trouble code / OBD specific diagnostic trouble code for check DFC_HdLampMax" VALUE 0x90812BC Val_Wu16 65535.00 DFES_OneToOne 0.00 65535.00 FORMAT "%8.2" /end CHARACTERISTIC
/begin CHARACTERISTIC DFES_DTCO.DFC_HdLampMin_C "OBD specific trouble code / OBD specific diagnostic trouble code for check DFC_HdLampMin" VALUE 0x90812BE Val_Wu16 65535.00 DFES_OneToOne 0.00 65535.00 FORMAT "%8.2" /end CHARACTERISTIC
/begin CHARACTERISTIC DFES_DTCO.DFC_HdLampSig_C "OBD specific trouble code / OBD specific diagnostic trouble code for check DFC_HdLampSig" VALUE 0x90812C0 Val_Wu16 65535.00 DFES_OneToOne 0.00 65535.00 FORMAT "%8.2" /end CHARACTERISTIC
/begin CHARACTERISTIC DFES_DTCO.DFC_IgnCoil1Err_C "OBD specific trouble code / OBD specific diagnostic trouble code for check DFC_IgnCoil1Err" VALUE 0x90812C2 Val_Wu16 65535.00 DFES_OneToOne 0.00 65535.00 FORMAT "%8.2" /end CHARACTERISTIC
/begin CHARACTERISTIC DFES_DTCO.DFC_IgnCoil2Err_C "OBD specific trouble code / OBD specific diagnostic trouble code for check DFC_IgnCoil2Err" VALUE 0x90812C4 Val_Wu16 65535.00 DFES_OneToOne 0.00 65535.00 FORMAT "%8.2" /end CHARACTERISTIC
/begin CHARACTERISTIC DFES_DTCO.DFC_IgnIgbtDiagSCG_0_C "OBD specific trouble code / OBD specific diagnostic trouble code for check DFC_IgnIgbtDiagSCG_0" VALUE 0x90812C6 Val_Wu16 65535.00 DFES_OneToOne 0.00 65535.00 FORMAT "%8.2" /end CHARACTERISTIC
/begin CHARACTERISTIC DFES_DTCO.DFC_IgnIgbtDiagSCG_1_C "OBD specific trouble code / OBD specific diagnostic trouble code for check DFC_IgnIgbtDiagSCG_1" VALUE 0x90812C8 Val_Wu16 65535.00 DFES_OneToOne 0.00 65535.00 FORMAT "%8.2" /end CHARACTERISTIC
/begin CHARACTERISTIC DFES_DTCO.DFC_IntkAirTAirFltDsPRCMax_C "OBD specific trouble code / OBD specific diagnostic trouble code for check DFC_IntkAirTAirFltDsPRCMax" VALUE 0x90812CA Val_Wu16 65535.00 DFES_OneToOne 0.00 65535.00 FORMAT "%8.2" /end CHARACTERISTIC
/begin CHARACTERISTIC DFES_DTCO.DFC_IntkAirTAirFltDsPRCMin_C "OBD specific trouble code / OBD specific diagnostic trouble code for check DFC_IntkAirTAirFltDsPRCMin" VALUE 0x90812CC Val_Wu16 65535.00 DFES_OneToOne 0.00 65535.00 FORMAT "%8.2" /end CHARACTERISTIC
/begin CHARACTERISTIC DFES_DTCO.DFC_IntkAirTAirFltDsSRCMax_C "OBD specific trouble code / OBD specific diagnostic trouble code for check DFC_IntkAirTAirFltDsSRCMax" VALUE 0x90812CE Val_Wu16 65535.00 DFES_OneToOne 0.00 65535.00 FORMAT "%8.2" /end CHARACTERISTIC
/begin CHARACTERISTIC DFES_DTCO.DFC_IntkAirTAirFltDsSRCMin_C "OBD specific trouble code / OBD specific diagnostic trouble code for check DFC_IntkAirTAirFltDsSRCMin" VALUE 0x90812D0 Val_Wu16 65535.00 DFES_OneToOne 0.00 65535.00 FORMAT "%8.2" /end CHARACTERISTIC
/begin CHARACTERISTIC DFES_DTCO.DFC_IntkMnfldPNoSyn_C "OBD specific trouble code / OBD specific diagnostic trouble code for check DFC_IntkMnfldPNoSyn" VALUE 0x90812D2 Val_Wu16 65535.00 DFES_OneToOne 0.00 65535.00 FORMAT "%8.2" /end CHARACTERISTIC
/begin CHARACTERISTIC DFES_DTCO.DFC_KAT_C "OBD specific trouble code / OBD specific diagnostic trouble code for check DFC_KAT" VALUE 0x90812D4 Val_Wu16 65535.00 DFES_OneToOne 0.00 65535.00 FORMAT "%8.2" /end CHARACTERISTIC
/begin CHARACTERISTIC DFES_DTCO.DFC_KPEmax_C "OBD specific trouble code / OBD specific diagnostic trouble code for check DFC_KPEmax" VALUE 0x90812D6 Val_Wu16 65535.00 DFES_OneToOne 0.00 65535.00 FORMAT "%8.2" /end CHARACTERISTIC
/begin CHARACTERISTIC DFES_DTCO.DFC_KPEmin_C "OBD specific trouble code / OBD specific diagnostic trouble code for check DFC_KPEmin" VALUE 0x90812D8 Val_Wu16 65535.00 DFES_OneToOne 0.00 65535.00 FORMAT "%8.2" /end CHARACTERISTIC
/begin CHARACTERISTIC DFES_DTCO.DFC_KPEsig_C "OBD specific trouble code / OBD specific diagnostic trouble code for check DFC_KPEsig" VALUE 0x90812DA Val_Wu16 65535.00 DFES_OneToOne 0.00 65535.00 FORMAT "%8.2" /end CHARACTERISTIC
/begin CHARACTERISTIC DFES_DTCO.DFC_KVSFmax_C "OBD specific trouble code / OBD specific diagnostic trouble code for check DFC_KVSFmax" VALUE 0x90812DC Val_Wu16 65535.00 DFES_OneToOne 0.00 65535.00 FORMAT "%8.2" /end CHARACTERISTIC
/begin CHARACTERISTIC DFES_DTCO.DFC_KVSFmin_C "OBD specific trouble code / OBD specific diagnostic trouble code for check DFC_KVSFmin" VALUE 0x90812DE Val_Wu16 65535.00 DFES_OneToOne 0.00 65535.00 FORMAT "%8.2" /end CHARACTERISTIC
/begin CHARACTERISTIC DFES_DTCO.DFC_KVSOmax_C "OBD specific trouble code / OBD specific diagnostic trouble code for check DFC_KVSOmax" VALUE 0x90812E0 Val_Wu16 65535.00 DFES_OneToOne 0.00 65535.00 FORMAT "%8.2" /end CHARACTERISTIC
/begin CHARACTERISTIC DFES_DTCO.DFC_KVSOmin_C "OBD specific trouble code / OBD specific diagnostic trouble code for check DFC_KVSOmin" VALUE 0x90812E2 Val_Wu16 65535.00 DFES_OneToOne 0.00 65535.00 FORMAT "%8.2" /end CHARACTERISTIC
/begin CHARACTERISTIC DFES_DTCO.DFC_LASHmn_C "OBD specific trouble code / OBD specific diagnostic trouble code for check DFC_LASHmn" VALUE 0x90812E4 Val_Wu16 65535.00 DFES_OneToOne 0.00 65535.00 FORMAT "%8.2" /end CHARACTERISTIC
/begin CHARACTERISTIC DFES_DTCO.DFC_LASHmx_C "OBD specific trouble code / OBD specific diagnostic trouble code for check DFC_LASHmx" VALUE 0x90812E6 Val_Wu16 65535.00 DFES_OneToOne 0.00 65535.00 FORMAT "%8.2" /end CHARACTERISTIC
/begin CHARACTERISTIC DFES_DTCO.DFC_LATP_C "OBD specific trouble code / OBD specific diagnostic trouble code for check DFC_LATP" VALUE 0x90812E8 Val_Wu16 65535.00 DFES_OneToOne 0.00 65535.00 FORMAT "%8.2" /end CHARACTERISTIC
/begin CHARACTERISTIC DFES_DTCO.DFC_LDLAHI_C "OBD specific trouble code / OBD specific diagnostic trouble code for check DFC_LDLAHI" VALUE 0x90812EA Val_Wu16 65535.00 DFES_OneToOne 0.00 65535.00 FORMAT "%8.2" /end CHARACTERISTIC
/begin CHARACTERISTIC DFES_DTCO.DFC_LFS1Max_C "OBD specific trouble code / OBD specific diagnostic trouble code for check DFC_LFS1Max" VALUE 0x90812EC Val_Wu16 65535.00 DFES_OneToOne 0.00 65535.00 FORMAT "%8.2" /end CHARACTERISTIC
/begin CHARACTERISTIC DFES_DTCO.DFC_LFS1Min_C "OBD specific trouble code / OBD specific diagnostic trouble code for check DFC_LFS1Min" VALUE 0x90812EE Val_Wu16 65535.00 DFES_OneToOne 0.00 65535.00 FORMAT "%8.2" /end CHARACTERISTIC
/begin CHARACTERISTIC DFES_DTCO.DFC_LFS1Sig_C "OBD specific trouble code / OBD specific diagnostic trouble code for check DFC_LFS1Sig" VALUE 0x90812F0 Val_Wu16 65535.00 DFES_OneToOne 0.00 65535.00 FORMAT "%8.2" /end CHARACTERISTIC
/begin CHARACTERISTIC DFES_DTCO.DFC_LSHmax_C "OBD specific trouble code / OBD specific diagnostic trouble code for check DFC_LSHmax" VALUE 0x90812F2 Val_Wu16 65535.00 DFES_OneToOne 0.00 65535.00 FORMAT "%8.2" /end CHARACTERISTIC
/begin CHARACTERISTIC DFES_DTCO.DFC_LSHmin_C "OBD specific trouble code / OBD specific diagnostic trouble code for check DFC_LSHmin" VALUE 0x90812F4 Val_Wu16 65535.00 DFES_OneToOne 0.00 65535.00 FORMAT "%8.2" /end CHARACTERISTIC
/begin CHARACTERISTIC DFES_DTCO.DFC_LSHnpl_C "OBD specific trouble code / OBD specific diagnostic trouble code for check DFC_LSHnpl" VALUE 0x90812F6 Val_Wu16 65535.00 DFES_OneToOne 0.00 65535.00 FORMAT "%8.2" /end CHARACTERISTIC
/begin CHARACTERISTIC DFES_DTCO.DFC_LSHsig_C "OBD specific trouble code / OBD specific diagnostic trouble code for check DFC_LSHsig" VALUE 0x90812F8 Val_Wu16 65535.00 DFES_OneToOne 0.00 65535.00 FORMAT "%8.2" /end CHARACTERISTIC
/begin CHARACTERISTIC DFES_DTCO.DFC_LSVmax_C "OBD specific trouble code / OBD specific diagnostic trouble code for check DFC_LSVmax" VALUE 0x90812FA Val_Wu16 65535.00 DFES_OneToOne 0.00 65535.00 FORMAT "%8.2" /end CHARACTERISTIC
/begin CHARACTERISTIC DFES_DTCO.DFC_LSVmin_C "OBD specific trouble code / OBD specific diagnostic trouble code for check DFC_LSVmin" VALUE 0x90812FC Val_Wu16 65535.00 DFES_OneToOne 0.00 65535.00 FORMAT "%8.2" /end CHARACTERISTIC
/begin CHARACTERISTIC DFES_DTCO.DFC_LSVnpl_C "OBD specific trouble code / OBD specific diagnostic trouble code for check DFC_LSVnpl" VALUE 0x90812FE Val_Wu16 65535.00 DFES_OneToOne 0.00 65535.00 FORMAT "%8.2" /end CHARACTERISTIC
/begin CHARACTERISTIC DFES_DTCO.DFC_LSVsig_C "OBD specific trouble code / OBD specific diagnostic trouble code for check DFC_LSVsig" VALUE 0x9081300 Val_Wu16 65535.00 DFES_OneToOne 0.00 65535.00 FORMAT "%8.2" /end CHARACTERISTIC
/begin CHARACTERISTIC DFES_DTCO.DFC_MDCat_C "OBD specific trouble code / OBD specific diagnostic trouble code for check DFC_MDCat" VALUE 0x9081302 Val_Wu16 65535.00 DFES_OneToOne 0.00 65535.00 FORMAT "%8.2" /end CHARACTERISTIC
/begin CHARACTERISTIC DFES_DTCO.DFC_MDCatCurr_C "OBD specific trouble code / OBD specific diagnostic trouble code for check DFC_MDCatCurr" VALUE 0x9081304 Val_Wu16 65535.00 DFES_OneToOne 0.00 65535.00 FORMAT "%8.2" /end CHARACTERISTIC
/begin CHARACTERISTIC DFES_DTCO.DFC_MDCyl_C "OBD specific trouble code / OBD specific diagnostic trouble code for check DFC_MDCyl" VALUE 0x9081306 Val_Wu16 65535.00 DFES_OneToOne 0.00 65535.00 FORMAT "%8.2" /end CHARACTERISTIC
/begin CHARACTERISTIC DFES_DTCO.DFC_MDEmi_C "OBD specific trouble code / OBD specific diagnostic trouble code for check DFC_MDEmi" VALUE 0x9081308 Val_Wu16 65535.00 DFES_OneToOne 0.00 65535.00 FORMAT "%8.2" /end CHARACTERISTIC
/begin CHARACTERISTIC DFES_DTCO.DFC_MDEmiStrt_C "OBD specific trouble code / OBD specific diagnostic trouble code for check DFC_MDEmiStrt" VALUE 0x908130A Val_Wu16 65535.00 DFES_OneToOne 0.00 65535.00 FORMAT "%8.2" /end CHARACTERISTIC
/begin CHARACTERISTIC DFES_DTCO.DFC_MDMpl_C "OBD specific trouble code / OBD specific diagnostic trouble code for check DFC_MDMpl" VALUE 0x908130C Val_Wu16 65535.00 DFES_OneToOne 0.00 65535.00 FORMAT "%8.2" /end CHARACTERISTIC
/begin CHARACTERISTIC DFES_DTCO.DFC_MoCADCNTP_C "OBD specific trouble code / OBD specific diagnostic trouble code for check DFC_MoCADCNTP" VALUE 0x908130E Val_Wu16 65535.00 DFES_OneToOne 0.00 65535.00 FORMAT "%8.2" /end CHARACTERISTIC
/begin CHARACTERISTIC DFES_DTCO.DFC_MoCADCTst_C "OBD specific trouble code / OBD specific diagnostic trouble code for check DFC_MoCADCTst" VALUE 0x9081310 Val_Wu16 65535.00 DFES_OneToOne 0.00 65535.00 FORMAT "%8.2" /end CHARACTERISTIC
/begin CHARACTERISTIC DFES_DTCO.DFC_MoFSidst_C "OBD specific trouble code / OBD specific diagnostic trouble code for check DFC_MoFSidst" VALUE 0x9081312 Val_Wu16 65535.00 DFES_OneToOne 0.00 65535.00 FORMAT "%8.2" /end CHARACTERISTIC
/begin CHARACTERISTIC DFES_DTCO.DFC_OCWDACom_C "OBD specific trouble code / OBD specific diagnostic trouble code for check DFC_OCWDACom" VALUE 0x9081314 Val_Wu16 65535.00 DFES_OneToOne 0.00 65535.00 FORMAT "%8.2" /end CHARACTERISTIC
/begin CHARACTERISTIC DFES_DTCO.DFC_OilPPSSwtMax_C "OBD specific trouble code / OBD specific diagnostic trouble code for check DFC_OilPPSSwtMax" VALUE 0x9081316 Val_Wu16 65535.00 DFES_OneToOne 0.00 65535.00 FORMAT "%8.2" /end CHARACTERISTIC
/begin CHARACTERISTIC DFES_DTCO.DFC_OilPPSSwtMin_C "OBD specific trouble code / OBD specific diagnostic trouble code for check DFC_OilPPSSwtMin" VALUE 0x9081318 Val_Wu16 65535.00 DFES_OneToOne 0.00 65535.00 FORMAT "%8.2" /end CHARACTERISTIC
/begin CHARACTERISTIC DFES_DTCO.DFC_OilPPSSwtSig_C "OBD specific trouble code / OBD specific diagnostic trouble code for check DFC_OilPPSSwtSig" VALUE 0x908131A Val_Wu16 65535.00 DFES_OneToOne 0.00 65535.00 FORMAT "%8.2" /end CHARACTERISTIC
/begin CHARACTERISTIC DFES_DTCO.DFC_OvHEngSpdLimr_C "OBD specific trouble code / OBD specific diagnostic trouble code for check DFC_OvHEngSpdLimr" VALUE 0x908131C Val_Wu16 65535.00 DFES_OneToOne 0.00 65535.00 FORMAT "%8.2" /end CHARACTERISTIC
/begin CHARACTERISTIC DFES_DTCO.DFC_RoVComVld_C "OBD specific trouble code / OBD specific diagnostic trouble code for check DFC_RoVComVld" VALUE 0x908131E Val_Wu16 65535.00 DFES_OneToOne 0.00 65535.00 FORMAT "%8.2" /end CHARACTERISTIC
/begin CHARACTERISTIC DFES_DTCO.DFC_RoVSNpl_C "OBD specific trouble code / OBD specific diagnostic trouble code for check DFC_RoVSNpl" VALUE 0x9081320 Val_Wu16 65535.00 DFES_OneToOne 0.00 65535.00 FORMAT "%8.2" /end CHARACTERISTIC
/begin CHARACTERISTIC DFES_DTCO.DFC_RoVSOL_C "OBD specific trouble code / OBD specific diagnostic trouble code for check DFC_RoVSOL" VALUE 0x9081322 Val_Wu16 65535.00 DFES_OneToOne 0.00 65535.00 FORMAT "%8.2" /end CHARACTERISTIC
/begin CHARACTERISTIC DFES_DTCO.DFC_RoVSSCB_C "OBD specific trouble code / OBD specific diagnostic trouble code for check DFC_RoVSSCB" VALUE 0x9081324 Val_Wu16 65535.00 DFES_OneToOne 0.00 65535.00 FORMAT "%8.2" /end CHARACTERISTIC
/begin CHARACTERISTIC DFES_DTCO.DFC_RoVSSCG_C "OBD specific trouble code / OBD specific diagnostic trouble code for check DFC_RoVSSCG" VALUE 0x9081326 Val_Wu16 65535.00 DFES_OneToOne 0.00 65535.00 FORMAT "%8.2" /end CHARACTERISTIC
/begin CHARACTERISTIC DFES_DTCO.DFC_SdSTNpl_C "OBD specific trouble code / OBD specific diagnostic trouble code for check DFC_SdSTNpl" VALUE 0x9081328 Val_Wu16 65535.00 DFES_OneToOne 0.00 65535.00 FORMAT "%8.2" /end CHARACTERISTIC
/begin CHARACTERISTIC DFES_DTCO.DFC_SdSTSCB_C "OBD specific trouble code / OBD specific diagnostic trouble code for check DFC_SdSTSCB" VALUE 0x908132A Val_Wu16 65535.00 DFES_OneToOne 0.00 65535.00 FORMAT "%8.2" /end CHARACTERISTIC
/begin CHARACTERISTIC DFES_DTCO.DFC_SdSTSCG_C "OBD specific trouble code / OBD specific diagnostic trouble code for check DFC_SdSTSCG" VALUE 0x908132C Val_Wu16 65535.00 DFES_OneToOne 0.00 65535.00 FORMAT "%8.2" /end CHARACTERISTIC
/begin CHARACTERISTIC DFES_DTCO.DFC_SdSTSOL_C "OBD specific trouble code / OBD specific diagnostic trouble code for check DFC_SdSTSOL" VALUE 0x908132E Val_Wu16 65535.00 DFES_OneToOne 0.00 65535.00 FORMAT "%8.2" /end CHARACTERISTIC
/begin CHARACTERISTIC DFES_DTCO.DFC_TEVEmax_C "OBD specific trouble code / OBD specific diagnostic trouble code for check DFC_TEVEmax" VALUE 0x9081330 Val_Wu16 65535.00 DFES_OneToOne 0.00 65535.00 FORMAT "%8.2" /end CHARACTERISTIC
/begin CHARACTERISTIC DFES_DTCO.DFC_TEVEmin_C "OBD specific trouble code / OBD specific diagnostic trouble code for check DFC_TEVEmin" VALUE 0x9081332 Val_Wu16 65535.00 DFES_OneToOne 0.00 65535.00 FORMAT "%8.2" /end CHARACTERISTIC
/begin CHARACTERISTIC DFES_DTCO.DFC_TEVEsig_C "OBD specific trouble code / OBD specific diagnostic trouble code for check DFC_TEVEsig" VALUE 0x9081334 Val_Wu16 65535.00 DFES_OneToOne 0.00 65535.00 FORMAT "%8.2" /end CHARACTERISTIC
/begin CHARACTERISTIC DFES_DTCO.DFC_TMnpl_C "OBD specific trouble code / OBD specific diagnostic trouble code for check DFC_TMnpl" VALUE 0x9081336 Val_Wu16 65535.00 DFES_OneToOne 0.00 65535.00 FORMAT "%8.2" /end CHARACTERISTIC
/begin CHARACTERISTIC DFES_DTCO.DFC_UBmax_C "OBD specific trouble code / OBD specific diagnostic trouble code for check DFC_UBmax" VALUE 0x9081338 Val_Wu16 65535.00 DFES_OneToOne 0.00 65535.00 FORMAT "%8.2" /end CHARACTERISTIC
/begin CHARACTERISTIC DFES_DTCO.DFC_UBmin_C "OBD specific trouble code / OBD specific diagnostic trouble code for check DFC_UBmin" VALUE 0x908133A Val_Wu16 65535.00 DFES_OneToOne 0.00 65535.00 FORMAT "%8.2" /end CHARACTERISTIC
/begin CHARACTERISTIC DFES_DTCO.DFC_UBnpl_C "OBD specific trouble code / OBD specific diagnostic trouble code for check DFC_UBnpl" VALUE 0x908133C Val_Wu16 65535.00 DFES_OneToOne 0.00 65535.00 FORMAT "%8.2" /end CHARACTERISTIC
/begin CHARACTERISTIC DFES_DTCO.DFC_VFZsig_C "OBD specific trouble code / OBD specific diagnostic trouble code for check DFC_VFZsig" VALUE 0x908133E Val_Wu16 65535.00 DFES_OneToOne 0.00 65535.00 FORMAT "%8.2" /end CHARACTERISTIC
/begin CHARACTERISTIC DFES_DTCO.DFC_VFZsig2_C "OBD specific trouble code / OBD specific diagnostic trouble code for check DFC_VFZsig2" VALUE 0x9081340 Val_Wu16 65535.00 DFES_OneToOne 0.00 65535.00 FORMAT "%8.2" /end CHARACTERISTIC
/begin CHARACTERISTIC DFES_Env.xSet1_CA "set of signals per environment data / Signal selection for environment dataset 1" VAL_BLK 0x9081346 ValA_Wu16 91.0000000000 Signals_IntSigNumVerb 0.00 91.0000000000 FORMAT "%13.10" NUMBER 1 /end CHARACTERISTIC
/begin CHARACTERISTIC DFES_Env.xSet2_CA "set of signals per environment data / Signal selection for environment dataset 2" VAL_BLK 0x9081348 ValA_Wu16 91.0000000000 Signals_IntSigNumVerb 0.00 91.0000000000 FORMAT "%13.10" NUMBER 1 /end CHARACTERISTIC
/begin CHARACTERISTIC DFES_EnvRef_C "Associated environment condition set (valid for all DFCs)" VALUE 0x90804DE Val_Wu8 1. DFES_EnvTabVerb 0.00 1. FORMAT "%2.0" /end CHARACTERISTIC
/begin CHARACTERISTIC DFES_FaultTyp_C "Fault type (3rd DTC byte; valid for all DFCs)" VALUE 0x90804DF Val_Wu8 255.0 DFES_OneToOne 0.00 255.0 FORMAT "%5.1" /end CHARACTERISTIC
/begin CHARACTERISTIC DFES_MonEvtMSK0_C "Event filter mask of Monitoring - Mask Id mast have 0 at bit mask 0 positions" VALUE 0x90804E0 Val_Wu16 65535.00 OneToOne 0.00 65535.00 FORMAT "%8.2" /end CHARACTERISTIC
/begin CHARACTERISTIC DFES_MonEvtMSK1_C "Event filter mask of Monitoring - Mask Id mast have 1 at bit mask 1 positions" VALUE 0x90804E2 Val_Wu16 65535.00 OneToOne 0.00 65535.00 FORMAT "%8.2" /end CHARACTERISTIC
/begin CHARACTERISTIC DFES_MonRepeat_C "switch to ignore same kind of monitoring events, set to 0 to suppress identical events in a row" VALUE 0x90804E4 Val_Wu8 255.0 OneToOne 0.00 255.0 FORMAT "%5.1" /end CHARACTERISTIC
/begin CHARACTERISTIC DFES_numClsDlt_CA "Fault class parameter: Number of cycles for OBD delete counter" VAL_BLK 0x90804E5 ValA_Wu8 255.0 DFES_OneToOne 0.00 255.0 FORMAT "%5.1" NUMBER 22 /end CHARACTERISTIC
/begin CHARACTERISTIC DFES_numClsFaultCycl_CA "Fault class parameter: Number of cycles for fault counter" VAL_BLK 0x90804FB ValA_Wu8 255.0 DFES_OneToOne 0.00 255.0 FORMAT "%5.1" NUMBER 22 /end CHARACTERISTIC
/begin CHARACTERISTIC DFES_numClsHealCycl_CA "Fault class parameter: Number of cycles for healing counter" VAL_BLK 0x9080511 ValA_Wu8 255.0 DFES_OneToOne 0.00 255.0 FORMAT "%5.1" NUMBER 22 /end CHARACTERISTIC
/begin CHARACTERISTIC DFES_numClsPndDlt_CA "Fault class parameter: Number of cycles for pending delete counter" VAL_BLK 0x9080527 ValA_Wu8 255.0 DFES_OneToOne 0.00 255.0 FORMAT "%5.1" NUMBER 22 /end CHARACTERISTIC
/begin CHARACTERISTIC DFES_numClsSvcDlt_CA "Fault class parameter: Number of cycles for delete counter" VAL_BLK 0x908053D ValA_Wu8 255.0 DFES_OneToOne 0.00 255.0 FORMAT "%5.1" NUMBER 22 /end CHARACTERISTIC
/begin CHARACTERISTIC DFES_numClsSVSFaultCycl_CA "Fault class parameter: Number of cycles for SVS lamp fault counter" VAL_BLK 0x9080553 ValA_Wu8 255.0 DFES_OneToOne 0.00 255.0 FORMAT "%5.1" NUMBER 22 /end CHARACTERISTIC
/begin CHARACTERISTIC DFES_numClsSVSHealCycl_CA "Fault class parameter: Number of cycles for SVS lamp healing counter" VAL_BLK 0x9080569 ValA_Wu8 255.0 DFES_OneToOne 0.00 255.0 FORMAT "%5.1" NUMBER 22 /end CHARACTERISTIC
/begin CHARACTERISTIC DFES_ThresSimCond.n_C "Threshold for similar conditions recognition / Maximum difference of engine speed to fulfill similar conditions" VALUE 0x9080580 Val_Wu16 16383.75 DFES_nPID0C 0.00 16383.75 FORMAT "%8.2" READ_ONLY /end CHARACTERISTIC
/begin CHARACTERISTIC DFES_ThresSimCond.r_C "Threshold for similar conditions recognition / Maximum difference of calculated load to fulfill similar conditions" VALUE 0x9080582 Val_Wu8 100.0 DFES_rPID04 0.00 100.0 FORMAT "%5.1" READ_ONLY /end CHARACTERISTIC
/begin CHARACTERISTIC DFES_ThresSimCond.t_C "Threshold for similar conditions recognition / Defines the temperature limit to differ between cold and hot warm-up status" VALUE 0x9080583 Val_Wu8 255.0 DFES_tPID05 -40.00 215.0 FORMAT "%5.1" READ_ONLY /end CHARACTERISTIC
/begin CHARACTERISTIC DFES_xAsgnFrzFrSig_CA "Signal selection for freeze frame (signal based)" VAL_BLK 0x9080586 ValA_Wu16 91.0000000000 Signals_IntSigNumVerb 0.00 91.0000000000 FORMAT "%13.10" NUMBER 21 /end CHARACTERISTIC
/begin CHARACTERISTIC DFES_xClsDltTrg_CA "Fault class parameter: Trigger type for OBD delete counter" VAL_BLK 0x90805B0 ValA_Wu8 14. DSMAUX_DTRGVerb 0.00 14. FORMAT "%2.0" NUMBER 22 /end CHARACTERISTIC
/begin CHARACTERISTIC DFES_xClsFaultTrg_CA "Fault class parameter: Trigger type for fault counter" VAL_BLK 0x90805C6 ValA_Wu8 14. DSMAUX_DTRGVerb 0.00 14. FORMAT "%2.0" NUMBER 22 /end CHARACTERISTIC
/begin CHARACTERISTIC DFES_xClsFltMIL_CA "Fault class parameter: MIL control" VAL_BLK 0x90805DC ValA_Wu8 3. DFES_LampFltMIL 0.00 3. FORMAT "%2.0" NUMBER 22 /end CHARACTERISTIC
/begin CHARACTERISTIC DFES_xClsFltSVS_CA "Fault class parameter: SVS lamp control" VAL_BLK 0x90805F2 ValA_Wu8 8.00000000000 DFES_LampFltSVS 0.00 8.00000000000 FORMAT "%13.11" NUMBER 22 /end CHARACTERISTIC
/begin CHARACTERISTIC DFES_xClsHealTrg_CA "Fault class parameter: Trigger type for healing counter" VAL_BLK 0x9080608 ValA_Wu8 14. DSMAUX_DTRGVerb 0.00 14. FORMAT "%2.0" NUMBER 22 /end CHARACTERISTIC
/begin CHARACTERISTIC DFES_xClsPndDltTrg_CA "Fault class parameter: Trigger type for pending delete counter" VAL_BLK 0x908061E ValA_Wu8 14. DSMAUX_DTRGVerb 0.00 14. FORMAT "%2.0" NUMBER 22 /end CHARACTERISTIC
/begin CHARACTERISTIC DFES_xClsPrio_CA "Fault class parameter: Static priority and tester visibility" VAL_BLK 0x9080634 ValA_Wu8 210.000000000 DFES_TstVisAndPrio 3.00000000000 213.000000000 FORMAT "%13.9" NUMBER 22 /end CHARACTERISTIC
/begin CHARACTERISTIC DFES_xClsSvcDltTrg_CA "Fault class parameter: Trigger type for delete counter" VAL_BLK 0x908064A ValA_Wu8 14. DSMAUX_DTRGVerb 0.00 14. FORMAT "%2.0" NUMBER 22 /end CHARACTERISTIC
/begin CHARACTERISTIC DFES_xClsSVSFaultTrg_CA "Fault class parameter: Trigger type for SVS lamp fault counter" VAL_BLK 0x9080660 ValA_Wu8 14. DSMAUX_DTRGVerb 0.00 14. FORMAT "%2.0" NUMBER 22 /end CHARACTERISTIC
/begin CHARACTERISTIC DFES_xClsSVSHealTrg_CA "Fault class parameter: Trigger type for SVS lamp healing counter" VAL_BLK 0x9080676 ValA_Wu8 14. DSMAUX_DTRGVerb 0.00 14. FORMAT "%2.0" NUMBER 22 /end CHARACTERISTIC
/begin CHARACTERISTIC DiaActr_ElecPsDiag_DbgSigId_C "Signal Id to be debugged" VALUE 0x9089F4C Val_Wu32 4294967295.00 OneToOne 0.00 4294967295.00 FORMAT "%13.2" /end CHARACTERISTIC
/begin CHARACTERISTIC DiaActr_ElecPsDiag_DbgSigTyp_C "Type of the output signal (PWMOut, DigOut, Pmd) to be debugged." VALUE 0x9089F50 Val_Wu8 3.00000000000 DiaActr_ElecPsDiag_DbgSigTyp_COMPU_VERB 0.00 3.00000000000 FORMAT "%13.11" /end CHARACTERISTIC
/begin CHARACTERISTIC DiaActr_ElecPsDiag_SigOutDurgOpenLd_C "Take into account Open-Load-Error for Shut-Off request." VALUE 0x9089F51 Val_Wu8 1.000 OneToOne 0.00 1.000 FORMAT "%5.3" EXTENDED_LIMITS 0.00 255.0 /end CHARACTERISTIC
/begin CHARACTERISTIC HEGO_rHeatrDiagDeltaThdS1_C "Sensor 1 Heater Diagnosis, Delta resistance for error healing" VALUE 0x9084F08 KwUw 131070.0 r_uw_q2 0.00 131070.0 FORMAT "%8.1" /end CHARACTERISTIC
/begin CHARACTERISTIC HEGO_rHeatrDiagDeltaThdS2_C "Sensor 2 Heater Diagnosis, Delta resistance for error healing" VALUE 0x9084F0A KwUw 131070.0 r_uw_q2 0.00 131070.0 FORMAT "%8.1" /end CHARACTERISTIC
/begin CHARACTERISTIC HEGO_tHeatrDiagMfTUpperThdS1_T "Sensor 1 heater diagnosis, Upper threshold based on mass flow" CURVE 0x9084F0C KlAxU8SstxU16WU8_Static 1275. temp_ub_q5_o50 -50.00 1225. FORMAT "%5.0"
 /begin AXIS_DESCR STD_AXIS ml_w m_uw_b6553p5 5 0.00 6553.500 FORMAT "%8.3" DEPOSIT ABSOLUTE /end AXIS_DESCR
/end CHARACTERISTIC
/begin CHARACTERISTIC HEGO_tHeatrDiagMfTUpperThdS2_T "Sensor 2 heater diagnosis, Upper threshold based on mass flow" CURVE 0x9084F1E KlAxU8SstxU16WU8_Static 1275. temp_ub_q5_o50 -50.00 1225. FORMAT "%5.0"
 /begin AXIS_DESCR STD_AXIS ml_w m_uw_b6553p5 5 0.00 6553.500 FORMAT "%8.3" DEPOSIT ABSOLUTE /end AXIS_DESCR
/end CHARACTERISTIC
/begin CHARACTERISTIC KFRINH "MAP for Nernst resistor post cat" MAP 0x9084F30 KfAxUbAyUbSstxUbSstyUbWUb 2040. r_q8 0.00 2040. FORMAT "%5.0"
 /begin AXIS_DESCR STD_AXIS tkihkm temp_ub_q5_o50 3 -50.00 1225. FORMAT "%5.0" DEPOSIT ABSOLUTE /end AXIS_DESCR
 /begin AXIS_DESCR STD_AXIS phlsnhxf fak_ub_q0p01 3 0.00 2.550 FORMAT "%5.3" DEPOSIT ABSOLUTE /end AXIS_DESCR
/end CHARACTERISTIC
/begin CHARACTERISTIC KFRINV "MAP for Nernst resistor pre cat" MAP 0x9084F41 KfAxUbAyUbSstxUbSstyUbWUb 2040. r_q8 0.00 2040. FORMAT "%5.0"
 /begin AXIS_DESCR STD_AXIS taikrm temp_ub_q5_o50 3 -50.00 1225. FORMAT "%5.0" DEPOSIT ABSOLUTE /end AXIS_DESCR
 /begin AXIS_DESCR STD_AXIS phlsnvxf fak_ub_q0p01 3 0.00 2.550 FORMAT "%5.3" DEPOSIT ABSOLUTE /end AXIS_DESCR
/end CHARACTERISTIC
/begin CHARACTERISTIC KLRINH "Multiplication factor for RIN nominal value downstream of the catalyzer" CURVE 0x9084F52 KlAUbSstUbWUb 63.75 fak_ub_b64 0.00 63.75 FORMAT "%5.2"
 /begin AXIS_DESCR STD_AXIS tkihkm temp_ub_q5_o50 3 -50.00 1225. FORMAT "%5.0" DEPOSIT ABSOLUTE /end AXIS_DESCR
/end CHARACTERISTIC
/begin CHARACTERISTIC KLRINV "Multiplicativ factor for RIN desired value pre cat" CURVE 0x9084F59 KlAUbSstUbWUb 63.75 fak_ub_b64 0.00 63.75 FORMAT "%5.2"
 /begin AXIS_DESCR STD_AXIS taikrm temp_ub_q5_o50 3 -50.00 1225. FORMAT "%5.0" DEPOSIT ABSOLUTE /end AXIS_DESCR
/end CHARACTERISTIC
/begin CHARACTERISTIC TADHMN "lower Temperature threshold for the heater diagnostic routine" VALUE 0x9084F60 KwUb 1275. temp_ub_q5_o50 -50.00 1225. FORMAT "%5.0" /end CHARACTERISTIC
/begin CHARACTERISTIC TDHHSRI "Debounce time for heater performance fault for downstream sensor" VALUE 0x9084F61 KwUb 51.00 t_q0p2 0.00 51.00 FORMAT "%5.2" /end CHARACTERISTIC
/begin CHARACTERISTIC TDHRIEE "Delay time for heater performance error after reset of heater power stage error - downstream sensor" VALUE 0x9084F62 KwUb 51.00 t_q0p2 0.00 51.00 FORMAT "%5.2" /end CHARACTERISTIC
/begin CHARACTERISTIC TDVHSRI "Debounce time for heater performance fault for Upstream sensor" VALUE 0x9084F63 KwUb 51.00 t_q0p2 0.00 51.00 FORMAT "%5.2" /end CHARACTERISTIC
/begin CHARACTERISTIC TDVRIEE "Delay time for heater performance error after reset of heater power stage error - upstream sensor" VALUE 0x9084F64 KwUb 51.00 t_q0p2 0.00 51.00 FORMAT "%5.2" /end CHARACTERISTIC
/begin CHARACTERISTIC TVRIF "Delay time for Ri fault" VALUE 0x9084F65 KwUb 51.00 t200msxs_ub_b51 0.00 51.00 FORMAT "%5.2" /end CHARACTERISTIC
/begin CHARACTERISTIC ZRINSH "Filter time const. sim. dyn. ceramic temp. downstr. cat." VALUE 0x9084F66 KwUw 13106.999997 zk200msxs_uw_b13107p2 0.20000305180 13107.200000 FORMAT "%12.6" /end CHARACTERISTIC
/begin CHARACTERISTIC ZRINSV "Filter time constant for modeling of dynamic of ceramic temp. pre cat" VALUE 0x9084F68 KwUw 13106.999997 zk200msxs_uw_b13107p2 0.20000305180 13107.200000 FORMAT "%12.6" /end CHARACTERISTIC
/begin MEASUREMENT B_endh "Condition enable diagnosis heater" UBYTE B_TRUE 1 100 0.00 1.00000000000 BIT_MASK 0x1 FORMAT "%13.11" ECU_ADDRESS 0x40008883
 /begin IF_DATA XCPplus 0x0102
  /begin DAQ_EVENT VARIABLE /begin AVAILABLE_EVENT_LIST EVENT 0 EVENT 1 EVENT 2 EVENT 3 /end AVAILABLE_EVENT_LIST /begin DEFAULT_EVENT_LIST EVENT 2 /end DEFAULT_EVENT_LIST /end DAQ_EVENT
 /end IF_DATA
/end MEASUREMENT
/begin MEASUREMENT B_enh "Condition enable Ri-diagnosis heater downsteream kat" UBYTE B_TRUE 1 100 0.00 1.00000000000 BIT_MASK 0x1 FORMAT "%13.11" ECU_ADDRESS 0x4000888B /end MEASUREMENT
/begin MEASUREMENT B_env "Condition enable Ri-diagnosis heater upstream kat" UBYTE B_TRUE 1 100 0.00 1.00000000000 BIT_MASK 0x1 FORMAT "%13.11" ECU_ADDRESS 0x40008886
 /begin IF_DATA XCPplus 0x0102
  /begin DAQ_EVENT VARIABLE /begin AVAILABLE_EVENT_LIST EVENT 0 EVENT 1 EVENT 2 EVENT 3 /end AVAILABLE_EVENT_LIST /begin DEFAULT_EVENT_LIST EVENT 3 /end DEFAULT_EVENT_LIST /end DAQ_EVENT
 /end IF_DATA
/end MEASUREMENT
/begin MEASUREMENT B_hsokh "Condition sensor heating OK downstream of the catalyzer" UBYTE B_TRUE 1 100 0.00 1.00000000000 BIT_MASK 0x1 FORMAT "%13.11" ECU_ADDRESS 0x4000888D /end MEASUREMENT
/begin MEASUREMENT B_hsokv "Condition Lambda sensor heating OK pre cat" UBYTE B_TRUE 1 100 0.00 1.00000000000 BIT_MASK 0x1 FORMAT "%13.11" ECU_ADDRESS 0x40008888
 /begin IF_DATA XCPplus 0x0102
  /begin DAQ_EVENT VARIABLE /begin AVAILABLE_EVENT_LIST EVENT 0 EVENT 1 EVENT 2 EVENT 3 /end AVAILABLE_EVENT_LIST /begin DEFAULT_EVENT_LIST EVENT 3 /end DEFAULT_EVENT_LIST /end DAQ_EVENT
 /end IF_DATA
/end MEASUREMENT
/begin MEASUREMENT B_npfhsh "no heater performance falt sensor downstream katalyst" UBYTE B_TRUE 1 100 0.00 1.00000000000 BIT_MASK 0x1 FORMAT "%13.11" ECU_ADDRESS 0x4000888C /end MEASUREMENT
/begin MEASUREMENT B_npfhsv "no heater performance fault sensor upstream catalyst" UBYTE B_TRUE 1 100 0.00 1.00000000000 BIT_MASK 0x1 FORMAT "%13.11" ECU_ADDRESS 0x40008887
 /begin IF_DATA XCPplus 0x0102
  /begin DAQ_EVENT VARIABLE /begin AVAILABLE_EVENT_LIST EVENT 0 EVENT 1 EVENT 2 EVENT 3 /end AVAILABLE_EVENT_LIST /begin DEFAULT_EVENT_LIST EVENT 3 /end DEFAULT_EVENT_LIST /end DAQ_EVENT
 /end IF_DATA
/end MEASUREMENT
/begin MEASUREMENT B_redhshk "Condition : FId_dhlshk released" UBYTE B_TRUE 1 100 0.00 1.00000000000 BIT_MASK 0x1 FORMAT "%13.11" ECU_ADDRESS 0x4000888E /end MEASUREMENT
/begin MEASUREMENT B_redhsvk "Condition : FId_dhlsvk released" UBYTE B_TRUE 1 100 0.00 1.00000000000 BIT_MASK 0x1 FORMAT "%13.11" ECU_ADDRESS 0x40008889
 /begin IF_DATA XCPplus 0x0102
  /begin DAQ_EVENT VARIABLE /begin AVAILABLE_EVENT_LIST EVENT 0 EVENT 1 EVENT 2 EVENT 3 /end AVAILABLE_EVENT_LIST /begin DEFAULT_EVENT_LIST EVENT 3 /end DEFAULT_EVENT_LIST /end DAQ_EVENT
 /end IF_DATA
/end MEASUREMENT
/begin MEASUREMENT DFES_ChkLstDltDemExCond_mp "Exit condition of last delete demand check during initialisation" UBYTE OneToOne 1 100 0.00 255.0 FORMAT "%5.1" ECU_ADDRESS 0x40009E40 /end MEASUREMENT
/begin MEASUREMENT DFES_chkSt "Check state of all DFCs stored in the error memory" UWORD OneToOne 1 100 0.00 65535.00 FORMAT "%8.2" ARRAY_SIZE 20 ECU_ADDRESS 0x4000CAB8 /end MEASUREMENT
/begin MEASUREMENT DFES_cnfSequence "DSM internal sequence counter to obtain confirmed entry sorting of all error memory entries" UBYTE OneToOne 1 100 0.00 255.0 FORMAT "%5.1" ARRAY_SIZE 20 ECU_ADDRESS 0x4000C970 /end MEASUREMENT
/begin MEASUREMENT DFES_ctDef "Fault counters (FLC) of error memory entries" UBYTE DFES_OneToOne 1 100 0.00 255.0 FORMAT "%5.1" ARRAY_SIZE 20 ECU_ADDRESS 0x4000CA2C /end MEASUREMENT
/begin MEASUREMENT DFES_ctDel "Delete counters (DLC) of error memory entries" UBYTE DFES_OneToOne 1 100 0.00 255.0 FORMAT "%5.1" ARRAY_SIZE 20 ECU_ADDRESS 0x4000C9DC /end MEASUREMENT
/begin MEASUREMENT DFES_ctEntry "Number of occupied DFES Entries" UBYTE DFES_OneToOne 1 100 0.00 255.0 FORMAT "%5.1" ECU_ADDRESS 0x40006467 /end MEASUREMENT
/begin MEASUREMENT DFES_ctFrq "Frequency counters of error memory entries" UBYTE DFES_OneToOne 1 100 0.00 255.0 FORMAT "%5.1" ARRAY_SIZE 20 ECU_ADDRESS 0x4000C72C /end MEASUREMENT
/begin MEASUREMENT DFES_ctManuDef "Manufacturer fault counters of error memory entries" UBYTE DFES_OneToOne 1 100 0.00 255.0 FORMAT "%5.1" ARRAY_SIZE 20 ECU_ADDRESS 0x4000CA04 /end MEASUREMENT
/begin MEASUREMENT DFES_ctManuOk "Manufacturer healing counters of error memory entries" UBYTE DFES_OneToOne 1 100 0.00 255.0 FORMAT "%5.1" ARRAY_SIZE 20 ECU_ADDRESS 0x4000C9F0 /end MEASUREMENT
/begin MEASUREMENT DFES_ctMIL "Number of DFES Entries illuminating the MIL(Only continuous illumination, no blinking counted)" UBYTE DFES_OneToOne 1 100 0.00 255.0 FORMAT "%5.1" ECU_ADDRESS 0x40006469 /end MEASUREMENT
/begin MEASUREMENT DFES_ctOBD "Number of DFES Entries visible in OBD Mode 3" UBYTE DFES_OneToOne 1 100 0.00 255.0 FORMAT "%5.1" ECU_ADDRESS 0x4000646B /end MEASUREMENT
/begin MEASUREMENT DFES_ctOBDPend "Number of DFES Entries visible in OBD Mode 7 (pending)" UBYTE DFES_OneToOne 1 100 0.00 255.0 FORMAT "%5.1" ECU_ADDRESS 0x4000646A /end MEASUREMENT
/begin MEASUREMENT DFES_ctOk "Healing counters (HLC) of error memory entries" UBYTE DFES_OneToOne 1 100 0.00 255.0 FORMAT "%5.1" ARRAY_SIZE 20 ECU_ADDRESS 0x4000CA18 /end MEASUREMENT
/begin MEASUREMENT DFES_ctSrv "Number of DFES Entries visible for Service tester" UBYTE DFES_OneToOne 1 100 0.00 255.0 FORMAT "%5.1" ECU_ADDRESS 0x40006468 /end MEASUREMENT
/begin MEASUREMENT DFES_entrySt "Entry state of all DFCs stored in the error memory" UBYTE DFES_Entry_Verb 1 100 0.00 28.0000000000 FORMAT "%13.10" ARRAY_SIZE 20 ECU_ADDRESS 0x4000CAA4 /end MEASUREMENT
/begin MEASUREMENT DFES_EnvBlock "Environmental data of all fault entries" UBYTE DFES_OneToOne 1 100 0.00 255.0 FORMAT "%5.1" ARRAY_SIZE 20 ECU_ADDRESS 0x4000C740 /end MEASUREMENT
/begin MEASUREMENT DFES_FrzFrVal "Freeze frame values of all fault entries" UBYTE DFES_OneToOne 1 100 0.00 255.0 FORMAT "%5.1" ARRAY_SIZE 540 ECU_ADDRESS 0x4000C754 /end MEASUREMENT
/begin MEASUREMENT DFES_idxSequence "Sequence in which DFES entries were allocated (became Service$03 or Service$07 visible)" UBYTE DFES_OneToOne 1 100 0.00 255.0 FORMAT "%5.1" ARRAY_SIZE 20 ECU_ADDRESS 0x4000C988 /end MEASUREMENT
/begin MEASUREMENT DFES_ISOFrstCnfDFC "DFC matching to criteria of first confirmed DTC" UWORD DFCDFP_Verb 1 100 0.00 186. FORMAT "%2.0" ECU_ADDRESS 0x4000C72A /end MEASUREMENT
/begin MEASUREMENT DFES_ISOFrstFailDFC "DFC matching to criteria of first failed DTC" UWORD DFCDFP_Verb 1 100 0.00 186. FORMAT "%2.0" ECU_ADDRESS 0x4000CAE2 /end MEASUREMENT
/begin MEASUREMENT DFES_ISORcntCnfDFC "DFC matching to criteria of most recent confirmed DTC" UWORD DFCDFP_Verb 1 100 0.00 186. FORMAT "%2.0" ECU_ADDRESS 0x4000C728 /end MEASUREMENT
/begin MEASUREMENT DFES_ISORcntFailDFC "DFC matching to criteria of most recent failed DTC" UWORD DFCDFP_Verb 1 100 0.00 186. FORMAT "%2.0" ECU_ADDRESS 0x4000CAE0 /end MEASUREMENT
/begin MEASUREMENT DFES_MonEvnt "DFES monitoring - Event Id" UWORD DFES_Mon_Verb 1 100 0.00 32786.0000000 FORMAT "%13.7" ARRAY_SIZE 2 ECU_ADDRESS 0x4000CB66 /end MEASUREMENT
/begin MEASUREMENT DFES_MonObjt "DFES monitoring - Object Id" UWORD OneToOne 1 100 0.00 65535.00 FORMAT "%8.2" ARRAY_SIZE 2 ECU_ADDRESS 0x4000CB62 /end MEASUREMENT
/begin MEASUREMENT DFES_MonParm "DFES monitoring - Parameter" UWORD OneToOne 1 100 0.00 65535.00 FORMAT "%8.2" ARRAY_SIZE 2 ECU_ADDRESS 0x4000CB5E /end MEASUREMENT
/begin MEASUREMENT DFES_MonPtr "DSM internal pointer for DFES monitoring" UBYTE DFES_OneToOne 1 100 0.00 255.0 FORMAT "%5.1" ECU_ADDRESS 0x4000CB6A /end MEASUREMENT
/begin MEASUREMENT DFES_numDFC "Names of stored fault checks in the error memory" UWORD DFC_Verb 1 100 0.00 160. FORMAT "%2.0" ARRAY_SIZE 20 ECU_ADDRESS 0x4000CA7C /end MEASUREMENT
/begin MEASUREMENT DFES_numDFCAck "acknowledged ID of fault entry (scanned and handled)" UWORD DFC_Verb 1 100 0.00 160. FORMAT "%2.0" ARRAY_SIZE 20 ECU_ADDRESS 0x4000C9B4 /end MEASUREMENT
/begin MEASUREMENT DFES_numDFCImdt "Names of immediately stored fault checks in the error memory" UWORD DFC_Verb 1 100 0.00 160. FORMAT "%2.0" ARRAY_SIZE 20 ECU_ADDRESS 0x4000CB34 /end MEASUREMENT
/begin MEASUREMENT DFES_numEntryAvl "Number of possible DFES Entries" UBYTE DFES_OneToOne 1 100 0.00 255.0 FORMAT "%5.1" ECU_ADDRESS 0x40006465 /end MEASUREMENT
/begin MEASUREMENT DFES_numEnvSize "Number of bytes in one environment block" UBYTE DFES_OneToOne 1 100 0.00 255.0 FORMAT "%5.1" ECU_ADDRESS 0x40006462 /end MEASUREMENT
/begin MEASUREMENT DFES_numExtdFrzFrmSize "Number of bytes for environmental conditions contained in one freeze frame extension set" UBYTE DFES_OneToOne 1 100 0.00 255.0 FORMAT "%5.1" ECU_ADDRESS 0x40006463 /end MEASUREMENT
/begin MEASUREMENT DFES_numFrzFrmSize "Number of bytes in one freeze frame" UBYTE DFES_OneToOne 1 100 0.00 255.0 FORMAT "%5.1" ECU_ADDRESS 0x40006464 /end MEASUREMENT
/begin MEASUREMENT DFES_OutLamps "Error lamp status of error memory entries" UBYTE DFES_OneToOne 1 100 0.00 255.0 FORMAT "%5.1" ARRAY_SIZE 20 ECU_ADDRESS 0x400047A4 /end MEASUREMENT
/begin MEASUREMENT DFES_PDTCStore "indication to store permanent DTCs at beginning of postdrive" UBYTE OneToOne 1 100 0.00 255.0 BIT_MASK 0x1 FORMAT "%5.1" ECU_ADDRESS 0x400062EE /end MEASUREMENT
/begin MEASUREMENT DFES_prioEntryImdt "Priority of error memory entries" UBYTE DFES_OneToOne 1 100 0.00 255.0 FORMAT "%5.1" ARRAY_SIZE 20 ECU_ADDRESS 0x4000CB20 /end MEASUREMENT
/begin MEASUREMENT DFES_StateVisibility "Tester visibility of error memory entries" UWORD DFES_OneToOne 1 100 0.00 65535.00 FORMAT "%8.2" ARRAY_SIZE 20 ECU_ADDRESS 0x40005CD4 /end MEASUREMENT
/begin MEASUREMENT DFES_stChk "Legacy check state of all DFCs stored in the error memory" UBYTE DFES_stCheck_Verb 1 100 0.00 7.00000000000 FORMAT "%13.11" ARRAY_SIZE 20 ECU_ADDRESS 0x4000CA68 /end MEASUREMENT
/begin MEASUREMENT DFES_stCounters "Counter state of all DFCs stored in the error memory" UBYTE DFES_stCnt_Verb 1 100 0.00 85.0000000000 FORMAT "%13.10" ARRAY_SIZE 20 ECU_ADDRESS 0x4000CA40 /end MEASUREMENT
/begin MEASUREMENT DFES_stCtlSetting "internal and central disable request" UBYTE OneToOne 1 100 0.00 255.0 FORMAT "%5.1" ECU_ADDRESS 0x400062EC /end MEASUREMENT
/begin MEASUREMENT DFES_stDataImdt "Environment data state of error memory entries" UBYTE DFES_stDataImdt_Verb 1 100 0.00 21.0000000000 FORMAT "%13.10" ARRAY_SIZE 20 ECU_ADDRESS 0x4000CAE4 /end MEASUREMENT
/begin MEASUREMENT DFES_stDataImdtTrans "Alternative environment data state of error memory entries during transition." UBYTE DFES_stDataImdt_Verb 1 100 0.00 21.0000000000 FORMAT "%13.10" ARRAY_SIZE 20 ECU_ADDRESS 0x400047B8 /end MEASUREMENT
/begin MEASUREMENT DFES_stDTCRecUpdt "state of disable DTC record update, AUTOSAR feature" UBYTE OneToOne 1 100 0.00 255.0 FORMAT "%5.1" ECU_ADDRESS 0x400062EB /end MEASUREMENT
/begin MEASUREMENT DFES_stDTCStorage "state of disable DTC storage AUTOSAR feature" UBYTE OneToOne 1 100 0.00 255.0 FORMAT "%5.1" ECU_ADDRESS 0x400062EA /end MEASUREMENT
/begin MEASUREMENT DFES_stEepWrReq "request for an EEPROM storage" UBYTE OneToOne 1 100 0.00 255.0 BIT_MASK 0x1 FORMAT "%5.1" ECU_ADDRESS 0x400062F1 /end MEASUREMENT
/begin MEASUREMENT DFES_stEntry "Legacy entry state of all DFCs stored in the error memory" UBYTE DFES_stEntry_Verb 1 100 0.00 254.000000000 FORMAT "%13.9" ARRAY_SIZE 20 ECU_ADDRESS 0x4000CA54 /end MEASUREMENT
/begin MEASUREMENT DFES_stErrDia "DSM internal status of all tester visibilities" UBYTE DFES_OneToOne 1 100 0.00 255.0 FORMAT "%5.1" ECU_ADDRESS 0x4000646D /end MEASUREMENT
/begin MEASUREMENT DFES_stErrLamp "DFES error lamp demands" UBYTE DFES_OneToOne 1 100 0.00 255.0 FORMAT "%5.1" ECU_ADDRESS 0x4000646E /end MEASUREMENT
/begin MEASUREMENT DFES_stInh "Inhibit (FIM) relevant state of fault entry" UBYTE DFES_OneToOne 1 100 0.00 255.0 FORMAT "%5.1" ARRAY_SIZE 20 ECU_ADDRESS 0x4000C9A0 /end MEASUREMENT
/begin MEASUREMENT DFES_stOrdImdt "Order state of error memory entries" UWORD DFES_OneToOne 1 100 0.00 65535.00 FORMAT "%8.2" ARRAY_SIZE 20 ECU_ADDRESS 0x4000CAF8 /end MEASUREMENT
/begin MEASUREMENT DFES_stOutstate "DSM Flag status to check whether error counter is valid or not." UBYTE DFES_OneToOne 1 100 0.00 255.0 FORMAT "%5.1" ECU_ADDRESS 0x4000646C /end MEASUREMENT
/begin MEASUREMENT DFES_stPrgEvt "ECU programming event detected (reset of all diagnostic informations including IUMPR and permanent DTCs)" UBYTE OneToOne 1 100 0.00 255.0 BIT_MASK 0x1 FORMAT "%5.1" ECU_ADDRESS 0x400062ED /end MEASUREMENT
/begin MEASUREMENT DFES_stRepClrAftPwrFail "Repeated DSM clear after powerfail necessary" UBYTE B_TRUE 1 100 0.00 1.00000000000 FORMAT "%13.11" ECU_ADDRESS 0x400062D7 /end MEASUREMENT
/begin MEASUREMENT DFES_stRepClrDtcOriginAftPwrFail "Request to repeat primary, secondary clear" UBYTE OneToOne 1 100 0.00 255.0 FORMAT "%5.1" ECU_ADDRESS 0x400062D6 /end MEASUREMENT
/begin MEASUREMENT DFES_xAsgnEnvAllDataSize "Memory usage of common calibrated environment data" UBYTE DFES_OneToOne 1 100 0.00 255.0 FORMAT "%5.1" ECU_ADDRESS 0x400062E9 /end MEASUREMENT
/begin MEASUREMENT DiaActrElecPsDiag_cntTestPlsTsk_mp "L-1 L=enNumber of testpulses in current driving cycleL-1" UWORD OneToOne 1 100 0.00 65535.00 FORMAT "%8.2" ECU_ADDRESS 0x40009DE8 /end MEASUREMENT
/begin MEASUREMENT DiaActrElecPsDiag_nrDiagErr_mp "Number of supported errors of the diagnosis signal" UBYTE OneToOne 1 100 0.00 255.0 FORMAT "%5.1" ECU_ADDRESS 0x40009E3F /end MEASUREMENT
/begin MEASUREMENT DiaActrElecPsDiag_nrTestPls_mp "Number of testpulses in current driving cycle" ULONG OneToOne 1 100 0.00 4294967295.00 FORMAT "%13.2" ECU_ADDRESS 0x40009D64 /end MEASUREMENT
/begin MEASUREMENT DiaActrElecPsDiag_stAttribOL_mp "Current DSM attribute (Tested detection) of the open load error when reporting open load error to DSM module" ULONG OneToOne 1 100 0.00 4294967295.00 FORMAT "%13.2" ECU_ADDRESS 0x40009D60 /end MEASUREMENT
/begin MEASUREMENT DiaActrElecPsDiag_stAttribOT_mp "Current DSM attribute (Tested detection) of the overtemperature error when reporting overtemperature error to DSM module" ULONG OneToOne 1 100 0.00 4294967295.00 FORMAT "%13.2" ECU_ADDRESS 0x40009D5C /end MEASUREMENT
/begin MEASUREMENT DiaActrElecPsDiag_stAttribSCB_mp "Current DSM attribute (Tested detection) of the short circuit to battery error when reporting short circuit to battery error to DSM module" ULONG OneToOne 1 100 0.00 4294967295.00 FORMAT "%13.2" ECU_ADDRESS 0x40009D58 /end MEASUREMENT
/begin MEASUREMENT DiaActrElecPsDiag_stAttribSCG_mp "Current DSM attribute (Tested detection) of the short circuit to ground error when reporting short circuit to ground error to DSM module" ULONG OneToOne 1 100 0.00 4294967295.00 FORMAT "%13.2" ECU_ADDRESS 0x40009D54 /end MEASUREMENT
/begin MEASUREMENT DiaActrElecPsDiag_stDsmDebOpenLoad_mp "Debounce status of OL error" ULONG OneToOne 1 100 0.00 4294967295.00 FORMAT "%13.2" ECU_ADDRESS 0x40009D50 /end MEASUREMENT
/begin MEASUREMENT DiaActrElecPsDiag_stDsmDebOverT_mp "Debounce status of OT error" ULONG OneToOne 1 100 0.00 4294967295.00 FORMAT "%13.2" ECU_ADDRESS 0x40009D4C /end MEASUREMENT
/begin MEASUREMENT DiaActrElecPsDiag_stDsmDebScb_mp "Debounce status of SCB error" ULONG OneToOne 1 100 0.00 4294967295.00 FORMAT "%13.2" ECU_ADDRESS 0x40009D48 /end MEASUREMENT
/begin MEASUREMENT DiaActrElecPsDiag_stDsmDebScg_mp "Debounce status of SCG error" ULONG OneToOne 1 100 0.00 4294967295.00 FORMAT "%13.2" ECU_ADDRESS 0x40009D44 /end MEASUREMENT
/begin MEASUREMENT DiaActrElecPsDiag_stErrCfgOpenLoad_mp "Configuration of behaviour for OL error" UBYTE OneToOne 1 100 0.00 255.0 FORMAT "%5.1" ECU_ADDRESS 0x40009E3E /end MEASUREMENT
/begin MEASUREMENT DiaActrElecPsDiag_stErrCfgOverT_mp "Configuration of behaviour for OT error" UBYTE OneToOne 1 100 0.00 255.0 FORMAT "%5.1" ECU_ADDRESS 0x40009E3D /end MEASUREMENT
/begin MEASUREMENT DiaActrElecPsDiag_stErrCfgScb_mp "Configuration of behaviour for SCB error" UBYTE OneToOne 1 100 0.00 255.0 FORMAT "%5.1" ECU_ADDRESS 0x40009E3C /end MEASUREMENT
/begin MEASUREMENT DiaActrElecPsDiag_stErrCfgScg_mp "Configuration of behaviour for SCG error" UBYTE OneToOne 1 100 0.00 255.0 FORMAT "%5.1" ECU_ADDRESS 0x40009E3B /end MEASUREMENT
/begin MEASUREMENT DiaActrElecPsDiag_stPrvTstRslt_mp "The latest result of test impulse" ULONG OneToOne 1 100 0.00 4294967295.00 FORMAT "%13.2" ECU_ADDRESS 0x40009D40 /end MEASUREMENT
/begin MEASUREMENT DiaActrElecPsDiag_stSigCfg_mp "Configuration of the diagnosis signal" UBYTE OneToOne 1 100 0.00 255.0 FORMAT "%5.1" ECU_ADDRESS 0x40009E3A /end MEASUREMENT
/begin MEASUREMENT DiaActrElecPsDiag_stSigErrInfo_mp "The last error information of HWE read from the chip" ULONG OneToOne 1 100 0.00 4294967295.00 FORMAT "%13.2" ECU_ADDRESS 0x40009D3C /end MEASUREMENT
/begin MEASUREMENT DiaActrElecPsDiag_stSig_mp "Actual state of the diagnosis signal: INVALID, NOTEST, NOFAULT, FAULT, PREFAULT, HEALFAULT, WAITSTATE" UBYTE DiaActrElecPsDiag_stSig_COMPU_VERB 1 100 0.00 6.00000000000 FORMAT "%13.11" ECU_ADDRESS 0x40009E39 /end MEASUREMENT
/begin MEASUREMENT DiaActrElecPsDiag_stTestPls_mp "L-1 L=enThe actual state of the testpulse state machine: NO, REQUESTED, RUN, FINISHED, RE-TRIGGEREDL-1" UBYTE DiaActrElecPsDiag_stTestPls_COMPU_VERB 1 100 1.00000000000 5.00000000000 FORMAT "%13.11" ECU_ADDRESS 0x40009E38 /end MEASUREMENT
/begin MEASUREMENT DiaActrElecPsDiag_stTmngTestPls_mp "The current time to wait between two testpulses" UBYTE DiaActrElecPsDiag_stTmngTestPls_COMPU_VERB 1 100 0.00 3.00000000000 FORMAT "%13.11" ECU_ADDRESS 0x40009E37 /end MEASUREMENT
/begin MEASUREMENT DiaActrElecPsDiag_tiTstPls_mp "Current status of timer for the time between testpulses during permanent fault" SWORD OneToOne 1 100 -32768.00 32767.00 FORMAT "%8.2" ECU_ADDRESS 0x40009DE6 /end MEASUREMENT
/begin MEASUREMENT DSM_stProtdRamVld "DFES protected ram content is valid" UBYTE OneToOne 1 100 0.00 255.0 BIT_MASK 0x1 FORMAT "%5.1" ECU_ADDRESS 0x4000B410 /end MEASUREMENT
/begin MEASUREMENT rinkfh "Internal resistance Nernst cell of Lambda sensor from mapping upstream of cat." UBYTE r_q8 1 100 0.00 2040. FORMAT "%5.0" ECU_ADDRESS 0x4000888A /end MEASUREMENT
/begin MEASUREMENT rinkfv "Internal resistance of lambda sensor from map pre cat" UBYTE r_q8 1 100 0.00 2040. FORMAT "%5.0" ECU_ADDRESS 0x40008885
 /begin IF_DATA XCPplus 0x0102
  /begin DAQ_EVENT VARIABLE /begin AVAILABLE_EVENT_LIST EVENT 0 EVENT 1 EVENT 2 EVENT 3 /end AVAILABLE_EVENT_LIST /begin DEFAULT_EVENT_LIST EVENT 3 /end DEFAULT_EVENT_LIST /end DAQ_EVENT
 /end IF_DATA
/end MEASUREMENT
/begin MEASUREMENT rinsh_w "Lim. value internal resistance Nernst cell of Lambda sensor downstream of cat." UWORD r_uw_q2 1 100 0.00 131070.0 FORMAT "%8.1" ECU_ADDRESS 0x400084BA /end MEASUREMENT
/begin MEASUREMENT rinsv_w "Limit value of internal resistor of Nernst cell of lambda sen. post cat" UWORD r_uw_q2 1 100 0.00 131070.0 FORMAT "%8.1" ECU_ADDRESS 0x400084B8
 /begin IF_DATA XCPplus 0x0102
  /begin DAQ_EVENT VARIABLE /begin AVAILABLE_EVENT_LIST EVENT 0 EVENT 1 EVENT 2 EVENT 3 /end AVAILABLE_EVENT_LIST /begin DEFAULT_EVENT_LIST EVENT 3 /end DEFAULT_EVENT_LIST /end DAQ_EVENT
 /end IF_DATA
/end MEASUREMENT
/begin FUNCTION DFES "30000.50.2Diagnostic Fault Event Storage"
 /begin DEF_CHARACTERISTIC DFES_Cls.DFC_Unused_C DFES_Cls.DFC_BusDiagOpenLoad_Can0_C DFES_Cls.DFC_Com_ABSInfo_DLC_C DFES_Cls.DFC_Com_ABSInfo_TO_C DFES_Cls.DFC_BusDiagBusOff_Can0_C DFES_Cls.DFC_DevLibBattUHi_C DFES_Cls.DFC_DevLibBattULo_C DFES_Cls.DFC_StrtOL_C DFES_Cls.DFC_StrtOvrTemp_C DFES_Cls.DFC_StrtSCB_C DFES_Cls.DFC_StrtSCG_C DFES_Cls.DFC_MILLmpOL_C DFES_Cls.DFC_MILLmpOT_C DFES_Cls.DFC_MILLmpSCB_C DFES_Cls.DFC_MILLmpSCG_C DFES_Cls.DFC_EV1max_C DFES_Cls.DFC_EV1min_C DFES_Cls.DFC_EV1sig_C DFES_Cls.DFC_CEngDsTPlausSTC_C DFES_Cls.DFC_ClthStkOpn_C DFES_Cls.DFC_EVX_C DFES_Cls.DFC_IntkAirTAirFltDsSTC_C DFES_Cls.DFC_RoughRoad_C DFES_Cls.DFC_SSpMon1_C DFES_Cls.DFC_SSpMon1OT_C DFES_Cls.DFC_SSpMon1OV_C DFES_Cls.DFC_SSpMon1SCG_C DFES_Cls.DFC_SSpMon1UV_C DFES_Cls.DFC_SSpMon2_C DFES_Cls.DFC_SSpMon2OT_C DFES_Cls.DFC_SSpMon2OV_C DFES_Cls.DFC_SSpMon2SCG_C DFES_Cls.DFC_SSpMon2UV_C DFES_Cls.DFC_CANIF_E_CTRL_NOT_SLEEP_ERROR_VALUE_C DFES_Cls.DFC_CANIF_E_CTRL_STOPPED_ERROR_VALUE_C DFES_Cls.DFC_CANIF_E_INVALID_DLC_ERROR_C DFES_Cls.DFC_CANNM_E_CANIF_TRANSMIT_ERROR_C DFES_Cls.DFC_CANNM_E_INIT_FAILED_C DFES_Cls.DFC_CANNM_E_NETWORK_TIMEOUT_C DFES_Cls.DFC_CAN_E_TIMEOUT_C DFES_Cls.DFC_COMM_E_NET_START_IND_CHANNEL_0_C DFES_Cls.DFC_COMM_E_NET_START_IND_CHANNEL_1_C DFES_Cls.DFC_COMM_E_NET_START_IND_CHANNEL_2_C DFES_Cls.DFC_COMM_E_NET_START_IND_CHANNEL_3_C DFES_Cls.DFC_COMM_E_NET_START_IND_CHANNEL_4_C DFES_Cls.DFC_COMM_E_NET_START_IND_CHANNEL_5_C DFES_Cls.DFC_PDUR_E_INIT_FAILED_C DFES_Cls.DFC_PDUR_E_PDU_INSTANCE_LOST_C DFES_Cls.DFC_RBA_IOEXTLIB_KEEPALIVE_DRV_C DFES_Cls.DFC_RBA_IOEXTLIB_KEEPALIVE_INI_C DFES_Cls.DFC_rba_IoSigRtc_StopCounter_C DFES_Cls.DFC_rba_MultiStackTrace_Threshold_C DFES_Cls.DFC_rba_MRly_Diag_Stk_Event_C DFES_Cls.DFC_rba_SyC_IrrSwOffTrigEngRun_Event_C DFES_Cls.DFC_rba_T15_Diag_ComInVld_Event_C DFES_Cls.DFC_rba_T15_Diag_ComOff_HwOn_Event_C DFES_Cls.DFC_rba_T15_Diag_ComOn_HwOff_Event_C DFES_Cls.DFC_BypAirActrOcCoil1_C DFES_Cls.DFC_BypAirActrOcCoil2_C DFES_Cls.DFC_BypAirActrOlCoil1_C DFES_Cls.DFC_BypAirActrOlCoil2_C DFES_Cls.DFC_BypAirActrOt_C DFES_Cls.DFC_BypAirActrScbCoil1_C DFES_Cls.DFC_BypAirActrScbCoil2_C DFES_Cls.DFC_BypAirActrScgCoil1_C DFES_Cls.DFC_BypAirActrScgCoil2_C DFES_Cls.DFC_CEngDsTPhysRngHi_C DFES_Cls.DFC_CEngDsTPhysRngLo_C DFES_Cls.DFC_CEngDsTSRCMax_C DFES_Cls.DFC_CEngDsTSRCMin_C DFES_Cls.DFC_DKmax_C DFES_Cls.DFC_DKmin_C DFES_Cls.DFC_DLLRmax_C DFES_Cls.DFC_DLLRmin_C DFES_Cls.DFC_DLLRnpl_C DFES_Cls.DFC_DSSRngMax_C DFES_Cls.DFC_DSSRngMin_C DFES_Cls.DFC_DSSmax_C DFES_Cls.DFC_DSSmin_C DFES_Cls.DFC_DSSnpl_C DFES_Cls.DFC_DSSnplMax_C DFES_Cls.DFC_DSSnplMin_C DFES_Cls.DFC_DSSsig_C DFES_Cls.DFC_EpmCrSErrSig_C DFES_Cls.DFC_EpmCrSNoSig_C DFES_Cls.DFC_HEGOS1B1ElecNpl_C DFES_Cls.DFC_HSH_C DFES_Cls.DFC_HSHEmax_C DFES_Cls.DFC_HSHEmin_C DFES_Cls.DFC_HSHEsig_C DFES_Cls.DFC_HSV_C DFES_Cls.DFC_HSVEmax_C DFES_Cls.DFC_HSVEmin_C DFES_Cls.DFC_HSVEsig_C DFES_Cls.DFC_HdLampMax_C DFES_Cls.DFC_HdLampMin_C DFES_Cls.DFC_HdLampSig_C DFES_Cls.DFC_IgnCoil1Err_C DFES_Cls.DFC_IgnCoil2Err_C DFES_Cls.DFC_IgnIgbtDiagSCG_0_C DFES_Cls.DFC_IgnIgbtDiagSCG_1_C DFES_Cls.DFC_IntkAirTAirFltDsPRCMax_C DFES_Cls.DFC_IntkAirTAirFltDsPRCMin_C DFES_Cls.DFC_IntkAirTAirFltDsSRCMax_C DFES_Cls.DFC_IntkAirTAirFltDsSRCMin_C DFES_Cls.DFC_IntkMnfldPNoSyn_C DFES_Cls.DFC_KAT_C DFES_Cls.DFC_KPEmax_C DFES_Cls.DFC_KPEmin_C DFES_Cls.DFC_KPEsig_C DFES_Cls.DFC_KVSFmax_C DFES_Cls.DFC_KVSFmin_C DFES_Cls.DFC_KVSOmax_C DFES_Cls.DFC_KVSOmin_C DFES_Cls.DFC_LASHmn_C DFES_Cls.DFC_LASHmx_C DFES_Cls.DFC_LATP_C DFES_Cls.DFC_LDLAHI_C DFES_Cls.DFC_LFS1Max_C DFES_Cls.DFC_LFS1Min_C DFES_Cls.DFC_LFS1Sig_C DFES_Cls.DFC_LSHmax_C DFES_Cls.DFC_LSHmin_C DFES_Cls.DFC_LSHnpl_C DFES_Cls.DFC_LSHsig_C DFES_Cls.DFC_LSVmax_C DFES_Cls.DFC_LSVmin_C DFES_Cls.DFC_LSVnpl_C DFES_Cls.DFC_LSVsig_C DFES_Cls.DFC_MDCat_C DFES_Cls.DFC_MDCatCurr_C DFES_Cls.DFC_MDCyl_C DFES_Cls.DFC_MDEmi_C DFES_Cls.DFC_MDEmiStrt_C DFES_Cls.DFC_MDMpl_C DFES_Cls.DFC_MoCADCNTP_C DFES_Cls.DFC_MoCADCTst_C DFES_Cls.DFC_MoFSidst_C DFES_Cls.DFC_OCWDACom_C DFES_Cls.DFC_OilPPSSwtMax_C DFES_Cls.DFC_OilPPSSwtMin_C DFES_Cls.DFC_OilPPSSwtSig_C DFES_Cls.DFC_OvHEngSpdLimr_C DFES_Cls.DFC_RoVComVld_C DFES_Cls.DFC_RoVSNpl_C DFES_Cls.DFC_RoVSOL_C DFES_Cls.DFC_RoVSSCB_C DFES_Cls.DFC_RoVSSCG_C DFES_Cls.DFC_SdSTNpl_C DFES_Cls.DFC_SdSTSCB_C DFES_Cls.DFC_SdSTSCG_C DFES_Cls.DFC_SdSTSOL_C DFES_Cls.DFC_TEVEmax_C DFES_Cls.DFC_TEVEmin_C DFES_Cls.DFC_TEVEsig_C DFES_Cls.DFC_TMnpl_C DFES_Cls.DFC_UBmax_C DFES_Cls.DFC_UBmin_C DFES_Cls.DFC_UBnpl_C DFES_Cls.DFC_VFZsig_C DFES_Cls.DFC_VFZsig2_C DFES_DbLv_C DFES_DTCO.DFC_Unused_C DFES_DTCO.DFC_BusDiagOpenLoad_Can0_C DFES_DTCO.DFC_Com_ABSInfo_DLC_C DFES_DTCO.DFC_Com_ABSInfo_TO_C DFES_DTCO.DFC_BusDiagBusOff_Can0_C DFES_DTCO.DFC_DevLibBattUHi_C DFES_DTCO.DFC_DevLibBattULo_C DFES_DTCO.DFC_StrtOL_C DFES_DTCO.DFC_StrtOvrTemp_C DFES_DTCO.DFC_StrtSCB_C DFES_DTCO.DFC_StrtSCG_C DFES_DTCO.DFC_MILLmpOL_C DFES_DTCO.DFC_MILLmpOT_C DFES_DTCO.DFC_MILLmpSCB_C DFES_DTCO.DFC_MILLmpSCG_C DFES_DTCO.DFC_EV1max_C DFES_DTCO.DFC_EV1min_C DFES_DTCO.DFC_EV1sig_C DFES_DTCO.DFC_CEngDsTPlausSTC_C DFES_DTCO.DFC_ClthStkOpn_C DFES_DTCO.DFC_EVX_C DFES_DTCO.DFC_IntkAirTAirFltDsSTC_C DFES_DTCO.DFC_RoughRoad_C DFES_DTCO.DFC_SSpMon1_C DFES_DTCO.DFC_SSpMon1OT_C DFES_DTCO.DFC_SSpMon1OV_C DFES_DTCO.DFC_SSpMon1SCG_C DFES_DTCO.DFC_SSpMon1UV_C DFES_DTCO.DFC_SSpMon2_C DFES_DTCO.DFC_SSpMon2OT_C DFES_DTCO.DFC_SSpMon2OV_C DFES_DTCO.DFC_SSpMon2SCG_C DFES_DTCO.DFC_SSpMon2UV_C DFES_DTCO.DFC_CANIF_E_CTRL_NOT_SLEEP_ERROR_VALUE_C DFES_DTCO.DFC_CANIF_E_CTRL_STOPPED_ERROR_VALUE_C DFES_DTCO.DFC_CANIF_E_INVALID_DLC_ERROR_C DFES_DTCO.DFC_CANNM_E_CANIF_TRANSMIT_ERROR_C DFES_DTCO.DFC_CANNM_E_INIT_FAILED_C DFES_DTCO.DFC_CANNM_E_NETWORK_TIMEOUT_C DFES_DTCO.DFC_CAN_E_TIMEOUT_C DFES_DTCO.DFC_COMM_E_NET_START_IND_CHANNEL_0_C DFES_DTCO.DFC_COMM_E_NET_START_IND_CHANNEL_1_C DFES_DTCO.DFC_COMM_E_NET_START_IND_CHANNEL_2_C DFES_DTCO.DFC_COMM_E_NET_START_IND_CHANNEL_3_C DFES_DTCO.DFC_COMM_E_NET_START_IND_CHANNEL_4_C DFES_DTCO.DFC_COMM_E_NET_START_IND_CHANNEL_5_C DFES_DTCO.DFC_PDUR_E_INIT_FAILED_C DFES_DTCO.DFC_PDUR_E_PDU_INSTANCE_LOST_C DFES_DTCO.DFC_RBA_IOEXTLIB_KEEPALIVE_DRV_C DFES_DTCO.DFC_RBA_IOEXTLIB_KEEPALIVE_INI_C DFES_DTCO.DFC_rba_IoSigRtc_StopCounter_C DFES_DTCO.DFC_rba_MultiStackTrace_Threshold_C DFES_DTCO.DFC_rba_MRly_Diag_Stk_Event_C DFES_DTCO.DFC_rba_SyC_IrrSwOffTrigEngRun_Event_C DFES_DTCO.DFC_rba_T15_Diag_ComInVld_Event_C DFES_DTCO.DFC_rba_T15_Diag_ComOff_HwOn_Event_C DFES_DTCO.DFC_rba_T15_Diag_ComOn_HwOff_Event_C DFES_DTCO.DFC_BypAirActrOcCoil1_C DFES_DTCO.DFC_BypAirActrOcCoil2_C DFES_DTCO.DFC_BypAirActrOlCoil1_C DFES_DTCO.DFC_BypAirActrOlCoil2_C DFES_DTCO.DFC_BypAirActrOt_C DFES_DTCO.DFC_BypAirActrScbCoil1_C DFES_DTCO.DFC_BypAirActrScbCoil2_C DFES_DTCO.DFC_BypAirActrScgCoil1_C DFES_DTCO.DFC_BypAirActrScgCoil2_C DFES_DTCO.DFC_CEngDsTPhysRngHi_C DFES_DTCO.DFC_CEngDsTPhysRngLo_C DFES_DTCO.DFC_CEngDsTSRCMax_C DFES_DTCO.DFC_CEngDsTSRCMin_C DFES_DTCO.DFC_DKmax_C DFES_DTCO.DFC_DKmin_C DFES_DTCO.DFC_DLLRmax_C DFES_DTCO.DFC_DLLRmin_C DFES_DTCO.DFC_DLLRnpl_C DFES_DTCO.DFC_DSSRngMax_C DFES_DTCO.DFC_DSSRngMin_C DFES_DTCO.DFC_DSSmax_C DFES_DTCO.DFC_DSSmin_C DFES_DTCO.DFC_DSSnpl_C DFES_DTCO.DFC_DSSnplMax_C DFES_DTCO.DFC_DSSnplMin_C DFES_DTCO.DFC_DSSsig_C DFES_DTCO.DFC_EpmCrSErrSig_C DFES_DTCO.DFC_EpmCrSNoSig_C DFES_DTCO.DFC_HEGOS1B1ElecNpl_C DFES_DTCO.DFC_HSH_C DFES_DTCO.DFC_HSHEmax_C DFES_DTCO.DFC_HSHEmin_C DFES_DTCO.DFC_HSHEsig_C DFES_DTCO.DFC_HSV_C DFES_DTCO.DFC_HSVEmax_C DFES_DTCO.DFC_HSVEmin_C DFES_DTCO.DFC_HSVEsig_C DFES_DTCO.DFC_HdLampMax_C DFES_DTCO.DFC_HdLampMin_C DFES_DTCO.DFC_HdLampSig_C DFES_DTCO.DFC_IgnCoil1Err_C DFES_DTCO.DFC_IgnCoil2Err_C DFES_DTCO.DFC_IgnIgbtDiagSCG_0_C DFES_DTCO.DFC_IgnIgbtDiagSCG_1_C DFES_DTCO.DFC_IntkAirTAirFltDsPRCMax_C DFES_DTCO.DFC_IntkAirTAirFltDsPRCMin_C DFES_DTCO.DFC_IntkAirTAirFltDsSRCMax_C DFES_DTCO.DFC_IntkAirTAirFltDsSRCMin_C DFES_DTCO.DFC_IntkMnfldPNoSyn_C DFES_DTCO.DFC_KAT_C DFES_DTCO.DFC_KPEmax_C DFES_DTCO.DFC_KPEmin_C DFES_DTCO.DFC_KPEsig_C DFES_DTCO.DFC_KVSFmax_C DFES_DTCO.DFC_KVSFmin_C DFES_DTCO.DFC_KVSOmax_C DFES_DTCO.DFC_KVSOmin_C DFES_DTCO.DFC_LASHmn_C DFES_DTCO.DFC_LASHmx_C DFES_DTCO.DFC_LATP_C DFES_DTCO.DFC_LDLAHI_C DFES_DTCO.DFC_LFS1Max_C DFES_DTCO.DFC_LFS1Min_C DFES_DTCO.DFC_LFS1Sig_C DFES_DTCO.DFC_LSHmax_C DFES_DTCO.DFC_LSHmin_C DFES_DTCO.DFC_LSHnpl_C DFES_DTCO.DFC_LSHsig_C DFES_DTCO.DFC_LSVmax_C DFES_DTCO.DFC_LSVmin_C DFES_DTCO.DFC_LSVnpl_C DFES_DTCO.DFC_LSVsig_C DFES_DTCO.DFC_MDCat_C DFES_DTCO.DFC_MDCatCurr_C DFES_DTCO.DFC_MDCyl_C DFES_DTCO.DFC_MDEmi_C DFES_DTCO.DFC_MDEmiStrt_C DFES_DTCO.DFC_MDMpl_C DFES_DTCO.DFC_MoCADCNTP_C DFES_DTCO.DFC_MoCADCTst_C DFES_DTCO.DFC_MoFSidst_C DFES_DTCO.DFC_OCWDACom_C DFES_DTCO.DFC_OilPPSSwtMax_C DFES_DTCO.DFC_OilPPSSwtMin_C DFES_DTCO.DFC_OilPPSSwtSig_C DFES_DTCO.DFC_OvHEngSpdLimr_C DFES_DTCO.DFC_RoVComVld_C DFES_DTCO.DFC_RoVSNpl_C DFES_DTCO.DFC_RoVSOL_C DFES_DTCO.DFC_RoVSSCB_C DFES_DTCO.DFC_RoVSSCG_C DFES_DTCO.DFC_SdSTNpl_C DFES_DTCO.DFC_SdSTSCB_C DFES_DTCO.DFC_SdSTSCG_C DFES_DTCO.DFC_SdSTSOL_C DFES_DTCO.DFC_TEVEmax_C DFES_DTCO.DFC_TEVEmin_C DFES_DTCO.DFC_TEVEsig_C DFES_DTCO.DFC_TMnpl_C DFES_DTCO.DFC_UBmax_C DFES_DTCO.DFC_UBmin_C DFES_DTCO.DFC_UBnpl_C DFES_DTCO.DFC_VFZsig_C DFES_DTCO.DFC_VFZsig2_C DFES_Env.xSet1_CA DFES_Env.xSet2_CA DFES_EnvRef_C DFES_FaultTyp_C DFES_MonEvtMSK0_C DFES_MonEvtMSK1_C DFES_MonRepeat_C DFES_numClsDlt_CA DFES_numClsFaultCycl_CA DFES_numClsHealCycl_CA DFES_numClsPndDlt_CA DFES_numClsSvcDlt_CA DFES_numClsSVSFaultCycl_CA DFES_numClsSVSHealCycl_CA DFES_ThresSimCond.n_C DFES_ThresSimCond.r_C DFES_ThresSimCond.t_C DFES_xAsgnFrzFrSig_CA DFES_xClsDltTrg_CA DFES_xClsFaultTrg_CA DFES_xClsFltMIL_CA DFES_xClsFltSVS_CA DFES_xClsHealTrg_CA DFES_xClsPndDltTrg_CA DFES_xClsPrio_CA DFES_xClsSvcDltTrg_CA DFES_xClsSVSFaultTrg_CA DFES_xClsSVSHealTrg_CA /end DEF_CHARACTERISTIC
 /begin IN_MEASUREMENT DSMAUX_stDCy DSM_TripChgAndClrFinshd /end IN_MEASUREMENT
 /begin OUT_MEASUREMENT DFES_stEepWrReq DFES_stErrLamp DFES_stOutstate DSM_stProtdRamVld /end OUT_MEASUREMENT
 /begin LOC_MEASUREMENT DFES_ChkLstDltDemExCond_mp DFES_chkSt DFES_cnfSequence DFES_ctDef DFES_ctDel DFES_ctEntry DFES_ctFrq DFES_ctManuDef DFES_ctManuOk DFES_ctMIL DFES_ctOBD DFES_ctOBDPend DFES_ctOk DFES_ctSrv DFES_entrySt DFES_EnvBlock DFES_FrzFrVal DFES_idxSequence DFES_ISOFrstCnfDFC DFES_ISOFrstFailDFC DFES_ISORcntCnfDFC DFES_ISORcntFailDFC DFES_MonEvnt DFES_MonObjt DFES_MonParm DFES_MonPtr DFES_numDFC DFES_numDFCAck DFES_numDFCImdt DFES_numEntryAvl DFES_numEnvSize DFES_numExtdFrzFrmSize DFES_numFrzFrmSize DFES_OutLamps DFES_PDTCStore DFES_prioEntryImdt DFES_StateVisibility DFES_stChk DFES_stCounters DFES_stCtlSetting DFES_stDataImdt DFES_stDataImdtTrans DFES_stDTCRecUpdt DFES_stDTCStorage DFES_stEntry DFES_stErrDia DFES_stInh DFES_stOrdImdt DFES_stPrgEvt DFES_stRepClrAftPwrFail DFES_stRepClrDtcOriginAftPwrFail DFES_xAsgnEnvAllDataSize /end LOC_MEASUREMENT
 FUNCTION_VERSION "30000.50.2" /end FUNCTION
/begin FUNCTION DFP "30000.3.0 Diagnostic Fault Path" FUNCTION_VERSION "30000.3.0" /end FUNCTION
/begin FUNCTION DfpCl "2.1.0     support of DFP handling" FUNCTION_VERSION "2.1.0" /end FUNCTION
/begin FUNCTION DHLS "9000.8.0  Diagnosis; Sensor heating"
 /begin DEF_CHARACTERISTIC CWDHLS CWDHLSEN DFC_CtlMsk2.DFC_HSH_C DFC_CtlMsk2.DFC_HSV_C DFC_DisblMsk2.DFC_HSH_C DFC_DisblMsk2.DFC_HSV_C HEGO_rHeatrDiagDeltaThdS1_C HEGO_rHeatrDiagDeltaThdS2_C HEGO_tHeatrDiagMfTUpperThdS1_T HEGO_tHeatrDiagMfTUpperThdS2_T KFRINH KFRINV KLRINH KLRINV TADHMN TDHHSRI TDHRIEE TDVHSRI TDVRIEE TVRIF ZRINSH ZRINSV /end DEF_CHARACTERISTIC
 /begin IN_MEASUREMENT B_atmtpa B_atmtpk B_rinh B_rinv B_stendes B_ttbmhh B_ttbmhv ml_w phlsnhxf phlsnvxf PrjCon_stLamSensRrCat_b rinh_w rinv_w SyC_stSub taikrm tkihkm ubsq /end IN_MEASUREMENT
 /begin LOC_MEASUREMENT B_endh B_enh B_env B_hsokh B_hsokv B_npfhsh B_npfhsv B_redhshk B_redhsvk rinkfh rinkfv rinsh_w rinsv_w /end LOC_MEASUREMENT
 FUNCTION_VERSION "9000.8.0" /end FUNCTION
/begin FUNCTION DHLSE "9000.5.0  Diagnosis of power stage O2 sensor heating"
 /begin DEF_CHARACTERISTIC CWPSHSHE CWPSHSVE DFC_CtlMsk2.DFC_HSHEmax_C DFC_CtlMsk2.DFC_HSHEmin_C DFC_CtlMsk2.DFC_HSHEsig_C DFC_CtlMsk2.DFC_HSVEmax_C DFC_CtlMsk2.DFC_HSVEmin_C DFC_CtlMsk2.DFC_HSVEsig_C DFC_DisblMsk2.DFC_HSHEmax_C DFC_DisblMsk2.DFC_HSHEmin_C DFC_DisblMsk2.DFC_HSHEsig_C DFC_DisblMsk2.DFC_HSVEmax_C DFC_DisblMsk2.DFC_HSVEmin_C DFC_DisblMsk2.DFC_HSVEsig_C /end DEF_CHARACTERISTIC
 /begin REF_CHARACTERISTIC TVP /end REF_CHARACTERISTIC
 /begin IN_MEASUREMENT B_atmtpa B_atmtpk B_desee_msg B_hshe B_hskfhxf B_hskfvxf B_hsve PrjCon_stLamSensRrCat_b SyC_stSub /end IN_MEASUREMENT
 FUNCTION_VERSION "9000.5.0" /end FUNCTION
/begin FUNCTION DiaActr_ElecPsDiag "1.4.0     Standardized electrical power stage diagnosis for discrete output signals"
 /begin DEF_CHARACTERISTIC DiaActr_ElecPsDiag_DbgSigId_C DiaActr_ElecPsDiag_DbgSigTyp_C DiaActr_ElecPsDiag_SigOutDurgOpenLd_C /end DEF_CHARACTERISTIC
 /begin LOC_MEASUREMENT DiaActrElecPsDiag_cntTestPlsTsk_mp DiaActrElecPsDiag_nrDiagErr_mp DiaActrElecPsDiag_nrTestPls_mp DiaActrElecPsDiag_stAttribOL_mp DiaActrElecPsDiag_stAttribOT_mp DiaActrElecPsDiag_stAttribSCB_mp DiaActrElecPsDiag_stAttribSCG_mp DiaActrElecPsDiag_stDsmDebOpenLoad_mp DiaActrElecPsDiag_stDsmDebOverT_mp DiaActrElecPsDiag_stDsmDebScb_mp DiaActrElecPsDiag_stDsmDebScg_mp DiaActrElecPsDiag_stErrCfgOpenLoad_mp DiaActrElecPsDiag_stErrCfgOverT_mp DiaActrElecPsDiag_stErrCfgScb_mp DiaActrElecPsDiag_stErrCfgScg_mp DiaActrElecPsDiag_stPrvTstRslt_mp DiaActrElecPsDiag_stSigCfg_mp DiaActrElecPsDiag_stSigErrInfo_mp DiaActrElecPsDiag_stSig_mp DiaActrElecPsDiag_stTestPls_mp DiaActrElecPsDiag_stTmngTestPls_mp DiaActrElecPsDiag_tiTstPls_mp /end LOC_MEASUREMENT
 FUNCTION_VERSION "1.4.0" /end FUNCTION
/begin FUNCTION DiaBas_BufAcs "30000.4.0_1.1.0Functions for platform independent access (swapping) to data stored in an MSB buffer" FUNCTION_VERSION "30000.4.0_1.1.0" /end FUNCTION
/begin FUNCTION DiagAdapt "23.11.1   Adaption of the Diagcom Interfaces to Autosar DCM to enable usage of ComDia and DiaBas with DCM" FUNCTION_VERSION "23.11.1" /end FUNCTION
/begin COMPU_METHOD B_TRUE "" TAB_VERB "%6.3" "" COMPU_TAB_REF B_TRUE /end COMPU_METHOD
/begin COMPU_VTAB B_TRUE "" TAB_VERB 2 0 "FALSE" 1 "TRUE" /end COMPU_VTAB
/begin COMPU_METHOD dez "" RAT_FUNC "%6.2" "" COEFFS 0 1 0 0 0 1 /end COMPU_METHOD
/begin COMPU_METHOD DFCDFP_Verb "" TAB_VERB "%2.1" "-" COMPU_TAB_REF DFCDFP_Verb /end COMPU_METHOD
/begin COMPU_VTAB DFCDFP_Verb "" TAB_VERB 187 0 "NoEntry" 1 "DFC_BusDiagOpenLoad_Can0" 2 "DFC_Com_ABSInfo_DLC" 3 "DFC_Com_ABSInfo_TO" 4 "DFC_BusDiagBusOff_Can0" 5 "DFC_DevLibBattUHi" 6 "DFC_DevLibBattULo" 7 "DFC_StrtOL" 8 "DFC_StrtOvrTemp" 9 "DFC_StrtSCB" 10 "DFC_StrtSCG" 11 "DFC_MILLmpOL" 12 "DFC_MILLmpOT" 13 "DFC_MILLmpSCB" 14 "DFC_MILLmpSCG" 15 "DFC_EV1max" 16 "DFC_EV1min" 17 "DFC_EV1sig" 18 "DFC_CEngDsTPlausSTC" 19 "DFC_ClthStkOpn" 20 "DFC_EVX" 21 "DFC_IntkAirTAirFltDsSTC" 22 "DFC_RoughRoad" 23 "DFC_SSpMon1" 24 "DFC_SSpMon1OT" 25 "DFC_SSpMon1OV" 26 "DFC_SSpMon1SCG" 27 "DFC_SSpMon1UV" 28 "DFC_SSpMon2" 29 "DFC_SSpMon2OT" 30 "DFC_SSpMon2OV" 31 "DFC_SSpMon2SCG" 32 "DFC_SSpMon2UV" 33 "DFC_CANIF_E_CTRL_NOT_SLEEP_ERROR_VALUE" 34 "DFC_CANIF_E_CTRL_STOPPED_ERROR_VALUE" 35 "DFC_CANIF_E_INVALID_DLC_ERROR" 36 "DFC_CANNM_E_CANIF_TRANSMIT_ERROR" 37 "DFC_CANNM_E_INIT_FAILED" 38 "DFC_CANNM_E_NETWORK_TIMEOUT" 39 "DFC_CAN_E_TIMEOUT" 40 "DFC_COMM_E_NET_START_IND_CHANNEL_0" 41 "DFC_COMM_E_NET_START_IND_CHANNEL_1" 42 "DFC_COMM_E_NET_START_IND_CHANNEL_2" 43 "DFC_COMM_E_NET_START_IND_CHANNEL_3" 44 "DFC_COMM_E_NET_START_IND_CHANNEL_4" 45 "DFC_COMM_E_NET_START_IND_CHANNEL_5" 46 "DFC_PDUR_E_INIT_FAILED" 47 "DFC_PDUR_E_PDU_INSTANCE_LOST" 48 "DFC_RBA_IOEXTLIB_KEEPALIVE_DRV" 49 "DFC_RBA_IOEXTLIB_KEEPALIVE_INI" 50 "DFC_rba_IoSigRtc_StopCounter" 51 "DFC_rba_MultiStackTrace_Threshold" 52 "DFC_rba_MRly_Diag_Stk_Event" 53 "DFC_rba_SyC_IrrSwOffTrigEngRun_Event" 54 "DFC_rba_T15_Diag_ComInVld_Event" 55 "DFC_rba_T15_Diag_ComOff_HwOn_Event" 56 "DFC_rba_T15_Diag_ComOn_HwOff_Event" 57 "DFC_BypAirActrOcCoil1" 58 "DFC_BypAirActrOcCoil2" 59 "DFC_BypAirActrOlCoil1" 60 "DFC_BypAirActrOlCoil2" 61 "DFC_BypAirActrOt" 62 "DFC_BypAirActrScbCoil1" 63 "DFC_BypAirActrScbCoil2" 64 "DFC_BypAirActrScgCoil1" 65 "DFC_BypAirActrScgCoil2" 66 "DFC_CEngDsTPhysRngHi" 67 "DFC_CEngDsTPhysRngLo" 68 "DFC_CEngDsTSRCMax" 69 "DFC_CEngDsTSRCMin" 70 "DFC_DKmax" 71 "DFC_DKmin" 72 "DFC_DLLRmax" 73 "DFC_DLLRmin" 74 "DFC_DLLRnpl" 75 "DFC_DSSRngMax" 76 "DFC_DSSRngMin" 77 "DFC_DSSmax" 78 "DFC_DSSmin" 79 "DFC_DSSnpl" 80 "DFC_DSSnplMax" 81 "DFC_DSSnplMin" 82 "DFC_DSSsig" 83 "DFC_EpmCrSErrSig" 84 "DFC_EpmCrSNoSig" 85 "DFC_HEGOS1B1ElecNpl" 86 "DFC_HSH" 87 "DFC_HSHEmax" 88 "DFC_HSHEmin" 89 "DFC_HSHEsig" 90 "DFC_HSV" 91 "DFC_HSVEmax" 92 "DFC_HSVEmin" 93 "DFC_HSVEsig" 94 "DFC_HdLampMax" 95 "DFC_HdLampMin" 96 "DFC_HdLampSig" 97 "DFC_IgnCoil1Err" 98 "DFC_IgnCoil2Err" 99 "DFC_IgnIgbtDiagSCG_0" 100 "DFC_IgnIgbtDiagSCG_1" 101 "DFC_IntkAirTAirFltDsPRCMax" 102 "DFC_IntkAirTAirFltDsPRCMin" 103 "DFC_IntkAirTAirFltDsSRCMax" 104 "DFC_IntkAirTAirFltDsSRCMin" 105 "DFC_IntkMnfldPNoSyn" 106 "DFC_KAT" 107 "DFC_KPEmax" 108 "DFC_KPEmin" 109 "DFC_KPEsig" 110 "DFC_KVSFmax" 111 "DFC_KVSFmin" 112 "DFC_KVSOmax" 113 "DFC_KVSOmin" 114 "DFC_LASHmn" 115 "DFC_LASHmx" 116 "DFC_LATP" 117 "DFC_LDLAHI" 118 "DFC_LFS1Max" 119 "DFC_LFS1Min" 120 "DFC_LFS1Sig" 121 "DFC_LSHmax" 122 "DFC_LSHmin" 123 "DFC_LSHnpl" 124 "DFC_LSHsig" 125 "DFC_LSVmax" 126 "DFC_LSVmin" 127 "DFC_LSVnpl" 128 "DFC_LSVsig" 129 "DFC_MDCat" 130 "DFC_MDCatCurr" 131 "DFC_MDCyl" 132 "DFC_MDEmi" 133 "DFC_MDEmiStrt" 134 "DFC_MDMpl" 135 "DFC_MoCADCNTP" 136 "DFC_MoCADCTst" 137 "DFC_MoFSidst" 138 "DFC_OCWDACom" 139 "DFC_OilPPSSwtMax" 140 "DFC_OilPPSSwtMin" 141 "DFC_OilPPSSwtSig" 142 "DFC_OvHEngSpdLimr" 143 "DFC_RoVComVld" 144 "DFC_RoVSNpl" 145 "DFC_RoVSOL" 146 "DFC_RoVSSCB" 147 "DFC_RoVSSCG" 148 "DFC_SdSTNpl" 149 "DFC_SdSTSCB" 150 "DFC_SdSTSCG" 151 "DFC_SdSTSOL" 152 "DFC_TEVEmax" 153 "DFC_TEVEmin" 154 "DFC_TEVEsig" 155 "DFC_TMnpl" 156 "DFC_UBmax" 157 "DFC_UBmin" 158 "DFC_UBnpl" 159 "DFC_VFZsig" 160 "DFC_VFZsig2" 161 "DFP_AAA" 162 "DFP_BM" 163 "DFP_DK" 164 "DFP_DLLR" 165 "DFP_DSS" 166 "DFP_EV1" 167 "DFP_HdLamp" 168 "DFP_HSH" 169 "DFP_HSHE" 170 "DFP_HSV" 171 "DFP_HSVE" 172 "DFP_KAT" 173 "DFP_KPE" 174 "DFP_LASH" 175 "DFP_LATP" 176 "DFP_LDLAHI" 177 "DFP_LFS1" 178 "DFP_LSH" 179 "DFP_LSV" 180 "DFP_N" 181 "DFP_OilPPSSwt" 182 "DFP_STRTR" 183 "DFP_TEVE" 184 "DFP_UBR" 185 "DFP_VFZ" 186 "DFP_ZZZ" DEFAULT_VALUE "---" /end COMPU_VTAB
/begin COMPU_METHOD DFC_Verb "" TAB_VERB "%2.1" "-" COMPU_TAB_REF DFC_Verb /end COMPU_METHOD
/begin COMPU_VTAB DFC_Verb "" TAB_VERB 161 0 "DFC_Unused" 4 "DFC_BusDiagBusOff_Can0" 1 "DFC_BusDiagOpenLoad_Can0" 57 "DFC_BypAirActrOcCoil1" 58 "DFC_BypAirActrOcCoil2" 59 "DFC_BypAirActrOlCoil1" 60 "DFC_BypAirActrOlCoil2" 61 "DFC_BypAirActrOt" 62 "DFC_BypAirActrScbCoil1" 63 "DFC_BypAirActrScbCoil2" 64 "DFC_BypAirActrScgCoil1" 65 "DFC_BypAirActrScgCoil2" 39 "DFC_CAN_E_TIMEOUT" 33 "DFC_CANIF_E_CTRL_NOT_SLEEP_ERROR_VALUE" 34 "DFC_CANIF_E_CTRL_STOPPED_ERROR_VALUE" 35 "DFC_CANIF_E_INVALID_DLC_ERROR" 36 "DFC_CANNM_E_CANIF_TRANSMIT_ERROR" 37 "DFC_CANNM_E_INIT_FAILED" 38 "DFC_CANNM_E_NETWORK_TIMEOUT" 66 "DFC_CEngDsTPhysRngHi" 67 "DFC_CEngDsTPhysRngLo" 18 "DFC_CEngDsTPlausSTC" 68 "DFC_CEngDsTSRCMax" 69 "DFC_CEngDsTSRCMin" 19 "DFC_ClthStkOpn" 2 "DFC_Com_ABSInfo_DLC" 3 "DFC_Com_ABSInfo_TO" 40 "DFC_COMM_E_NET_START_IND_CHANNEL_0" 41 "DFC_COMM_E_NET_START_IND_CHANNEL_1" 42 "DFC_COMM_E_NET_START_IND_CHANNEL_2" 43 "DFC_COMM_E_NET_START_IND_CHANNEL_3" 44 "DFC_COMM_E_NET_START_IND_CHANNEL_4" 45 "DFC_COMM_E_NET_START_IND_CHANNEL_5" 5 "DFC_DevLibBattUHi" 6 "DFC_DevLibBattULo" 70 "DFC_DKmax" 71 "DFC_DKmin" 72 "DFC_DLLRmax" 73 "DFC_DLLRmin" 74 "DFC_DLLRnpl" 77 "DFC_DSSmax" 78 "DFC_DSSmin" 79 "DFC_DSSnpl" 80 "DFC_DSSnplMax" 81 "DFC_DSSnplMin" 75 "DFC_DSSRngMax" 76 "DFC_DSSRngMin" 82 "DFC_DSSsig" 83 "DFC_EpmCrSErrSig" 84 "DFC_EpmCrSNoSig" 15 "DFC_EV1max" 16 "DFC_EV1min" 17 "DFC_EV1sig" 20 "DFC_EVX" 94 "DFC_HdLampMax" 95 "DFC_HdLampMin" 96 "DFC_HdLampSig" 85 "DFC_HEGOS1B1ElecNpl" 86 "DFC_HSH" 87 "DFC_HSHEmax" 88 "DFC_HSHEmin" 89 "DFC_HSHEsig" 90 "DFC_HSV" 91 "DFC_HSVEmax" 92 "DFC_HSVEmin" 93 "DFC_HSVEsig" 97 "DFC_IgnCoil1Err" 98 "DFC_IgnCoil2Err" 99 "DFC_IgnIgbtDiagSCG_0" 100 "DFC_IgnIgbtDiagSCG_1" 101 "DFC_IntkAirTAirFltDsPRCMax" 102 "DFC_IntkAirTAirFltDsPRCMin" 103 "DFC_IntkAirTAirFltDsSRCMax" 104 "DFC_IntkAirTAirFltDsSRCMin" 21 "DFC_IntkAirTAirFltDsSTC" 105 "DFC_IntkMnfldPNoSyn" 106 "DFC_KAT" 107 "DFC_KPEmax" 108 "DFC_KPEmin" 109 "DFC_KPEsig" 110 "DFC_KVSFmax" 111 "DFC_KVSFmin" 112 "DFC_KVSOmax" 113 "DFC_KVSOmin" 114 "DFC_LASHmn" 115 "DFC_LASHmx" 116 "DFC_LATP" 117 "DFC_LDLAHI" 118 "DFC_LFS1Max" 119 "DFC_LFS1Min" 120 "DFC_LFS1Sig" 121 "DFC_LSHmax" 122 "DFC_LSHmin" 123 "DFC_LSHnpl" 124 "DFC_LSHsig" 125 "DFC_LSVmax" 126 "DFC_LSVmin" 127 "DFC_LSVnpl" 128 "DFC_LSVsig" 129 "DFC_MDCat" 130 "DFC_MDCatCurr" 131 "DFC_MDCyl" 132 "DFC_MDEmi" 133 "DFC_MDEmiStrt" 134 "DFC_MDMpl" 11 "DFC_MILLmpOL" 12 "DFC_MILLmpOT" 13 "DFC_MILLmpSCB" 14 "DFC_MILLmpSCG" 135 "DFC_MoCADCNTP" 136 "DFC_MoCADCTst" 137 "DFC_MoFSidst" 138 "DFC_OCWDACom" 139 "DFC_OilPPSSwtMax" 140 "DFC_OilPPSSwtMin" 141 "DFC_OilPPSSwtSig" 142 "DFC_OvHEngSpdLimr" 46 "DFC_PDUR_E_INIT_FAILED" 47 "DFC_PDUR_E_PDU_INSTANCE_LOST" 48 "DFC_RBA_IOEXTLIB_KEEPALIVE_DRV" 49 "DFC_RBA_IOEXTLIB_KEEPALIVE_INI" 50 "DFC_rba_IoSigRtc_StopCounter" 52 "DFC_rba_MRly_Diag_Stk_Event" 51 "DFC_rba_MultiStackTrace_Threshold" 53 "DFC_rba_SyC_IrrSwOffTrigEngRun_Event" 54 "DFC_rba_T15_Diag_ComInVld_Event" 55 "DFC_rba_T15_Diag_ComOff_HwOn_Event" 56 "DFC_rba_T15_Diag_ComOn_HwOff_Event" 22 "DFC_RoughRoad" 143 "DFC_RoVComVld" 144 "DFC_RoVSNpl" 145 "DFC_RoVSOL" 146 "DFC_RoVSSCB" 147 "DFC_RoVSSCG" 148 "DFC_SdSTNpl" 149 "DFC_SdSTSCB" 150 "DFC_SdSTSCG" 151 "DFC_SdSTSOL" 23 "DFC_SSpMon1" 24 "DFC_SSpMon1OT" 25 "DFC_SSpMon1OV" 26 "DFC_SSpMon1SCG" 27 "DFC_SSpMon1UV" 28 "DFC_SSpMon2" 29 "DFC_SSpMon2OT" 30 "DFC_SSpMon2OV" 31 "DFC_SSpMon2SCG" 32 "DFC_SSpMon2UV" 7 "DFC_StrtOL" 8 "DFC_StrtOvrTemp" 9 "DFC_StrtSCB" 10 "DFC_StrtSCG" 152 "DFC_TEVEmax" 153 "DFC_TEVEmin" 154 "DFC_TEVEsig" 155 "DFC_TMnpl" 156 "DFC_UBmax" 157 "DFC_UBmin" 158 "DFC_UBnpl" 159 "DFC_VFZsig" 160 "DFC_VFZsig2" DEFAULT_VALUE "---" /end COMPU_VTAB
/begin COMPU_METHOD DFES_Entry_Verb "" TAB_VERB "%6.3" "" COMPU_TAB_REF DFES_Entry_Verb /end COMPU_METHOD
/begin COMPU_VTAB DFES_Entry_Verb "" TAB_VERB 29 0 "Empty" 1 "Erased" 2 "Erased_PdtcClrd" 3 "Erased_PdtcClrdMinTrip" 4 "Erased_PdtcClrdOk" 5 "FrzFrm" 6 "FrzFrm_PdtcClrd" 7 "FrzFrm_PdtcClrdMinTrip" 8 "FrzFrm_PdtcClrdOk" 9 "Shadow" 10 "Shadow_PdtcClrd" 11 "Shadow_PdtcClrdMinTrip" 12 "Shadow_PdtcClrdOk" 13 "Service" 14 "Service_PdtcClrdOk" 15 "Service_Shdw" 16 "Service_ShdwPdtcClrdOk" 17 "Service_FrzFrm" 18 "Service_FrzFrmPdtcClrdOk" 19 "Pending" 20 "Pending_PdtcClrd" 21 "Pending_PdtcClrdMinTrip" 22 "Pending_PdtcClrdOk" 23 "Confirmed" 24 "Confirmed_Pdtc" 25 "ConfirmedHealing" 26 "ConfirmedHealing_Pdtc" 27 "ConfirmedPending" 28 "ConfirmedAging" /end COMPU_VTAB
/begin COMPU_METHOD DFES_EnvTabVerb "" TAB_VERB "%2.1" "-" COMPU_TAB_REF DFES_EnvTabVerb /end COMPU_METHOD
/begin COMPU_VTAB DFES_EnvTabVerb "" TAB_VERB 2 0 "xSet1" 1 "xSet2" DEFAULT_VALUE "---" /end COMPU_VTAB
/begin COMPU_METHOD DFES_LampFltMIL "" TAB_VERB "%2.1" "-" COMPU_TAB_REF DFES_LampFltMIL /end COMPU_METHOD
/begin COMPU_VTAB DFES_LampFltMIL "" TAB_VERB 4 0 "NO_Lamp_Activation" 1 "Continous_Lamp_Support" 2 "Blinking_Lamp_Support" 3 "Blinking_and_Continous_Lamp_Supp" /end COMPU_VTAB
/begin COMPU_METHOD DFES_LampFltSVS "" TAB_VERB "%6.3" "-" COMPU_TAB_REF DFES_LampFltSVS /end COMPU_METHOD
/begin COMPU_VTAB DFES_LampFltSVS "" TAB_VERB 6 0 "NO_Lamp_Activation" 1 "Continous_Lamp_Support" 2 "Blinking_Lamp_Support" 3 "Blinking_and_Continous_Lamp_Supp" 4 "Continuous_SVS_Support_LDF" 8 "Continuous_SVS_Support_LDF_FLC" /end COMPU_VTAB
/begin COMPU_METHOD DFES_Mon_Verb "" TAB_VERB "%6.3" "-" COMPU_TAB_REF DFES_Mon_Verb /end COMPU_METHOD
/begin COMPU_VTAB DFES_Mon_Verb "" TAB_VERB 22 0 "-----" 257 "double entry" 1025 "LDF_Diff DFCst - ORD" 513 "Counter exceeds" 258 "MEM missing" 1032 "retry entry" 514 "DEL Counter Serv ex" 260 "MEM no Entry" 516 "DEL Counter Pend ex" 1026 "Deb ok missing" 520 "DEL Counter OBD ex" 1028 "Deb def missing" 2049 "EepQueOvfl" 2050 "EepIniFailed" 2051 "EepIniNoSucss" 4097 "Erased_prioHigh" 4098 "slow_scan" 8193 "miss diumpr Fid" 16385 "invalid DTR limit" 32770 "event lost due to rollback limit" 32785 "number active InhUdp negative" 32786 "non zero InhUpd counter used" /end COMPU_VTAB
/begin COMPU_METHOD DFES_nPID0C "" RAT_FUNC "%6.3" "rpm" COEFFS 0 4 0 0 0 1 /end COMPU_METHOD
/begin COMPU_METHOD DFES_OneToOne "" RAT_FUNC "%6.2" "-" COEFFS 0 1 0 0 0 1 /end COMPU_METHOD
/begin COMPU_METHOD DFES_rPID04 "" RAT_FUNC "%6.3" "%" COEFFS 0 2.55 0 0 0 1 /end COMPU_METHOD
/begin COMPU_METHOD DFES_stCheck_Verb "" TAB_VERB "%6.3" "-" COMPU_TAB_REF DFES_stCheck_Verb /end COMPU_METHOD
/begin COMPU_VTAB DFES_stCheck_Verb "" TAB_VERB 8 0 "OkNoTst" 1 "OkTested" 2 "OkHealed" 3 "OkRstNoTst" 4 "DefectNoTst" 5 "DefectDelay" 6 "Defect" 7 "DefectRstNoTst" /end COMPU_VTAB
/begin COMPU_METHOD DFES_stCnt_Verb "" TAB_VERB "%6.3" "-" COMPU_TAB_REF DFES_stCnt_Verb /end COMPU_METHOD
/begin COMPU_VTAB DFES_stCnt_Verb "" TAB_VERB 36 0 "SVS_NONE__MIL_NONE" 1 "SVS_NONE__MIL_HLC_TRG" 2 "SVS_NONE__MIL_HLC_ELAP" 3 "SVS_NONE__MIL_FLC_CNT" 4 "SVS_NONE__MIL_FLC_TIME" 5 "SVS_NONE__MIL_HLC_TIME" 16 "SVS_HLC_TRG__MIL_NONE" 17 "SVS_HLC_TRG__MIL_HLC_TRG" 18 "SVS_HLC_TRG__MIL_HLC_ELAP" 19 "SVS_HLC_TRG__MIL_FLC_CNT" 20 "SVS_HLC_TRG__MIL_FLC_TIME" 21 "SVS_HLC_TRG__MIL_HLC_TIME" 32 "SVS_HLC_ELAP__MIL_NONE" 33 "SVS_HLC_ELAP__MIL_HLC_TRG" 34 "SVS_HLC_ELAP__MIL_HLC_ELAP" 35 "SVS_HLC_ELAP__MIL_FLC_CNT" 36 "SVS_HLC_ELAP__MIL_FLC_TIME" 37 "SVS_HLC_ELAP__MIL_HLC_TIME" 48 "SVS_FLC_CNT__MIL_NONE" 49 "SVS_FLC_CNT__MIL_HLC_TRG" 50 "SVS_FLC_CNT__MIL_HLC_ELAP" 51 "SVS_FLC_CNT__MIL_FLC_CNT" 52 "SVS_FLC_CNT__MIL_FLC_TIME" 53 "SVS_FLC_CNT__MIL_HLC_TIME" 64 "SVS_FLC_TIME__MIL_NONE" 65 "SVS_FLC_TIME__MIL_HLC_TRG" 66 "SVS_FLC_TIME__MIL_HLC_ELAP" 67 "SVS_FLC_TIME__MIL_FLC_CNT" 68 "SVS_FLC_TIME__MIL_FLC_TIME" 69 "SVS_FLC_TIME__MIL_HLC_TIME" 80 "SVS_HLC_TIME__MIL_NONE" 81 "SVS_HLC_TIME__MIL_HLC_TRG" 82 "SVS_HLC_TIME__MIL_HLC_ELAP" 83 "SVS_HLC_TIME__MIL_FLC_CNT" 84 "SVS_HLC_TIME__MIL_FLC_TIME" 85 "SVS_HLC_TIME__MIL_HLC_TIME" /end COMPU_VTAB
/begin COMPU_METHOD DFES_stDataImdt_Verb "" TAB_VERB "%6.3" "" COMPU_TAB_REF DFES_stDataImdt_Verb /end COMPU_METHOD
/begin COMPU_VTAB DFES_stDataImdt_Verb "" TAB_VERB 22 0 "ERASED" 1 "ERASED_ACTSEQ_FRZ_ENV" 2 "FRZONLY" 3 "FRZONLY_ACTSEQ_FRZ_ENV" 4 "SHADOW" 5 "SHADOW_ACTSEQ_FRZ_ENV" 12 "OKENTRY" 13 "OKENTRY_ACTSEQ_LCK" 14 "OKENTRY_ACTSEQ_LCK_ENV_LCK" 15 "OKENTRY_ACTSEQ_FRZ_ENV_LCK" 16 "OKENTRY_ACTSEQ_ENV_LCK" 17 "ERROR" 18 "ERROR_ACTSEQ_LCK" 19 "ERROR_ACTSEQ_LCK_ENV_LCK" 20 "ERROR_ACTSEQ_FRZ_ENV_LCK" 21 "ERROR_ACTSEQ_ENV_LCK" 6 "SHADOWFRZ" 7 "SHADOWFRZ_ACTSEQ_FRZ_ENV" 8 "SHADOWOK" 9 "SHADOWOK_ACTSEQ_FRZ_ENV" 10 "SHADOWOKFRZ" 11 "SHADOWOKFRZ_ACTSEQ_FRZ_ENV" /end COMPU_VTAB
/begin COMPU_METHOD DFES_stEntry_Verb "" TAB_VERB "%6.3" "-" COMPU_TAB_REF DFES_stEntry_Verb /end COMPU_METHOD
/begin COMPU_VTAB DFES_stEntry_Verb "" TAB_VERB 240 0 "NoEntry" 1 "Erased" 2 "PrivateTemporary" 3 "SVSOff_FreezeFrameOnly" 4 "SVSOff_DelayActiveDefect" 5 "SVSOff_ServiceNoDefect" 6 "SVSOff_ServiceDefect" 7 "SVSOff_ServiceHistoryDefect" 8 "SVSOff_ServiceHistoryNoDefect" 9 "SVSOff_DelayActiveNoDefect" 10 "SVSOff_PendingDefect" 11 "SVSOff_DebouncedDefect" 12 "SVSOff_HistoryPendingDefect" 13 "SVSOff_HealingNoDefect" 14 "SVSOff_HistoryNoDefect" 16 "DelD_NoEntry" 17 "DelD_Erased" 18 "DelD_PrivateTemporary" 19 "SVSOff_DelD_FreezeFrameOnly" 20 "SVSOff_DelD_DelayActiveDefect" 21 "SVSOff_DelD_ServiceNoDefect" 22 "SVSOff_DelD_ServiceDefect" 23 "SVSOff_DelD_ServiceHistoryDefect" 24 "SVSOff_DelD_ServiceHistoryNoDefect" 25 "SVSOff_DelD_DelayActiveNoDefect" 26 "SVSOff_DelD_PendingDefect" 27 "SVSOff_DelD_DebouncedDefect" 28 "SVSOff_DelD_HistoryPendingDefect" 29 "SVSOff_DelD_HealingNoDefect" 30 "SVSOff_DelD_HistoryNoDefect" 32 "P_NoEntry" 33 "P_Erased" 34 "P_PrivateTemporary" 35 "SVSOff_P_FreezeFrameOnly" 36 "SVSOff_P_DelayActiveDefect" 37 "SVSOff_P_ServiceNoDefect" 38 "SVSOff_P_ServiceDefect" 39 "SVSOff_P_ServiceHistoryDefect" 40 "SVSOff_P_ServiceHistoryNoDefect" 41 "SVSOff_P_DelayActiveNoDefect" 42 "SVSOff_P_PendingDefect" 43 "SVSOff_P_DebouncedDefect" 44 "SVSOff_P_HistoryPendingDefect" 45 "SVSOff_P_HealingNoDefect" 46 "SVSOff_P_HistoryNoDefect" 48 "P_DelD_NoEntry" 49 "P_DelD_Erased" 50 "P_DelD_PrivateTemporary" 51 "SVSOff_P_DelD_FreezeFrameOnly" 52 "SVSOff_P_DelD_DelayActiveDefect" 53 "SVSOff_P_DelD_ServiceNoDefect" 54 "SVSOff_P_DelD_ServiceDefect" 55 "SVSOff_P_DelD_ServiceHistoryDefect" 56 "SVSOff_P_DelD_ServiceHistoryNoDefect" 57 "SVSOff_P_DelD_DelayActiveNoDefect" 58 "SVSOff_P_DelD_PendingDefect" 59 "SVSOff_P_DelD_DebouncedDefect" 60 "SVSOff_P_DelD_HistoryPendingDefect" 61 "SVSOff_P_DelD_HealingNoDefect" 62 "SVSOff_P_DelD_HistoryNoDefect" 64 "PS_NoEntry" 65 "PS_Erased" 66 "PS_PrivateTemporary" 67 "SVSOff_PS_FreezeFrameOnly" 68 "SVSOff_PS_DelayActiveDefect" 69 "SVSOff_PS_ServiceNoDefect" 70 "SVSOff_PS_ServiceDefect" 71 "SVSOff_PS_ServiceHistoryDefect" 72 "SVSOff_PS_ServiceHistoryNoDefect" 73 "SVSOff_PS_DelayActiveNoDefect" 74 "SVSOff_PS_PendingDefect" 75 "SVSOff_PS_DebouncedDefect" 76 "SVSOff_PS_HistoryPendingDefect" 77 "SVSOff_PS_HealingNoDefect" 78 "SVSOff_PS_HistoryNoDefect" 80 "PS_DelD_NoEntry" 81 "PS_DelD_Erased" 82 "PS_DelD_PrivateTemporary" 83 "SVSOff_PS_DelD_FreezeFrameOnly" 84 "SVSOff_PS_DelD_DelayActiveDefect" 85 "SVSOff_PS_DelD_ServiceNoDefect" 86 "SVSOff_PS_DelD_ServiceDefect" 87 "SVSOff_PS_DelD_ServiceHistoryDefect" 88 "SVSOff_PS_DelD_ServiceHistoryNoDefect" 89 "SVSOff_PS_DelD_DelayActiveNoDefect" 90 "SVSOff_PS_DelD_PendingDefect" 91 "SVSOff_PS_DelD_DebouncedDefect" 92 "SVSOff_PS_DelD_HistoryPendingDefect" 93 "SVSOff_PS_DelD_HealingNoDefect" 94 "SVSOff_PS_DelD_HistoryNoDefect" 96 "PS_P_NoEntry" 97 "PS_P_Erased" 98 "PS_P_PrivateTemporary" 99 "SVSOff_PS_P_FreezeFrameOnly" 100 "SVSOff_PS_P_DelayActiveDefect" 101 "SVSOff_PS_P_ServiceNoDefect" 102 "SVSOff_PS_P_ServiceDefect" 103 "SVSOff_PS_P_ServiceHistoryDefect" 104 "SVSOff_PS_P_ServiceHistoryNoDefect" 105 "SVSOff_PS_P_DelayActiveNoDefect" 106 "SVSOff_PS_P_PendingDefect" 107 "SVSOff_PS_P_DebouncedDefect" 108 "SVSOff_PS_P_HistoryPendingDefect" 109 "SVSOff_PS_P_HealingNoDefect" 110 "SVSOff_PS_P_HistoryNoDefect" 112 "PS_P_DelD_NoEntry" 113 "PS_P_DelD_Erased" 114 "PS_P_DelD_PrivateTemporary" 115 "SVSOff_PS_P_DelD_FreezeFrameOnly" 116 "SVSOff_PS_P_DelD_DelayActiveDefect" 117 "SVSOff_PS_P_DelD_ServiceNoDefect" 118 "SVSOff_PS_P_DelD_ServiceDefect" 119 "SVSOff_PS_P_DelD_ServiceHistoryDefect" 120 "SVSOff_PS_P_DelD_ServiceHistoryNoDefect" 121 "SVSOff_PS_P_DelD_DelayActiveNoDefect" 122 "SVSOff_PS_P_DelD_PendingDefect" 123 "SVSOff_PS_P_DelD_DebouncedDefect" 124 "SVSOff_PS_P_DelD_HistoryPendingDefect" 125 "SVSOff_PS_P_DelD_HealingNoDefect" 126 "SVSOff_PS_P_DelD_HistoryNoDefect" 128 "SVSOn_NoEntry" 129 "SVSOn_Erased" 130 "SVSOn_PrivateTemporary" 131 "SVSOn_FreezeFrameOnly" 132 "SVSOn_DelayActiveDefect" 133 "SVSOn_ServiceNoDefect" 134 "SVSOn_ServiceDefect" 135 "SVSOn_ServiceHistoryDefect" 136 "SVSOn_ServiceHistoryNoDefect" 137 "SVSOn_DelayActiveNoDefect" 138 "SVSOn_PendingDefect" 139 "SVSOn_DebouncedDefect" 140 "SVSOn_HistoryPendingDefect" 141 "SVSOn_HealingNoDefect" 142 "SVSOn_HistoryNoDefect" 144 "SVSOn_DelD_NoEntry" 145 "SVSOn_DelD_Erased" 146 "SVSOn_DelD_PrivateTemporary" 147 "SVSOn_DelD_FreezeFrameOnly" 148 "SVSOn_DelD_DelayActiveDefect" 149 "SVSOn_DelD_ServiceNoDefect" 150 "SVSOn_DelD_ServiceDefect" 151 "SVSOn_DelD_ServiceHistoryDefect" 152 "SVSOn_DelD_ServiceHistoryNoDefect" 153 "SVSOn_DelD_DelayActiveNoDefect" 154 "SVSOn_DelD_PendingDefect" 155 "SVSOn_DelD_DebouncedDefect" 156 "SVSOn_DelD_HistoryPendingDefect" 157 "SVSOn_DelD_HealingNoDefect" 158 "SVSOn_DelD_HistoryNoDefect" 160 "SVSOn_P_NoEntry" 161 "SVSOn_P_Erased" 162 "SVSOn_P_PrivateTemporary" 163 "SVSOn_P_FreezeFrameOnly" 164 "SVSOn_P_DelayActiveDefect" 165 "SVSOn_P_ServiceNoDefect" 166 "SVSOn_P_ServiceDefect" 167 "SVSOn_P_ServiceHistoryDefect" 168 "SVSOn_P_ServiceHistoryNoDefect" 169 "SVSOn_P_DelayActiveNoDefect" 170 "SVSOn_P_PendingDefect" 171 "SVSOn_P_DebouncedDefect" 172 "SVSOn_P_HistoryPendingDefect" 173 "SVSOn_P_HealingNoDefect" 174 "SVSOn_P_HistoryNoDefect" 176 "SVSOn_P_DelD_NoEntry" 177 "SVSOn_P_DelD_Erased" 178 "SVSOn_P_DelD_PrivateTemporary" 179 "SVSOn_P_DelD_FreezeFrameOnly" 180 "SVSOn_P_DelD_DelayActiveDefect" 181 "SVSOn_P_DelD_ServiceNoDefect" 182 "SVSOn_P_DelD_ServiceDefect" 183 "SVSOn_P_DelD_ServiceHistoryDefect" 184 "SVSOn_P_DelD_ServiceHistoryNoDefect" 185 "SVSOn_P_DelD_DelayActiveNoDefect" 186 "SVSOn_P_DelD_PendingDefect" 187 "SVSOn_P_DelD_DebouncedDefect" 188 "SVSOn_P_DelD_HistoryPendingDefect" 189 "SVSOn_P_DelD_HealingNoDefect" 190 "SVSOn_P_DelD_HistoryNoDefect" 192 "SVSOn_PS_NoEntry" 193 "SVSOn_PS_Erased" 194 "SVSOn_PS_PrivateTemporary" 195 "SVSOn_PS_FreezeFrameOnly" 196 "SVSOn_PS_DelayActiveDefect" 197 "SVSOn_PS_ServiceNoDefect" 198 "SVSOn_PS_ServiceDefect" 199 "SVSOn_PS_ServiceHistoryDefect" 200 "SVSOn_PS_ServiceHistoryNoDefect" 201 "SVSOn_PS_DelayActiveNoDefect" 202 "SVSOn_PS_PendingDefect" 203 "SVSOn_PS_DebouncedDefect" 204 "SVSOn_PS_HistoryPendingDefect" 205 "SVSOn_PS_HealingNoDefect" 206 "SVSOn_PS_HistoryNoDefect" 208 "SVSOn_PS_DelD_NoEntry" 209 "SVSOn_PS_DelD_Erased" 210 "SVSOn_PS_DelD_PrivateTemporary" 211 "SVSOn_PS_DelD_FreezeFrameOnly" 212 "SVSOn_PS_DelD_DelayActiveDefect" 213 "SVSOn_PS_DelD_ServiceNoDefect" 214 "SVSOn_PS_DelD_ServiceDefect" 215 "SVSOn_PS_DelD_ServiceHistoryDefect" 216 "SVSOn_PS_DelD_ServiceHistoryNoDefect" 217 "SVSOn_PS_DelD_DelayActiveNoDefect" 218 "SVSOn_PS_DelD_PendingDefect" 219 "SVSOn_PS_DelD_DebouncedDefect" 220 "SVSOn_PS_DelD_HistoryPendingDefect" 221 "SVSOn_PS_DelD_HealingNoDefect" 222 "SVSOn_PS_DelD_HistoryNoDefect" 224 "SVSOn_PS_P_NoEntry" 225 "SVSOn_PS_P_Erased" 226 "SVSOn_PS_P_PrivateTemporary" 227 "SVSOn_PS_P_FreezeFrameOnly" 228 "SVSOn_PS_P_DelayActiveDefect" 229 "SVSOn_PS_P_ServiceNoDefect" 230 "SVSOn_PS_P_ServiceDefect" 231 "SVSOn_PS_P_ServiceHistoryDefect" 232 "SVSOn_PS_P_ServiceHistoryNoDefect" 233 "SVSOn_PS_P_DelayActiveNoDefect" 234 "SVSOn_PS_P_PendingDefect" 235 "SVSOn_PS_P_DebouncedDefect" 236 "SVSOn_PS_P_HistoryPendingDefect" 237 "SVSOn_PS_P_HealingNoDefect" 238 "SVSOn_PS_P_HistoryNoDefect" 240 "SVSOn_PS_P_DelD_NoEntry" 241 "SVSOn_PS_P_DelD_Erased" 242 "SVSOn_PS_P_DelD_PrivateTemporary" 243 "SVSOn_PS_P_DelD_FreezeFrameOnly" 244 "SVSOn_PS_P_DelD_DelayActiveDefect" 245 "SVSOn_PS_P_DelD_ServiceNoDefect" 246 "SVSOn_PS_P_DelD_ServiceDefect" 247 "SVSOn_PS_P_DelD_ServiceHistoryDefect" 248 "SVSOn_PS_P_DelD_ServiceHistoryNoDefect" 249 "SVSOn_PS_P_DelD_DelayActiveNoDefect" 250 "SVSOn_PS_P_DelD_PendingDefect" 251 "SVSOn_PS_P_DelD_DebouncedDefect" 252 "SVSOn_PS_P_DelD_HistoryPendingDefect" 253 "SVSOn_PS_P_DelD_HealingNoDefect" 254 "SVSOn_PS_P_DelD_HistoryNoDefect" /end COMPU_VTAB
/begin COMPU_METHOD DFES_tPID05 "" RAT_FUNC "%6.2" "deg C" COEFFS 0 1 40 0 0 1 /end COMPU_METHOD
/begin COMPU_METHOD DFES_TstVisAndPrio "" TAB_VERB "%6.3" "-" COMPU_TAB_REF DFES_TstVisAndPrio /end COMPU_METHOD
/begin COMPU_VTAB DFES_TstVisAndPrio "" TAB_VERB 10 3 "invisible_for_all_Testers" 5 "ServiceLow" 7 "ServiceHigh" 201 "OBDLow" 203 "OBDHigh" 205 "OBDHighPlus" 207 "ServiceHigh_MaxPrio" 209 "ServiceHigh_OBDLow_MaxPrio" 211 "ServiceHigh_OBDHigh_MaxPrio" 213 "ServiceHigh_OBDHighPlus_MaxPrio" /end COMPU_VTAB
/begin COMPU_METHOD DiaActrElecPsDiag_stSig_COMPU_VERB "" TAB_VERB "%6.3" "" COMPU_TAB_REF DiaActrElecPsDiag_stSig_COMPU_VERB /end COMPU_METHOD
/begin COMPU_VTAB DiaActrElecPsDiag_stSig_COMPU_VERB "" TAB_VERB 7 0 "INVALID" 1 "NOTEST" 2 "NOFAULT" 3 "FAULT" 4 "PREFAULT" 5 "HEALFAULT" 6 "WAITSTATE" DEFAULT_VALUE "0" /end COMPU_VTAB
/begin COMPU_METHOD DiaActrElecPsDiag_stTestPls_COMPU_VERB "" TAB_VERB "%6.3" "" COMPU_TAB_REF DiaActrElecPsDiag_stTestPls_COMPU_VERB /end COMPU_METHOD
/begin COMPU_VTAB DiaActrElecPsDiag_stTestPls_COMPU_VERB "" TAB_VERB 5 1 "NO" 2 "REQUESTED" 3 "RUNNING" 4 "FINISHED" 5 "RE-TRIGGERED" DEFAULT_VALUE "1" /end COMPU_VTAB
/begin COMPU_METHOD DiaActrElecPsDiag_stTmngTestPls_COMPU_VERB "" TAB_VERB "%6.3" "" COMPU_TAB_REF DiaActrElecPsDiag_stTmngTestPls_COMPU_VERB /end COMPU_METHOD
/begin COMPU_VTAB DiaActrElecPsDiag_stTmngTestPls_COMPU_VERB "" TAB_VERB 4 1 "EVERY_RASTER" 2 "TIME_BETWEEN_TEST_1" 3 "TIME_BETWEEN_TEST_2" 0 "NO" DEFAULT_VALUE "0" /end COMPU_VTAB
/begin COMPU_METHOD DiaActr_ElecPsDiag_DbgSigTyp_COMPU_VERB "" TAB_VERB "%6.3" "" COMPU_TAB_REF DiaActr_ElecPsDiag_DbgSigTyp_COMPU_VERB /end COMPU_METHOD
/begin COMPU_VTAB DiaActr_ElecPsDiag_DbgSigTyp_COMPU_VERB "" TAB_VERB 4 1 "DIGITAL_OUTPUT" 2 "PWM_OUTPUT" 3 "PMD_OUTPUT" 0 "NONE" DEFAULT_VALUE "0" /end COMPU_VTAB
/begin COMPU_METHOD DIUMPR_EVAPDENOMTIPRPSYSOFF_SC_Compu "" TAB_VERB "%6.3" "" COMPU_TAB_REF DIUMPR_EVAPDENOMTIPRPSYSOFF_SC_Compu /end COMPU_METHOD
/begin COMPU_VTAB DIUMPR_EVAPDENOMTIPRPSYSOFF_SC_Compu "" TAB_VERB 2 0 "False" 1 "True" /end COMPU_VTAB
/begin COMPU_METHOD DIUMPR_EVAPDEN_SY_Compu "" TAB_VERB "%6.3" "" COMPU_TAB_REF DIUMPR_EVAPDEN_SY_Compu /end COMPU_METHOD
/begin COMPU_VTAB DIUMPR_EVAPDEN_SY_Compu "" TAB_VERB 2 0 "False" 1 "True" /end COMPU_VTAB
/begin COMPU_METHOD DIUMPR_FUENGOPERTI_SC_Compu "" TAB_VERB "%6.3" "" COMPU_TAB_REF DIUMPR_FUENGOPERTI_SC_Compu /end COMPU_METHOD
/begin COMPU_VTAB DIUMPR_FUENGOPERTI_SC_Compu "" TAB_VERB 2 0 "False" 1 "True" /end COMPU_VTAB
/begin COMPU_METHOD DIUMPR_NUMDENOMIDXGRP_SY_Compu "" TAB_VERB "%6.3" "" COMPU_TAB_REF DIUMPR_NUMDENOMIDXGRP_SY_Compu /end COMPU_METHOD
/begin COMPU_VTAB DIUMPR_NUMDENOMIDXGRP_SY_Compu "" TAB_VERB 2 0 "False" 1 "True" /end COMPU_VTAB
/begin COMPU_METHOD DKPROSG_SY_Compu "" TAB_VERB "%6.3" "" COMPU_TAB_REF DKPROSG_SY_Compu /end COMPU_METHOD
/begin COMPU_VTAB DKPROSG_SY_Compu "" TAB_VERB 4 0 "NODK" 1 "1DK" 2 "2DK" 3 "3DK" /end COMPU_VTAB
/begin COMPU_METHOD dmNOx_mg_p_s "" RAT_FUNC "%6.3" "mg/s" COEFFS 0 6.66666666666667 0 0 0 1 /end COMPU_METHOD
/begin COMPU_METHOD dmOilAsh_mg_p_s "" RAT_FUNC "%6.4" "mg/s" COEFFS 0 100 0 0 0 1 /end COMPU_METHOD
/begin COMPU_METHOD dmSoot_g_p_s "" RAT_FUNC "%7.6" "g/s" COEFFS 0 10000 0 0 0 1 /end COMPU_METHOD
/begin COMPU_METHOD dmSoot_mg_p_s "" RAT_FUNC "%6.4" "mg/s" COEFFS 0 100 0 0 0 1 /end COMPU_METHOD
/begin COMPU_METHOD DOIP_SC_Compu "" TAB_VERB "%6.3" "" COMPU_TAB_REF DOIP_SC_Compu /end COMPU_METHOD
/begin COMPU_VTAB DOIP_SC_Compu "" TAB_VERB 2 0 "INACTIVE" 1 "ACTIVE" /end COMPU_VTAB
/begin COMPU_METHOD dPres_hPa_p_s "" RAT_FUNC "%6.2" "hPa/s" COEFFS 0 1 0 0 0 1 /end COMPU_METHOD
/begin COMPU_METHOD DRCTSTRT_SY_Compu "" TAB_VERB "%6.3" "" COMPU_TAB_REF DRCTSTRT_SY_Compu /end COMPU_METHOD
/begin COMPU_VTAB DRCTSTRT_SY_Compu "" TAB_VERB 4 0 "DRCTSTRT_DISBL" 1 "DRCTSTRT_STASUPRT" 2 "DRCTSTRT_NOSTASUPRT" 3 "DRCTSTRT_STASPFI" /end COMPU_VTAB
/begin COMPU_METHOD drLamRec_Persec "" RAT_FUNC "%6.4" "1/s" COEFFS 0 100 0 0 0 1 /end COMPU_METHOD
/begin COMPU_METHOD DRVMOD_SC_Compu "" TAB_VERB "%6.3" "" COMPU_TAB_REF DRVMOD_SC_Compu /end COMPU_METHOD
/begin COMPU_VTAB DRVMOD_SC_Compu "" TAB_VERB 2 0 "False" 1 "True" /end COMPU_VTAB
/begin COMPU_METHOD DRVPRGSWT_NUMSPRT_Compu "" RAT_FUNC "%6.2" "" COEFFS 0 1 0 0 0 1 /end COMPU_METHOD
/begin COMPU_METHOD DSCHED_COEOMEXT_SC_Compu "" TAB_VERB "%6.3" "" COMPU_TAB_REF DSCHED_COEOMEXT_SC_Compu /end COMPU_METHOD
/begin COMPU_VTAB DSCHED_COEOMEXT_SC_Compu "" TAB_VERB 2 0 "Standard_Only" 1 "Extended_SubModes" /end COMPU_VTAB
/begin COMPU_METHOD DSCHED_COEOM_SY_Compu "" TAB_VERB "%6.3" "" COMPU_TAB_REF DSCHED_COEOM_SY_Compu /end COMPU_METHOD
/begin COMPU_VTAB DSCHED_COEOM_SY_Compu "" TAB_VERB 2 0 "False" 1 "True" /end COMPU_VTAB
/begin COMPU_METHOD DSCHED_DFCSPEC_SY_Compu "" TAB_VERB "%6.3" "" COMPU_TAB_REF DSCHED_DFCSPEC_SY_Compu /end COMPU_METHOD
/begin COMPU_VTAB DSCHED_DFCSPEC_SY_Compu "" TAB_VERB 2 0 "DSCHED_DFCSPECIFIC_DISBL" 1 "DSCHED_DFCSPECIFIC_ENA" /end COMPU_VTAB
/begin COMPU_METHOD DSCHED_FIDMAXPRIOLST_SY_Compu "" RAT_FUNC "%6.2" "" COEFFS 0 1 0 0 0 1 /end COMPU_METHOD
/begin COMPU_METHOD DSCHED_FTI_SY_Compu "" TAB_VERB "%6.3" "" COMPU_TAB_REF DSCHED_FTI_SY_Compu /end COMPU_METHOD
/begin COMPU_VTAB DSCHED_FTI_SY_Compu "" TAB_VERB 2 0 "DSCHED_FTI_DISBL" 1 "DSCHED_FTI_ENA" /end COMPU_VTAB
/begin COMPU_METHOD DSCHED_PRIOACTVJMP_SY_Compu "" TAB_VERB "%6.3" "" COMPU_TAB_REF DSCHED_PRIOACTVJMP_SY_Compu /end COMPU_METHOD
/begin COMPU_VTAB DSCHED_PRIOACTVJMP_SY_Compu "" TAB_VERB 2 0 "DSCHED_PRIOACTVJMP_DISBL" 1 "DSCHED_PRIOACTVJMP_ENA" /end COMPU_VTAB
/begin COMPU_METHOD DSCHED_PRIODFCSTLDF_SY_Compu "" TAB_VERB "%6.3" "" COMPU_TAB_REF DSCHED_PRIODFCSTLDF_SY_Compu /end COMPU_METHOD
/begin COMPU_VTAB DSCHED_PRIODFCSTLDF_SY_Compu "" TAB_VERB 3 0 "DSCHED_DFCSTLDF_DISBL" 1 "DSCHED_DFCSTLDF_ENA_UNIF" 2 "DSCHED_DFCSTLDF_ENA_INDIV" /end COMPU_VTAB
/begin COMPU_METHOD DSCHED_PRIODFCSTTST_SY_Compu "" TAB_VERB "%6.3" "" COMPU_TAB_REF DSCHED_PRIODFCSTTST_SY_Compu /end COMPU_METHOD
/begin COMPU_VTAB DSCHED_PRIODFCSTTST_SY_Compu "" TAB_VERB 3 0 "DSCHED_DFCSTTST_DISBL" 1 "DSCHED_DFCSTTST_ENA_UNIF" 2 "DSCHED_DFCSTTST_ENA_INDIV" /end COMPU_VTAB
/begin COMPU_METHOD DSCHED_PRIOPHYSURGENCY_SY_Compu "" TAB_VERB "%6.3" "" COMPU_TAB_REF DSCHED_PRIOPHYSURGENCY_SY_Compu /end COMPU_METHOD
/begin COMPU_VTAB DSCHED_PRIOPHYSURGENCY_SY_Compu "" TAB_VERB 2 0 "DSCHED_PHYSURGENCY_DISBL" 1 "DSCHED_PHYSURGENCY_ENA" /end COMPU_VTAB
/begin COMPU_METHOD DSCHED_PRIORMPCALC_SY_Compu "" TAB_VERB "%6.3" "" COMPU_TAB_REF DSCHED_PRIORMPCALC_SY_Compu /end COMPU_METHOD
/begin COMPU_VTAB DSCHED_PRIORMPCALC_SY_Compu "" TAB_VERB 2 0 "DSCHED_PRIORMPCALC_DISBL" 1 "DSCHED_PRIORMPCALC_ENA" /end COMPU_VTAB
/begin COMPU_METHOD DSMAUX_DTRGVerb "" TAB_VERB "%2.1" "-" COMPU_TAB_REF DSMAUX_DTRGVerb /end COMPU_METHOD
/begin COMPU_VTAB DSMAUX_DTRGVerb "" TAB_VERB 15 3 "DTRG_AlwaysTrue" 2 "DTRG_DrivingCycleFLC" 8 "DTRG_DrivingCycleHLC" 5 "DTRG_MDCatFLC" 4 "DTRG_MDCatHLC" 13 "DTRG_MDEmiFLC" 12 "DTRG_MDEmiHLC" 9 "DTRG_MDEmiStrtFLC" 11 "DTRG_MDEmiStrtHLC" 6 "DTRG_MDFLC" 14 "DTRG_MDHLC" 10 "DTRG_NoTrigger" 1 "DTRG_SimilarCondHLC" 0 "DTRG_Time200ms" 7 "DTRG_WarmUpCycle" DEFAULT_VALUE "---" /end COMPU_VTAB
/begin COMPU_METHOD fak_ub_b64 "" RAT_FUNC "%6.3" "-" COEFFS 0 256 0 0 0 64 /end COMPU_METHOD
/begin COMPU_METHOD fak_ub_q0p01 "" RAT_FUNC "%6.4" "-" COEFFS 0 1 0 0 0 0.01 /end COMPU_METHOD
/begin COMPU_METHOD m_uw_b6553p5 "" RAT_FUNC "%6.3" "kg/h" COEFFS 0 1 0 0 0 0.1 /end COMPU_METHOD
/begin COMPU_METHOD OneToOne "" RAT_FUNC "%6.2" "-" COEFFS 0 1 0 0 0 1 /end COMPU_METHOD
/begin COMPU_METHOD r_q8 "" RAT_FUNC "%6.2" "Ohm" COEFFS 0 1 0 0 0 8 /end COMPU_METHOD
/begin COMPU_METHOD r_uw_q2 "" RAT_FUNC "%6.2" "Ohm" COEFFS 0 1 0 0 0 2 /end COMPU_METHOD
/begin COMPU_METHOD Signals_IntSigNumVerb "" TAB_VERB "%6.3" "" COMPU_TAB_REF Signals_IntSigNumVerb /end COMPU_METHOD
/begin COMPU_VTAB Signals_IntSigNumVerb "" TAB_VERB 92 0 "SIGNALS_Signals_Default" 1 "SIGNALS_EngDa_tEng_s" 2 "SIGNALS_EpmCrS_stSigMode_s" 3 "SIGNALS_Epm_nEng" 4 "SIGNALS_Epm_nEng_s" 5 "SIGNALS_Epm_stOpMode" 6 "SIGNALS_MILLmp_stMIL_s" 7 "SIGNALS_PID01h" 8 "SIGNALS_PID04h" 9 "SIGNALS_PID07h_0" 10 "SIGNALS_PID11h" 11 "SIGNALS_PID13h" 12 "SIGNALS_PID1Ch" 13 "SIGNALS_PID21h" 14 "SIGNALS_PID30h" 15 "SIGNALS_PID31h" 16 "SIGNALS_PID43h" 17 "SIGNALS_PID45h" 18 "SIGNALS_PID4Dh" 19 "SIGNALS_PID4Eh" 20 "SIGNALS_PID_FILLSIG_1BIT" 21 "SIGNALS_PID_FILLSIG_1BITNZ" 22 "SIGNALS_PID_FILLSIG_1BYTE" 23 "SIGNALS_PID_FILLSIG_1BYTENZ" 24 "SIGNALS_PID_FILLSIG_2BIT" 25 "SIGNALS_PID_FILLSIG_2BITNZ" 26 "SIGNALS_PID_FILLSIG_2BYTE" 27 "SIGNALS_PID_FILLSIG_2BYTENZ" 28 "SIGNALS_PID_FILLSIG_3BIT" 29 "SIGNALS_PID_FILLSIG_3BITNZ" 30 "SIGNALS_PID_FILLSIG_4BIT" 31 "SIGNALS_PID_FILLSIG_4BITNZ" 32 "SIGNALS_PID_FILLSIG_4BYTE" 33 "SIGNALS_PID_FILLSIG_4BYTENZ" 34 "SIGNALS_PID_FILLSIG_5BIT" 35 "SIGNALS_PID_FILLSIG_5BITNZ" 36 "SIGNALS_PID_FILLSIG_6BIT" 37 "SIGNALS_PID_FILLSIG_6BITNZ" 38 "SIGNALS_PID_FILLSIG_7BIT" 39 "SIGNALS_PID_FILLSIG_7BITNZ" 40 "SIGNALS_VehV_v_s" 41 "SIGNALS_avgmlg_s" 42 "SIGNALS_avgvfzg_0__s" 43 "SIGNALS_engcmbstevnt_l_s" 44 "SIGNALS_engrevcntr_l_s" 45 "SIGNALS_fr_w_s" 46 "SIGNALS_fra_w_s" 47 "SIGNALS_frm_w_s" 48 "SIGNALS_gangi_s" 49 "SIGNALS_kmstand_l_s" 50 "SIGNALS_ml_w_s" 51 "SIGNALS_ofmsdkq_w_s" 52 "SIGNALS_olls_w_s" 53 "SIGNALS_psdss_w_s" 54 "SIGNALS_rka_w_s" 55 "SIGNALS_rl_s" 56 "SIGNALS_sdstactcntr_l_s" 57 "SIGNALS_szout_w_s" 58 "SIGNALS_tans_s" 59 "SIGNALS_tateout_w_s" 60 "SIGNALS_tieff_w_s" 61 "SIGNALS_tltcntr_l_s" 62 "SIGNALS_topre1m_l_s" 63 "SIGNALS_ubsq_s" 64 "SIGNALS_udss_w_s" 65 "SIGNALS_urovs_w_s" 66 "SIGNALS_usdst_w_s" 67 "SIGNALS_usvkl_s" 68 "SIGNALS_uwdk_w_s" 69 "SIGNALS_vmlg_nonavg_s" 70 "SIGNALS_wdkba_s" 71 "SIGNALS_wtans_s" 72 "SIGNALS_wubcntr_l_s" 73 "SIGNALS_zwout1_s" 74 "SIGNALS_zwout_s" 75 "SIGNALS_PID03h" 76 "SIGNALS_PID05h" 77 "SIGNALS_PID06h" 78 "SIGNALS_PID07h" 79 "SIGNALS_PID0Bh" 80 "SIGNALS_PID0Dh" 81 "SIGNALS_PID0Eh" 82 "SIGNALS_PID0Fh" 83 "SIGNALS_PID14h_a" 84 "SIGNALS_PID14h_b" 85 "SIGNALS_PID1Fh" 86 "SIGNALS_PID2Eh" 87 "SIGNALS_PID33H" 88 "SIGNALS_PID42h" 89 "SIGNALS_Virtual_B_atmtpa_s" 90 "SIGNALS_Virtual_B_bm_s" 91 "SIGNALS_Virtual_DcmDspUds_DID_0110_Engine_status_s" /end COMPU_VTAB
/begin COMPU_METHOD t200msxs_ub_b51 "" RAT_FUNC "%6.3" "s" COEFFS 0 1 0 0 0 0.2 /end COMPU_METHOD
/begin COMPU_METHOD temp_ub_q5_o50 "" RAT_FUNC "%6.2" "Grad C" COEFFS 0 1 50 0 0 5 /end COMPU_METHOD
/begin COMPU_METHOD t_q0p2 "" RAT_FUNC "%6.3" "s" COEFFS 0 10 0 0 0 2 /end COMPU_METHOD
/begin COMPU_METHOD zk200msxs_uw_b13107p2 "" RAT_FUNC "%6.0" "s" COEFFS 0 0 65536 0 5 0 /end COMPU_METHOD
/begin RECORD_LAYOUT KfAxUbAyUbSstxUbSstyUbWUb NO_AXIS_PTS_X 1 UBYTE NO_AXIS_PTS_Y 2 UBYTE AXIS_PTS_X 3 UBYTE INDEX_INCR DIRECT AXIS_PTS_Y 4 UBYTE INDEX_INCR DIRECT FNC_VALUES 5 UBYTE COLUMN_DIR DIRECT /end RECORD_LAYOUT
/begin RECORD_LAYOUT KlAUbSstUbWUb NO_AXIS_PTS_X 1 UBYTE AXIS_PTS_X 2 UBYTE INDEX_INCR DIRECT FNC_VALUES 3 UBYTE COLUMN_DIR DIRECT /end RECORD_LAYOUT
/begin RECORD_LAYOUT KlAxU8SstxU16WU8_Static NO_AXIS_PTS_X 1 UWORD AXIS_PTS_X 2 UWORD INDEX_INCR DIRECT FNC_VALUES 3 UBYTE COLUMN_DIR DIRECT STATIC_RECORD_LAYOUT /end RECORD_LAYOUT
/begin RECORD_LAYOUT KwUb FNC_VALUES 1 UBYTE COLUMN_DIR DIRECT /end RECORD_LAYOUT
/begin RECORD_LAYOUT KwUw FNC_VALUES 1 UWORD COLUMN_DIR DIRECT /end RECORD_LAYOUT
/begin RECORD_LAYOUT KwWU8 FNC_VALUES 1 UBYTE COLUMN_DIR DIRECT /end RECORD_LAYOUT
/begin RECORD_LAYOUT ValA_Wu16 FNC_VALUES 1 UWORD COLUMN_DIR DIRECT /end RECORD_LAYOUT
/begin RECORD_LAYOUT ValA_Wu8 FNC_VALUES 1 UBYTE COLUMN_DIR DIRECT /end RECORD_LAYOUT
/begin RECORD_LAYOUT Val_Wu16 FNC_VALUES 1 UWORD COLUMN_DIR DIRECT /end RECORD_LAYOUT
/begin RECORD_LAYOUT Val_Wu32 FNC_VALUES 1 ULONG COLUMN_DIR DIRECT /end RECORD_LAYOUT
/begin RECORD_LAYOUT Val_Wu8 FNC_VALUES 1 UBYTE COLUMN_DIR DIRECT /end RECORD_LAYOUT
/end MODULE
/end PROJECT
