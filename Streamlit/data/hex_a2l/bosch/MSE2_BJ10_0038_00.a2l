ASAP2_VERSION 1 60
/begin PROJECT MSE2_BJ10_0038_00 "MDG1"
/begin HEADER "" VERSION "MSE2_BJ10_0038_00" PROJECT_NO MSE2_BJ10_0038_00 /end HEADER
/begin MODULE DIM ""
/begin MOD_COMMON "" BYTE_ORDER MSB_FIRST ALIGNMENT_BYTE 1 ALIGNMENT_WORD 2 ALIGNMENT_LONG 4 ALIGNMENT_INT64 4 ALIGNMENT_FLOAT32_IEEE 4 ALIGNMENT_FLOAT64_IEEE 4 /end MOD_COMMON
/*********** End of merged CHARACTERISTIC blocks ***********/
/begin CHARACTERISTIC ADKATNF "scaling factor for signal amplitude of the sensor resp. of the catalyst stress" VALUE 0x9084F6A KwWU8 24.90 q0p09766_DIV_V 0.00 24.90 FORMAT "%5.2" /end CHARACTERISTIC
/begin CHARACTERISTIC AHKATMX "Threshold value catalyst defect, ahkat greater than AHKATMX" VALUE 0x9084F6B KwWU8 0.9961 fak_ub_b1 0.00 0.9961 /end CHARACTERISTIC
/begin CHARACTERISTIC ANZDPVK "number of periodes for ready flag of Usvk period monitoring" VALUE 0x908509A KwUb 255.0 dez 0.00 255.0 FORMAT "%5.1" /end CHARACTERISTIC
/begin CHARACTERISTIC ANZHZKH "Amount of O2 sensor heater coupling post catalyst" VALUE 0x90850B0 KwUb 255.0 dez 0.00 255.0 FORMAT "%5.1" /end CHARACTERISTIC
/begin CHARACTERISTIC ANZHZKV "Amount of heater coupling to sensor before catalyst" VALUE 0x90850D4 KwUb 255.0 dez 0.00 255.0 FORMAT "%5.1" /end CHARACTERISTIC
/begin CHARACTERISTIC ANZHZOFFH "Numbers of sensor heating disconnecting downstream cat" VALUE 0x90850B1 KwUb 255.0 dez 0.00 255.0 FORMAT "%5.1" /end CHARACTERISTIC
/begin CHARACTERISTIC ANZHZOFFV "Numbers of sensor heating disconnecting upstream cat" VALUE 0x90850D5 KwUb 255.0 dez 0.00 255.0 FORMAT "%5.1" /end CHARACTERISTIC
/begin CHARACTERISTIC ANZTP "number of unconsidered cycles for cycle duration monitoring" VALUE 0x908509B KwUb 255.0 dez 0.00 255.0 FORMAT "%5.1" /end CHARACTERISTIC
/begin CHARACTERISTIC AVKATFS "setting value for catalyst in case of powerfail or after clearing of fault codes" VALUE 0x9084F6C KwWU8 0.9961 fak_ub_b1 0.00 0.9961 /end CHARACTERISTIC
/begin CHARACTERISTIC CWDKATEN "Code word for catalyst diagnosis" VALUE 0x9084F6D KwWU8 255.0 dez 0.00 255.0 FORMAT "%5.1" /end CHARACTERISTIC
/begin CHARACTERISTIC CWDLLR "Codeword for DLLR configuration" VALUE 0x908504C KwWU8 255.0 dez 0.00 255.0 FORMAT "%5.1" /end CHARACTERISTIC
/begin CHARACTERISTIC CWDLLRKH "Code word for DLLR active during catalyst heating." VALUE 0x908504D KwWU8 255.0 dez 0.00 255.0 FORMAT "%5.1" /end CHARACTERISTIC
/begin CHARACTERISTIC CWDLSAFA "code word for test aging of O2-sensor upstream catalyst" VALUE 0x908509C KwUb 255.0 dez 0.00 255.0 FORMAT "%5.1" /end CHARACTERISTIC
/begin CHARACTERISTIC CWDLSAHK "code word CWDLSAHK for test aging of O2-sensor post cat" VALUE 0x9085082 KwUb 255.0 dez 0.00 255.0 FORMAT "%5.1" /end CHARACTERISTIC
/begin CHARACTERISTIC CWKATUM "code word for switch-over in the catalyst diagnosis" VALUE 0x9084F6E KwWU8 255.0 dez 0.00 255.0 FORMAT "%5.1" /end CHARACTERISTIC
/begin CHARACTERISTIC DASA "number of fuel cut-out phases to detect ISC-actuator error" VALUE 0x908504E KwWU8 255.0 dez 0.00 255.0 FORMAT "%5.1" /end CHARACTERISTIC
/begin CHARACTERISTIC DFC_CtlMsk2.DFC_ClthStkOpn_C "Behaviour control mask / Behaviour control masks of check DFC_ClthStkOpn" VALUE 0x90803AB Val_Wu8 255.0 DFES_OneToOne 0.00 255.0 FORMAT "%5.1" /end CHARACTERISTIC
/begin CHARACTERISTIC DFC_CtlMsk2.DFC_DLLRmax_C "Behaviour control mask / Behaviour control masks of check DFC_DLLRmax" VALUE 0x90803E0 Val_Wu8 255.0 DFES_OneToOne 0.00 255.0 FORMAT "%5.1" /end CHARACTERISTIC
/begin CHARACTERISTIC DFC_CtlMsk2.DFC_DLLRmin_C "Behaviour control mask / Behaviour control masks of check DFC_DLLRmin" VALUE 0x90803E1 Val_Wu8 255.0 DFES_OneToOne 0.00 255.0 FORMAT "%5.1" /end CHARACTERISTIC
/begin CHARACTERISTIC DFC_CtlMsk2.DFC_DLLRnpl_C "Behaviour control mask / Behaviour control masks of check DFC_DLLRnpl" VALUE 0x90803E2 Val_Wu8 255.0 DFES_OneToOne 0.00 255.0 FORMAT "%5.1" /end CHARACTERISTIC
/begin CHARACTERISTIC DFC_CtlMsk2.DFC_DSSRngMax_C "Behaviour control mask / Behaviour control masks of check DFC_DSSRngMax" VALUE 0x90803E3 Val_Wu8 255.0 DFES_OneToOne 0.00 255.0 FORMAT "%5.1" /end CHARACTERISTIC
/begin CHARACTERISTIC DFC_CtlMsk2.DFC_DSSRngMin_C "Behaviour control mask / Behaviour control masks of check DFC_DSSRngMin" VALUE 0x90803E4 Val_Wu8 255.0 DFES_OneToOne 0.00 255.0 FORMAT "%5.1" /end CHARACTERISTIC
/begin CHARACTERISTIC DFC_CtlMsk2.DFC_DSSnpl_C "Behaviour control mask / Behaviour control masks of check DFC_DSSnpl" VALUE 0x90803E7 Val_Wu8 255.0 DFES_OneToOne 0.00 255.0 FORMAT "%5.1" /end CHARACTERISTIC
/begin CHARACTERISTIC DFC_CtlMsk2.DFC_DSSnplMax_C "Behaviour control mask / Behaviour control masks of check DFC_DSSnplMax" VALUE 0x90803E8 Val_Wu8 255.0 DFES_OneToOne 0.00 255.0 FORMAT "%5.1" /end CHARACTERISTIC
/begin CHARACTERISTIC DFC_CtlMsk2.DFC_DSSnplMin_C "Behaviour control mask / Behaviour control masks of check DFC_DSSnplMin" VALUE 0x90803E9 Val_Wu8 255.0 DFES_OneToOne 0.00 255.0 FORMAT "%5.1" /end CHARACTERISTIC
/begin CHARACTERISTIC DFC_CtlMsk2.DFC_DSSsig_C "Behaviour control mask / Behaviour control masks of check DFC_DSSsig" VALUE 0x90803EA Val_Wu8 255.0 DFES_OneToOne 0.00 255.0 FORMAT "%5.1" /end CHARACTERISTIC
/begin CHARACTERISTIC DFC_CtlMsk2.DFC_HEGOS1B1ElecNpl_C "Behaviour control mask / Behaviour control masks of check DFC_HEGOS1B1ElecNpl" VALUE 0x90803ED Val_Wu8 255.0 DFES_OneToOne 0.00 255.0 FORMAT "%5.1" /end CHARACTERISTIC
/begin CHARACTERISTIC DFC_CtlMsk2.DFC_KAT_C "Behaviour control mask / Behaviour control masks of check DFC_KAT" VALUE 0x9080402 Val_Wu8 255.0 DFES_OneToOne 0.00 255.0 FORMAT "%5.1" /end CHARACTERISTIC
/begin CHARACTERISTIC DFC_CtlMsk2.DFC_KVSFmax_C "Behaviour control mask / Behaviour control masks of check DFC_KVSFmax" VALUE 0x9080406 Val_Wu8 255.0 DFES_OneToOne 0.00 255.0 FORMAT "%5.1" /end CHARACTERISTIC
/begin CHARACTERISTIC DFC_CtlMsk2.DFC_KVSFmin_C "Behaviour control mask / Behaviour control masks of check DFC_KVSFmin" VALUE 0x9080407 Val_Wu8 255.0 DFES_OneToOne 0.00 255.0 FORMAT "%5.1" /end CHARACTERISTIC
/begin CHARACTERISTIC DFC_CtlMsk2.DFC_KVSOmax_C "Behaviour control mask / Behaviour control masks of check DFC_KVSOmax" VALUE 0x9080408 Val_Wu8 255.0 DFES_OneToOne 0.00 255.0 FORMAT "%5.1" /end CHARACTERISTIC
/begin CHARACTERISTIC DFC_CtlMsk2.DFC_KVSOmin_C "Behaviour control mask / Behaviour control masks of check DFC_KVSOmin" VALUE 0x9080409 Val_Wu8 255.0 DFES_OneToOne 0.00 255.0 FORMAT "%5.1" /end CHARACTERISTIC
/begin CHARACTERISTIC DFC_CtlMsk2.DFC_LASHmn_C "Behaviour control mask / Behaviour control masks of check DFC_LASHmn" VALUE 0x908040A Val_Wu8 255.0 DFES_OneToOne 0.00 255.0 FORMAT "%5.1" /end CHARACTERISTIC
/begin CHARACTERISTIC DFC_CtlMsk2.DFC_LASHmx_C "Behaviour control mask / Behaviour control masks of check DFC_LASHmx" VALUE 0x908040B Val_Wu8 255.0 DFES_OneToOne 0.00 255.0 FORMAT "%5.1" /end CHARACTERISTIC
/begin CHARACTERISTIC DFC_CtlMsk2.DFC_LATP_C "Behaviour control mask / Behaviour control masks of check DFC_LATP" VALUE 0x908040C Val_Wu8 255.0 DFES_OneToOne 0.00 255.0 FORMAT "%5.1" /end CHARACTERISTIC
/begin CHARACTERISTIC DFC_CtlMsk2.DFC_LDLAHI_C "Behaviour control mask / Behaviour control masks of check DFC_LDLAHI" VALUE 0x908040D Val_Wu8 255.0 DFES_OneToOne 0.00 255.0 FORMAT "%5.1" /end CHARACTERISTIC
/begin CHARACTERISTIC DFC_CtlMsk2.DFC_LSHmax_C "Behaviour control mask / Behaviour control masks of check DFC_LSHmax" VALUE 0x9080411 Val_Wu8 255.0 DFES_OneToOne 0.00 255.0 FORMAT "%5.1" /end CHARACTERISTIC
/begin CHARACTERISTIC DFC_CtlMsk2.DFC_LSHmin_C "Behaviour control mask / Behaviour control masks of check DFC_LSHmin" VALUE 0x9080412 Val_Wu8 255.0 DFES_OneToOne 0.00 255.0 FORMAT "%5.1" /end CHARACTERISTIC
/begin CHARACTERISTIC DFC_CtlMsk2.DFC_LSHnpl_C "Behaviour control mask / Behaviour control masks of check DFC_LSHnpl" VALUE 0x9080413 Val_Wu8 255.0 DFES_OneToOne 0.00 255.0 FORMAT "%5.1" /end CHARACTERISTIC
/begin CHARACTERISTIC DFC_CtlMsk2.DFC_LSHsig_C "Behaviour control mask / Behaviour control masks of check DFC_LSHsig" VALUE 0x9080414 Val_Wu8 255.0 DFES_OneToOne 0.00 255.0 FORMAT "%5.1" /end CHARACTERISTIC
/begin CHARACTERISTIC DFC_CtlMsk2.DFC_LSVmax_C "Behaviour control mask / Behaviour control masks of check DFC_LSVmax" VALUE 0x9080415 Val_Wu8 255.0 DFES_OneToOne 0.00 255.0 FORMAT "%5.1" /end CHARACTERISTIC
/begin CHARACTERISTIC DFC_CtlMsk2.DFC_LSVmin_C "Behaviour control mask / Behaviour control masks of check DFC_LSVmin" VALUE 0x9080416 Val_Wu8 255.0 DFES_OneToOne 0.00 255.0 FORMAT "%5.1" /end CHARACTERISTIC
/begin CHARACTERISTIC DFC_CtlMsk2.DFC_LSVnpl_C "Behaviour control mask / Behaviour control masks of check DFC_LSVnpl" VALUE 0x9080417 Val_Wu8 255.0 DFES_OneToOne 0.00 255.0 FORMAT "%5.1" /end CHARACTERISTIC
/begin CHARACTERISTIC DFC_CtlMsk2.DFC_LSVsig_C "Behaviour control mask / Behaviour control masks of check DFC_LSVsig" VALUE 0x9080418 Val_Wu8 255.0 DFES_OneToOne 0.00 255.0 FORMAT "%5.1" /end CHARACTERISTIC
/begin CHARACTERISTIC DFC_DisblMsk2.DFC_ClthStkOpn_C "disable mask / Disable masks of check DFC_ClthStkOpn" VALUE 0x9080D7B Val_Wu8 255.0 DFES_OneToOne 0.00 255.0 FORMAT "%5.1" /end CHARACTERISTIC
/begin CHARACTERISTIC DFC_DisblMsk2.DFC_DLLRmax_C "disable mask / Disable masks of check DFC_DLLRmax" VALUE 0x9080DB0 Val_Wu8 255.0 DFES_OneToOne 0.00 255.0 FORMAT "%5.1" /end CHARACTERISTIC
/begin CHARACTERISTIC DFC_DisblMsk2.DFC_DLLRmin_C "disable mask / Disable masks of check DFC_DLLRmin" VALUE 0x9080DB1 Val_Wu8 255.0 DFES_OneToOne 0.00 255.0 FORMAT "%5.1" /end CHARACTERISTIC
/begin CHARACTERISTIC DFC_DisblMsk2.DFC_DLLRnpl_C "disable mask / Disable masks of check DFC_DLLRnpl" VALUE 0x9080DB2 Val_Wu8 255.0 DFES_OneToOne 0.00 255.0 FORMAT "%5.1" /end CHARACTERISTIC
/begin CHARACTERISTIC DFC_DisblMsk2.DFC_DSSRngMax_C "disable mask / Disable masks of check DFC_DSSRngMax" VALUE 0x9080DB3 Val_Wu8 255.0 DFES_OneToOne 0.00 255.0 FORMAT "%5.1" /end CHARACTERISTIC
/begin CHARACTERISTIC DFC_DisblMsk2.DFC_DSSRngMin_C "disable mask / Disable masks of check DFC_DSSRngMin" VALUE 0x9080DB4 Val_Wu8 255.0 DFES_OneToOne 0.00 255.0 FORMAT "%5.1" /end CHARACTERISTIC
/begin CHARACTERISTIC DFC_DisblMsk2.DFC_DSSnpl_C "disable mask / Disable masks of check DFC_DSSnpl" VALUE 0x9080DB7 Val_Wu8 255.0 DFES_OneToOne 0.00 255.0 FORMAT "%5.1" /end CHARACTERISTIC
/begin CHARACTERISTIC DFC_DisblMsk2.DFC_DSSnplMax_C "disable mask / Disable masks of check DFC_DSSnplMax" VALUE 0x9080DB8 Val_Wu8 255.0 DFES_OneToOne 0.00 255.0 FORMAT "%5.1" /end CHARACTERISTIC
/begin CHARACTERISTIC DFC_DisblMsk2.DFC_DSSnplMin_C "disable mask / Disable masks of check DFC_DSSnplMin" VALUE 0x9080DB9 Val_Wu8 255.0 DFES_OneToOne 0.00 255.0 FORMAT "%5.1" /end CHARACTERISTIC
/begin CHARACTERISTIC DFC_DisblMsk2.DFC_DSSsig_C "disable mask / Disable masks of check DFC_DSSsig" VALUE 0x9080DBA Val_Wu8 255.0 DFES_OneToOne 0.00 255.0 FORMAT "%5.1" /end CHARACTERISTIC
/begin CHARACTERISTIC DFC_DisblMsk2.DFC_HEGOS1B1ElecNpl_C "disable mask / Disable masks of check DFC_HEGOS1B1ElecNpl" VALUE 0x9080DBD Val_Wu8 255.0 DFES_OneToOne 0.00 255.0 FORMAT "%5.1" /end CHARACTERISTIC
/begin CHARACTERISTIC DFC_DisblMsk2.DFC_KAT_C "disable mask / Disable masks of check DFC_KAT" VALUE 0x9080DD2 Val_Wu8 255.0 DFES_OneToOne 0.00 255.0 FORMAT "%5.1" /end CHARACTERISTIC
/begin CHARACTERISTIC DFC_DisblMsk2.DFC_KVSFmax_C "disable mask / Disable masks of check DFC_KVSFmax" VALUE 0x9080DD6 Val_Wu8 255.0 DFES_OneToOne 0.00 255.0 FORMAT "%5.1" /end CHARACTERISTIC
/begin CHARACTERISTIC DFC_DisblMsk2.DFC_KVSFmin_C "disable mask / Disable masks of check DFC_KVSFmin" VALUE 0x9080DD7 Val_Wu8 255.0 DFES_OneToOne 0.00 255.0 FORMAT "%5.1" /end CHARACTERISTIC
/begin CHARACTERISTIC DFC_DisblMsk2.DFC_KVSOmax_C "disable mask / Disable masks of check DFC_KVSOmax" VALUE 0x9080DD8 Val_Wu8 255.0 DFES_OneToOne 0.00 255.0 FORMAT "%5.1" /end CHARACTERISTIC
/begin CHARACTERISTIC DFC_DisblMsk2.DFC_KVSOmin_C "disable mask / Disable masks of check DFC_KVSOmin" VALUE 0x9080DD9 Val_Wu8 255.0 DFES_OneToOne 0.00 255.0 FORMAT "%5.1" /end CHARACTERISTIC
/begin CHARACTERISTIC DFC_DisblMsk2.DFC_LASHmn_C "disable mask / Disable masks of check DFC_LASHmn" VALUE 0x9080DDA Val_Wu8 255.0 DFES_OneToOne 0.00 255.0 FORMAT "%5.1" /end CHARACTERISTIC
/begin CHARACTERISTIC DFC_DisblMsk2.DFC_LASHmx_C "disable mask / Disable masks of check DFC_LASHmx" VALUE 0x9080DDB Val_Wu8 255.0 DFES_OneToOne 0.00 255.0 FORMAT "%5.1" /end CHARACTERISTIC
/begin CHARACTERISTIC DFC_DisblMsk2.DFC_LATP_C "disable mask / Disable masks of check DFC_LATP" VALUE 0x9080DDC Val_Wu8 255.0 DFES_OneToOne 0.00 255.0 FORMAT "%5.1" /end CHARACTERISTIC
/begin CHARACTERISTIC DFC_DisblMsk2.DFC_LDLAHI_C "disable mask / Disable masks of check DFC_LDLAHI" VALUE 0x9080DDD Val_Wu8 255.0 DFES_OneToOne 0.00 255.0 FORMAT "%5.1" /end CHARACTERISTIC
/begin CHARACTERISTIC DFC_DisblMsk2.DFC_LSHmax_C "disable mask / Disable masks of check DFC_LSHmax" VALUE 0x9080DE1 Val_Wu8 255.0 DFES_OneToOne 0.00 255.0 FORMAT "%5.1" /end CHARACTERISTIC
/begin CHARACTERISTIC DFC_DisblMsk2.DFC_LSHmin_C "disable mask / Disable masks of check DFC_LSHmin" VALUE 0x9080DE2 Val_Wu8 255.0 DFES_OneToOne 0.00 255.0 FORMAT "%5.1" /end CHARACTERISTIC
/begin CHARACTERISTIC DFC_DisblMsk2.DFC_LSHnpl_C "disable mask / Disable masks of check DFC_LSHnpl" VALUE 0x9080DE3 Val_Wu8 255.0 DFES_OneToOne 0.00 255.0 FORMAT "%5.1" /end CHARACTERISTIC
/begin CHARACTERISTIC DFC_DisblMsk2.DFC_LSHsig_C "disable mask / Disable masks of check DFC_LSHsig" VALUE 0x9080DE4 Val_Wu8 255.0 DFES_OneToOne 0.00 255.0 FORMAT "%5.1" /end CHARACTERISTIC
/begin CHARACTERISTIC DFC_DisblMsk2.DFC_LSVmax_C "disable mask / Disable masks of check DFC_LSVmax" VALUE 0x9080DE5 Val_Wu8 255.0 DFES_OneToOne 0.00 255.0 FORMAT "%5.1" /end CHARACTERISTIC
/begin CHARACTERISTIC DFC_DisblMsk2.DFC_LSVmin_C "disable mask / Disable masks of check DFC_LSVmin" VALUE 0x9080DE6 Val_Wu8 255.0 DFES_OneToOne 0.00 255.0 FORMAT "%5.1" /end CHARACTERISTIC
/begin CHARACTERISTIC DFC_DisblMsk2.DFC_LSVnpl_C "disable mask / Disable masks of check DFC_LSVnpl" VALUE 0x9080DE7 Val_Wu8 255.0 DFES_OneToOne 0.00 255.0 FORMAT "%5.1" /end CHARACTERISTIC
/begin CHARACTERISTIC DFC_DisblMsk2.DFC_LSVsig_C "disable mask / Disable masks of check DFC_LSVsig" VALUE 0x9080DE8 Val_Wu8 255.0 DFES_OneToOne 0.00 255.0 FORMAT "%5.1" /end CHARACTERISTIC
/begin CHARACTERISTIC DFRAD "hysteresis for fra error healing" VALUE 0x9085042 KwWU16 1.999969 fak_uw_b2 0.00 1.999969 FORMAT "%8.6" /end CHARACTERISTIC
/begin CHARACTERISTIC DFRAE "Delta Threshold for detecting ""Factor fra at steady state""" VALUE 0x9085044 KwWU16 1.999969 fak_uw_b2 0.00 1.999969 FORMAT "%8.6" /end CHARACTERISTIC
/begin CHARACTERISTIC DKATCW "single run resp. initialization of the DKAT function" VALUE 0x9084F6F KwWU8 255.0 dez 0.00 255.0 FORMAT "%5.1" /end CHARACTERISTIC
/begin CHARACTERISTIC Dkuppl_qStatyVehVN_C "Threshold of VN ratio to detect stationary vehicle" VALUE 0x9085036 KwWU16 0.6553500 VelToN 0.00 0.6553500 FORMAT "%9.7" /end CHARACTERISTIC
/begin CHARACTERISTIC Dkuppl_qVNMinDrvState_C "Threshold of VN ratio to detect drive state" VALUE 0x9085038 KwWU16 0.6553500 VelToN 0.00 0.6553500 FORMAT "%9.7" /end CHARACTERISTIC
/begin CHARACTERISTIC Dkuppl_tiClthStuckDeb_C "Time to debounce clutch stuck error" VALUE 0x908503A KwWU16 655.3500 t_q0p01 0.00 655.3500 FORMAT "%8.4" /end CHARACTERISTIC
/begin CHARACTERISTIC Dkuppl_tiFilVehV_C "TIme for vehicle speed filter" VALUE 0x908503C KwWU16 655.3500 t_q0p01 0.00 655.3500 FORMAT "%8.4" /end CHARACTERISTIC
/begin CHARACTERISTIC Dkuppl_tiFilVN_C "TIme for VN ratio filter" VALUE 0x908503E KwWU16 655.3500 t_q0p01 0.00 655.3500 FORMAT "%8.4" /end CHARACTERISTIC
/begin CHARACTERISTIC Dkuppl_vStatyVeh_C "Vehicle speed threshold to detect stationary vehicle" VALUE 0x9085040 KwWU16 655.3500 vel_q0p01 0.00 655.3500 FORMAT "%8.4" /end CHARACTERISTIC
/begin CHARACTERISTIC DLAHIMDL "Start value modelled delta-lambda for I-portion" VALUE 0x908509D KwSb 0.06226 fak_q0p000244 -0.03125 0.03101 FORMAT "%7.5" /end CHARACTERISTIC
/begin CHARACTERISTIC DLAHIMN "minimal integrator limit of continuous LRHK" VALUE 0x908509E KwSb 0.06226 fak_q0p000244 -0.03125 0.03101 FORMAT "%7.5" /end CHARACTERISTIC
/begin CHARACTERISTIC DLAHIMX "maximal integrator limit of continuous LRHK" VALUE 0x908509F KwSb 0.06226 fak_q0p000244 -0.03125 0.03101 FORMAT "%7.5" /end CHARACTERISTIC
/begin CHARACTERISTIC DLAMLASHF "Delta Lambda set point (rich) for the test oscillation check downstream" VALUE 0x9085084 KwUw 15.99976 fak_uw_b16 0.00 15.99976 FORMAT "%8.5" /end CHARACTERISTIC
/begin CHARACTERISTIC DLAMLASHM "Delta Lambda set point (lean) for the test oscillation check downstream" VALUE 0x9085086 KwUw 15.99976 fak_uw_b16 0.00 15.99976 FORMAT "%8.5" /end CHARACTERISTIC
/begin CHARACTERISTIC DMLDKT "Threshold for air mass flow change" VALUE 0x9084F70 KwWS16 6553.500 m_sw_q0p1 -3276.800 3276.700 FORMAT "%8.3" /end CHARACTERISTIC
/begin CHARACTERISTIC DNDLLRO "Maximal speed deviation (low speed) for diagnosis of idle speed control" VALUE 0x908504F KwWS8 2550. nmotd_sb_q10 -1280. 1270. FORMAT "%5.0" /end CHARACTERISTIC
/begin CHARACTERISTIC DNDLLROKH "Maximal speed deviation (low speed) for diagnosis of idle speed control during catalyst heating" VALUE 0x9085050 KwWS8 2550. nmotd_sb_q10 -1280. 1270. FORMAT "%5.0" /end CHARACTERISTIC
/begin CHARACTERISTIC DNDLLRU "Maximal speed deviation (high speed) for diagnosis of idle speed control" VALUE 0x9085051 KwWS8 2550. nmotd_sb_q10 -1280. 1270. FORMAT "%5.0" /end CHARACTERISTIC
/begin CHARACTERISTIC DNDLLRUKH "Maximal speed deviation (high speed) for diagnosis of idle speed control during catalyst heating" VALUE 0x9085052 KwWS8 2550. nmotd_sb_q10 -1280. 1270. FORMAT "%5.0" /end CHARACTERISTIC
/begin CHARACTERISTIC DNMOTG "Nominal engine speed idling amplitude" VALUE 0x9085054 KwWS16 16383.75 nmot_sw_q0p25 -8192.000 8191.750 FORMAT "%8.3" /end CHARACTERISTIC
/begin CHARACTERISTIC DOFLRAD "hysteresis for ora error healing" VALUE 0x9085046 KwWS16 26.21400 m_q0p0004 -13.10720 13.10680 FORMAT "%8.5" /end CHARACTERISTIC
/begin CHARACTERISTIC DORAE "Threshold for detecting "" offset at steady state""" VALUE 0x9085048 KwWU16 26.21400 m_q0p0004 0.00 26.21400 FORMAT "%8.5" /end CHARACTERISTIC
/begin CHARACTERISTIC DPSWATCHINDEX "Index of the observed output stage (in case of diagnosis problem)" VALUE 0x9085132 KwUb 255.0 dez 0.00 255.0 FORMAT "%5.1" /end CHARACTERISTIC
/begin CHARACTERISTIC DRLKTDP "Threshold for engine load change" VALUE 0x9084F72 KwWS8 191.3 rel_sb_q0p75 -96.00 95.25 FORMAT "%5.2" /end CHARACTERISTIC
/begin CHARACTERISTIC DSCHED_BsPrio.FId_InhibitAlways_C "base priority / Base priority for scheduled FId FId_InhibitAlways" VALUE 0x908111C Val_Wu16 8191.000 DFC_OneToOne 0.00 8191.000 FORMAT "%8.3" EXTENDED_LIMITS 0.00 65535.00 /end CHARACTERISTIC
/begin CHARACTERISTIC DSCHED_LimPrio.FId_InhibitAlways_C "upper priority limit / Upper priority limit if rate calculation is disabled for scheduled FId FId_InhibitAlways" VALUE 0x908111E Val_Wu16 8191.000 DFC_OneToOne 0.00 8191.000 FORMAT "%8.3" EXTENDED_LIMITS 0.00 65535.00 /end CHARACTERISTIC
/begin CHARACTERISTIC DSCHED_stMode_C "Central disable switch for all scheduled FIDs (disabled if set to 0)" VALUE 0x9081122 Val_Wu8 255.0 DINH_OneToOne 0.00 255.0 FORMAT "%5.1" /end CHARACTERISTIC
/begin CHARACTERISTIC DSCHED_valDflOpMode_C "Default request value for operation mode coordinator during disable state (DSCHED_stMode_C = 0)" VALUE 0x9081124 Val_Wu16 65535.00 DINH_OneToOne 0.00 65535.00 FORMAT "%8.2" /end CHARACTERISTIC
/begin CHARACTERISTIC DSCHED_valOfsPrioOpMode_C "Jump Priority Operation Mode (additional priority if operation mode is compatible to possible operation modes)" VALUE 0x9081120 Val_Wu16 65535.00 DINH_OneToOne 0.00 65535.00 FORMAT "%8.2" /end CHARACTERISTIC
/begin CHARACTERISTIC DSMAUX_dtWUCMin_C "minimum temperature raise for warm up cycle detection" VALUE 0x9080CFA Val_Ws16 6553.500 TempDiff_Kelv -3276.800 3276.700 FORMAT "%8.3" READ_ONLY /end CHARACTERISTIC
/begin CHARACTERISTIC DSMAUX_tWUCMin_C "minimum temperature for warm up cycle detection" VALUE 0x9080CFC Val_Ws16 6553.500 Temp_Cels -3549.940 3003.560 FORMAT "%8.3" READ_ONLY /end CHARACTERISTIC
/begin CHARACTERISTIC DSMAUX_xClearMode_C "clear mode for clear trigger" VALUE 0x9080CFE Val_Wu16 160. DFC_Verb 0.00 160. FORMAT "%2.0" /end CHARACTERISTIC
/begin CHARACTERISTIC DSMAUX_xClearTrg_C "clear trigger to delete diagnostic information" VALUE 0x9080D00 Val_Wu8 255.0 DFC_OneToOne 0.00 255.0 FORMAT "%5.1" /end CHARACTERISTIC
/begin CHARACTERISTIC DSMDur_valEvntQntDist_C "increment quantization for travelled distance counter" VALUE 0x9080D02 Val_Wu16 65535.00 DFES_OneToOne 0.00 65535.00 FORMAT "%8.2" /end CHARACTERISTIC
/begin CHARACTERISTIC DSMDur_valEvntQntTi_C "increment quantization for operation time counter" VALUE 0x9080D04 Val_Wu16 65535.00 DFES_OneToOne 0.00 65535.00 FORMAT "%8.2" /end CHARACTERISTIC
/begin CHARACTERISTIC DSMDur_xEnaGlb_CA "Enable conditions for global duration counters" VAL_BLK 0x9080D06 ValA_Wu16 65535.00 DFES_OneToOne 0.00 65535.00 FORMAT "%8.2" NUMBER 1 /end CHARACTERISTIC
/begin CHARACTERISTIC DSMDur_xRstGlb_CA "Reset conditions for global duration counters" VAL_BLK 0x9080D08 ValA_Wu8 255.0 DFES_OneToOne 0.00 255.0 FORMAT "%5.1" NUMBER 1 /end CHARACTERISTIC
/begin CHARACTERISTIC DSMDur_xSelEvntGlb_CA "Counting event selection for global duration counters" VAL_BLK 0x9080D09 ValA_Wu8 8.00000000000 DSMDur_EvntSel_Verb 0.00 8.00000000000 FORMAT "%13.11" NUMBER 1 /end CHARACTERISTIC
/begin CHARACTERISTIC DSMRdy_Grp.Cat_CA "Fault checks for readiness calculation / Checks for group Cat" VAL_BLK 0x908112C ValA_Wu16 160. DFC_Verb 0.00 160. FORMAT "%2.0" NUMBER 15 /end CHARACTERISTIC
/begin CHARACTERISTIC DSMRdy_Grp.HtCat_CA "Fault checks for readiness calculation / Checks for group HtCat" VAL_BLK 0x908114A ValA_Wu16 160. DFC_Verb 0.00 160. FORMAT "%2.0" NUMBER 15 /end CHARACTERISTIC
/begin CHARACTERISTIC DSMRdy_Grp.EvpSys_CA "Fault checks for readiness calculation / Checks for group EvpSys" VAL_BLK 0x9081168 ValA_Wu16 160. DFC_Verb 0.00 160. FORMAT "%2.0" NUMBER 15 /end CHARACTERISTIC
/begin CHARACTERISTIC DSMRdy_Grp.SecAirSys_CA "Fault checks for readiness calculation / Checks for group SecAirSys" VAL_BLK 0x9081186 ValA_Wu16 160. DFC_Verb 0.00 160. FORMAT "%2.0" NUMBER 15 /end CHARACTERISTIC
/begin CHARACTERISTIC DSMRdy_Grp.O2Sens_CA "Fault checks for readiness calculation / Checks for group O2Sens" VAL_BLK 0x90811A6 ValA_Wu16 160. DFC_Verb 0.00 160. FORMAT "%2.0" NUMBER 15 /end CHARACTERISTIC
/begin CHARACTERISTIC DSMRdy_Grp.O2SensHt_CA "Fault checks for readiness calculation / Checks for group O2SensHt" VAL_BLK 0x90811C4 ValA_Wu16 160. DFC_Verb 0.00 160. FORMAT "%2.0" NUMBER 15 /end CHARACTERISTIC
/begin CHARACTERISTIC DSMRdy_Grp.EGR_CA "Fault checks for readiness calculation / Checks for group EGR" VAL_BLK 0x90811E2 ValA_Wu16 160. DFC_Verb 0.00 160. FORMAT "%2.0" NUMBER 15 /end CHARACTERISTIC
/begin CHARACTERISTIC DSMRdy_X.PID1ForceLowMsk_C "DSMRdy calibration masks / Enforced zero bits of PID$01 output" VALUE 0x9080D0C Val_Wu32 4294967295.00 DSMRdy_OneToOne 0.00 4294967295.00 FORMAT "%13.2" /end CHARACTERISTIC
/begin CHARACTERISTIC DSMRdy_X.PID1ForceHighMsk_C "DSMRdy calibration masks / Enforced one bits of PID$01 output" VALUE 0x9080D10 Val_Wu32 4294967295.00 DSMRdy_OneToOne 0.00 4294967295.00 FORMAT "%13.2" /end CHARACTERISTIC
/begin CHARACTERISTIC DSMRdy_X.PID41ForceLowMsk_C "DSMRdy calibration masks / Enforced zero bits of PID$41 output" VALUE 0x9080D14 Val_Wu32 4294967295.00 DSMRdy_OneToOne 0.00 4294967295.00 FORMAT "%13.2" /end CHARACTERISTIC
/begin CHARACTERISTIC DSMRdy_X.PID41ForceHighMsk_C "DSMRdy calibration masks / Enforced one bits of PID$41 output" VALUE 0x9080D18 Val_Wu32 4294967295.00 DSMRdy_OneToOne 0.00 4294967295.00 FORMAT "%13.2" /end CHARACTERISTIC
/begin CHARACTERISTIC DTFRAE "time for detecting "" factor fra at steady state""" VALUE 0x908504A KwWU8 51.00 t_q0p2 0.00 51.00 FORMAT "%5.2" /end CHARACTERISTIC
/begin CHARACTERISTIC DTKIHKMDKT "Threshold for main catalyst temperature change" VALUE 0x9084F73 KwWS8 1275. temp_q5 -640.0 635.0 FORMAT "%5.1" /end CHARACTERISTIC
/begin CHARACTERISTIC DTORAE "Time duration for detecting "" offset at steady state""" VALUE 0x908504B KwWU8 51.00 t_q0p2 0.00 51.00 FORMAT "%5.2" /end CHARACTERISTIC
/begin CHARACTERISTIC DTSVKO "delta upper limit for cycle duration of lambda sensor upstream cat" VALUE 0x90850A0 KwSb 5.100 t_q0p02 -2.560 2.540 FORMAT "%5.3" /end CHARACTERISTIC
/begin CHARACTERISTIC DTSVKZTP "delta buffer time for cycle duration of lambda sensor upstream cat" VALUE 0x90850A1 KwSb 5.100 t_q0p02 -2.560 2.540 FORMAT "%5.3" /end CHARACTERISTIC
/begin CHARACTERISTIC DUSHKHZKXF "Threshold for delta sensor voltage to check heater coupling downstr. cat (LSF with Pumped Reference)" VALUE 0x90850B2 KwUw 327.6750 spg_q0p005 0.00 327.6750 FORMAT "%8.4" /end CHARACTERISTIC
/begin CHARACTERISTIC DUSVKHZKXF "Threshold for delta sensor voltage to check heater coupling upstr. cat (LSF with Pumped Reference)" VALUE 0x90850D6 KwUw 327.6750 spg_q0p005 0.00 327.6750 FORMAT "%8.4" /end CHARACTERISTIC
/begin CHARACTERISTIC FALRKTD "amplification factor for amplitude of lambda controller" VALUE 0x9084F74 KwWU8 7.969 fak_ub_b8 0.00 7.969 FORMAT "%5.3" /end CHARACTERISTIC
/begin CHARACTERISTIC FHDLLR "altitude threshold for performing of ISC-actuator diagnosis" VALUE 0x9085056 KwWU8 3.984 fak_ub_b4 0.00 3.984 FORMAT "%5.3" /end CHARACTERISTIC
/begin CHARACTERISTIC FKRLDSSM "Factor difference of modeled DSS relative air charge" VALUE 0x9085110 KwWU16 1.999969 fak_uw_b2 0.00 1.999969 FORMAT "%8.6" /end CHARACTERISTIC
/begin CHARACTERISTIC FRLDKRMNHY "factor value for hysteresis to heal min plaus error of MAP sensor" VALUE 0x9085112 KwWU16 3.999939 fak_uw_b4 0.00 3.999939 FORMAT "%8.6" /end CHARACTERISTIC
/begin CHARACTERISTIC FRLDKRMXHY "factor value for hysteresis to heal max plaus error of MAP sensor" VALUE 0x9085114 KwWU16 3.999939 fak_uw_b4 0.00 3.999939 FORMAT "%8.6" /end CHARACTERISTIC
/begin CHARACTERISTIC FRMLASHO "Upper threshold for mean value of lambda control factor" VALUE 0x9085088 KwUw 1.999969 fak_uw_b2 0.00 1.999969 FORMAT "%8.6" /end CHARACTERISTIC
/begin CHARACTERISTIC FRMLASHU "Lower threshold for mean value of lambda control factor" VALUE 0x908508A KwUw 1.999969 fak_uw_b2 0.00 1.999969 FORMAT "%8.6" /end CHARACTERISTIC
/begin CHARACTERISTIC HEGOD_ratLamCtrlMaxThres_C "Calibration threshold maximum for the ratio of negative slope to the positive slope of lambda Control" VALUE 0x90850A2 KwUb 1.992188 fak_ub_b2 0.00 1.992188 FORMAT "%8.6" /end CHARACTERISTIC
/begin CHARACTERISTIC HEGOD_ratLamCtrlMinThres_C "Calibration threshold minimum for the ratio of negative slope to the positive slope of lambda Control" VALUE 0x90850A3 KwUb 1.992188 fak_ub_b2 0.00 1.992188 FORMAT "%8.6" /end CHARACTERISTIC
/begin CHARACTERISTIC HEGO_mAirStkHiDeb_C "Threshould of integrated air mass flow for lambda sensor current leakage diagnosis" VALUE 0x90850D8 KwUw 6553.500 m_q0p1_g 0.00 6553.500 FORMAT "%8.3" /end CHARACTERISTIC
/begin CHARACTERISTIC HEGO_mAirStkLowDebSensDs_C "Threshould of integrated air mass flow for lambda sensor heater coupling error diagnosis - Cat.down" VALUE 0x90850DA KwUw 6553.500 m_q0p1_g 0.00 6553.500 FORMAT "%8.3" /end CHARACTERISTIC
/begin CHARACTERISTIC HEGO_mAirStkLowDeb_C "Threshould of integrated air mass flow for lambda sensor heater coupling error diagnosis-Cat. up" VALUE 0x90850DC KwUw 6553.500 m_q0p1_g 0.00 6553.500 FORMAT "%8.3" /end CHARACTERISTIC
/begin CHARACTERISTIC HEGO_mEgLamAdjmtThd_C "Exhaust gas mass flow threshold for lambda adjustment end check" VALUE 0x908508C KwUw 6553.500 m_q0p1_g 0.00 6553.500 FORMAT "%8.3" /end CHARACTERISTIC
/begin CHARACTERISTIC HEGO_nEngSpdThdIdle_C "LSFET idling engine speed threshold limit" VALUE 0x90850DE KwUw 16383.75 nmot_q0p25 0.00 16383.75 FORMAT "%8.2" /end CHARACTERISTIC
/begin CHARACTERISTIC HEGO_resScgMin_C "Minimum threshold of resistance for diagnosis of the sensor short circuit to ground." VALUE 0x90850E0 KwUw 131070.0 r_uw_q2 0.00 131070.0 FORMAT "%8.1" /end CHARACTERISTIC
/begin CHARACTERISTIC HEGO_stDiagUpSnsr_CW "LSFET Idling enable or disable" VALUE 0x90850E2 KwUb 255.0 dez 0.00 255.0 FORMAT "%5.1" /end CHARACTERISTIC
/begin CHARACTERISTIC HEGO_stElecDiag_C "Codeword enable for electrical diagnosis of sensor upstream catalyst" VALUE 0x90850E3 KwUb 255.0 dez 0.00 255.0 FORMAT "%5.1" /end CHARACTERISTIC
/begin CHARACTERISTIC HEGO_tiDebIdleInactv_C "LSFET idling Timer delay" VALUE 0x90850E4 KwUb 25.50 t100msxs_ub_b25p5 0.00 25.50 FORMAT "%5.2" /end CHARACTERISTIC
/begin CHARACTERISTIC HYKATA "Absolute hysteresis, cat. monitoring" VALUE 0x9084F75 KwWU8 0.9961 fak_ub_b1 0.00 0.9961 /end CHARACTERISTIC
/begin CHARACTERISTIC HYKATR "Relative hysteresis, for catalyst monitoring" VALUE 0x9084F76 KwWU8 0.9961 fak_ub_b1 0.00 0.9961 /end CHARACTERISTIC
/begin CHARACTERISTIC INJCOPAT "Calibration for Injection cut-off pattern" VALUE 0x9085057 KwWU8 255.0 dez 0.00 255.0 FORMAT "%5.1" /end CHARACTERISTIC
/begin CHARACTERISTIC KATBFML "Filter time constant for signal attenuation in catalyst load" CURVE 0x9084F77 GklWU8 12.7498 zk50msxs_ub_b12p8 0.0501961 12.8000 FORMAT "%7.4"
 /begin AXIS_DESCR COM_AXIS ml_w m_uw_b6553p5 5 0.00 6553.500 FORMAT "%8.3" AXIS_PTS_REF SML05DKUW /end AXIS_DESCR
/end CHARACTERISTIC
/begin CHARACTERISTIC KATBFMN "threshold value for small catalyst stress" VALUE 0x9084F7C KwWU8 0.9961 fak_ub_b1 0.00 0.9961 /end CHARACTERISTIC
/begin CHARACTERISTIC KATBFN "standardized mean value of the sensor amplitude" VALUE 0x9084F7D KwWU8 0.9961 fak_ub_b1 0.00 0.9961 /end CHARACTERISTIC
/begin CHARACTERISTIC KATBFNM "Scaling factor multiplicative for catalyst load" VALUE 0x9084F7E KwWU8 1.275 spg_q0p005 0.00 1.275 FORMAT "%5.3" /end CHARACTERISTIC
/begin CHARACTERISTIC KATBFNP "Scaling factor additive for catalyst load" VALUE 0x9084F7F KwWU8 1.275 spg_q0p005 0.00 1.275 FORMAT "%5.3" /end CHARACTERISTIC
/begin CHARACTERISTIC KATBFXM "max. catalyst load threshold for stop condition" CURVE 0x9084F80 GklWS16 1023.984 freq_sw_b512 -512.0000 511.9844 FORMAT "%8.4"
 /begin AXIS_DESCR COM_AXIS ml_w m_uw_b6553p5 5 0.00 6553.500 FORMAT "%8.3" AXIS_PTS_REF SML05DKUW /end AXIS_DESCR
/end CHARACTERISTIC
/begin CHARACTERISTIC KATBSG "Catalyst storage value for catalyst load" VALUE 0x9084F8A KwWU8 221.4 m_ub_b221p35 0.00 221.4 FORMAT "%5.1" /end CHARACTERISTIC
/begin CHARACTERISTIC KATBSH "offset for lambda control slightly in the rich area" VALUE 0x9084F8B KwWU8 221.4 mgrad_ub_b221p35 0.00 221.4 FORMAT "%5.1" /end CHARACTERISTIC
/begin CHARACTERISTIC KATBSHF "amplification factor for difference of mean values of the O2/S" VALUE 0x9084F8C KwWU16 681693.9 q10p402_mg_DIV_Vs 0.00 681693.9 FORMAT "%8.1" /end CHARACTERISTIC
/begin CHARACTERISTIC KATBSHG "limitation factor of model lambda-offset due to sensor mean values" VALUE 0x9084F8E KwWU8 0.9961 fak_ub_b1 0.00 0.9961 /end CHARACTERISTIC
/begin CHARACTERISTIC KFKABMT "Map for correction of calculated amplitude, dependent on ml and cat. temperature" MAP 0x9084F8F KfAxU8AyU8SstxU8SstyU8WU8 1.992188 fak_ub_b2 0.00 1.992188 FORMAT "%8.6"
 /begin AXIS_DESCR STD_AXIS ml m_ub_b1020 5 0.00 1020. FORMAT "%5.0" DEPOSIT ABSOLUTE /end AXIS_DESCR
 /begin AXIS_DESCR STD_AXIS tkihkm temp_ub_q5_o50 5 -50.00 1225. FORMAT "%5.0" DEPOSIT ABSOLUTE /end AXIS_DESCR
/end CHARACTERISTIC
/begin CHARACTERISTIC KFLRDKTOL "Request from cat monitoring: Increase oxygen load by lambda controller" MAP 0x9084FB4 KfAxU8AyU8SstxU16SstyU16WU16 6553.500 m_q0p1_mg 0.00 6553.500 FORMAT "%8.3"
 /begin AXIS_DESCR STD_AXIS ml m_ub_b1020 4 0.00 1020.000 FORMAT "%8.3" EXTENDED_LIMITS 0.00 262140.0 DEPOSIT ABSOLUTE /end AXIS_DESCR
 /begin AXIS_DESCR STD_AXIS tkihkm temp_ub_q5_o50 4 -50.00000 1225.000 FORMAT "%8.3" EXTENDED_LIMITS -50.00000 327625.0 DEPOSIT ABSOLUTE /end AXIS_DESCR
/end CHARACTERISTIC
/begin CHARACTERISTIC LSAKTD "Impact of slow front sensor on cat. monitoring" CURVE 0x9084FE8 KlAxU8SstxU16WU8_Static 0.9961 fak_ub_b1 0.00 0.9961
 /begin AXIS_DESCR STD_AXIS tpsvkmf_w t10msxs_uw_b655p35 4 0.00 655.3500 FORMAT "%8.4" DEPOSIT ABSOLUTE /end AXIS_DESCR
/end CHARACTERISTIC
/begin CHARACTERISTIC NDKTSO "upper engine speed limit for DKAT-active" VALUE 0x9084FF6 KwWU8 10200. nmot_ub_q40 0.00 10200. FORMAT "%5.0" /end CHARACTERISTIC
/begin CHARACTERISTIC NDKTSU "lower engine speed limit for DKAT-active" VALUE 0x9084FF7 KwWU8 10200. nmot_ub_q40 0.00 10200. FORMAT "%5.0" /end CHARACTERISTIC
/begin CHARACTERISTIC NMDPLPSR "engine speed threshold for MAP diagnosis" VALUE 0x9085116 KwWU16 16383.75 nmot_uw_q0p25 0.00 16383.75 FORMAT "%8.2" /end CHARACTERISTIC
/begin CHARACTERISTIC NMOTDLLR "Engine speed threshold to diasble DLLR." VALUE 0x9085058 KwWU16 16383.75 nmot_uw_q0p25 0.00 16383.75 FORMAT "%8.2" /end CHARACTERISTIC
/begin CHARACTERISTIC NMOTGNP "Engine speed amplitude error threshold for non-plausible error" VALUE 0x908505A KwWS16 16383.75 nmot_sw_q0p25 -8192.000 8191.750 FORMAT "%8.3" /end CHARACTERISTIC
/begin CHARACTERISTIC NTPVKO "upper speed threshold for cycle duration monitoring upstream catalyst" VALUE 0x90850A4 KwUb 10200. nmot_ub_q40 0.00 10200. FORMAT "%5.0" /end CHARACTERISTIC
/begin CHARACTERISTIC NTPVKU "lower speed threshold for cycle duration monitoring upstream catalyst" VALUE 0x90850A5 KwUb 10200. nmot_ub_q40 0.00 10200. FORMAT "%5.0" /end CHARACTERISTIC
/begin CHARACTERISTIC PHLSHMN "Heating power for adequate sensor heating" VALUE 0x90850B4 KwUb 2.550 fak_ub_q0p01 0.00 2.550 FORMAT "%5.3" /end CHARACTERISTIC
/begin CHARACTERISTIC PHLSNVMN "minimal normalised heating-power-diagnosis sensor pre catalyst" VALUE 0x90850E5 KwUb 2.550 fak_ub_q0p01 0.00 2.550 FORMAT "%5.3" /end CHARACTERISTIC
/begin CHARACTERISTIC PIntkVUs_nrCntrSigErr_C "Parameter: Counter to detect DSS sensor signal stuck error" VALUE 0x9085118 KwWU8 255.0 dez 0.00 255.0 FORMAT "%5.1" /end CHARACTERISTIC
/begin CHARACTERISTIC PIntkVUs_nrCntrSigHeal_C "Parameter: Counter to detect DSS sensor signal stuck Heal" VALUE 0x9085119 KwWU8 255.0 dez 0.00 255.0 FORMAT "%5.1" /end CHARACTERISTIC
/begin CHARACTERISTIC PIntkVUs_pDeltaSigVld_C "Parameter: Delta pressure threshold to determine signal stuck error" VALUE 0x908511A KwWU16 2559.961 p_uw_q0p039 0.00 2559.961 FORMAT "%8.3" /end CHARACTERISTIC
/begin CHARACTERISTIC PIntkVUs_rThrVlvLimPSigChk_T "Curve: throttle limit for working range of signal stuck check" CURVE 0x908511C KlAxU8SstxU16WU8_Static 100.0 relDK_ub_b100 0.00 100.0 FORMAT "%5.1"
 /begin AXIS_DESCR STD_AXIS nmot_w nmot_uw_q0p25 2 0.00 16383.75 FORMAT "%8.2" DEPOSIT ABSOLUTE /end AXIS_DESCR
/end CHARACTERISTIC
/begin CHARACTERISTIC PSRRNGMN "Minimum wroking range of DSS" VALUE 0x9085124 KwWU16 2559.961 p_uw_q0p039 0.00 2559.961 FORMAT "%8.3" /end CHARACTERISTIC
/begin CHARACTERISTIC PSRRNGMX "Maximum wroking range of DSS" VALUE 0x9085126 KwWU16 2559.961 p_uw_q0p039 0.00 2559.961 FORMAT "%8.3" /end CHARACTERISTIC
/begin CHARACTERISTIC RIXFSBHK "Actual value of internal resistance of lambda sensor,after cat" VALUE 0x90850B6 KwUw 131070.0 r_uw_q2 0.00 131070.0 FORMAT "%8.1" /end CHARACTERISTIC
/begin CHARACTERISTIC RIXFSBVK "Actual value of internal resistance of lambda sensor,pre cat" VALUE 0x90850E6 KwUw 131070.0 r_uw_q2 0.00 131070.0 FORMAT "%8.1" /end CHARACTERISTIC
/begin CHARACTERISTIC RLDKGPLPS "threshold for throttle based charge gradient for diagnosis" VALUE 0x9085128 KwWU8 50.00 rel_ub_b50 0.00 50.00 FORMAT "%5.2" /end CHARACTERISTIC
/begin CHARACTERISTIC RLDKTSO "upper load characteristic line for DKAT-active" CURVE 0x9084FF8 GklWU8 191.3 rel_ub_q0p75 0.00 191.3 FORMAT "%5.1"
 /begin AXIS_DESCR COM_AXIS nmot nmot_ub_q40 5 0.00 10200. FORMAT "%5.0" AXIS_PTS_REF SNM05DKUB /end AXIS_DESCR
/end CHARACTERISTIC
/begin CHARACTERISTIC RLDKTSU "lower load characteristic line for DKAT-active" CURVE 0x9084FFD GklWU8 191.3 rel_ub_q0p75 0.00 191.3 FORMAT "%5.1"
 /begin AXIS_DESCR COM_AXIS nmot nmot_ub_q40 5 0.00 10200. FORMAT "%5.0" AXIS_PTS_REF SNM05DKUB /end AXIS_DESCR
/end CHARACTERISTIC
/begin CHARACTERISTIC RLHYSHLMN "hyseresis for healing intake pressure sensor based relative air charge" VALUE 0x908512A KwWU16 39.99939 rel_uw_b40 0.00 39.99939 FORMAT "%8.5" /end CHARACTERISTIC
/begin CHARACTERISTIC RLHYSHLMX "hyseresis for healing intake pressure sensor based relative air charge" VALUE 0x908512C KwWU16 39.99939 rel_uw_b40 0.00 39.99939 FORMAT "%8.5" /end CHARACTERISTIC
/begin CHARACTERISTIC RLMDVERL "intake gas threshold for for idle speed diagnosis ;dep. on accessory load" CURVE 0x908505C KlAxU8SstxU16WU8_Static 99.75 rel_ub_q0p75 0.00 99.75 FORMAT "%5.2" EXTENDED_LIMITS 0.00 191.3
 /begin AXIS_DESCR STD_AXIS mdverl_w rel_uw_b100 3 0.00 99.99847 FORMAT "%8.5" DEPOSIT ABSOLUTE /end AXIS_DESCR
/end CHARACTERISTIC
/begin CHARACTERISTIC RLMDVERLKH "intake gas threshold for for idle speed diagnosis ;dep. on accessory load during catalyst heating" CURVE 0x9085068 KlAxU8SstxU16WU8_Static 99.75 rel_ub_q0p75 0.00 99.75 FORMAT "%5.2" EXTENDED_LIMITS 0.00 191.3
 /begin AXIS_DESCR STD_AXIS mdverl_w rel_uw_b100 3 0.00 99.99847 FORMAT "%8.5" DEPOSIT ABSOLUTE /end AXIS_DESCR
/end CHARACTERISTIC
/begin CHARACTERISTIC RLTPVKO "upper load threshold for cycle duration monitoring upstream catalyst" VALUE 0x90850A6 KwUb 191.3 rel_ub_q0p75 0.00 191.3 FORMAT "%5.1" /end CHARACTERISTIC
/begin CHARACTERISTIC RLTPVKU "lower load threshold for cycle duration monitoring upstream catalyst" VALUE 0x90850A7 KwUb 191.3 rel_ub_q0p75 0.00 191.3 FORMAT "%5.1" /end CHARACTERISTIC
/begin AXIS_PTS SML05DKUW "base point distribution air mass" 0x9085002 ml_w SstAU8SstU16 6553.500 m_uw_b6553p5 5 0.00 6553.500 FORMAT "%8.3" DEPOSIT ABSOLUTE /end AXIS_PTS
/begin AXIS_PTS SNM05DKUB "base point distribution nmot" 0x908500E nmot SstAU8SstU8 10200. nmot_ub_q40 5 0.00 10200. FORMAT "%5.0" DEPOSIT ABSOLUTE /end AXIS_PTS
/begin CHARACTERISTIC TADLLR "intake air temperature threshold for ISC-actuator diagnosis" VALUE 0x9085074 KwWU8 191.3 temp_ub_q0p75_o48 -48.00 143.3 FORMAT "%5.1" /end CHARACTERISTIC
/begin CHARACTERISTIC TAMDOGH "temp. threshold from exhaust temp. model for diagnosis sensor downstream cat" VALUE 0x90850B8 KwUb 1275. temp_ub_q5_o50 -50.00 1225. FORMAT "%5.0" /end CHARACTERISTIC
/begin CHARACTERISTIC TAMDOGV "temp. threshold from exhaust temp. modell for diagnosis sensor upstream cat" VALUE 0x90850E8 KwUb 1275. temp_ub_q5_o50 -50.00 1225. FORMAT "%5.0" /end CHARACTERISTIC
/begin CHARACTERISTIC TAMDUGH "temp. threshold from exhaust temp. modell for diagn. sensor downstream cat" VALUE 0x90850B9 KwUb 1275. temp_ub_q5_o50 -50.00 1225. FORMAT "%5.0" /end CHARACTERISTIC
/begin CHARACTERISTIC TAMDUGV "temp. threshold from exhaust temp. modell for diagn. sensor upstream cat" VALUE 0x90850E9 KwUb 1275. temp_ub_q5_o50 -50.00 1225. FORMAT "%5.0" /end CHARACTERISTIC
/begin CHARACTERISTIC TASIGH "time for fade out of interference peaks outside of band for det. of signal disruption" VALUE 0x90850BA KwUb 2.550 t_q0p01 0.00 2.550 FORMAT "%5.3" /end CHARACTERISTIC
/begin CHARACTERISTIC TASIGV "Time for the deactiv.of interf. peaks outside of range for det.of signal upstream cat" VALUE 0x90850EA KwUb 2.550 t_q0p01 0.00 2.550 FORMAT "%5.3" /end CHARACTERISTIC
/begin CHARACTERISTIC TDDPLPSR "debounce time for fault detection plausibility check for intake manifold pressure sensor" VALUE 0x908512E KwWU8 25.50 t_q0p1 0.00 25.50 FORMAT "%5.2" /end CHARACTERISTIC
/begin CHARACTERISTIC TDDSSST "debounce time for fault detection plausibility check during start" VALUE 0x908512F KwWU8 25.50 t_q0p1 0.00 25.50 FORMAT "%5.2" /end CHARACTERISTIC
/begin CHARACTERISTIC TDEPLDSS "Time debounce for pressure sensor plausibility check" VALUE 0x9085130 KwWU8 5.100 t_q0p02 0.00 5.100 FORMAT "%5.3" /end CHARACTERISTIC
/begin CHARACTERISTIC TDKATAKT "threshold value cycle finished if active monitoring time > TDKATAKT" VALUE 0x9085014 KwWU16 3276.750 t_q0p05 0.00 3276.750 FORMAT "%8.3" /end CHARACTERISTIC
/begin CHARACTERISTIC TDLLFG1 "Time delay for setting the condition diagnosis of ISC-actuator" VALUE 0x9085075 KwWU8 51.00 t_q0p2 0.00 51.00 FORMAT "%5.2" /end CHARACTERISTIC
/begin CHARACTERISTIC TDLLR "Time delay for setting the condition diagnosis of ISC-actuator" VALUE 0x9085076 KwWU8 51.00 t_q0p2 0.00 51.00 FORMAT "%5.2" /end CHARACTERISTIC
/begin CHARACTERISTIC TDLLRMN "Time delay before storing error of closed ISC-actuator" VALUE 0x9085077 KwWU8 51.00 t_q0p2 0.00 51.00 FORMAT "%5.2" /end CHARACTERISTIC
/begin CHARACTERISTIC TDLLRMNKH "Time delay before storing error of closed ISC-actuator during catalyst heating" VALUE 0x9085078 KwWU8 51.00 t_q0p2 0.00 51.00 FORMAT "%5.2" /end CHARACTERISTIC
/begin CHARACTERISTIC TDLLRMX "Time delay before storing the error ISC-actuator open" VALUE 0x9085079 KwWU8 51.00 t_q0p2 0.00 51.00 FORMAT "%5.2" /end CHARACTERISTIC
/begin CHARACTERISTIC TDLLRMXKH "Time delay before storing the error ISC-actuator open during catalyst heating" VALUE 0x908507A KwWU8 51.00 t_q0p2 0.00 51.00 FORMAT "%5.2" /end CHARACTERISTIC
/begin CHARACTERISTIC TDLLRNF "Time delay before storing ISC-actuator with no error" VALUE 0x908507B KwWU8 51.00 t_q0p2 0.00 51.00 FORMAT "%5.2" /end CHARACTERISTIC
/begin CHARACTERISTIC TDLLRNFKH "Time delay before storing ISC-actuator with no error during catalyst heating" VALUE 0x908507C KwWU8 51.00 t_q0p2 0.00 51.00 FORMAT "%5.2" /end CHARACTERISTIC
/begin CHARACTERISTIC TDSA "time delay for fuel cutoff based enabling of diagnosis for DSS" VALUE 0x9085131 KwWU8 5.100 t_q0p02 0.00 5.100 FORMAT "%5.3" /end CHARACTERISTIC
/begin CHARACTERISTIC THP "delay time failure heiling powerstage diagnosis" VALUE 0x9085133 KwUb 25.00 t_q0p1 0.5000 25.50 FORMAT "%5.2" EXTENDED_LIMITS 0.00 25.50 /end CHARACTERISTIC
/begin CHARACTERISTIC TKTDVS "Delay time prior to calculation of ahkat value" VALUE 0x9085016 KwWU8 12.75 t_q0p05 0.00 12.75 FORMAT "%5.2" /end CHARACTERISTIC
/begin CHARACTERISTIC TMAXKAT "maximum catalyst temp. for active diagnosis" VALUE 0x9085017 KwWU8 1275. temp_ub_q5_o50 -50.00 1225. FORMAT "%5.0" /end CHARACTERISTIC
/begin CHARACTERISTIC TMDLLR "Engine temperature threshold for ISC-actuator diagnosis" VALUE 0x908507D KwWU8 191.3 temp_ub_q0p75_o48 -48.00 143.3 FORMAT "%5.1" /end CHARACTERISTIC
/begin CHARACTERISTIC TMDLLRKH "Engine temperature threshold for engine speed diagnosis catalyst heating" VALUE 0x908507E KwWU8 191.3 temp_ub_q0p75_o48 -48.00 143.3 FORMAT "%5.1" /end CHARACTERISTIC
/begin CHARACTERISTIC TMINKAT "minimum catalyst temperature for monitoring" VALUE 0x9085018 KwWU8 1275. temp_ub_q5_o50 -50.00 1225. FORMAT "%5.0" /end CHARACTERISTIC
/begin CHARACTERISTIC TMSH "engine temp. threshold for recognition cold start for measur. sensor downstream" VALUE 0x90850BC KwWS16 6553.500 Temp_Cels -3549.940 3003.560 FORMAT "%8.3" /end CHARACTERISTIC
/begin CHARACTERISTIC TMSHA "threshold for engine switch-off temp. for measur. cooling sensor downstream cat" VALUE 0x90850BE KwWS16 6553.500 Temp_Cels -3549.940 3003.560 FORMAT "%8.3" /end CHARACTERISTIC
/begin CHARACTERISTIC TMSUKTD "minimum engine start temp. for monitoring" VALUE 0x908501A KwWS16 6553.500 Temp_Cels -3549.940 3003.560 FORMAT "%8.3" /end CHARACTERISTIC
/begin CHARACTERISTIC TMSV "engine temp. threshold for recognition cold start for measuring sensor upstream" VALUE 0x90850EC KwWS16 6553.500 Temp_Cels -3549.940 3003.560 FORMAT "%8.3" /end CHARACTERISTIC
/begin CHARACTERISTIC TMSVA "threshold for engine switch-off temp. for measuring cooling sensor upstream cat" VALUE 0x90850EE KwWS16 6553.500 Temp_Cels -3549.940 3003.560 FORMAT "%8.3" /end CHARACTERISTIC
/begin CHARACTERISTIC TNSTDLLR "Time delay until idle speed control diagnosis is activated" VALUE 0x9085080 KwWU16 6553.500 t100msxs_uw_b6553p5 0.00 6553.500 FORMAT "%8.3" /end CHARACTERISTIC
/begin CHARACTERISTIC TNSTDN "time after start for diagnosis shunt resistance fault (monoflop)" VALUE 0x90850F0 KwUb 25.50 t100msxs_ub_b25p5 0.00 25.50 FORMAT "%5.2" /end CHARACTERISTIC
/begin CHARACTERISTIC TNSTDNH "time after start for diagnosis wire-to-wire (monoflop)" VALUE 0x90850C0 KwUb 25.50 t100msxs_ub_b25p5 0.00 25.50 FORMAT "%5.2" /end CHARACTERISTIC
/begin CHARACTERISTIC TRSA "monitoring time closed-loop control (upstream CAT) -> sensor off" VALUE 0x90850F2 KwUw 6553.500 t100msxs_uw_q100 0.00 6553.500 FORMAT "%8.3" /end CHARACTERISTIC
/begin CHARACTERISTIC TRSAH "monitoring time cable broken (Voltage within range) for sensor downstream cat" VALUE 0x90850C2 KwUw 6553.500 t100msxs_uw_b6553p5 0.00 6553.500 FORMAT "%8.3" /end CHARACTERISTIC
/begin CHARACTERISTIC TSALASH "Time after fuel cut-off for the checking of the sensor downstream catalyst" VALUE 0x908508E KwUb 25.50 t_q0p1 0.00 25.50 FORMAT "%5.2" /end CHARACTERISTIC
/begin CHARACTERISTIC TSALSAHK "Delay time for interference peaks at thrust detection of the rear oxygen sensor" VALUE 0x908508F KwUb 25.50 t100msxs_ub_b25p5 0.00 25.50 FORMAT "%5.2" /end CHARACTERISTIC
/begin CHARACTERISTIC TSEINV "Delay for setting sensor readiness" VALUE 0x90850F4 KwUb 25.50 t100msxs_ub_b25p5 0.00 25.50 FORMAT "%5.2" /end CHARACTERISTIC
/begin CHARACTERISTIC TSTEAA "inhibit time after condition B_te (canister purge active)" VALUE 0x90850A8 KwUb 25.50 t_q0p1 0.00 25.50 FORMAT "%5.2" /end CHARACTERISTIC
/begin CHARACTERISTIC TSVKO "upper limit for cycle duration of lambda sensor upstream cat" VALUE 0x90850A9 KwUb 2.550 t10msxs_ub_b2p55 0.00 2.550 FORMAT "%5.3" /end CHARACTERISTIC
/begin CHARACTERISTIC TTBMH "period for theoretical operation readiness of sensor with heating" VALUE 0x90850C4 KwUw 6553.500 t100msxs_uw_q100 0.00 6553.500 FORMAT "%8.3" /end CHARACTERISTIC
/begin CHARACTERISTIC TTBMHV "Period for theoretical operation readiness of sensor with heating upstream cat" VALUE 0x90850F6 KwUw 6553.500 t100msxs_uw_q100 0.00 6553.500 FORMAT "%8.3" /end CHARACTERISTIC
/begin CHARACTERISTIC TTLASH "Time for voltage of O2 sensor post cat lower/higher than desired threshold" VALUE 0x9085090 KwUw 6553.500 t100msxs_uw_b6553p5 0.00 6553.500 FORMAT "%8.3" /end CHARACTERISTIC
/begin CHARACTERISTIC TUSCHUB "Delay time for interference peaks at thrust detection of the rear oxygen sensor" VALUE 0x9085092 KwUb 25.50 t100msxs_ub_b25p5 0.00 25.50 FORMAT "%5.2" /end CHARACTERISTIC
/begin CHARACTERISTIC TUSDU "time delay for detec. intercore short circ. and sensor with limit. volt. up.cat" VALUE 0x90850F8 KwUw 6553.500 t100msxs_uw_q100 0.00 6553.500 FORMAT "%8.3" /end CHARACTERISTIC
/begin CHARACTERISTIC TUSDUC "delay time code for detec. wire-to-wire sh. circ. of the oxyg. sens. upstr. cat" VALUE 0x90850FA KwUw 6553.500 t100msxs_uw_q100 0.00 6553.500 FORMAT "%8.3" /end CHARACTERISTIC
/begin CHARACTERISTIC TUSDUH "time delay for detection intercore short circuit l. sensor downstr. cat." VALUE 0x90850C6 KwUw 6553.500 t100msxs_uw_q100 0.00 6553.500 FORMAT "%8.3" /end CHARACTERISTIC
/begin CHARACTERISTIC TUSENLASH "time for duration until lean/rich detection is downstream cat" VALUE 0x9085094 KwUw 6553.500 t100msxs_uw_b6553p5 0.00 6553.500 FORMAT "%8.3" /end CHARACTERISTIC
/begin CHARACTERISTIC TUSHZFH "Time window to measure heater coupling to sensor signal downstr. catalyst" VALUE 0x90850C8 KwUb 2.550 t_q0p01 0.00 2.550 FORMAT "%5.3" /end CHARACTERISTIC
/begin CHARACTERISTIC TUSHZFV "Time window to measure heater coupling of sensor signal upstr. catalyst" VALUE 0x90850FC KwUb 2.550 t_q0p01 0.00 2.550 FORMAT "%5.3" /end CHARACTERISTIC
/begin CHARACTERISTIC TUSLASH "Test time for duration enrichment/enleanment downstream catalyst" VALUE 0x9085096 KwUw 6553.500 t100msxs_uw_b6553p5 0.00 6553.500 FORMAT "%8.3" /end CHARACTERISTIC
/begin CHARACTERISTIC TUSMAX "monitoring time for Usmax" VALUE 0x90850C9 KwUb 25.50 t100msxs_ub_b25p5 0.00 25.50 FORMAT "%5.2" /end CHARACTERISTIC
/begin CHARACTERISTIC TUSMAXV "Monitoring time for Usmax for sensor upstream cat" VALUE 0x90850FD KwUb 25.50 t100msxs_ub_b25p5 0.00 25.50 FORMAT "%5.2" /end CHARACTERISTIC
/begin CHARACTERISTIC TUSMD "Delay for detection 'wire to wire connection' during misfire" VALUE 0x90850CA KwUw 6553.500 t100msxs_uw_q100 0.00 6553.500 FORMAT "%8.3" /end CHARACTERISTIC
/begin CHARACTERISTIC TUSPNMX "max. time of the sensor voltage between pos. and neg. slope" VALUE 0x90850AA KwUb 2.550 t10msxs_ub_b2p55 0.00 2.550 FORMAT "%5.3" /end CHARACTERISTIC
/begin CHARACTERISTIC TUSSA "delay time after crossing the control threshold downstream cat" VALUE 0x9085098 KwUb 25.50 t100msxs_ub_b25p5 0.00 25.50 FORMAT "%5.2" /end CHARACTERISTIC
/begin CHARACTERISTIC TVKTDTE "cat monitoring: delay time until temperature stabilized" VALUE 0x908501C KwWU16 3276.750 t_q0p05 0.00 3276.750 FORMAT "%8.3" /end CHARACTERISTIC
/begin CHARACTERISTIC TVP "delay time failure verification powerstage diagnosis ME(D) 9" VALUE 0x9085134 KwUb 25.00 t_q0p1 0.5000 25.50 FORMAT "%5.2" EXTENDED_LIMITS 0.00 25.50 /end CHARACTERISTIC
/begin CHARACTERISTIC TWCD_facFilPerdDurn_C "Factor for filtering lambda control period duration" VALUE 0x908501E KwWU8 0.9961 fak_ub_b1 0.00 0.9961 /end CHARACTERISTIC
/begin CHARACTERISTIC TWCD_facPerdDurnFilLam_C "Calibration factor to select Period Duration for mean controller action value" VALUE 0x908501F KwWU8 1.992188 fak_ub_b2 0.00 1.992188 FORMAT "%8.6" /end CHARACTERISTIC
/begin CHARACTERISTIC TWCD_facPerdDurnFilSnsrU_C "Calibration factor to select Period Duration for flitering of downstream sensor voltage" VALUE 0x9085020 KwWU8 1.992188 fak_ub_b2 0.00 1.992188 FORMAT "%8.6" /end CHARACTERISTIC
/begin CHARACTERISTIC TWCD_mfThdEnaCatDiag_C "Calibration threshold to indicate sufficient air mass flow to Enable the Catalyst Diagnosis" VALUE 0x9085022 KwWU16 6553.500 m_q0p1_g 0.00 6553.500 FORMAT "%8.3" /end CHARACTERISTIC
/begin CHARACTERISTIC TWCD_ratAccrMax_C "Maximum normalised accelerator pedal position for catalyst diagnosis" VALUE 0x9085024 KwWS16 799.9878 rel_q0p012207 -400.0000 399.9878 FORMAT "%8.4" /end CHARACTERISTIC
/begin CHARACTERISTIC TWDKATST "waiting time after stop condition for filter and integrator" VALUE 0x9085026 KwWU8 12.75 t_q0p05 0.00 12.75 FORMAT "%5.2" /end CHARACTERISTIC
/begin CHARACTERISTIC TWDKTSF "waiting time after stop condition for filter and integrator" VALUE 0x9085027 KwWU8 12.75 t_q0p05 0.00 12.75 FORMAT "%5.2" /end CHARACTERISTIC
/begin CHARACTERISTIC TWDLAHI "delay time for readiness flag dlahi diagnosis" VALUE 0x90850AC KwUw 65535.00 t1sxs_uw_b65535 0.00 65535.00 FORMAT "%8.2" /end CHARACTERISTIC
/begin CHARACTERISTIC USFHKXF "sensor voltage threshold for detection 'rich' downstream cat (LSF with Pumped Reference)" VALUE 0x90850FE KwUw 327.6750 spg_q0p005 0.00 327.6750 FORMAT "%8.4" /end CHARACTERISTIC
/begin CHARACTERISTIC USLNPVXF "Upper limit of lower non-plausible error band for LSF sensor with Pumped Reference" VALUE 0x9085100 KwUw 327.6750 spg_q0p005 0.00 327.6750 FORMAT "%8.4" /end CHARACTERISTIC
/begin CHARACTERISTIC USMAXHXF "threshold for short circuit of sensor to Ubat downstream cat (LSF with Pumped Reference)" VALUE 0x90850CC KwUw 327.6750 spg_q0p005 0.00 327.6750 FORMAT "%8.4" /end CHARACTERISTIC
/begin CHARACTERISTIC USMAXVXF "threshold for short circuit of sensor to Ubat upstream cat (LSF with Pumped Reference)" VALUE 0x9085102 KwUw 327.6750 spg_q0p005 0.00 327.6750 FORMAT "%8.4" /end CHARACTERISTIC
/begin CHARACTERISTIC USMHKXF "sensor voltage threshold for detection 'lean' downstream cat (LSF with Pumped Reference)" VALUE 0x9085104 KwUw 327.6750 spg_q0p005 0.00 327.6750 FORMAT "%8.4" /end CHARACTERISTIC
/begin CHARACTERISTIC USMINHXF "threshold for short circuit of sensor to ground downstream cat (LSF with Pumped Reference)" VALUE 0x90850CE KwUw 327.6750 spg_q0p005 0.00 327.6750 FORMAT "%8.4" /end CHARACTERISTIC
/begin CHARACTERISTIC USMINVXF "threshold for short circuit of sensor to ground upstream cat (LSF with Pumped Reference)" VALUE 0x9085106 KwUw 327.6750 spg_q0p005 0.00 327.6750 FORMAT "%8.4" /end CHARACTERISTIC
/begin CHARACTERISTIC USOVRRN "Threshold for sensor voltage downstream catalyst after fuel cut-off" VALUE 0x9085099 KwUb 1.275 spg_q0p005 0.00 1.275 FORMAT "%5.3" /end CHARACTERISTIC
/begin CHARACTERISTIC USPVRXF "threshold for reset of fault ""potential offset"" of sensor upstream cat (LSF with Pumped Reference)" VALUE 0x9085108 KwUw 327.6750 spg_q0p005 0.00 327.6750 FORMAT "%8.4" /end CHARACTERISTIC
/begin CHARACTERISTIC USREFHXF "threshold for operation readiness of sensor downstream CAT at rich mixture (LSF with Pumped Reference)" VALUE 0x90850D0 KwUw 327.6750 spg_q0p005 0.00 327.6750 FORMAT "%8.4" /end CHARACTERISTIC
/begin CHARACTERISTIC USREFXF "threshold for operation readiness of sensor at rich mixture (upstream CAT) (LSF with Pumped Reference)" VALUE 0x908510A KwUw 327.6750 spg_q0p005 0.00 327.6750 FORMAT "%8.4" /end CHARACTERISTIC
/begin CHARACTERISTIC USREMHXF "threshold for operation readiness of sensor downstream CAT at lean mixture (LSF with Pumped Reference)" VALUE 0x90850D2 KwUw 327.6750 spg_q0p005 0.00 327.6750 FORMAT "%8.4" /end CHARACTERISTIC
/begin CHARACTERISTIC USREMXF "threshold for operation readiness of sensor at lean mixture (upstream CAT) (LSF with Pumped Reference4)" VALUE 0x908510C KwUw 327.6750 spg_q0p005 0.00 327.6750 FORMAT "%8.4" /end CHARACTERISTIC
/begin CHARACTERISTIC USUNPVXF "lower limit of upper band of non-plausible error for LSF with Pumped Reference" VALUE 0x908510E KwUw 327.6750 spg_q0p005 0.00 327.6750 FORMAT "%8.4" /end CHARACTERISTIC
/begin CHARACTERISTIC ZDKATAD "filter time constant of the differentiator for signal amplitude" VALUE 0x9085028 KwWU8 12.70 t_q0p05 0.05000 12.75 FORMAT "%5.2" EXTENDED_LIMITS 0.00 12.75 /end CHARACTERISTIC
/begin CHARACTERISTIC ZDKATAF "time constant ""absolute value filter"" for signal amplitude" VALUE 0x9085029 KwWU8 12.7498 zk50msxs_ub_b12p8 0.0501961 12.8000 FORMAT "%7.4" /end CHARACTERISTIC
/begin CHARACTERISTIC ZDKATSH "time constant low pass filter, mean sensor values" VALUE 0x908502A KwWU8 12.7498 zk50msxs_ub_b12p8 0.0501961 12.8000 FORMAT "%7.4" /end CHARACTERISTIC
/begin CHARACTERISTIC ZDKTBD "time constant of the differentiator for RF-alternating component" VALUE 0x908502C KwWU16 3276.700 t_q0p05 0.05000000 3276.750 FORMAT "%8.3" EXTENDED_LIMITS 0.00 3276.750 /end CHARACTERISTIC
/begin CHARACTERISTIC ZDKTBF "time constant for gas mixing procedure in front of catalyst" VALUE 0x908502E KwWU16 3276.7499992 zk50msxs_uw_b3276p8 0.050000762951 3276.8000000 FORMAT "%12.7" /end CHARACTERISTIC
/begin CHARACTERISTIC ZFTSVK "time constant for filter cycle duration of sensor upstream catalyst" VALUE 0x90850AE KwUb 0.9961 fak_ub_b1 0.00 0.9961 /end CHARACTERISTIC
/begin CHARACTERISTIC ZKTDML "low pass filter time constant for air mass flow of catalyst diagnosis" VALUE 0x9085030 KwWU16 3276.750 t_q0p05 0.00 3276.750 FORMAT "%8.3" /end CHARACTERISTIC
/begin CHARACTERISTIC ZKTDRL "time constant low pass filter, engine load" VALUE 0x9085032 KwWU16 3276.750 t_q0p05 0.00 3276.750 FORMAT "%8.3" /end CHARACTERISTIC
/begin CHARACTERISTIC ZTKIHKM "low pass filter time constant for temperature of main catalyst" VALUE 0x9085034 KwWU16 3276.750 t_q0p05 0.00 3276.750 FORMAT "%8.3" /end CHARACTERISTIC
/begin MEASUREMENT ahkat "mean value of the amplitude sensor signal behind catalyst corrected by KB" UBYTE fak_ub_b1 1 100 0.00 0.9961 ECU_ADDRESS 0x40008899
 /begin IF_DATA XCPplus 0x0102
  /begin DAQ_EVENT VARIABLE /begin AVAILABLE_EVENT_LIST EVENT 0 EVENT 1 EVENT 2 EVENT 3 /end AVAILABLE_EVENT_LIST /begin DEFAULT_EVENT_LIST EVENT 2 /end DEFAULT_EVENT_LIST /end DAQ_EVENT
 /end IF_DATA
/end MEASUREMENT
/begin MEASUREMENT ahkati "mean value of the amplitude sensor signal behind catalyst corrected by KB,intern" UBYTE fak_ub_b1 1 100 0.00 0.9961 ECU_ADDRESS 0x400088AC
 /begin IF_DATA XCPplus 0x0102
  /begin DAQ_EVENT VARIABLE /begin AVAILABLE_EVENT_LIST EVENT 0 EVENT 1 EVENT 2 EVENT 3 /end AVAILABLE_EVENT_LIST /begin DEFAULT_EVENT_LIST EVENT 2 /end DEFAULT_EVENT_LIST /end DAQ_EVENT
 /end IF_DATA
/end MEASUREMENT
/begin MEASUREMENT ahkatn "amplitude sensor signal behind catalyst standardized" UBYTE fak_ub_b1 1 100 0.00 0.9961 ECU_ADDRESS 0x400088A7
 /begin IF_DATA XCPplus 0x0102
  /begin DAQ_EVENT VARIABLE /begin AVAILABLE_EVENT_LIST EVENT 0 EVENT 1 EVENT 2 EVENT 3 /end AVAILABLE_EVENT_LIST /begin DEFAULT_EVENT_LIST EVENT 2 /end DEFAULT_EVENT_LIST /end DAQ_EVENT
 /end IF_DATA
/end MEASUREMENT
/begin MEASUREMENT ahktki_w "amplitude sensor signal behind catalyst corrected and integrated" UWORD t50msxs_uw_b819p2 1 100 0.00 819.1875 FORMAT "%8.4" ECU_ADDRESS 0x400084C8
 /begin IF_DATA XCPplus 0x0102
  /begin DAQ_EVENT VARIABLE /begin AVAILABLE_EVENT_LIST EVENT 0 EVENT 1 EVENT 2 EVENT 3 /end AVAILABLE_EVENT_LIST /begin DEFAULT_EVENT_LIST EVENT 2 /end DEFAULT_EVENT_LIST /end DAQ_EVENT
 /end IF_DATA
/end MEASUREMENT
/begin MEASUREMENT ahktnk "corrected sensor signal amplitude standardized" UBYTE fak_ub_b1 1 100 0.00 0.9961 ECU_ADDRESS 0x400088AB
 /begin IF_DATA XCPplus 0x0102
  /begin DAQ_EVENT VARIABLE /begin AVAILABLE_EVENT_LIST EVENT 0 EVENT 1 EVENT 2 EVENT 3 /end AVAILABLE_EVENT_LIST /begin DEFAULT_EVENT_LIST EVENT 2 /end DEFAULT_EVENT_LIST /end DAQ_EVENT
 /end IF_DATA
/end MEASUREMENT
/begin MEASUREMENT akatbn "amplitude of the catalyst stress signal" UBYTE fak_ub_b1 1 100 0.00 0.9961 ECU_ADDRESS 0x400088A8
 /begin IF_DATA XCPplus 0x0102
  /begin DAQ_EVENT VARIABLE /begin AVAILABLE_EVENT_LIST EVENT 0 EVENT 1 EVENT 2 EVENT 3 /end AVAILABLE_EVENT_LIST /begin DEFAULT_EVENT_LIST EVENT 2 /end DEFAULT_EVENT_LIST /end DAQ_EVENT
 /end IF_DATA
/end MEASUREMENT
/begin MEASUREMENT akatbnk "corrected amplitude of the catalyst stress signal" UBYTE fak_ub_b1 1 100 0.00 0.9961 ECU_ADDRESS 0x400088AA
 /begin IF_DATA XCPplus 0x0102
  /begin DAQ_EVENT VARIABLE /begin AVAILABLE_EVENT_LIST EVENT 0 EVENT 1 EVENT 2 EVENT 3 /end AVAILABLE_EVENT_LIST /begin DEFAULT_EVENT_LIST EVENT 2 /end DEFAULT_EVENT_LIST /end DAQ_EVENT
 /end IF_DATA
/end MEASUREMENT
/begin MEASUREMENT avkatf "amplitude ratio laafh/laafv filtered" UBYTE fak_ub_b1 1 100 0.00 0.9961 ECU_ADDRESS 0x4000C70E
 /begin IF_DATA XCPplus 0x0102
  /begin DAQ_EVENT VARIABLE /begin AVAILABLE_EVENT_LIST EVENT 0 EVENT 1 EVENT 2 EVENT 3 /end AVAILABLE_EVENT_LIST /begin DEFAULT_EVENT_LIST EVENT 2 /end DEFAULT_EVENT_LIST /end DAQ_EVENT
 /end IF_DATA
/end MEASUREMENT
/begin MEASUREMENT B_adsh "condition for short-circuit downstream sensor" UBYTE B_TRUE 1 100 0.00 1.00000000000 BIT_MASK 0x1 FORMAT "%13.11" ECU_ADDRESS 0x400088E9 /end MEASUREMENT
/begin MEASUREMENT B_adshs "condition for short-circuit ""set"" downstream sensor" UBYTE B_TRUE 1 100 0.00 1.00000000000 BIT_MASK 0x1 FORMAT "%13.11" ECU_ADDRESS 0x400088E8 /end MEASUREMENT
/begin MEASUREMENT B_adsvb "prohibition operating readiness because of SC wire-to-wire" UBYTE B_TRUE 1 100 0.00 1.00000000000 BIT_MASK 0x1 FORMAT "%13.11" ECU_ADDRESS 0x40008913
 /begin IF_DATA XCPplus 0x0102
  /begin DAQ_EVENT VARIABLE /begin AVAILABLE_EVENT_LIST EVENT 0 EVENT 1 EVENT 2 EVENT 3 /end AVAILABLE_EVENT_LIST /begin DEFAULT_EVENT_LIST EVENT 2 /end DEFAULT_EVENT_LIST /end DAQ_EVENT
 /end IF_DATA
/end MEASUREMENT
/begin MEASUREMENT B_anzhzkh "Cond. numbers of heater-couples to sensor signal is reached downstr. cat" UBYTE B_TRUE 1 100 0.00 1.00000000000 BIT_MASK 0x8 FORMAT "%13.11" ECU_ADDRESS 0x400088EA /end MEASUREMENT
/begin MEASUREMENT B_anzhzkv "Cond. numbers of heater-couples to sensor signal is reached upstream cat" UBYTE B_TRUE 1 100 0.00 1.00000000000 BIT_MASK 0x1 FORMAT "%13.11" ECU_ADDRESS 0x4000890E
 /begin IF_DATA XCPplus 0x0102
  /begin DAQ_EVENT VARIABLE /begin AVAILABLE_EVENT_LIST EVENT 0 EVENT 1 EVENT 2 EVENT 3 /end AVAILABLE_EVENT_LIST /begin DEFAULT_EVENT_LIST EVENT 1 /end DEFAULT_EVENT_LIST /end DAQ_EVENT
 /end IF_DATA
/end MEASUREMENT
/begin MEASUREMENT B_anzhzoh "Cond. numbers of heater disconnections is reached downstr. cat" UBYTE B_TRUE 1 100 0.00 1.00000000000 BIT_MASK 0x4 FORMAT "%13.11" ECU_ADDRESS 0x400088EA /end MEASUREMENT
/begin MEASUREMENT B_anzhzov "Cond. numbers of heater disconnections is reached upstream cat" UBYTE B_TRUE 1 100 0.00 1.00000000000 BIT_MASK 0x2 FORMAT "%13.11" ECU_ADDRESS 0x4000890E
 /begin IF_DATA XCPplus 0x0102
  /begin DAQ_EVENT VARIABLE /begin AVAILABLE_EVENT_LIST EVENT 0 EVENT 1 EVENT 2 EVENT 3 /end AVAILABLE_EVENT_LIST /begin DEFAULT_EVENT_LIST EVENT 1 /end DEFAULT_EVENT_LIST /end DAQ_EVENT
 /end IF_DATA
/end MEASUREMENT
/begin MEASUREMENT B_anztp "condition number of valid LR periods obtained" UBYTE B_TRUE 1 100 0.00 1.00000000000 BIT_MASK 0x1 FORMAT "%13.11" ECU_ADDRESS 0x400088C3
 /begin IF_DATA XCPplus 0x0102
  /begin DAQ_EVENT VARIABLE /begin AVAILABLE_EVENT_LIST EVENT 0 EVENT 1 EVENT 2 EVENT 3 /end AVAILABLE_EVENT_LIST /begin DEFAULT_EVENT_LIST EVENT 1 /end DEFAULT_EVENT_LIST /end DAQ_EVENT
 /end IF_DATA
/end MEASUREMENT
/begin MEASUREMENT B_anztpip "condition number of valid LR periods obtained(for IUMPR)" UBYTE B_TRUE 1 100 0.00 1.00000000000 BIT_MASK 0x1 FORMAT "%13.11" ECU_ADDRESS 0x400088C2
 /begin IF_DATA XCPplus 0x0102
  /begin DAQ_EVENT VARIABLE /begin AVAILABLE_EVENT_LIST EVENT 0 EVENT 1 EVENT 2 EVENT 3 /end AVAILABLE_EVENT_LIST /begin DEFAULT_EVENT_LIST EVENT 1 /end DEFAULT_EVENT_LIST /end DAQ_EVENT
 /end IF_DATA
/end MEASUREMENT
/begin MEASUREMENT B_dfra "Condition for detecting "" factor fra at steady state""" UBYTE B_TRUE 1 100 0.00 1.00000000000 BIT_MASK 0x1 FORMAT "%13.11" ECU_ADDRESS 0x400088B4
 /begin IF_DATA XCPplus 0x0102
  /begin DAQ_EVENT VARIABLE /begin AVAILABLE_EVENT_LIST EVENT 0 EVENT 1 EVENT 2 EVENT 3 /end AVAILABLE_EVENT_LIST /begin DEFAULT_EVENT_LIST EVENT 3 /end DEFAULT_EVENT_LIST /end DAQ_EVENT
 /end IF_DATA
/end MEASUREMENT
/begin MEASUREMENT B_dkini "condition for initialize DKAT function" UBYTE B_TRUE 1 100 0.00 1.00000000000 BIT_MASK 0x1 FORMAT "%13.11" ECU_ADDRESS 0x4000889A
 /begin IF_DATA XCPplus 0x0102
  /begin DAQ_EVENT VARIABLE /begin AVAILABLE_EVENT_LIST EVENT 0 EVENT 1 EVENT 2 EVENT 3 /end AVAILABLE_EVENT_LIST /begin DEFAULT_EVENT_LIST EVENT 2 /end DEFAULT_EVENT_LIST /end DAQ_EVENT
 /end IF_DATA
/end MEASUREMENT
/begin MEASUREMENT B_dktakt "catalyst monitoring active" UBYTE B_TRUE 1 100 0.00 1.00000000000 BIT_MASK 0x2 FORMAT "%13.11" ECU_ADDRESS 0x40008898
 /begin IF_DATA XCPplus 0x0102
  /begin DAQ_EVENT VARIABLE /begin AVAILABLE_EVENT_LIST EVENT 0 EVENT 1 EVENT 2 EVENT 3 /end AVAILABLE_EVENT_LIST /begin DEFAULT_EVENT_LIST EVENT 2 /end DEFAULT_EVENT_LIST /end DAQ_EVENT
 /end IF_DATA
/end MEASUREMENT
/begin MEASUREMENT B_dktbfn "Condition: catalyst monitoring not aborted due to too low catalyst charge" UBYTE B_TRUE 1 100 0.00 1.00000000000 BIT_MASK 0x2 FORMAT "%13.11" ECU_ADDRESS 0x4000889A
 /begin IF_DATA XCPplus 0x0102
  /begin DAQ_EVENT VARIABLE /begin AVAILABLE_EVENT_LIST EVENT 0 EVENT 1 EVENT 2 EVENT 3 /end AVAILABLE_EVENT_LIST /begin DEFAULT_EVENT_LIST EVENT 2 /end DEFAULT_EVENT_LIST /end DAQ_EVENT
 /end IF_DATA
/end MEASUREMENT
/begin MEASUREMENT B_dktbfx "Condition: catalyst monitoring aborted due to too high catalyst charge" UBYTE B_TRUE 1 100 0.00 1.00000000000 BIT_MASK 0x4 FORMAT "%13.11" ECU_ADDRESS 0x4000889A
 /begin IF_DATA XCPplus 0x0102
  /begin DAQ_EVENT VARIABLE /begin AVAILABLE_EVENT_LIST EVENT 0 EVENT 1 EVENT 2 EVENT 3 /end AVAILABLE_EVENT_LIST /begin DEFAULT_EVENT_LIST EVENT 2 /end DEFAULT_EVENT_LIST /end DAQ_EVENT
 /end IF_DATA
/end MEASUREMENT
/begin MEASUREMENT B_dkten "DKAT no longer active for this trip" UBYTE B_TRUE 1 100 0.00 1.00000000000 BIT_MASK 0x8 FORMAT "%13.11" ECU_ADDRESS 0x4000889A
 /begin IF_DATA XCPplus 0x0102
  /begin DAQ_EVENT VARIABLE /begin AVAILABLE_EVENT_LIST EVENT 0 EVENT 1 EVENT 2 EVENT 3 /end AVAILABLE_EVENT_LIST /begin DEFAULT_EVENT_LIST EVENT 2 /end DEFAULT_EVENT_LIST /end DAQ_EVENT
 /end IF_DATA
/end MEASUREMENT
/begin MEASUREMENT B_dktlp "Request of parameter switch over in lambda control" UBYTE B_TRUE 1 100 0.00 1.00000000000 BIT_MASK 0x1 FORMAT "%13.11" ECU_ADDRESS 0x40008898
 /begin IF_DATA XCPplus 0x0102
  /begin DAQ_EVENT VARIABLE /begin AVAILABLE_EVENT_LIST EVENT 0 EVENT 1 EVENT 2 EVENT 3 /end AVAILABLE_EVENT_LIST /begin DEFAULT_EVENT_LIST EVENT 2 /end DEFAULT_EVENT_LIST /end DAQ_EVENT
 /end IF_DATA
/end MEASUREMENT
/begin MEASUREMENT B_dktnr "speed-/load range left" UBYTE B_TRUE 1 100 0.00 1.00000000000 BIT_MASK 0x10 FORMAT "%13.11" ECU_ADDRESS 0x4000889A
 /begin IF_DATA XCPplus 0x0102
  /begin DAQ_EVENT VARIABLE /begin AVAILABLE_EVENT_LIST EVENT 0 EVENT 1 EVENT 2 EVENT 3 /end AVAILABLE_EVENT_LIST /begin DEFAULT_EVENT_LIST EVENT 2 /end DEFAULT_EVENT_LIST /end DAQ_EVENT
 /end IF_DATA
/end MEASUREMENT
/begin MEASUREMENT B_dktsb "bank-specific stop condition" UBYTE B_TRUE 1 100 0.00 1.00000000000 BIT_MASK 0x20 FORMAT "%13.11" ECU_ADDRESS 0x4000889A
 /begin IF_DATA XCPplus 0x0102
  /begin DAQ_EVENT VARIABLE /begin AVAILABLE_EVENT_LIST EVENT 0 EVENT 1 EVENT 2 EVENT 3 /end AVAILABLE_EVENT_LIST /begin DEFAULT_EVENT_LIST EVENT 2 /end DEFAULT_EVENT_LIST /end DAQ_EVENT
 /end IF_DATA
/end MEASUREMENT
/begin MEASUREMENT B_dktsp "physical stop condition" UBYTE B_TRUE 1 100 0.00 1.00000000000 BIT_MASK 0x40 FORMAT "%13.11" ECU_ADDRESS 0x4000889A
 /begin IF_DATA XCPplus 0x0102
  /begin DAQ_EVENT VARIABLE /begin AVAILABLE_EVENT_LIST EVENT 0 EVENT 1 EVENT 2 EVENT 3 /end AVAILABLE_EVENT_LIST /begin DEFAULT_EVENT_LIST EVENT 2 /end DEFAULT_EVENT_LIST /end DAQ_EVENT
 /end IF_DATA
/end MEASUREMENT
/begin MEASUREMENT B_dktst "Catalyst diagnosis is enabled" UBYTE B_TRUE 1 100 0.00 1.00000000000 BIT_MASK 0x1 FORMAT "%13.11" ECU_ADDRESS 0x40008896
 /begin IF_DATA XCPplus 0x0102
  /begin DAQ_EVENT VARIABLE /begin AVAILABLE_EVENT_LIST EVENT 0 EVENT 1 EVENT 2 EVENT 3 /end AVAILABLE_EVENT_LIST /begin DEFAULT_EVENT_LIST EVENT 2 /end DEFAULT_EVENT_LIST /end DAQ_EVENT
 /end IF_DATA
/end MEASUREMENT
/begin MEASUREMENT B_dktstff "Catalyst diagnosis is enabled. flip-flop" UBYTE B_TRUE 1 100 0.00 1.00000000000 BIT_MASK 0x2 FORMAT "%13.11" ECU_ADDRESS 0x400088A2
 /begin IF_DATA XCPplus 0x0102
  /begin DAQ_EVENT VARIABLE /begin AVAILABLE_EVENT_LIST EVENT 0 EVENT 1 EVENT 2 EVENT 3 /end AVAILABLE_EVENT_LIST /begin DEFAULT_EVENT_LIST EVENT 2 /end DEFAULT_EVENT_LIST /end DAQ_EVENT
 /end IF_DATA
/end MEASUREMENT
/begin MEASUREMENT B_dkttemp "catalyst temperature in diagnosis range" UBYTE B_TRUE 1 100 0.00 1.00000000000 BIT_MASK 0x1 FORMAT "%13.11" ECU_ADDRESS 0x400088A0
 /begin IF_DATA XCPplus 0x0102
  /begin DAQ_EVENT VARIABLE /begin AVAILABLE_EVENT_LIST EVENT 0 EVENT 1 EVENT 2 EVENT 3 /end AVAILABLE_EVENT_LIST /begin DEFAULT_EVENT_LIST EVENT 2 /end DEFAULT_EVENT_LIST /end DAQ_EVENT
 /end IF_DATA
/end MEASUREMENT
/begin MEASUREMENT B_dkttk "Catalyst monitoring stopped due to catalyst temperature" UBYTE B_TRUE 1 100 0.00 1.00000000000 BIT_MASK 0x4 FORMAT "%13.11" ECU_ADDRESS 0x400088A2
 /begin IF_DATA XCPplus 0x0102
  /begin DAQ_EVENT VARIABLE /begin AVAILABLE_EVENT_LIST EVENT 0 EVENT 1 EVENT 2 EVENT 3 /end AVAILABLE_EVENT_LIST /begin DEFAULT_EVENT_LIST EVENT 2 /end DEFAULT_EVENT_LIST /end DAQ_EVENT
 /end IF_DATA
/end MEASUREMENT
/begin MEASUREMENT B_dlaff "Number of valid Tp measurements reached since B_dlatp=1" UBYTE B_TRUE 1 100 0.00 1.00000000000 BIT_MASK 0x2 FORMAT "%13.11" ECU_ADDRESS 0x400088C7
 /begin IF_DATA XCPplus 0x0102
  /begin DAQ_EVENT VARIABLE /begin AVAILABLE_EVENT_LIST EVENT 0 EVENT 1 EVENT 2 EVENT 3 /end AVAILABLE_EVENT_LIST /begin DEFAULT_EVENT_LIST EVENT 1 /end DEFAULT_EVENT_LIST /end DAQ_EVENT
 /end IF_DATA
/end MEASUREMENT
/begin MEASUREMENT B_dlahi "Enable calculation of dlahi" UBYTE B_TRUE 1 100 0.00 1.00000000000 BIT_MASK 0x1 FORMAT "%13.11" ECU_ADDRESS 0x400088C1 /end MEASUREMENT
/begin MEASUREMENT B_dlash "Condition Enable oscillation check downstream catalyst" UBYTE B_TRUE 1 100 0.00 1.00000000000 BIT_MASK 0x4 FORMAT "%13.11" ECU_ADDRESS 0x400088D2 /end MEASUREMENT
/begin MEASUREMENT B_dlashkf "Condition Enable oscillation check downstream catalyst - Stuck high" UBYTE B_TRUE 1 100 0.00 1.00000000000 BIT_MASK 0x4 FORMAT "%13.11" ECU_ADDRESS 0x400088DB /end MEASUREMENT
/begin MEASUREMENT B_dlashkm "Condition Enable oscillation check downstream catalyst - Stuck low" UBYTE B_TRUE 1 100 0.00 1.00000000000 BIT_MASK 0x2 FORMAT "%13.11" ECU_ADDRESS 0x400088DB /end MEASUREMENT
/begin MEASUREMENT B_dlash_FF "Flipflop of B_dlash" UBYTE B_TRUE 1 100 0.00 1.00000000000 BIT_MASK 0x1 FORMAT "%13.11" ECU_ADDRESS 0x4000C711 /end MEASUREMENT
/begin MEASUREMENT B_dlatp "condition for active diagnosis: lambda sensor aging TP" UBYTE B_TRUE 1 100 0.00 1.00000000000 BIT_MASK 0x1 FORMAT "%13.11" ECU_ADDRESS 0x400088C0
 /begin IF_DATA XCPplus 0x0102
  /begin DAQ_EVENT VARIABLE /begin AVAILABLE_EVENT_LIST EVENT 0 EVENT 1 EVENT 2 EVENT 3 /end AVAILABLE_EVENT_LIST /begin DEFAULT_EVENT_LIST EVENT 2 /end DEFAULT_EVENT_LIST /end DAQ_EVENT
 /end IF_DATA
/end MEASUREMENT
/begin MEASUREMENT B_dllr "DLLR:Detected overspeed error, release of integrator limit" UBYTE B_TRUE 1 100 0.00 1.00000000000 BIT_MASK 0x2 FORMAT "%13.11" ECU_ADDRESS 0x400088BA
 /begin IF_DATA XCPplus 0x0102
  /begin DAQ_EVENT VARIABLE /begin AVAILABLE_EVENT_LIST EVENT 0 EVENT 1 EVENT 2 EVENT 3 /end AVAILABLE_EVENT_LIST /begin DEFAULT_EVENT_LIST EVENT 3 /end DEFAULT_EVENT_LIST /end DAQ_EVENT
 /end IF_DATA
/end MEASUREMENT
/begin MEASUREMENT B_dllrebd "Condition physical prerequisites for DLLR release satisfied" UBYTE B_TRUE 1 100 0.00 1.00000000000 BIT_MASK 0x20 FORMAT "%13.11" ECU_ADDRESS 0x400088BD
 /begin IF_DATA XCPplus 0x0102
  /begin DAQ_EVENT VARIABLE /begin AVAILABLE_EVENT_LIST EVENT 0 EVENT 1 EVENT 2 EVENT 3 /end AVAILABLE_EVENT_LIST /begin DEFAULT_EVENT_LIST EVENT 3 /end DEFAULT_EVENT_LIST /end DAQ_EVENT
 /end IF_DATA
/end MEASUREMENT
/begin MEASUREMENT B_dllrfg "physical pre-condition DLLR (general)" UBYTE B_TRUE 1 100 0.00 1.00000000000 BIT_MASK 0x10 FORMAT "%13.11" ECU_ADDRESS 0x400088BA
 /begin IF_DATA XCPplus 0x0102
  /begin DAQ_EVENT VARIABLE /begin AVAILABLE_EVENT_LIST EVENT 0 EVENT 1 EVENT 2 EVENT 3 /end AVAILABLE_EVENT_LIST /begin DEFAULT_EVENT_LIST EVENT 3 /end DEFAULT_EVENT_LIST /end DAQ_EVENT
 /end IF_DATA
/end MEASUREMENT
/begin MEASUREMENT B_dllrkha "physical release condition for DLLR catalyst heating" UBYTE B_TRUE 1 100 0.00 1.00000000000 BIT_MASK 0x80 FORMAT "%13.11" ECU_ADDRESS 0x400088BA
 /begin IF_DATA XCPplus 0x0102
  /begin DAQ_EVENT VARIABLE /begin AVAILABLE_EVENT_LIST EVENT 0 EVENT 1 EVENT 2 EVENT 3 /end AVAILABLE_EVENT_LIST /begin DEFAULT_EVENT_LIST EVENT 3 /end DEFAULT_EVENT_LIST /end DAQ_EVENT
 /end IF_DATA
/end MEASUREMENT
/begin MEASUREMENT B_dora "Condition for detecting "" offset at steady state""" UBYTE B_TRUE 1 100 0.00 1.00000000000 BIT_MASK 0x2 FORMAT "%13.11" ECU_ADDRESS 0x400088B4
 /begin IF_DATA XCPplus 0x0102
  /begin DAQ_EVENT VARIABLE /begin AVAILABLE_EVENT_LIST EVENT 0 EVENT 1 EVENT 2 EVENT 3 /end AVAILABLE_EVENT_LIST /begin DEFAULT_EVENT_LIST EVENT 3 /end DEFAULT_EVENT_LIST /end DAQ_EVENT
 /end IF_DATA
/end MEASUREMENT
/begin MEASUREMENT B_dshen "condition enable sensor diagnosis downstream catalyst" UBYTE B_TRUE 1 100 0.00 1.00000000000 BIT_MASK 0x8 FORMAT "%13.11" ECU_ADDRESS 0x400088E9 /end MEASUREMENT
/begin MEASUREMENT B_dshk "Condition diagnosis in %DLSH and %DHLS with o.k. downstream cat report" UBYTE B_TRUE 1 100 0.00 1.00000000000 BIT_MASK 0x1 FORMAT "%13.11" ECU_ADDRESS 0x400088D6 /end MEASUREMENT
/begin MEASUREMENT B_dsven "condition enable sensor diagnosis upstream catalyst" UBYTE B_TRUE 1 100 0.00 1.00000000000 BIT_MASK 0x1 FORMAT "%13.11" ECU_ADDRESS 0x40008908
 /begin IF_DATA XCPplus 0x0102
  /begin DAQ_EVENT VARIABLE /begin AVAILABLE_EVENT_LIST EVENT 0 EVENT 1 EVENT 2 EVENT 3 /end AVAILABLE_EVENT_LIST /begin DEFAULT_EVENT_LIST EVENT 2 /end DEFAULT_EVENT_LIST /end DAQ_EVENT
 /end IF_DATA
/end MEASUREMENT
/begin MEASUREMENT B_dsvenel "condition enable (electrically) sensor diagnosis upstream catalyst" UBYTE B_TRUE 1 100 0.00 1.00000000000 BIT_MASK 0x2 FORMAT "%13.11" ECU_ADDRESS 0x40008913
 /begin IF_DATA XCPplus 0x0102
  /begin DAQ_EVENT VARIABLE /begin AVAILABLE_EVENT_LIST EVENT 0 EVENT 1 EVENT 2 EVENT 3 /end AVAILABLE_EVENT_LIST /begin DEFAULT_EVENT_LIST EVENT 2 /end DEFAULT_EVENT_LIST /end DAQ_EVENT
 /end IF_DATA
/end MEASUREMENT
/begin MEASUREMENT B_dushsch "Cond. threshold sen. downstream cat during fuel cut-off not undershot" UBYTE B_TRUE 1 100 0.00 1.00000000000 BIT_MASK 0x80 FORMAT "%13.11" ECU_ADDRESS 0x400088D6 /end MEASUREMENT
/begin MEASUREMENT B_edss "condition: DSS error (without debounce)" UBYTE B_TRUE 1 100 0.00 1.00000000000 BIT_MASK 0x1 FORMAT "%13.11" ECU_ADDRESS 0x4000892B
 /begin IF_DATA XCPplus 0x0102
  /begin DAQ_EVENT VARIABLE /begin AVAILABLE_EVENT_LIST EVENT 0 EVENT 1 EVENT 2 EVENT 3 /end AVAILABLE_EVENT_LIST /begin DEFAULT_EVENT_LIST EVENT 0 /end DEFAULT_EVENT_LIST /end DAQ_EVENT
 /end IF_DATA
/end MEASUREMENT
/begin MEASUREMENT B_enlash "Condition test for oscillation check terminated downstream cat" UBYTE B_TRUE 1 100 0.00 1.00000000000 BIT_MASK 0x20 FORMAT "%13.11" ECU_ADDRESS 0x400088D6 /end MEASUREMENT
/begin MEASUREMENT B_enmod "Condition modeled Holding Time Elapsed for IUMPR-ramp test" UBYTE B_TRUE 1 100 0.00 1.00000000000 BIT_MASK 0x8 FORMAT "%13.11" ECU_ADDRESS 0x400088DB /end MEASUREMENT
/begin MEASUREMENT B_entest "Condition Holding Time Elapsed for test diagnosis of sensor downstream of cataly" UBYTE B_TRUE 1 100 0.00 1.00000000000 BIT_MASK 0x8 FORMAT "%13.11" ECU_ADDRESS 0x400088D6 /end MEASUREMENT
/begin MEASUREMENT B_eol "end of line modus active" UBYTE B_TRUE 1 100 0.00 1.00000000000 BIT_MASK 0x1 FORMAT "%13.11" ECU_ADDRESS 0x40008914
 /begin IF_DATA XCPplus 0x0102
  /begin DAQ_EVENT VARIABLE /begin AVAILABLE_EVENT_LIST EVENT 0 EVENT 1 EVENT 2 EVENT 3 /end AVAILABLE_EVENT_LIST /begin DEFAULT_EVENT_LIST EVENT 2 /end DEFAULT_EVENT_LIST /end DAQ_EVENT
 /end IF_DATA
/end MEASUREMENT
/begin MEASUREMENT B_epldss "non plausible error of manifold pressure sensor" UBYTE B_TRUE 1 100 0.00 1.00000000000 BIT_MASK 0x1 FORMAT "%13.11" ECU_ADDRESS 0x4000892A
 /begin IF_DATA XCPplus 0x0102
  /begin DAQ_EVENT VARIABLE /begin AVAILABLE_EVENT_LIST EVENT 0 EVENT 1 EVENT 2 EVENT 3 /end AVAILABLE_EVENT_LIST /begin DEFAULT_EVENT_LIST EVENT 2 /end DEFAULT_EVENT_LIST /end DAQ_EVENT
 /end IF_DATA
/end MEASUREMENT
/begin MEASUREMENT B_erdkt "Internal fault at catalyst diagnosis" UBYTE B_TRUE 1 100 0.00 1.00000000000 BIT_MASK 0x8 FORMAT "%13.11" ECU_ADDRESS 0x400088A2
 /begin IF_DATA XCPplus 0x0102
  /begin DAQ_EVENT VARIABLE /begin AVAILABLE_EVENT_LIST EVENT 0 EVENT 1 EVENT 2 EVENT 3 /end AVAILABLE_EVENT_LIST /begin DEFAULT_EVENT_LIST EVENT 2 /end DEFAULT_EVENT_LIST /end DAQ_EVENT
 /end IF_DATA
/end MEASUREMENT
/begin MEASUREMENT B_erngmax "Condition: max range error for DSS" UBYTE B_TRUE 1 100 0.00 1.00000000000 BIT_MASK 0x1 FORMAT "%13.11" ECU_ADDRESS 0x40008929
 /begin IF_DATA XCPplus 0x0102
  /begin DAQ_EVENT VARIABLE /begin AVAILABLE_EVENT_LIST EVENT 0 EVENT 1 EVENT 2 EVENT 3 /end AVAILABLE_EVENT_LIST /begin DEFAULT_EVENT_LIST EVENT 2 /end DEFAULT_EVENT_LIST /end DAQ_EVENT
 /end IF_DATA
/end MEASUREMENT
/begin MEASUREMENT B_erngmin "Condition: min range error for DSS" UBYTE B_TRUE 1 100 0.00 1.00000000000 BIT_MASK 0x1 FORMAT "%13.11" ECU_ADDRESS 0x40008928
 /begin IF_DATA XCPplus 0x0102
  /begin DAQ_EVENT VARIABLE /begin AVAILABLE_EVENT_LIST EVENT 0 EVENT 1 EVENT 2 EVENT 3 /end AVAILABLE_EVENT_LIST /begin DEFAULT_EVENT_LIST EVENT 2 /end DEFAULT_EVENT_LIST /end DAQ_EVENT
 /end IF_DATA
/end MEASUREMENT
/begin MEASUREMENT B_errmnpl "Error condition: Minimum error for plausibility check of manifold pressure sensor" UBYTE B_TRUE 1 100 0.00 1.00000000000 BIT_MASK 0x1 FORMAT "%13.11" ECU_ADDRESS 0x40008927
 /begin IF_DATA XCPplus 0x0102
  /begin DAQ_EVENT VARIABLE /begin AVAILABLE_EVENT_LIST EVENT 0 EVENT 1 EVENT 2 EVENT 3 /end AVAILABLE_EVENT_LIST /begin DEFAULT_EVENT_LIST EVENT 2 /end DEFAULT_EVENT_LIST /end DAQ_EVENT
 /end IF_DATA
/end MEASUREMENT
/begin MEASUREMENT B_errmxpl "Error condition: Maximum error for plausibility check of manifold pressure sensor" UBYTE B_TRUE 1 100 0.00 1.00000000000 BIT_MASK 0x1 FORMAT "%13.11" ECU_ADDRESS 0x40008926
 /begin IF_DATA XCPplus 0x0102
  /begin DAQ_EVENT VARIABLE /begin AVAILABLE_EVENT_LIST EVENT 0 EVENT 1 EVENT 2 EVENT 3 /end AVAILABLE_EVENT_LIST /begin DEFAULT_EVENT_LIST EVENT 2 /end DEFAULT_EVENT_LIST /end DAQ_EVENT
 /end IF_DATA
/end MEASUREMENT
/begin MEASUREMENT B_errorafra "Error flag to indicate error in ora or fra" UBYTE B_TRUE 1 100 0.00 1.00000000000 BIT_MASK 0x1 FORMAT "%13.11" ECU_ADDRESS 0x400088B9
 /begin IF_DATA XCPplus 0x0102
  /begin DAQ_EVENT VARIABLE /begin AVAILABLE_EVENT_LIST EVENT 0 EVENT 1 EVENT 2 EVENT 3 /end AVAILABLE_EVENT_LIST /begin DEFAULT_EVENT_LIST EVENT 3 /end DEFAULT_EVENT_LIST /end DAQ_EVENT
 /end IF_DATA
/end MEASUREMENT
/begin MEASUREMENT B_esgnps "Condition for set sensor signal stuck error" UBYTE B_TRUE 1 100 0.00 1.00000000000 BIT_MASK 0x1 FORMAT "%13.11" ECU_ADDRESS 0x40008925
 /begin IF_DATA XCPplus 0x0102
  /begin DAQ_EVENT VARIABLE /begin AVAILABLE_EVENT_LIST EVENT 0 EVENT 1 EVENT 2 EVENT 3 /end AVAILABLE_EVENT_LIST /begin DEFAULT_EVENT_LIST EVENT 0 /end DEFAULT_EVENT_LIST /end DAQ_EVENT
 /end IF_DATA
/end MEASUREMENT
/begin MEASUREMENT B_esmnllr "Condition minimum engine speed error suspicion" UBYTE B_TRUE 1 100 0.00 1.00000000000 BIT_MASK 0x2 FORMAT "%13.11" ECU_ADDRESS 0x400088BD
 /begin IF_DATA XCPplus 0x0102
  /begin DAQ_EVENT VARIABLE /begin AVAILABLE_EVENT_LIST EVENT 0 EVENT 1 EVENT 2 EVENT 3 /end AVAILABLE_EVENT_LIST /begin DEFAULT_EVENT_LIST EVENT 3 /end DEFAULT_EVENT_LIST /end DAQ_EVENT
 /end IF_DATA
/end MEASUREMENT
/begin MEASUREMENT B_esmxllr "Condition maximum engine speed error suspicion" UBYTE B_TRUE 1 100 0.00 1.00000000000 BIT_MASK 0x4 FORMAT "%13.11" ECU_ADDRESS 0x400088BD
 /begin IF_DATA XCPplus 0x0102
  /begin DAQ_EVENT VARIABLE /begin AVAILABLE_EVENT_LIST EVENT 0 EVENT 1 EVENT 2 EVENT 3 /end AVAILABLE_EVENT_LIST /begin DEFAULT_EVENT_LIST EVENT 3 /end DEFAULT_EVENT_LIST /end DAQ_EVENT
 /end IF_DATA
/end MEASUREMENT
/begin MEASUREMENT B_esnpllr "Condition non-plausibel engine speed error suspicion" UBYTE B_TRUE 1 100 0.00 1.00000000000 BIT_MASK 0x2 FORMAT "%13.11" ECU_ADDRESS 0x400088BB
 /begin IF_DATA XCPplus 0x0102
  /begin DAQ_EVENT VARIABLE /begin AVAILABLE_EVENT_LIST EVENT 0 EVENT 1 EVENT 2 EVENT 3 /end AVAILABLE_EVENT_LIST /begin DEFAULT_EVENT_LIST EVENT 3 /end DEFAULT_EVENT_LIST /end DAQ_EVENT
 /end IF_DATA
/end MEASUREMENT
/begin MEASUREMENT B_fgadss "condition enable evaluation DSS" UBYTE B_TRUE 1 100 0.00 1.00000000000 BIT_MASK 0x1 FORMAT "%13.11" ECU_ADDRESS 0x40008924
 /begin IF_DATA XCPplus 0x0102
  /begin DAQ_EVENT VARIABLE /begin AVAILABLE_EVENT_LIST EVENT 0 EVENT 1 EVENT 2 EVENT 3 /end AVAILABLE_EVENT_LIST /begin DEFAULT_EVENT_LIST EVENT 2 /end DEFAULT_EVENT_LIST /end DAQ_EVENT
 /end IF_DATA
/end MEASUREMENT
/begin MEASUREMENT B_fpsrpl "Condition: Release of model-based intake manifold pressure diagnosis" UBYTE B_TRUE 1 100 0.00 1.00000000000 BIT_MASK 0x1 FORMAT "%13.11" ECU_ADDRESS 0x40008923
 /begin IF_DATA XCPplus 0x0102
  /begin DAQ_EVENT VARIABLE /begin AVAILABLE_EVENT_LIST EVENT 0 EVENT 1 EVENT 2 EVENT 3 /end AVAILABLE_EVENT_LIST /begin DEFAULT_EVENT_LIST EVENT 2 /end DEFAULT_EVENT_LIST /end DAQ_EVENT
 /end IF_DATA
/end MEASUREMENT
/begin MEASUREMENT B_fraef "fra in steady state" UBYTE B_TRUE 1 100 0.00 1.00000000000 BIT_MASK 0x4 FORMAT "%13.11" ECU_ADDRESS 0x400088B4
 /begin IF_DATA XCPplus 0x0102
  /begin DAQ_EVENT VARIABLE /begin AVAILABLE_EVENT_LIST EVENT 0 EVENT 1 EVENT 2 EVENT 3 /end AVAILABLE_EVENT_LIST /begin DEFAULT_EVENT_LIST EVENT 3 /end DEFAULT_EVENT_LIST /end DAQ_EVENT
 /end IF_DATA
/end MEASUREMENT
/begin MEASUREMENT B_framn "Minimum multiplicative correction of LRA within the range" UBYTE B_TRUE 1 100 0.00 1.00000000000 BIT_MASK 0x1 FORMAT "%13.11" ECU_ADDRESS 0x400088B8
 /begin IF_DATA XCPplus 0x0102
  /begin DAQ_EVENT VARIABLE /begin AVAILABLE_EVENT_LIST EVENT 0 EVENT 1 EVENT 2 EVENT 3 /end AVAILABLE_EVENT_LIST /begin DEFAULT_EVENT_LIST EVENT 3 /end DEFAULT_EVENT_LIST /end DAQ_EVENT
 /end IF_DATA
/end MEASUREMENT
/begin MEASUREMENT B_framx "Maximum multiplicative correction of LRA within the range" UBYTE B_TRUE 1 100 0.00 1.00000000000 BIT_MASK 0x1 FORMAT "%13.11" ECU_ADDRESS 0x400088B7
 /begin IF_DATA XCPplus 0x0102
  /begin DAQ_EVENT VARIABLE /begin AVAILABLE_EVENT_LIST EVENT 0 EVENT 1 EVENT 2 EVENT 3 /end AVAILABLE_EVENT_LIST /begin DEFAULT_EVENT_LIST EVENT 3 /end DEFAULT_EVENT_LIST /end DAQ_EVENT
 /end IF_DATA
/end MEASUREMENT
/begin MEASUREMENT B_gae "condition for adaptive Lambda pilot control successful" UBYTE B_TRUE 1 100 0.00 1.00000000000 BIT_MASK 0x8 FORMAT "%13.11" ECU_ADDRESS 0x400088B4
 /begin IF_DATA XCPplus 0x0102
  /begin DAQ_EVENT VARIABLE /begin AVAILABLE_EVENT_LIST EVENT 0 EVENT 1 EVENT 2 EVENT 3 /end AVAILABLE_EVENT_LIST /begin DEFAULT_EVENT_LIST EVENT 3 /end DEFAULT_EVENT_LIST /end DAQ_EVENT
 /end IF_DATA
/end MEASUREMENT
/begin MEASUREMENT B_gaef "condition for adaptive Lambda pilot control successful for gasoline fuel" UBYTE B_TRUE 1 100 0.00 1.00000000000 BIT_MASK 0x10 FORMAT "%13.11" ECU_ADDRESS 0x400088B4
 /begin IF_DATA XCPplus 0x0102
  /begin DAQ_EVENT VARIABLE /begin AVAILABLE_EVENT_LIST EVENT 0 EVENT 1 EVENT 2 EVENT 3 /end AVAILABLE_EVENT_LIST /begin DEFAULT_EVENT_LIST EVENT 3 /end DEFAULT_EVENT_LIST /end DAQ_EVENT
 /end IF_DATA
/end MEASUREMENT
/begin MEASUREMENT B_healrng "Condition: healing for DSS range check" UBYTE B_TRUE 1 100 0.00 1.00000000000 BIT_MASK 0x1 FORMAT "%13.11" ECU_ADDRESS 0x40008922
 /begin IF_DATA XCPplus 0x0102
  /begin DAQ_EVENT VARIABLE /begin AVAILABLE_EVENT_LIST EVENT 0 EVENT 1 EVENT 2 EVENT 3 /end AVAILABLE_EVENT_LIST /begin DEFAULT_EVENT_LIST EVENT 2 /end DEFAULT_EVENT_LIST /end DAQ_EVENT
 /end IF_DATA
/end MEASUREMENT
/begin MEASUREMENT B_heplsr "Condition for healing of plausibility-diagnosis manifold-pressure sensor" UBYTE B_TRUE 1 100 0.00 1.00000000000 BIT_MASK 0x1 FORMAT "%13.11" ECU_ADDRESS 0x40008921
 /begin IF_DATA XCPplus 0x0102
  /begin DAQ_EVENT VARIABLE /begin AVAILABLE_EVENT_LIST EVENT 0 EVENT 1 EVENT 2 EVENT 3 /end AVAILABLE_EVENT_LIST /begin DEFAULT_EVENT_LIST EVENT 2 /end DEFAULT_EVENT_LIST /end DAQ_EVENT
 /end IF_DATA
/end MEASUREMENT
/begin MEASUREMENT B_hzkfh "Condition fault heater-couppling downstream main cat" UBYTE B_TRUE 1 100 0.00 1.00000000000 BIT_MASK 0x1 FORMAT "%13.11" ECU_ADDRESS 0x400088E7 /end MEASUREMENT
/begin MEASUREMENT B_hzkfv "Condition fault heater-couppling upstream cat" UBYTE B_TRUE 1 100 0.00 1.00000000000 BIT_MASK 0x1 FORMAT "%13.11" ECU_ADDRESS 0x40008907
 /begin IF_DATA XCPplus 0x0102
  /begin DAQ_EVENT VARIABLE /begin AVAILABLE_EVENT_LIST EVENT 0 EVENT 1 EVENT 2 EVENT 3 /end AVAILABLE_EVENT_LIST /begin DEFAULT_EVENT_LIST EVENT 1 /end DEFAULT_EVENT_LIST /end DAQ_EVENT
 /end IF_DATA
/end MEASUREMENT
/begin MEASUREMENT B_hzkhzyk "Condition heater-couppling for formation cycle flag downstr. main cat" UBYTE B_TRUE 1 100 0.00 1.00000000000 BIT_MASK 0x10 FORMAT "%13.11" ECU_ADDRESS 0x400088EA /end MEASUREMENT
/begin MEASUREMENT B_hzkvzyk "Cond. heater-couppling for formation cycle flag upstr. cat bank2" UBYTE B_TRUE 1 100 0.00 1.00000000000 BIT_MASK 0x1 FORMAT "%13.11" ECU_ADDRESS 0x40008912
 /begin IF_DATA XCPplus 0x0102
  /begin DAQ_EVENT VARIABLE /begin AVAILABLE_EVENT_LIST EVENT 0 EVENT 1 EVENT 2 EVENT 3 /end AVAILABLE_EVENT_LIST /begin DEFAULT_EVENT_LIST EVENT 1 /end DEFAULT_EVENT_LIST /end DAQ_EVENT
 /end IF_DATA
/end MEASUREMENT
/begin MEASUREMENT B_hzoffh "Condition heater disconnecting downstream main cat" UBYTE B_TRUE 1 100 0.00 1.00000000000 BIT_MASK 0x1 FORMAT "%13.11" ECU_ADDRESS 0x400088EA /end MEASUREMENT
/begin MEASUREMENT B_hzoffv "Condition heater disconnecting upstream catalyst" UBYTE B_TRUE 1 100 0.00 1.00000000000 BIT_MASK 0x4 FORMAT "%13.11" ECU_ADDRESS 0x4000890E
 /begin IF_DATA XCPplus 0x0102
  /begin DAQ_EVENT VARIABLE /begin AVAILABLE_EVENT_LIST EVENT 0 EVENT 1 EVENT 2 EVENT 3 /end AVAILABLE_EVENT_LIST /begin DEFAULT_EVENT_LIST EVENT 1 /end DEFAULT_EVENT_LIST /end DAQ_EVENT
 /end IF_DATA
/end MEASUREMENT
/begin MEASUREMENT B_kupplheal "Condition clutch pressed observation once in driving cycle" UBYTE B_TRUE 1 100 0.00 1.00000000000 BIT_MASK 0x1 FORMAT "%13.11" ECU_ADDRESS 0x400088B3
 /begin IF_DATA XCPplus 0x0102
  /begin DAQ_EVENT VARIABLE /begin AVAILABLE_EVENT_LIST EVENT 0 EVENT 1 EVENT 2 EVENT 3 /end AVAILABLE_EVENT_LIST /begin DEFAULT_EVENT_LIST EVENT 1 /end DEFAULT_EVENT_LIST /end DAQ_EVENT
 /end IF_DATA
/end MEASUREMENT
/begin MEASUREMENT B_lamdiag "Lambda nominal value called by diagnosis function" UBYTE B_TRUE 1 100 0.00 1.00000000000 BIT_MASK 0x2 FORMAT "%13.11" ECU_ADDRESS 0x400088D2 /end MEASUREMENT
/begin MEASUREMENT B_lamend "Condition end of the Lambda adjustment in %LAMKO downstr. cat" UBYTE B_TRUE 1 100 0.00 1.00000000000 BIT_MASK 0x4 FORMAT "%13.11" ECU_ADDRESS 0x400088D6 /end MEASUREMENT
/begin MEASUREMENT B_lammod "Cond. enable modeled IUMPR-ramp test" UBYTE B_TRUE 1 100 0.00 1.00000000000 BIT_MASK 0x10 FORMAT "%13.11" ECU_ADDRESS 0x400088DB /end MEASUREMENT
/begin MEASUREMENT B_lashken "condition enable sensor ageing-diagnosis downstream catalyst" UBYTE B_TRUE 1 100 0.00 1.00000000000 BIT_MASK 0x1 FORMAT "%13.11" ECU_ADDRESS 0x400088DC /end MEASUREMENT
/begin MEASUREMENT B_lrstat "static condition for lambda controller" UBYTE B_TRUE 1 100 0.00 1.00000000000 BIT_MASK 0x4 FORMAT "%13.11" ECU_ADDRESS 0x400088C7
 /begin IF_DATA XCPplus 0x0102
  /begin DAQ_EVENT VARIABLE /begin AVAILABLE_EVENT_LIST EVENT 0 EVENT 1 EVENT 2 EVENT 3 /end AVAILABLE_EVENT_LIST /begin DEFAULT_EVENT_LIST EVENT 1 /end DEFAULT_EVENT_LIST /end DAQ_EVENT
 /end IF_DATA
/end MEASUREMENT
/begin MEASUREMENT B_lrtpp "Periodic time valid, static cond. for %LR (amplitude/periodic time) = TRUE" UBYTE B_TRUE 1 100 0.00 1.00000000000 BIT_MASK 0x2 FORMAT "%13.11" ECU_ADDRESS 0x400088C8
 /begin IF_DATA XCPplus 0x0102
  /begin DAQ_EVENT VARIABLE /begin AVAILABLE_EVENT_LIST EVENT 0 EVENT 1 EVENT 2 EVENT 3 /end AVAILABLE_EVENT_LIST /begin DEFAULT_EVENT_LIST EVENT 1 /end DEFAULT_EVENT_LIST /end DAQ_EVENT
 /end IF_DATA
/end MEASUREMENT
/begin MEASUREMENT B_lsads "condition for lambda sensor upstream cat SC wire to wire" UBYTE B_TRUE 1 100 0.00 1.00000000000 BIT_MASK 0x1 FORMAT "%13.11" ECU_ADDRESS 0x4000C713
 /begin IF_DATA XCPplus 0x0102
  /begin DAQ_EVENT VARIABLE /begin AVAILABLE_EVENT_LIST EVENT 0 EVENT 1 EVENT 2 EVENT 3 /end AVAILABLE_EVENT_LIST /begin DEFAULT_EVENT_LIST EVENT 2 /end DEFAULT_EVENT_LIST /end DAQ_EVENT
 /end IF_DATA
/end MEASUREMENT
/begin MEASUREMENT B_lsastp "flag for general disabling conditions for DLSA" UBYTE B_TRUE 1 100 0.00 1.00000000000 BIT_MASK 0x4 FORMAT "%13.11" ECU_ADDRESS 0x400088C8
 /begin IF_DATA XCPplus 0x0102
  /begin DAQ_EVENT VARIABLE /begin AVAILABLE_EVENT_LIST EVENT 0 EVENT 1 EVENT 2 EVENT 3 /end AVAILABLE_EVENT_LIST /begin DEFAULT_EVENT_LIST EVENT 2 /end DEFAULT_EVENT_LIST /end DAQ_EVENT
 /end IF_DATA
/end MEASUREMENT
/begin MEASUREMENT B_lsfet "condition for sensor voltage current leakage to UBatt upstream cat" UBYTE B_TRUE 1 100 0.00 1.00000000000 BIT_MASK 0x1 FORMAT "%13.11" ECU_ADDRESS 0x4000C712
 /begin IF_DATA XCPplus 0x0102
  /begin DAQ_EVENT VARIABLE /begin AVAILABLE_EVENT_LIST EVENT 0 EVENT 1 EVENT 2 EVENT 3 /end AVAILABLE_EVENT_LIST /begin DEFAULT_EVENT_LIST EVENT 2 /end DEFAULT_EVENT_LIST /end DAQ_EVENT
 /end IF_DATA
/end MEASUREMENT
/begin MEASUREMENT B_lshklt "condition cold oxygen sensor downstream catalyst" UBYTE B_TRUE 1 100 0.00 1.00000000000 BIT_MASK 0x1 FORMAT "%13.11" ECU_ADDRESS 0x400088E6 /end MEASUREMENT
/begin MEASUREMENT B_lshub "condition for lambda sensor upstream cat with restricted signal amplitude" UBYTE B_TRUE 1 100 0.00 1.00000000000 BIT_MASK 0x2 FORMAT "%13.11" ECU_ADDRESS 0x4000C713
 /begin IF_DATA XCPplus 0x0102
  /begin DAQ_EVENT VARIABLE /begin AVAILABLE_EVENT_LIST EVENT 0 EVENT 1 EVENT 2 EVENT 3 /end AVAILABLE_EVENT_LIST /begin DEFAULT_EVENT_LIST EVENT 2 /end DEFAULT_EVENT_LIST /end DAQ_EVENT
 /end IF_DATA
/end MEASUREMENT
/begin MEASUREMENT B_lsvklt "condition cold oxygen sensor upstream catalyst" UBYTE B_TRUE 1 100 0.00 1.00000000000 BIT_MASK 0x4 FORMAT "%13.11" ECU_ADDRESS 0x40008908
 /begin IF_DATA XCPplus 0x0102
  /begin DAQ_EVENT VARIABLE /begin AVAILABLE_EVENT_LIST EVENT 0 EVENT 1 EVENT 2 EVENT 3 /end AVAILABLE_EVENT_LIST /begin DEFAULT_EVENT_LIST EVENT 2 /end DEFAULT_EVENT_LIST /end DAQ_EVENT
 /end IF_DATA
/end MEASUREMENT
/begin MEASUREMENT B_maxdlahi "Condition for fault type ""maximum value"" for dlahi -test upstr. cat" UBYTE B_TRUE 1 100 0.00 1.00000000000 BIT_MASK 0x1 FORMAT "%13.11" ECU_ADDRESS 0x400088CF /end MEASUREMENT
/begin MEASUREMENT B_maxflsh "Short-circuit to UBatt on sensor downstream catalyst detected" UBYTE B_TRUE 1 100 0.00 1.00000000000 BIT_MASK 0x10 FORMAT "%13.11" ECU_ADDRESS 0x400088E9 /end MEASUREMENT
/begin MEASUREMENT B_maxflsv "Short circiut to battery voltage at O2 sensor pre cat" UBYTE B_TRUE 1 100 0.00 1.00000000000 BIT_MASK 0x1 FORMAT "%13.11" ECU_ADDRESS 0x40008906
 /begin IF_DATA XCPplus 0x0102
  /begin DAQ_EVENT VARIABLE /begin AVAILABLE_EVENT_LIST EVENT 0 EVENT 1 EVENT 2 EVENT 3 /end AVAILABLE_EVENT_LIST /begin DEFAULT_EVENT_LIST EVENT 2 /end DEFAULT_EVENT_LIST /end DAQ_EVENT
 /end IF_DATA
/end MEASUREMENT
/begin MEASUREMENT B_maxlash "Condition sensor-fault for ""max.value"" for oscillat. check downst.cat not detec." UBYTE B_TRUE 1 100 0.00 1.00000000000 BIT_MASK 0x40 FORMAT "%13.11" ECU_ADDRESS 0x400088D6 /end MEASUREMENT
/begin MEASUREMENT B_maxlatp "Cond. for fault type ""max. value"" for cycle durat. upstr. cat detect.`dyn' bank2" UBYTE B_TRUE 1 100 0.00 1.00000000000 BIT_MASK 0x1 FORMAT "%13.11" ECU_ADDRESS 0x400088BF
 /begin IF_DATA XCPplus 0x0102
  /begin DAQ_EVENT VARIABLE /begin AVAILABLE_EVENT_LIST EVENT 0 EVENT 1 EVENT 2 EVENT 3 /end AVAILABLE_EVENT_LIST /begin DEFAULT_EVENT_LIST EVENT 2 /end DEFAULT_EVENT_LIST /end DAQ_EVENT
 /end IF_DATA
/end MEASUREMENT
/begin MEASUREMENT B_mindlahi "Condition for fault type ""minimum value"" for dlahi -test upstream catalayst" UBYTE B_TRUE 1 100 0.00 1.00000000000 BIT_MASK 0x4 FORMAT "%13.11" ECU_ADDRESS 0x400088CF /end MEASUREMENT
/begin MEASUREMENT B_minflsh "Intercore short circuit or KS according to mass in sensor detected after CAT" UBYTE B_TRUE 1 100 0.00 1.00000000000 BIT_MASK 0x20 FORMAT "%13.11" ECU_ADDRESS 0x400088E9 /end MEASUREMENT
/begin MEASUREMENT B_minflsv "Intercore short circuit or short circuit detced after mass before CAT" UBYTE B_TRUE 1 100 0.00 1.00000000000 BIT_MASK 0x1 FORMAT "%13.11" ECU_ADDRESS 0x40008905
 /begin IF_DATA XCPplus 0x0102
  /begin DAQ_EVENT VARIABLE /begin AVAILABLE_EVENT_LIST EVENT 0 EVENT 1 EVENT 2 EVENT 3 /end AVAILABLE_EVENT_LIST /begin DEFAULT_EVENT_LIST EVENT 2 /end DEFAULT_EVENT_LIST /end DAQ_EVENT
 /end IF_DATA
/end MEASUREMENT
/begin MEASUREMENT B_minlash "Condition sensor-fault for ""min. value"" of oscillation check downstr. cat not detec." UBYTE B_TRUE 1 100 0.00 1.00000000000 BIT_MASK 0x1 FORMAT "%13.11" ECU_ADDRESS 0x400088D3 /end MEASUREMENT
/begin MEASUREMENT B_mslkmn "Minimum additive correction of LRA within the range" UBYTE B_TRUE 1 100 0.00 1.00000000000 BIT_MASK 0x1 FORMAT "%13.11" ECU_ADDRESS 0x400088B6
 /begin IF_DATA XCPplus 0x0102
  /begin DAQ_EVENT VARIABLE /begin AVAILABLE_EVENT_LIST EVENT 0 EVENT 1 EVENT 2 EVENT 3 /end AVAILABLE_EVENT_LIST /begin DEFAULT_EVENT_LIST EVENT 3 /end DEFAULT_EVENT_LIST /end DAQ_EVENT
 /end IF_DATA
/end MEASUREMENT
/begin MEASUREMENT B_mslkmx "Maximum additive correction of LRA within the range" UBYTE B_TRUE 1 100 0.00 1.00000000000 BIT_MASK 0x1 FORMAT "%13.11" ECU_ADDRESS 0x400088B5
 /begin IF_DATA XCPplus 0x0102
  /begin DAQ_EVENT VARIABLE /begin AVAILABLE_EVENT_LIST EVENT 0 EVENT 1 EVENT 2 EVENT 3 /end AVAILABLE_EVENT_LIST /begin DEFAULT_EVENT_LIST EVENT 3 /end DEFAULT_EVENT_LIST /end DAQ_EVENT
 /end IF_DATA
/end MEASUREMENT
/begin MEASUREMENT B_ncdlahi "Cond. Numerator Complete DLSA, dlahi monitoring" UBYTE B_TRUE 1 100 0.00 1.00000000000 BIT_MASK 0x4 FORMAT "%13.11" ECU_ADDRESS 0x400088D0 /end MEASUREMENT
/begin MEASUREMENT B_nclash "Condition Nominator Complete for DLSAHK" UBYTE B_TRUE 1 100 0.00 1.00000000000 BIT_MASK 0x20 FORMAT "%13.11" ECU_ADDRESS 0x400088DB /end MEASUREMENT
/begin MEASUREMENT B_nclatp "Cond. Numerator Complete DLSA, Periodtime" UBYTE B_TRUE 1 100 0.00 1.00000000000 BIT_MASK 0x1 FORMAT "%13.11" ECU_ADDRESS 0x400088D0
 /begin IF_DATA XCPplus 0x0102
  /begin DAQ_EVENT VARIABLE /begin AVAILABLE_EVENT_LIST EVENT 0 EVENT 1 EVENT 2 EVENT 3 /end AVAILABLE_EVENT_LIST /begin DEFAULT_EVENT_LIST EVENT 2 /end DEFAULT_EVENT_LIST /end DAQ_EVENT
 /end IF_DATA
/end MEASUREMENT
/begin MEASUREMENT B_noadsh "condition for no short-circuit downstream sensor" UBYTE B_TRUE 1 100 0.00 1.00000000000 BIT_MASK 0x1 FORMAT "%13.11" ECU_ADDRESS 0x400088F2 /end MEASUREMENT
/begin MEASUREMENT B_nodlahi "Condition for no error for dlahi -test upstr. cat" UBYTE B_TRUE 1 100 0.00 1.00000000000 BIT_MASK 0x8 FORMAT "%13.11" ECU_ADDRESS 0x400088CF /end MEASUREMENT
/begin MEASUREMENT B_nolashmn "Condition diagnosis finished with o.k. report" UBYTE B_TRUE 1 100 0.00 1.00000000000 BIT_MASK 0x1 FORMAT "%13.11" ECU_ADDRESS 0x400088DB /end MEASUREMENT
/begin MEASUREMENT B_nolashmx "Condition diagnosis oscillation check finished with o.k. report" UBYTE B_TRUE 1 100 0.00 1.00000000000 BIT_MASK 0x2 FORMAT "%13.11" ECU_ADDRESS 0x400088D3 /end MEASUREMENT
/begin MEASUREMENT B_nolatp "Condition diagnosis cycle duration finished with o.k. report" UBYTE B_TRUE 1 100 0.00 1.00000000000 BIT_MASK 0x10 FORMAT "%13.11" ECU_ADDRESS 0x400088CF
 /begin IF_DATA XCPplus 0x0102
  /begin DAQ_EVENT VARIABLE /begin AVAILABLE_EVENT_LIST EVENT 0 EVENT 1 EVENT 2 EVENT 3 /end AVAILABLE_EVENT_LIST /begin DEFAULT_EVENT_LIST EVENT 2 /end DEFAULT_EVENT_LIST /end DAQ_EVENT
 /end IF_DATA
/end MEASUREMENT
/begin MEASUREMENT B_nolsh "Condition diagnosis finished with o.k. downstream cat report" UBYTE B_TRUE 1 100 0.00 1.00000000000 BIT_MASK 0x4 FORMAT "%13.11" ECU_ADDRESS 0x400088E9 /end MEASUREMENT
/begin MEASUREMENT B_nolsv "Condition diagnosis finished with o.k. upstream cat report" UBYTE B_TRUE 1 100 0.00 1.00000000000 BIT_MASK 0x1 FORMAT "%13.11" ECU_ADDRESS 0x40008904
 /begin IF_DATA XCPplus 0x0102
  /begin DAQ_EVENT VARIABLE /begin AVAILABLE_EVENT_LIST EVENT 0 EVENT 1 EVENT 2 EVENT 3 /end AVAILABLE_EVENT_LIST /begin DEFAULT_EVENT_LIST EVENT 2 /end DEFAULT_EVENT_LIST /end DAQ_EVENT
 /end IF_DATA
/end MEASUREMENT
/begin MEASUREMENT B_nplflsh "Wire-to-wire SC on sensor downstream catalyst detected" UBYTE B_TRUE 1 100 0.00 1.00000000000 BIT_MASK 0x80 FORMAT "%13.11" ECU_ADDRESS 0x400088E9 /end MEASUREMENT
/begin MEASUREMENT B_nplflsv "Short circuit between cables at O2 sensor pre cat" UBYTE B_TRUE 1 100 0.00 1.00000000000 BIT_MASK 0x1 FORMAT "%13.11" ECU_ADDRESS 0x40008903
 /begin IF_DATA XCPplus 0x0102
  /begin DAQ_EVENT VARIABLE /begin AVAILABLE_EVENT_LIST EVENT 0 EVENT 1 EVENT 2 EVENT 3 /end AVAILABLE_EVENT_LIST /begin DEFAULT_EVENT_LIST EVENT 2 /end DEFAULT_EVENT_LIST /end DAQ_EVENT
 /end IF_DATA
/end MEASUREMENT
/begin MEASUREMENT B_oraef "ORA in steady state" UBYTE B_TRUE 1 100 0.00 1.00000000000 BIT_MASK 0x20 FORMAT "%13.11" ECU_ADDRESS 0x400088B4
 /begin IF_DATA XCPplus 0x0102
  /begin DAQ_EVENT VARIABLE /begin AVAILABLE_EVENT_LIST EVENT 0 EVENT 1 EVENT 2 EVENT 3 /end AVAILABLE_EVENT_LIST /begin DEFAULT_EVENT_LIST EVENT 3 /end DEFAULT_EVENT_LIST /end DAQ_EVENT
 /end IF_DATA
/end MEASUREMENT
/begin MEASUREMENT B_psrg "Condition manifold pressure valid" UBYTE B_TRUE 1 100 0.00 1.00000000000 BIT_MASK 0x1 FORMAT "%13.11" ECU_ADDRESS 0x40008920
 /begin IF_DATA XCPplus 0x0102
  /begin DAQ_EVENT VARIABLE /begin AVAILABLE_EVENT_LIST EVENT 0 EVENT 1 EVENT 2 EVENT 3 /end AVAILABLE_EVENT_LIST /begin DEFAULT_EVENT_LIST EVENT 0 /end DEFAULT_EVENT_LIST /end DAQ_EVENT
 /end IF_DATA
/end MEASUREMENT
/begin MEASUREMENT B_psrpl "Status for intake air manifold pressure value plausible" UBYTE B_TRUE 1 100 0.00 1.00000000000 BIT_MASK 0x1 FORMAT "%13.11" ECU_ADDRESS 0x4000891F
 /begin IF_DATA XCPplus 0x0102
  /begin DAQ_EVENT VARIABLE /begin AVAILABLE_EVENT_LIST EVENT 0 EVENT 1 EVENT 2 EVENT 3 /end AVAILABLE_EVENT_LIST /begin DEFAULT_EVENT_LIST EVENT 0 /end DEFAULT_EVENT_LIST /end DAQ_EVENT
 /end IF_DATA
/end MEASUREMENT
/begin MEASUREMENT B_refmax "Condition O2-sensor voltage in plausible area between USREF and USMAX,pre cat" UBYTE B_TRUE 1 100 0.00 1.00000000000 BIT_MASK 0x1 FORMAT "%13.11" ECU_ADDRESS 0x4000890D
 /begin IF_DATA XCPplus 0x0102
  /begin DAQ_EVENT VARIABLE /begin AVAILABLE_EVENT_LIST EVENT 0 EVENT 1 EVENT 2 EVENT 3 /end AVAILABLE_EVENT_LIST /begin DEFAULT_EVENT_LIST EVENT 1 /end DEFAULT_EVENT_LIST /end DAQ_EVENT
 /end IF_DATA
/end MEASUREMENT
/begin MEASUREMENT B_resgnps "Condition for reset sensor signal stuck error" UBYTE B_TRUE 1 100 0.00 1.00000000000 BIT_MASK 0x1 FORMAT "%13.11" ECU_ADDRESS 0x4000891E
 /begin IF_DATA XCPplus 0x0102
  /begin DAQ_EVENT VARIABLE /begin AVAILABLE_EVENT_LIST EVENT 0 EVENT 1 EVENT 2 EVENT 3 /end AVAILABLE_EVENT_LIST /begin DEFAULT_EVENT_LIST EVENT 0 /end DEFAULT_EVENT_LIST /end DAQ_EVENT
 /end IF_DATA
/end MEASUREMENT
/begin MEASUREMENT B_resmaxpl "Condition plausibility error throttle maximum" UBYTE B_TRUE 1 100 0.00 1.00000000000 BIT_MASK 0x1 FORMAT "%13.11" ECU_ADDRESS 0x4000891D
 /begin IF_DATA XCPplus 0x0102
  /begin DAQ_EVENT VARIABLE /begin AVAILABLE_EVENT_LIST EVENT 0 EVENT 1 EVENT 2 EVENT 3 /end AVAILABLE_EVENT_LIST /begin DEFAULT_EVENT_LIST EVENT 2 /end DEFAULT_EVENT_LIST /end DAQ_EVENT
 /end IF_DATA
/end MEASUREMENT
/begin MEASUREMENT B_resminpl "Condition plausibility error throttle minimum" UBYTE B_TRUE 1 100 0.00 1.00000000000 BIT_MASK 0x1 FORMAT "%13.11" ECU_ADDRESS 0x4000891C
 /begin IF_DATA XCPplus 0x0102
  /begin DAQ_EVENT VARIABLE /begin AVAILABLE_EVENT_LIST EVENT 0 EVENT 1 EVENT 2 EVENT 3 /end AVAILABLE_EVENT_LIST /begin DEFAULT_EVENT_LIST EVENT 2 /end DEFAULT_EVENT_LIST /end DAQ_EVENT
 /end IF_DATA
/end MEASUREMENT
/begin MEASUREMENT B_sbbhk "condition for lambda sensor downstream main cat ready for operation" UBYTE B_TRUE 1 100 0.00 1.00000000000 BIT_MASK 0x2 FORMAT "%13.11" ECU_ADDRESS 0x400088E9 /end MEASUREMENT
/begin MEASUREMENT B_sbbhkv "condition for lambda sensor downstream cat ready for operation delayed" UBYTE B_TRUE 1 100 0.00 1.00000000000 BIT_MASK 0x40 FORMAT "%13.11" ECU_ADDRESS 0x400088D4 /end MEASUREMENT
/begin MEASUREMENT B_sbbvk "condition for lambda sensor upstream cat ready for operation" UBYTE B_TRUE 1 100 0.00 1.00000000000 BIT_MASK 0x2 FORMAT "%13.11" ECU_ADDRESS 0x40008908
 /begin IF_DATA XCPplus 0x0102
  /begin DAQ_EVENT VARIABLE /begin AVAILABLE_EVENT_LIST EVENT 0 EVENT 1 EVENT 2 EVENT 3 /end AVAILABLE_EVENT_LIST /begin DEFAULT_EVENT_LIST EVENT 2 /end DEFAULT_EVENT_LIST /end DAQ_EVENT
 /end IF_DATA
/end MEASUREMENT
/begin MEASUREMENT B_scckat "status of Fid_dkat." UBYTE B_TRUE 1 100 0.00 1.00000000000 BIT_MASK 0x1 FORMAT "%13.11" ECU_ADDRESS 0x4000889F
 /begin IF_DATA XCPplus 0x0102
  /begin DAQ_EVENT VARIABLE /begin AVAILABLE_EVENT_LIST EVENT 0 EVENT 1 EVENT 2 EVENT 3 /end AVAILABLE_EVENT_LIST /begin DEFAULT_EVENT_LIST EVENT 2 /end DEFAULT_EVENT_LIST /end DAQ_EVENT
 /end IF_DATA
/end MEASUREMENT
/begin MEASUREMENT B_sigflsh "Signal interruption (wiring interruption) on sensor downstream catalyst detected" UBYTE B_TRUE 1 100 0.00 1.00000000000 BIT_MASK 0x40 FORMAT "%13.11" ECU_ADDRESS 0x400088E9 /end MEASUREMENT
/begin MEASUREMENT B_sigflsv "Signal interruption at O2 sensor upstream cat" UBYTE B_TRUE 1 100 0.00 1.00000000000 BIT_MASK 0x1 FORMAT "%13.11" ECU_ADDRESS 0x40008902
 /begin IF_DATA XCPplus 0x0102
  /begin DAQ_EVENT VARIABLE /begin AVAILABLE_EVENT_LIST EVENT 0 EVENT 1 EVENT 2 EVENT 3 /end AVAILABLE_EVENT_LIST /begin DEFAULT_EVENT_LIST EVENT 2 /end DEFAULT_EVENT_LIST /end DAQ_EVENT
 /end IF_DATA
/end MEASUREMENT
/begin MEASUREMENT B_szkat "cycle time and error one bank run out" UBYTE B_TRUE 1 100 0.00 1.00000000000 BIT_MASK 0x1 FORMAT "%13.11" ECU_ADDRESS 0x40008895
 /begin IF_DATA XCPplus 0x0102
  /begin DAQ_EVENT VARIABLE /begin AVAILABLE_EVENT_LIST EVENT 0 EVENT 1 EVENT 2 EVENT 3 /end AVAILABLE_EVENT_LIST /begin DEFAULT_EVENT_LIST EVENT 2 /end DEFAULT_EVENT_LIST /end DAQ_EVENT
 /end IF_DATA
/end MEASUREMENT
/begin MEASUREMENT B_teslash "Condition perform test for check of the sensor downstream catalyst" UBYTE B_TRUE 1 100 0.00 1.00000000000 BIT_MASK 0x10 FORMAT "%13.11" ECU_ADDRESS 0x400088D6 /end MEASUREMENT
/begin MEASUREMENT B_tfrae "Time condition for detecting "" Factor FRA at steady state" UBYTE B_TRUE 1 100 0.00 1.00000000000 BIT_MASK 0x40 FORMAT "%13.11" ECU_ADDRESS 0x400088B4
 /begin IF_DATA XCPplus 0x0102
  /begin DAQ_EVENT VARIABLE /begin AVAILABLE_EVENT_LIST EVENT 0 EVENT 1 EVENT 2 EVENT 3 /end AVAILABLE_EVENT_LIST /begin DEFAULT_EVENT_LIST EVENT 3 /end DEFAULT_EVENT_LIST /end DAQ_EVENT
 /end IF_DATA
/end MEASUREMENT
/begin MEASUREMENT B_tmdllrkh "Condition: start temperature below threshold for engine speed diagnosis catalyst heating" UBYTE B_TRUE 1 100 0.00 1.00000000000 BIT_MASK 0x4 FORMAT "%13.11" ECU_ADDRESS 0x400088BB /end MEASUREMENT
/begin MEASUREMENT B_torae "Time condition for detecting ""offset at steady state""" UBYTE B_TRUE 1 100 0.00 1.00000000000 BIT_MASK 0x80 FORMAT "%13.11" ECU_ADDRESS 0x400088B4
 /begin IF_DATA XCPplus 0x0102
  /begin DAQ_EVENT VARIABLE /begin AVAILABLE_EVENT_LIST EVENT 0 EVENT 1 EVENT 2 EVENT 3 /end AVAILABLE_EVENT_LIST /begin DEFAULT_EVENT_LIST EVENT 3 /end DEFAULT_EVENT_LIST /end DAQ_EVENT
 /end IF_DATA
/end MEASUREMENT
/begin MEASUREMENT B_trsa "Condition wiring interruption for sensor upstream catalyst" UBYTE B_TRUE 1 100 0.00 1.00000000000 BIT_MASK 0x1 FORMAT "%13.11" ECU_ADDRESS 0x40008901
 /begin IF_DATA XCPplus 0x0102
  /begin DAQ_EVENT VARIABLE /begin AVAILABLE_EVENT_LIST EVENT 0 EVENT 1 EVENT 2 EVENT 3 /end AVAILABLE_EVENT_LIST /begin DEFAULT_EVENT_LIST EVENT 2 /end DEFAULT_EVENT_LIST /end DAQ_EVENT
 /end IF_DATA
/end MEASUREMENT
/begin MEASUREMENT B_trsah "Condition wiring interruption for sensor downstream catalyst" UBYTE B_TRUE 1 100 0.00 1.00000000000 BIT_MASK 0x1 FORMAT "%13.11" ECU_ADDRESS 0x400088E5 /end MEASUREMENT
/begin MEASUREMENT B_ttbmhh "cond. theoretical lambda sensor operation readiness downstr. cat with heating" UBYTE B_TRUE 1 100 0.00 1.00000000000 BIT_MASK 0x1 FORMAT "%13.11" ECU_ADDRESS 0x400088E4 /end MEASUREMENT
/begin MEASUREMENT B_ttbmhv "condition theoretical lambda sensor operation readiness with heating upstream cat." UBYTE B_TRUE 1 100 0.00 1.00000000000 BIT_MASK 0x1 FORMAT "%13.11" ECU_ADDRESS 0x40008900
 /begin IF_DATA XCPplus 0x0102
  /begin DAQ_EVENT VARIABLE /begin AVAILABLE_EVENT_LIST EVENT 0 EVENT 1 EVENT 2 EVENT 3 /end AVAILABLE_EVENT_LIST /begin DEFAULT_EVENT_LIST EVENT 2 /end DEFAULT_EVENT_LIST /end DAQ_EVENT
 /end IF_DATA
/end MEASUREMENT
/begin MEASUREMENT B_tuschub "Cond. threshold sen. downstream cat during fuel cut-off undershot" UBYTE B_TRUE 1 100 0.00 1.00000000000 BIT_MASK 0x1 FORMAT "%13.11" ECU_ADDRESS 0x400088D8 /end MEASUREMENT
/begin MEASUREMENT B_tushzfh "Condition for time windows to heater coupling downstr. cat" UBYTE B_TRUE 1 100 0.00 1.00000000000 BIT_MASK 0x2 FORMAT "%13.11" ECU_ADDRESS 0x400088EA /end MEASUREMENT
/begin MEASUREMENT B_tushzfv "Condition for time windows to heater coupling upstr. cat" UBYTE B_TRUE 1 100 0.00 1.00000000000 BIT_MASK 0x8 FORMAT "%13.11" ECU_ADDRESS 0x4000890E
 /begin IF_DATA XCPplus 0x0102
  /begin DAQ_EVENT VARIABLE /begin AVAILABLE_EVENT_LIST EVENT 0 EVENT 1 EVENT 2 EVENT 3 /end AVAILABLE_EVENT_LIST /begin DEFAULT_EVENT_LIST EVENT 1 /end DEFAULT_EVENT_LIST /end DAQ_EVENT
 /end IF_DATA
/end MEASUREMENT
/begin MEASUREMENT B_uhsig "Con.sensor voltage downstr.cat.in the voltage range for signal interrupt." UBYTE B_TRUE 1 100 0.00 1.00000000000 BIT_MASK 0x1 FORMAT "%13.11" ECU_ADDRESS 0x400088E3 /end MEASUREMENT
/begin MEASUREMENT B_uschers "Flag simulated sufficient overrun measurement downstream catalyst" UBYTE B_TRUE 1 100 0.00 1.00000000000 BIT_MASK 0x40 FORMAT "%13.11" ECU_ADDRESS 0x400088DB /end MEASUREMENT
/begin MEASUREMENT B_ushkf "Condition sensor voltage downstream cat. ""Rich"" (set point exceeded)" UBYTE B_TRUE 1 100 0.00 1.00000000000 BIT_MASK 0x8 FORMAT "%13.11" ECU_ADDRESS 0x400088D2 /end MEASUREMENT
/begin MEASUREMENT B_ushkfr "Condition to reset Flip-flop" UBYTE B_TRUE 1 100 0.00 1.00000000000 BIT_MASK 0x80 FORMAT "%13.11" ECU_ADDRESS 0x400088D4 /end MEASUREMENT
/begin MEASUREMENT B_ushkm "Condition sensor voltage downstream catalyst ""Lean"" (set point undershot)" UBYTE B_TRUE 1 100 0.00 1.00000000000 BIT_MASK 0x1 FORMAT "%13.11" ECU_ADDRESS 0x400088D2 /end MEASUREMENT
/begin MEASUREMENT B_ushkmr "Condition to reset Flip-flop" UBYTE B_TRUE 1 100 0.00 1.00000000000 BIT_MASK 0x2 FORMAT "%13.11" ECU_ADDRESS 0x400088D8 /end MEASUREMENT
/begin MEASUREMENT B_uvsig "Condition O2 sensor voltage pre cat in voltage band for signal interruption" UBYTE B_TRUE 1 100 0.00 1.00000000000 BIT_MASK 0x1 FORMAT "%13.11" ECU_ADDRESS 0x4000890C
 /begin IF_DATA XCPplus 0x0102
  /begin DAQ_EVENT VARIABLE /begin AVAILABLE_EVENT_LIST EVENT 0 EVENT 1 EVENT 2 EVENT 3 /end AVAILABLE_EVENT_LIST /begin DEFAULT_EVENT_LIST EVENT 1 /end DEFAULT_EVENT_LIST /end DAQ_EVENT
 /end IF_DATA
/end MEASUREMENT
/begin MEASUREMENT B_zdkt "Condition: o.k. testing, catalyst monitoring" UBYTE B_TRUE 1 100 0.00 1.00000000000 BIT_MASK 0x1 FORMAT "%13.11" ECU_ADDRESS 0x400088AF
 /begin IF_DATA XCPplus 0x0102
  /begin DAQ_EVENT VARIABLE /begin AVAILABLE_EVENT_LIST EVENT 0 EVENT 1 EVENT 2 EVENT 3 /end AVAILABLE_EVENT_LIST /begin DEFAULT_EVENT_LIST EVENT 2 /end DEFAULT_EVENT_LIST /end DAQ_EVENT
 /end IF_DATA
/end MEASUREMENT
/begin MEASUREMENT B_zdlahi "Cond. ""malfunction could have been found"", dlahi-monitoring" UBYTE B_TRUE 1 100 0.00 1.00000000000 BIT_MASK 0x8 FORMAT "%13.11" ECU_ADDRESS 0x400088D0 /end MEASUREMENT
/begin MEASUREMENT B_zmdlahi "Cond. ""malfunction could have been found"", dlahi-monitoring model" UBYTE B_TRUE 1 100 0.00 1.00000000000 BIT_MASK 0x10 FORMAT "%13.11" ECU_ADDRESS 0x400088D0 /end MEASUREMENT
/begin MEASUREMENT B_zmodf "Condition modeled ramp towards ""Rich"" exceeded set point" UBYTE B_TRUE 1 100 0.00 1.00000000000 BIT_MASK 0x80 FORMAT "%13.11" ECU_ADDRESS 0x400088DB /end MEASUREMENT
/begin MEASUREMENT B_zmodh "Condition malfunction could have been found downstream cat" UBYTE B_TRUE 1 100 0.00 1.00000000000 BIT_MASK 0x1 FORMAT "%13.11" ECU_ADDRESS 0x400088DF /end MEASUREMENT
/begin MEASUREMENT B_zmodsch "IUMPR model of fault detection by fuel cut-off, ox. sens. dwstr. main cat" UBYTE B_TRUE 1 100 0.00 1.00000000000 BIT_MASK 0x2 FORMAT "%13.11" ECU_ADDRESS 0x400088DF /end MEASUREMENT
/begin MEASUREMENT dasactr "counter for fuel cut of for recognition for blocked idle speed actuator" UBYTE dez 1 100 0.00 255.0 FORMAT "%5.1" ECU_ADDRESS 0x400088BE
 /begin IF_DATA XCPplus 0x0102
  /begin DAQ_EVENT VARIABLE /begin AVAILABLE_EVENT_LIST EVENT 0 EVENT 1 EVENT 2 EVENT 3 /end AVAILABLE_EVENT_LIST /begin DEFAULT_EVENT_LIST EVENT 3 /end DEFAULT_EVENT_LIST /end DAQ_EVENT
 /end IF_DATA
/end MEASUREMENT
/begin MEASUREMENT Dem_BswErrorBufferWriteCounter "Write access counter" UWORD OneToOne 1 100 0.00 65535.00 FORMAT "%8.2" ECU_ADDRESS 0x40002CD6 /end MEASUREMENT
/begin MEASUREMENT Dem_BswErrorBufferWriteIndex "Write index for pre init buffer" UWORD OneToOne 1 100 0.00 65535.00 FORMAT "%8.2" ECU_ADDRESS 0x40002CD8 /end MEASUREMENT
/begin MEASUREMENT Dem_PTOSt "Current PTO active status reported to Dem" UBYTE OneToOne 1 100 0.00 255.0 BIT_MASK 0x1 FORMAT "%5.1" ECU_ADDRESS 0x40002E03 /end MEASUREMENT
/begin MEASUREMENT Dem_stInit "Initialization state of Dem" UBYTE OneToOne 1 100 0.00 255.0 FORMAT "%5.1" ECU_ADDRESS 0x40002E22 /end MEASUREMENT
/begin MEASUREMENT dkatakt_w "active monitoring time for DKAT" UWORD t_q0p05 1 100 0.00 3276.750 FORMAT "%8.3" ECU_ADDRESS 0x400084C6
 /begin IF_DATA XCPplus 0x0102
  /begin DAQ_EVENT VARIABLE /begin AVAILABLE_EVENT_LIST EVENT 0 EVENT 1 EVENT 2 EVENT 3 /end AVAILABLE_EVENT_LIST /begin DEFAULT_EVENT_LIST EVENT 2 /end DEFAULT_EVENT_LIST /end DAQ_EVENT
 /end IF_DATA
/end MEASUREMENT
/begin MEASUREMENT Dkuppl_qVN "Vehicle speed to Engine speed ratio" UWORD VelToN 1 100 0.00 0.6553500 FORMAT "%9.7" ECU_ADDRESS 0x400084CA
 /begin IF_DATA XCPplus 0x0102
  /begin DAQ_EVENT VARIABLE /begin AVAILABLE_EVENT_LIST EVENT 0 EVENT 1 EVENT 2 EVENT 3 /end AVAILABLE_EVENT_LIST /begin DEFAULT_EVENT_LIST EVENT 1 /end DEFAULT_EVENT_LIST /end DAQ_EVENT
 /end IF_DATA
/end MEASUREMENT
/begin MEASUREMENT Dkuppl_qVNFild "Vehicle speed to Engine speed ratio - filtered" UWORD VelToN 1 100 0.00 0.6553500 FORMAT "%9.7" ECU_ADDRESS 0x400084CE
 /begin IF_DATA XCPplus 0x0102
  /begin DAQ_EVENT VARIABLE /begin AVAILABLE_EVENT_LIST EVENT 0 EVENT 1 EVENT 2 EVENT 3 /end AVAILABLE_EVENT_LIST /begin DEFAULT_EVENT_LIST EVENT 1 /end DEFAULT_EVENT_LIST /end DAQ_EVENT
 /end IF_DATA
/end MEASUREMENT
/begin MEASUREMENT Dkuppl_stDrvState "Condition vehicle drive state" UBYTE B_TRUE 1 100 0.00 1.00000000000 BIT_MASK 0x1 FORMAT "%13.11" ECU_ADDRESS 0x400088B2
 /begin IF_DATA XCPplus 0x0102
  /begin DAQ_EVENT VARIABLE /begin AVAILABLE_EVENT_LIST EVENT 0 EVENT 1 EVENT 2 EVENT 3 /end AVAILABLE_EVENT_LIST /begin DEFAULT_EVENT_LIST EVENT 1 /end DEFAULT_EVENT_LIST /end DAQ_EVENT
 /end IF_DATA
/end MEASUREMENT
/begin MEASUREMENT Dkuppl_stStatyVehV "Condition stationary vehicle - detected through vehicle speed threshold" UBYTE B_TRUE 1 100 0.00 1.00000000000 BIT_MASK 0x1 FORMAT "%13.11" ECU_ADDRESS 0x400088B0
 /begin IF_DATA XCPplus 0x0102
  /begin DAQ_EVENT VARIABLE /begin AVAILABLE_EVENT_LIST EVENT 0 EVENT 1 EVENT 2 EVENT 3 /end AVAILABLE_EVENT_LIST /begin DEFAULT_EVENT_LIST EVENT 1 /end DEFAULT_EVENT_LIST /end DAQ_EVENT
 /end IF_DATA
/end MEASUREMENT
/begin MEASUREMENT Dkuppl_stStatyVehVN "Condition stationary vehicle - detected through VN threshold" UBYTE B_TRUE 1 100 0.00 1.00000000000 BIT_MASK 0x1 FORMAT "%13.11" ECU_ADDRESS 0x400088B1
 /begin IF_DATA XCPplus 0x0102
  /begin DAQ_EVENT VARIABLE /begin AVAILABLE_EVENT_LIST EVENT 0 EVENT 1 EVENT 2 EVENT 3 /end AVAILABLE_EVENT_LIST /begin DEFAULT_EVENT_LIST EVENT 1 /end DEFAULT_EVENT_LIST /end DAQ_EVENT
 /end IF_DATA
/end MEASUREMENT
/begin MEASUREMENT Dkuppl_vFild "Vehicle speed - filtered" SWORD vel_q0p01 1 100 0.00 327.6700 FORMAT "%8.4" ECU_ADDRESS 0x400084CC
 /begin IF_DATA XCPplus 0x0102
  /begin DAQ_EVENT VARIABLE /begin AVAILABLE_EVENT_LIST EVENT 0 EVENT 1 EVENT 2 EVENT 3 /end AVAILABLE_EVENT_LIST /begin DEFAULT_EVENT_LIST EVENT 1 /end DEFAULT_EVENT_LIST /end DAQ_EVENT
 /end IF_DATA
/end MEASUREMENT
/begin MEASUREMENT dlaimod "dlahi of modelled control downstream cat" SBYTE fak_q0p000244 1 100 -0.03125 0.03101 FORMAT "%7.5" ECU_ADDRESS 0x4000C710 /end MEASUREMENT
/begin MEASUREMENT dps_error "last read Pmd_GetErr() content of state OBSERVING" UWORD dez 1 100 0.00 65535.00 FORMAT "%8.2" ECU_ADDRESS 0x40008512 /end MEASUREMENT
/begin MEASUREMENT dps_errStat "read Pmd_GetErr() content in state VERIFY or RECOVERY; this content is compared to dps_error" UWORD dez 1 100 0.00 65535.00 FORMAT "%8.2" ECU_ADDRESS 0x40008510 /end MEASUREMENT
/begin MEASUREMENT dps_errStat_sum_rec "contains dps_errStat read during RECOVERY state" UWORD dez 1 100 0.00 65535.00 FORMAT "%8.2" ECU_ADDRESS 0x4000850E /end MEASUREMENT
/begin MEASUREMENT dps_errStat_sum_ver "contains dps_errStat read during VERIFY state" UWORD dez 1 100 0.00 65535.00 FORMAT "%8.2" ECU_ADDRESS 0x4000850C /end MEASUREMENT
/begin MEASUREMENT dps_index "Indicates which powerstage is being observed" UBYTE dez 1 100 0.00 255.0 FORMAT "%5.1" ECU_ADDRESS 0x40008930 /end MEASUREMENT
/begin MEASUREMENT dps_recoveryTime "Timer Recovery" UBYTE t_q0p1 1 100 0.00 25.50 FORMAT "%5.2" ECU_ADDRESS 0x4000892F /end MEASUREMENT
/begin MEASUREMENT dps_state "Index Statemachine" UBYTE dez 1 100 0.00 255.0 FORMAT "%5.1" ECU_ADDRESS 0x4000892E /end MEASUREMENT
/begin MEASUREMENT dps_verifyTime "Timer Verify" UBYTE t_q0p1 1 100 0.00 25.50 FORMAT "%5.2" ECU_ADDRESS 0x4000892D /end MEASUREMENT
/begin MEASUREMENT DSCHED_DynPrio.FId_Unused "dynamic priority / " SWORD DFC_OneToOne 1 100 -32768.00 32767.00 FORMAT "%8.2" ECU_ADDRESS 0x40006006 /end MEASUREMENT
/begin MEASUREMENT DSCHED_DynPrio.FId_InhibitAlways "dynamic priority / Dynamic priority of scheduled function identifier FId_InhibitAlways" SWORD DFC_OneToOne 1 100 -32768.00 32767.00 FORMAT "%8.2" ECU_ADDRESS 0x40006008 /end MEASUREMENT
/begin MEASUREMENT DSCHED_St.FId_Unused "Scheduler Status / " UBYTE DSCHED_StVerb 1 100 0.00 238.000000000 FORMAT "%13.9" ECU_ADDRESS 0x400050AC /end MEASUREMENT
/begin MEASUREMENT DSCHED_St.FId_InhibitAlways "Scheduler Status / Scheduler status of function identifier FId_InhibitAlways" UBYTE DSCHED_StVerb 1 100 0.00 238.000000000 FORMAT "%13.9" ECU_ADDRESS 0x400050AD /end MEASUREMENT
/begin MEASUREMENT DSCHED_WhyExcl.FId_Unused "exclusion reason / " UWORD DSCHED_FIdExcCauseVerb 1 100 0.00 255. FORMAT "%2.0" ECU_ADDRESS 0x40006002 /end MEASUREMENT
/begin MEASUREMENT DSCHED_WhyExcl.FId_InhibitAlways "exclusion reason / Exclusion cause of scheduled function identifier FId_InhibitAlways" UWORD DSCHED_FIdExcCauseVerb 1 100 0.00 255. FORMAT "%2.0" ECU_ADDRESS 0x40006004 /end MEASUREMENT
/begin MEASUREMENT DSMAUX_ctObdDCy "Number of OBD driving cycle since diagnostic trouble codes cleared" UWORD OneToOne 1 100 0.00 65535.00 FORMAT "%8.2" ECU_ADDRESS 0x4000CC8A /end MEASUREMENT
/begin MEASUREMENT DSMAUX_ctObdDCy_msg "Number of OBD driving cycle since diagnostic trouble codes cleared" UWORD OneToOne 1 100 0.00 65535.00 FORMAT "%8.2" ECU_ADDRESS 0x40005D72
 /begin IF_DATA XCPplus 0x0102
  /begin DAQ_EVENT VARIABLE /begin AVAILABLE_EVENT_LIST EVENT 0 EVENT 1 EVENT 2 EVENT 3 /end AVAILABLE_EVENT_LIST /begin DEFAULT_EVENT_LIST EVENT 2 /end DEFAULT_EVENT_LIST /end DAQ_EVENT
 /end IF_DATA
/end MEASUREMENT
/begin MEASUREMENT DSMAUX_ctWUC "Number of warm-ups since diagnostic trouble codes cleared" UBYTE OneToOne 1 100 0.00 255.0 FORMAT "%5.1" ECU_ADDRESS 0x4000C6F4 /end MEASUREMENT
/begin MEASUREMENT DSMAUX_ctWUC_msg "Number of warm-ups since diagnostic trouble codes cleared" UBYTE OneToOne 1 100 0.00 255.0 FORMAT "%5.1" ECU_ADDRESS 0x40006358
 /begin IF_DATA XCPplus 0x0102
  /begin DAQ_EVENT VARIABLE /begin AVAILABLE_EVENT_LIST EVENT 0 EVENT 1 EVENT 2 EVENT 3 /end AVAILABLE_EVENT_LIST /begin DEFAULT_EVENT_LIST EVENT 2 /end DEFAULT_EVENT_LIST /end DAQ_EVENT
 /end IF_DATA
/end MEASUREMENT
/begin MEASUREMENT DSMAUX_DTRG.DTRG_Time200ms "Trigger state / Trigger DTRG_Time200ms" UBYTE DFC_OneToOne 1 100 0.00 255.0 FORMAT "%5.1" ECU_ADDRESS 0x4000CC78 /end MEASUREMENT
/begin MEASUREMENT DSMAUX_DTRG.DTRG_SimilarCondHLC "Trigger state / Trigger DTRG_SimilarCondHLC" UBYTE DFC_OneToOne 1 100 0.00 255.0 FORMAT "%5.1" ECU_ADDRESS 0x4000CC79 /end MEASUREMENT
/begin MEASUREMENT DSMAUX_DTRG.DTRG_DrivingCycleFLC "Trigger state / Trigger DTRG_DrivingCycleFLC" UBYTE DFC_OneToOne 1 100 0.00 255.0 FORMAT "%5.1" ECU_ADDRESS 0x4000CC7A /end MEASUREMENT
/begin MEASUREMENT DSMAUX_DTRG.DTRG_AlwaysTrue "Trigger state / Trigger DTRG_AlwaysTrue" UBYTE DFC_OneToOne 1 100 0.00 255.0 FORMAT "%5.1" ECU_ADDRESS 0x4000CC7B /end MEASUREMENT
/begin MEASUREMENT DSMAUX_DTRG.DTRG_MDCatHLC "Trigger state / Trigger DTRG_MDCatHLC" UBYTE DFC_OneToOne 1 100 0.00 255.0 FORMAT "%5.1" ECU_ADDRESS 0x4000CC7C /end MEASUREMENT
/begin MEASUREMENT DSMAUX_DTRG.DTRG_MDCatFLC "Trigger state / Trigger DTRG_MDCatFLC" UBYTE DFC_OneToOne 1 100 0.00 255.0 FORMAT "%5.1" ECU_ADDRESS 0x4000CC7D /end MEASUREMENT
/begin MEASUREMENT DSMAUX_DTRG.DTRG_MDFLC "Trigger state / Trigger DTRG_MDFLC" UBYTE DFC_OneToOne 1 100 0.00 255.0 FORMAT "%5.1" ECU_ADDRESS 0x4000CC7E /end MEASUREMENT
/begin MEASUREMENT DSMAUX_DTRG.DTRG_WarmUpCycle "Trigger state / Trigger DTRG_WarmUpCycle" UBYTE DFC_OneToOne 1 100 0.00 255.0 FORMAT "%5.1" ECU_ADDRESS 0x4000CC7F /end MEASUREMENT
/begin MEASUREMENT DSMAUX_DTRG.DTRG_DrivingCycleHLC "Trigger state / Trigger DTRG_DrivingCycleHLC" UBYTE DFC_OneToOne 1 100 0.00 255.0 FORMAT "%5.1" ECU_ADDRESS 0x4000CC80 /end MEASUREMENT
/begin MEASUREMENT DSMAUX_DTRG.DTRG_MDEmiStrtFLC "Trigger state / Trigger DTRG_MDEmiStrtFLC" UBYTE DFC_OneToOne 1 100 0.00 255.0 FORMAT "%5.1" ECU_ADDRESS 0x4000CC81 /end MEASUREMENT
/begin MEASUREMENT DSMAUX_DTRG.DTRG_NoTrigger "Trigger state / Trigger DTRG_NoTrigger" UBYTE DFC_OneToOne 1 100 0.00 255.0 FORMAT "%5.1" ECU_ADDRESS 0x4000CC82 /end MEASUREMENT
/begin MEASUREMENT DSMAUX_DTRG.DTRG_MDEmiStrtHLC "Trigger state / Trigger DTRG_MDEmiStrtHLC" UBYTE DFC_OneToOne 1 100 0.00 255.0 FORMAT "%5.1" ECU_ADDRESS 0x4000CC83 /end MEASUREMENT
/begin MEASUREMENT DSMAUX_DTRG.DTRG_MDEmiHLC "Trigger state / Trigger DTRG_MDEmiHLC" UBYTE DFC_OneToOne 1 100 0.00 255.0 FORMAT "%5.1" ECU_ADDRESS 0x4000CC84 /end MEASUREMENT
/begin MEASUREMENT DSMAUX_DTRG.DTRG_MDEmiFLC "Trigger state / Trigger DTRG_MDEmiFLC" UBYTE DFC_OneToOne 1 100 0.00 255.0 FORMAT "%5.1" ECU_ADDRESS 0x4000CC85 /end MEASUREMENT
/begin MEASUREMENT DSMAUX_DTRG.DTRG_MDHLC "Trigger state / Trigger DTRG_MDHLC" UBYTE DFC_OneToOne 1 100 0.00 255.0 FORMAT "%5.1" ECU_ADDRESS 0x4000CC86 /end MEASUREMENT
/begin MEASUREMENT DSMAUX_stClrProc "Statemachine for clear requests" UBYTE OneToOne 1 100 0.00 255.0 FORMAT "%5.1" ECU_ADDRESS 0x400062FE /end MEASUREMENT
/begin MEASUREMENT DSMAUX_stClrTaskFin "End flag for OS_DSM_Clear_Task run" UBYTE OneToOne 1 100 0.00 255.0 FORMAT "%5.1" ECU_ADDRESS 0x400062FD /end MEASUREMENT
/begin MEASUREMENT DSMAUX_stDCy "Status OBD driving cycle" UBYTE DSMAUX_stDCyVerb 1 100 0.00 3.00000000000 FORMAT "%13.11" ECU_ADDRESS 0x4000CC88
 /begin IF_DATA XCPplus 0x0102
  /begin DAQ_EVENT VARIABLE /begin AVAILABLE_EVENT_LIST EVENT 0 EVENT 1 EVENT 2 EVENT 3 /end AVAILABLE_EVENT_LIST /begin DEFAULT_EVENT_LIST EVENT 2 /end DEFAULT_EVENT_LIST /end DAQ_EVENT
 /end IF_DATA
/end MEASUREMENT
/begin MEASUREMENT DSMAUX_stDCy_msg "Status OBD driving cycle" UBYTE DSMAUX_stDCyVerb 1 100 0.00 3.00000000000 FORMAT "%13.11" ECU_ADDRESS 0x40006357
 /begin IF_DATA XCPplus 0x0102
  /begin DAQ_EVENT VARIABLE /begin AVAILABLE_EVENT_LIST EVENT 0 EVENT 1 EVENT 2 EVENT 3 /end AVAILABLE_EVENT_LIST /begin DEFAULT_EVENT_LIST EVENT 2 /end DEFAULT_EVENT_LIST /end DAQ_EVENT
 /end IF_DATA
/end MEASUREMENT
/begin MEASUREMENT DSMAUX_stDsmClrActv "Indicator of a running DSM clear procedure" UBYTE B_TRUE 1 100 0.00 1.00000000000 BIT_MASK 0x1 FORMAT "%13.11" ECU_ADDRESS 0x4000641A
 /begin IF_DATA XCPplus 0x0102
  /begin DAQ_EVENT VARIABLE /begin AVAILABLE_EVENT_LIST EVENT 0 EVENT 1 EVENT 2 EVENT 3 /end AVAILABLE_EVENT_LIST /begin DEFAULT_EVENT_LIST EVENT 2 /end DEFAULT_EVENT_LIST /end DAQ_EVENT
 /end IF_DATA
/end MEASUREMENT
/begin MEASUREMENT DSMAUX_stStrtEnd "Condition normal engine operation was attained" UBYTE OneToOne 1 100 0.00 255.0 BIT_MASK 0x1 FORMAT "%5.1" ECU_ADDRESS 0x400064A7 /end MEASUREMENT
/begin MEASUREMENT DSMAUX_stTranGlbJob "Current transition job" UBYTE OneToOne 1 100 0.00 255.0 FORMAT "%5.1" ECU_ADDRESS 0x40006300 /end MEASUREMENT
/begin MEASUREMENT DSMAUX_stTranGlbRun "Transition job is running" UBYTE OneToOne 1 100 0.00 255.0 FORMAT "%5.1" ECU_ADDRESS 0x400062FF /end MEASUREMENT
/begin MEASUREMENT DSMAUX_stTranReq "Queue of transition request" UBYTE OneToOne 1 100 0.00 255.0 FORMAT "%5.1" ARRAY_SIZE 3 ECU_ADDRESS 0x4000B42C /end MEASUREMENT
/begin MEASUREMENT DSMAUX_tClntStrt "coolant temperature at start" SWORD Temp_Cels 1 100 -3549.940 3003.560 FORMAT "%8.3" ECU_ADDRESS 0x4000600A /end MEASUREMENT
/begin MEASUREMENT DSMDur_cntrPID4Dh "PID$4D: Engine operating time while MIL is activated." UWORD Time_Min_One2One 1 100 0.00 65535.00 FORMAT "%8.2" ECU_ADDRESS 0x4000C69E /end MEASUREMENT
/begin MEASUREMENT DSMDur_cntrPID4Eh "PID$4E: Engine operating time since diagnostic trouble codes cleared." UWORD Time_Min_One2One 1 100 0.00 65535.00 FORMAT "%8.2" ECU_ADDRESS 0x4000C69C /end MEASUREMENT
/begin MEASUREMENT DSMDur_ct40WUC "number of WUCs to hold the PID21 counter, because of external MIL requests" UBYTE DFES_OneToOne 1 100 0.00 255.0 FORMAT "%5.1" ECU_ADDRESS 0x4000CC8C /end MEASUREMENT
/begin MEASUREMENT DSMDur_ctGlb "Global duration counters (32 bit values)" ULONG DFES_OneToOne 1 100 0.00 4294967295.00 FORMAT "%13.2" ARRAY_SIZE 1 ECU_ADDRESS 0x4000CC9C /end MEASUREMENT
/begin MEASUREMENT DSMDur_ctPID21h "counter for distance travelled while MIL is activated" ULONG DSMDUR_10m_Counter 1 100 0.00 42949672.9500 FORMAT "%13.4" ECU_ADDRESS 0x4000C66C /end MEASUREMENT
/begin MEASUREMENT DSMDur_ctPID31h "counter for distance since diagnostic trouble codes cleared" ULONG DSMDUR_10m_Counter 1 100 0.00 42949672.9500 FORMAT "%13.4" ECU_ADDRESS 0x4000C668 /end MEASUREMENT
/begin MEASUREMENT DSMDur_lRef "distance when the next DSMDur increment will be counted" SLONG OneToOne 1 100 -2147483648.00 2147483647.00 FORMAT "%13.2" ECU_ADDRESS 0x4000583C /end MEASUREMENT
/begin MEASUREMENT DSMDur_lRef10m "distance where next 10m increment will be counted" SLONG OneToOne 1 100 -2147483648.00 2147483647.00 FORMAT "%13.2" ECU_ADDRESS 0x40005838 /end MEASUREMENT
/begin MEASUREMENT DSMDur_stGlb "Global duration counter states" UBYTE DSMDur_StDispl_Verb 1 100 0.00 2.00000000000 FORMAT "%13.11" ARRAY_SIZE 1 ECU_ADDRESS 0x4000CC98 /end MEASUREMENT
/begin MEASUREMENT DSMDur_stPID21h "state of the counter for distance travelled while MIL is activated" UBYTE DSMDur_StDispl_Verb 1 100 0.00 2.00000000000 FORMAT "%13.11" ECU_ADDRESS 0x4000CC94 /end MEASUREMENT
/begin MEASUREMENT DSMDur_stWUCLst "warm up cycle reached" UBYTE OneToOne 1 100 0.00 255.0 FORMAT "%5.1" ECU_ADDRESS 0x400064AF
 /begin IF_DATA XCPplus 0x0102
  /begin DAQ_EVENT VARIABLE /begin AVAILABLE_EVENT_LIST EVENT 0 EVENT 1 EVENT 2 EVENT 3 /end AVAILABLE_EVENT_LIST /begin DEFAULT_EVENT_LIST EVENT 2 /end DEFAULT_EVENT_LIST /end DAQ_EVENT
 /end IF_DATA
/end MEASUREMENT
/begin MEASUREMENT DSMDur_tiRef "time when next DSMDur increment will be counted" SLONG OneToOne 1 100 -2147483648.00 2147483647.00 FORMAT "%13.2" ECU_ADDRESS 0x40005834 /end MEASUREMENT
/begin MEASUREMENT DSMDur_tiRef60s "time when next minute will be counted" SLONG OneToOne 1 100 -2147483648.00 2147483647.00 FORMAT "%13.2" ECU_ADDRESS 0x40005830 /end MEASUREMENT
/begin MEASUREMENT DSMRdy_stGrpRdy "Readiness calculation, ready status" UWORD DSMRdy_OneToOne 1 100 0.00 65535.00 FORMAT "%8.2" ECU_ADDRESS 0x4000CC8E /end MEASUREMENT
/begin MEASUREMENT DSMRdy_stGrpRdyDFES "Readiness calculation, ready status from DFES status" UWORD DSMRdy_OneToOne 1 100 0.00 65535.00 FORMAT "%8.2" ECU_ADDRESS 0x40005D32 /end MEASUREMENT
/begin MEASUREMENT DSMRdy_stGrpRdyScan "Readiness calculation, ready status from check scanning" UWORD DSMRdy_OneToOne 1 100 0.00 65535.00 FORMAT "%8.2" ECU_ADDRESS 0x40005D34 /end MEASUREMENT
/begin MEASUREMENT DSMRdy_stGrpSup "Readiness calculation, supported status" UWORD DSMRdy_OneToOne 1 100 0.00 65535.00 FORMAT "%8.2" ECU_ADDRESS 0x40005D30 /end MEASUREMENT
/begin MEASUREMENT DSMRdy_xPId1 "Readiness calculation, result for PID01" ULONG DSMRdy_OneToOne 1 100 0.00 4294967295.00 FORMAT "%13.2" ECU_ADDRESS 0x40004778 /end MEASUREMENT
/begin MEASUREMENT DSM_stPostDrive "Status of DSM postdrive control" UBYTE OneToOne 1 100 0.00 255.0 FORMAT "%5.1" ECU_ADDRESS 0x400064AC
 /begin IF_DATA XCPplus 0x0102
  /begin DAQ_EVENT VARIABLE /begin AVAILABLE_EVENT_LIST EVENT 0 EVENT 1 EVENT 2 EVENT 3 /end AVAILABLE_EVENT_LIST /begin DEFAULT_EVENT_LIST EVENT 2 /end DEFAULT_EVENT_LIST /end DAQ_EVENT
 /end IF_DATA
/end MEASUREMENT
/begin MEASUREMENT DSM_stReInit "Status of reinitialization in DSM after cancelled postdrive" UBYTE OneToOne 1 100 0.00 255.0 FORMAT "%5.1" ECU_ADDRESS 0x400064AD
 /begin IF_DATA XCPplus 0x0102
  /begin DAQ_EVENT VARIABLE /begin AVAILABLE_EVENT_LIST EVENT 0 EVENT 1 EVENT 2 EVENT 3 /end AVAILABLE_EVENT_LIST /begin DEFAULT_EVENT_LIST EVENT 2 /end DEFAULT_EVENT_LIST /end DAQ_EVENT
 /end IF_DATA
/end MEASUREMENT
/begin MEASUREMENT DSM_TripChgAndClrFinshd "Message to indicate completion of clear triggered by DSM after initialization" UBYTE OneToOne 1 100 0.00 255.0 BIT_MASK 0x1 FORMAT "%5.1" ECU_ADDRESS 0x40006418
 /begin IF_DATA XCPplus 0x0102
  /begin DAQ_EVENT VARIABLE /begin AVAILABLE_EVENT_LIST EVENT 0 EVENT 1 EVENT 2 EVENT 3 /end AVAILABLE_EVENT_LIST /begin DEFAULT_EVENT_LIST EVENT 2 /end DEFAULT_EVENT_LIST /end DAQ_EVENT
 /end IF_DATA
/end MEASUREMENT
/begin MEASUREMENT DSM_TripChgFinshd "Trip change of DSM (Diagnostic System Management) finished" UBYTE OneToOne 1 100 0.00 255.0 BIT_MASK 0x1 FORMAT "%5.1" ECU_ADDRESS 0x40006417
 /begin IF_DATA XCPplus 0x0102
  /begin DAQ_EVENT VARIABLE /begin AVAILABLE_EVENT_LIST EVENT 0 EVENT 1 EVENT 2 EVENT 3 /end AVAILABLE_EVENT_LIST /begin DEFAULT_EVENT_LIST EVENT 2 /end DEFAULT_EVENT_LIST /end DAQ_EVENT
 /end IF_DATA
/end MEASUREMENT
/begin MEASUREMENT dtpsvkmf "filtered delta cycle duration of sensor signal upstream cat. (word)" SBYTE t_q0p02 1 100 -2.560 2.540 FORMAT "%5.3" ECU_ADDRESS 0x4000C70F
 /begin IF_DATA XCPplus 0x0102
  /begin DAQ_EVENT VARIABLE /begin AVAILABLE_EVENT_LIST EVENT 0 EVENT 1 EVENT 2 EVENT 3 /end AVAILABLE_EVENT_LIST /begin DEFAULT_EVENT_LIST EVENT 1 /end DEFAULT_EVENT_LIST /end DAQ_EVENT
 /end IF_DATA
/end MEASUREMENT
/begin MEASUREMENT dtpsvkof "measured delta cycle duration of sensor upstream cat, without filter" SBYTE t_q0p02 1 100 -2.560 2.540 FORMAT "%5.3" ECU_ADDRESS 0x400088CA
 /begin IF_DATA XCPplus 0x0102
  /begin DAQ_EVENT VARIABLE /begin AVAILABLE_EVENT_LIST EVENT 0 EVENT 1 EVENT 2 EVENT 3 /end AVAILABLE_EVENT_LIST /begin DEFAULT_EVENT_LIST EVENT 1 /end DEFAULT_EVENT_LIST /end DAQ_EVENT
 /end IF_DATA
/end MEASUREMENT
/begin MEASUREMENT falrdkt "Request form cat monitoring: modify lambda controller amplitude" UBYTE fak_ub_b8 1 100 0.00 7.969 FORMAT "%5.3" ECU_ADDRESS 0x40008897
 /begin IF_DATA XCPplus 0x0102
  /begin DAQ_EVENT VARIABLE /begin AVAILABLE_EVENT_LIST EVENT 0 EVENT 1 EVENT 2 EVENT 3 /end AVAILABLE_EVENT_LIST /begin DEFAULT_EVENT_LIST EVENT 2 /end DEFAULT_EVENT_LIST /end DAQ_EVENT
 /end IF_DATA
/end MEASUREMENT
/begin MEASUREMENT fraref_w "Reference value for detecting ""factor fra at steady state""" UWORD fak_uw_b2 1 100 0.00 1.999969 FORMAT "%8.6" ECU_ADDRESS 0x400084D2
 /begin IF_DATA XCPplus 0x0102
  /begin DAQ_EVENT VARIABLE /begin AVAILABLE_EVENT_LIST EVENT 0 EVENT 1 EVENT 2 EVENT 3 /end AVAILABLE_EVENT_LIST /begin DEFAULT_EVENT_LIST EVENT 3 /end DEFAULT_EVENT_LIST /end DAQ_EVENT
 /end IF_DATA
/end MEASUREMENT
/begin MEASUREMENT HEGO_bS1B1ErrElecHtrCpl "Bit electrical error heater coupling, HEGO sensor 1 bank 1" UBYTE B_TRUE 1 100 0.00 1.00000000000 BIT_MASK 0x1 FORMAT "%13.11" ECU_ADDRESS 0x400088FF
 /begin IF_DATA XCPplus 0x0102
  /begin DAQ_EVENT VARIABLE /begin AVAILABLE_EVENT_LIST EVENT 0 EVENT 1 EVENT 2 EVENT 3 /end AVAILABLE_EVENT_LIST /begin DEFAULT_EVENT_LIST EVENT 2 /end DEFAULT_EVENT_LIST /end DAQ_EVENT
 /end IF_DATA
/end MEASUREMENT
/begin MEASUREMENT HEGO_flgStuckHiFltCurr "B_lsfet status in the current driving cycle" UBYTE B_TRUE 1 100 0.00 1.00000000000 BIT_MASK 0x1 FORMAT "%13.11" ECU_ADDRESS 0x4000890A
 /begin IF_DATA XCPplus 0x0102
  /begin DAQ_EVENT VARIABLE /begin AVAILABLE_EVENT_LIST EVENT 0 EVENT 1 EVENT 2 EVENT 3 /end AVAILABLE_EVENT_LIST /begin DEFAULT_EVENT_LIST EVENT 2 /end DEFAULT_EVENT_LIST /end DAQ_EVENT
 /end IF_DATA
/end MEASUREMENT
/begin MEASUREMENT HEGO_flgStuckHiFltPrev "B_lsfet status in the Previous driving cycle" UBYTE B_TRUE 1 100 0.00 1.00000000000 BIT_MASK 0x1 FORMAT "%13.11" ECU_ADDRESS 0x40008909 /end MEASUREMENT
/begin MEASUREMENT HEGO_flgTheoRdnDsSnsrHeatg "Theoritical readiness for downstream sensor heating" UBYTE B_TRUE 1 100 0.00 1.00000000000 BIT_MASK 0x1 FORMAT "%13.11" ECU_ADDRESS 0x400088E2 /end MEASUREMENT
/begin MEASUREMENT HEGO_flgTheoRdnSnsrHeatg "Theoritical sensor heating readiness with out delay" UBYTE B_TRUE 1 100 0.00 1.00000000000 BIT_MASK 0x1 FORMAT "%13.11" ECU_ADDRESS 0x400088FE
 /begin IF_DATA XCPplus 0x0102
  /begin DAQ_EVENT VARIABLE /begin AVAILABLE_EVENT_LIST EVENT 0 EVENT 1 EVENT 2 EVENT 3 /end AVAILABLE_EVENT_LIST /begin DEFAULT_EVENT_LIST EVENT 2 /end DEFAULT_EVENT_LIST /end DAQ_EVENT
 /end IF_DATA
/end MEASUREMENT
/begin MEASUREMENT HEGO_mAirStkHiS1B1 "Integrated stuck high air mass flow for lambda sensor heater coupling error diagnosis,S1B1" UWORD m_q0p1_g 1 100 0.00 6553.500 FORMAT "%8.3" ECU_ADDRESS 0x40008918
 /begin IF_DATA XCPplus 0x0102
  /begin DAQ_EVENT VARIABLE /begin AVAILABLE_EVENT_LIST EVENT 0 EVENT 1 EVENT 2 EVENT 3 /end AVAILABLE_EVENT_LIST /begin DEFAULT_EVENT_LIST EVENT 2 /end DEFAULT_EVENT_LIST /end DAQ_EVENT
 /end IF_DATA
/end MEASUREMENT
/begin MEASUREMENT HEGO_mAirStkLowS1B1 "Integrated stuck low air mass flow for lambda sensor heater coupling error diagnosis,S1B1" UWORD m_q0p1_g 1 100 0.00 6553.500 FORMAT "%8.3" ECU_ADDRESS 0x40008916
 /begin IF_DATA XCPplus 0x0102
  /begin DAQ_EVENT VARIABLE /begin AVAILABLE_EVENT_LIST EVENT 0 EVENT 1 EVENT 2 EVENT 3 /end AVAILABLE_EVENT_LIST /begin DEFAULT_EVENT_LIST EVENT 2 /end DEFAULT_EVENT_LIST /end DAQ_EVENT
 /end IF_DATA
/end MEASUREMENT
/begin MEASUREMENT HEGO_mEgLamAdjmtIK_I.memory "Exhaust gas mass flow integrator for lambda adjustment end check / current integrator value" ULONG m_q1p526Em6_g 1 100 0.00 6553.59999847 FORMAT "%13.8" ECU_ADDRESS 0x40009020 /end MEASUREMENT
/begin MEASUREMENT kakbmt "Correction value for the modelled amplitude of the rear sensor" UBYTE fak_ub_b2 1 100 0.00 1.992188 FORMAT "%8.6" ECU_ADDRESS 0x400088A9
 /begin IF_DATA XCPplus 0x0102
  /begin DAQ_EVENT VARIABLE /begin AVAILABLE_EVENT_LIST EVENT 0 EVENT 1 EVENT 2 EVENT 3 /end AVAILABLE_EVENT_LIST /begin DEFAULT_EVENT_LIST EVENT 2 /end DEFAULT_EVENT_LIST /end DAQ_EVENT
 /end IF_DATA
/end MEASUREMENT
/begin MEASUREMENT katbf "signal after memory standardized comparable to ushk" UBYTE spg_q0p005 1 100 0.00 1.275 FORMAT "%5.3" ECU_ADDRESS 0x4000889E
 /begin IF_DATA XCPplus 0x0102
  /begin DAQ_EVENT VARIABLE /begin AVAILABLE_EVENT_LIST EVENT 0 EVENT 1 EVENT 2 EVENT 3 /end AVAILABLE_EVENT_LIST /begin DEFAULT_EVENT_LIST EVENT 2 /end DEFAULT_EVENT_LIST /end DAQ_EVENT
 /end IF_DATA
/end MEASUREMENT
/begin MEASUREMENT katbfi_w "amount of oxygen upstream of accumulator (catalyzer model)" SWORD freq_sw_b512 1 100 -512.0000 511.9844 FORMAT "%8.4" ECU_ADDRESS 0x400084C2
 /begin IF_DATA XCPplus 0x0102
  /begin DAQ_EVENT VARIABLE /begin AVAILABLE_EVENT_LIST EVENT 0 EVENT 1 EVENT 2 EVENT 3 /end AVAILABLE_EVENT_LIST /begin DEFAULT_EVENT_LIST EVENT 2 /end DEFAULT_EVENT_LIST /end DAQ_EVENT
 /end IF_DATA
/end MEASUREMENT
/begin MEASUREMENT katbfs "signal downstream of accumulator (catalyzer model)" SBYTE fak_sb_b1 1 100 -1.000 0.9922 FORMAT "%5.3" ECU_ADDRESS 0x4000889D
 /begin IF_DATA XCPplus 0x0102
  /begin DAQ_EVENT VARIABLE /begin AVAILABLE_EVENT_LIST EVENT 0 EVENT 1 EVENT 2 EVENT 3 /end AVAILABLE_EVENT_LIST /begin DEFAULT_EVENT_LIST EVENT 2 /end DEFAULT_EVENT_LIST /end DAQ_EVENT
 /end IF_DATA
/end MEASUREMENT
/begin MEASUREMENT katbftp "signal downstream of accumulator, standardized, low-pass filtered" UBYTE spg_q0p005 1 100 0.00 1.275 FORMAT "%5.3" ECU_ADDRESS 0x400088A5
 /begin IF_DATA XCPplus 0x0102
  /begin DAQ_EVENT VARIABLE /begin AVAILABLE_EVENT_LIST EVENT 0 EVENT 1 EVENT 2 EVENT 3 /end AVAILABLE_EVENT_LIST /begin DEFAULT_EVENT_LIST EVENT 2 /end DEFAULT_EVENT_LIST /end DAQ_EVENT
 /end IF_DATA
/end MEASUREMENT
/begin MEASUREMENT katbshd_w "signal for rich-shift of the catalyst model" SWORD mgrad_sw_b28p44 1 100 -28.44444 28.44358 FORMAT "%8.5" ECU_ADDRESS 0x400084C0
 /begin IF_DATA XCPplus 0x0102
  /begin DAQ_EVENT VARIABLE /begin AVAILABLE_EVENT_LIST EVENT 0 EVENT 1 EVENT 2 EVENT 3 /end AVAILABLE_EVENT_LIST /begin DEFAULT_EVENT_LIST EVENT 2 /end DEFAULT_EVENT_LIST /end DAQ_EVENT
 /end IF_DATA
/end MEASUREMENT
/begin MEASUREMENT kbdkt_w "catalyst load signal" SWORD mgrad_sw_b28p44 1 100 -28.44444 28.44358 FORMAT "%8.5" ECU_ADDRESS 0x400084BE
 /begin IF_DATA XCPplus 0x0102
  /begin DAQ_EVENT VARIABLE /begin AVAILABLE_EVENT_LIST EVENT 0 EVENT 1 EVENT 2 EVENT 3 /end AVAILABLE_EVENT_LIST /begin DEFAULT_EVENT_LIST EVENT 2 /end DEFAULT_EVENT_LIST /end DAQ_EVENT
 /end IF_DATA
/end MEASUREMENT
/begin MEASUREMENT lamdiag "Desired lambda for diagnosis" UBYTE fak_q0p0039_op0p5 1 100 0.5000 1.496 FORMAT "%5.3" ECU_ADDRESS 0x400088D1 /end MEASUREMENT
/begin MEASUREMENT lsadkt "Correction value (slow front sensor) of cat. monitoring result" UBYTE fak_ub_b1 1 100 0.00 0.9961 ECU_ADDRESS 0x400088AD
 /begin IF_DATA XCPplus 0x0102
  /begin DAQ_EVENT VARIABLE /begin AVAILABLE_EVENT_LIST EVENT 0 EVENT 1 EVENT 2 EVENT 3 /end AVAILABLE_EVENT_LIST /begin DEFAULT_EVENT_LIST EVENT 2 /end DEFAULT_EVENT_LIST /end DAQ_EVENT
 /end IF_DATA
/end MEASUREMENT
/begin MEASUREMENT mldkthp "high pass filtered air mass flow, cat. monitoring" SWORD m_sw_q0p1 1 100 -3276.800 3276.700 FORMAT "%8.3" ECU_ADDRESS 0x400084C4
 /begin IF_DATA XCPplus 0x0102
  /begin DAQ_EVENT VARIABLE /begin AVAILABLE_EVENT_LIST EVENT 0 EVENT 1 EVENT 2 EVENT 3 /end AVAILABLE_EVENT_LIST /begin DEFAULT_EVENT_LIST EVENT 2 /end DEFAULT_EVENT_LIST /end DAQ_EVENT
 /end IF_DATA
/end MEASUREMENT
/begin MEASUREMENT msleakrf_w "Reference value of msleak_w" SWORD m_q0p0004 1 100 -13.10720 13.10680 FORMAT "%8.5" ECU_ADDRESS 0x400084D0
 /begin IF_DATA XCPplus 0x0102
  /begin DAQ_EVENT VARIABLE /begin AVAILABLE_EVENT_LIST EVENT 0 EVENT 1 EVENT 2 EVENT 3 /end AVAILABLE_EVENT_LIST /begin DEFAULT_EVENT_LIST EVENT 3 /end DEFAULT_EVENT_LIST /end DAQ_EVENT
 /end IF_DATA
/end MEASUREMENT
/begin MEASUREMENT nmotgneg "Negative engine speed amplitude" SWORD nmot_sw_q0p25 1 100 -8192.000 8191.750 FORMAT "%8.3" ECU_ADDRESS 0x400084DA
 /begin IF_DATA XCPplus 0x0102
  /begin DAQ_EVENT VARIABLE /begin AVAILABLE_EVENT_LIST EVENT 0 EVENT 1 EVENT 2 EVENT 3 /end AVAILABLE_EVENT_LIST /begin DEFAULT_EVENT_LIST EVENT 2 /end DEFAULT_EVENT_LIST /end DAQ_EVENT
 /end IF_DATA
/end MEASUREMENT
/begin MEASUREMENT nmotgpos "Positive engine speed amplitude" SWORD nmot_sw_q0p25 1 100 -8192.000 8191.750 FORMAT "%8.3" ECU_ADDRESS 0x400084D8
 /begin IF_DATA XCPplus 0x0102
  /begin DAQ_EVENT VARIABLE /begin AVAILABLE_EVENT_LIST EVENT 0 EVENT 1 EVENT 2 EVENT 3 /end AVAILABLE_EVENT_LIST /begin DEFAULT_EVENT_LIST EVENT 2 /end DEFAULT_EVENT_LIST /end DAQ_EVENT
 /end IF_DATA
/end MEASUREMENT
/begin MEASUREMENT osctvdkt_w "LR: O2 mass for switch tv symmetric to increase cat load for DKAT" UWORD m_q0p1_mg 1 100 0.00 6553.500 FORMAT "%8.3" ECU_ADDRESS 0x400084BC
 /begin IF_DATA XCPplus 0x0102
  /begin DAQ_EVENT VARIABLE /begin AVAILABLE_EVENT_LIST EVENT 0 EVENT 1 EVENT 2 EVENT 3 /end AVAILABLE_EVENT_LIST /begin DEFAULT_EVENT_LIST EVENT 2 /end DEFAULT_EVENT_LIST /end DAQ_EVENT
 /end IF_DATA
/end MEASUREMENT
/begin MEASUREMENT PIntkVUs_nrCntrSigChk "Counter to detect DSS sensor signal stuck information" UBYTE dez 1 100 0.00 255.0 FORMAT "%5.1" ECU_ADDRESS 0x4000892C
 /begin IF_DATA XCPplus 0x0102
  /begin DAQ_EVENT VARIABLE /begin AVAILABLE_EVENT_LIST EVENT 0 EVENT 1 EVENT 2 EVENT 3 /end AVAILABLE_EVENT_LIST /begin DEFAULT_EVENT_LIST EVENT 0 /end DEFAULT_EVENT_LIST /end DAQ_EVENT
 /end IF_DATA
/end MEASUREMENT
/begin MEASUREMENT PIntkVUs_stSigChkFrz "Condition to freeze signal stuck check" UBYTE B_TRUE 1 100 0.00 1.00000000000 BIT_MASK 0x1 FORMAT "%13.11" ECU_ADDRESS 0x4000891B
 /begin IF_DATA XCPplus 0x0102
  /begin DAQ_EVENT VARIABLE /begin AVAILABLE_EVENT_LIST EVENT 0 EVENT 1 EVENT 2 EVENT 3 /end AVAILABLE_EVENT_LIST /begin DEFAULT_EVENT_LIST EVENT 0 /end DEFAULT_EVENT_LIST /end DAQ_EVENT
 /end IF_DATA
/end MEASUREMENT
/begin MEASUREMENT rldkthp "High pass filteres engine load signal" SBYTE rel_sb_q0p75 1 100 -96.00 95.25 FORMAT "%5.2" ECU_ADDRESS 0x400088AE
 /begin IF_DATA XCPplus 0x0102
  /begin DAQ_EVENT VARIABLE /begin AVAILABLE_EVENT_LIST EVENT 0 EVENT 1 EVENT 2 EVENT 3 /end AVAILABLE_EVENT_LIST /begin DEFAULT_EVENT_LIST EVENT 2 /end DEFAULT_EVENT_LIST /end DAQ_EVENT
 /end IF_DATA
/end MEASUREMENT
/begin MEASUREMENT tdkttemp "waiting time after stop condition for filter and integrator" UBYTE t_q0p05 1 100 0.00 12.75 FORMAT "%5.2" ECU_ADDRESS 0x400088A3
 /begin IF_DATA XCPplus 0x0102
  /begin DAQ_EVENT VARIABLE /begin AVAILABLE_EVENT_LIST EVENT 0 EVENT 1 EVENT 2 EVENT 3 /end AVAILABLE_EVENT_LIST /begin DEFAULT_EVENT_LIST EVENT 2 /end DEFAULT_EVENT_LIST /end DAQ_EVENT
 /end IF_DATA
/end MEASUREMENT
/begin MEASUREMENT tkihkmhp "high pass filtered main catalyst temperature, cat.monitoring" SBYTE temp_q5 1 100 -640.0 635.0 FORMAT "%5.1" ECU_ADDRESS 0x400088A1
 /begin IF_DATA XCPplus 0x0102
  /begin DAQ_EVENT VARIABLE /begin AVAILABLE_EVENT_LIST EVENT 0 EVENT 1 EVENT 2 EVENT 3 /end AVAILABLE_EVENT_LIST /begin DEFAULT_EVENT_LIST EVENT 2 /end DEFAULT_EVENT_LIST /end DAQ_EVENT
 /end IF_DATA
/end MEASUREMENT
/begin MEASUREMENT tlatpip_w "time counter of the periode duration for IUMPR bank 1" UWORD t10msxs_uw_b655p35 1 100 0.00 655.3500 FORMAT "%8.4" ECU_ADDRESS 0x400084EA
 /begin IF_DATA XCPplus 0x0102
  /begin DAQ_EVENT VARIABLE /begin AVAILABLE_EVENT_LIST EVENT 0 EVENT 1 EVENT 2 EVENT 3 /end AVAILABLE_EVENT_LIST /begin DEFAULT_EVENT_LIST EVENT 1 /end DEFAULT_EVENT_LIST /end DAQ_EVENT
 /end IF_DATA
/end MEASUREMENT
/begin MEASUREMENT tplrn "Time duration lambda controller negative slope" UBYTE t10msxs_ub_b2p55 1 100 0.00 2.550 FORMAT "%5.3" ECU_ADDRESS 0x400088C6
 /begin IF_DATA XCPplus 0x0102
  /begin DAQ_EVENT VARIABLE /begin AVAILABLE_EVENT_LIST EVENT 0 EVENT 1 EVENT 2 EVENT 3 /end AVAILABLE_EVENT_LIST /begin DEFAULT_EVENT_LIST EVENT 1 /end DEFAULT_EVENT_LIST /end DAQ_EVENT
 /end IF_DATA
/end MEASUREMENT
/begin MEASUREMENT tplrp "Time duration lambda controller positive slope" UBYTE t10msxs_ub_b2p55 1 100 0.00 2.550 FORMAT "%5.3" ECU_ADDRESS 0x400088C5
 /begin IF_DATA XCPplus 0x0102
  /begin DAQ_EVENT VARIABLE /begin AVAILABLE_EVENT_LIST EVENT 0 EVENT 1 EVENT 2 EVENT 3 /end AVAILABLE_EVENT_LIST /begin DEFAULT_EVENT_LIST EVENT 1 /end DEFAULT_EVENT_LIST /end DAQ_EVENT
 /end IF_DATA
/end MEASUREMENT
/begin MEASUREMENT tpsvkmfd_w "filtered cycle duration of sensor upstream cat, decimal value" UWORD t_q0p04 1 100 0.00 2621.400 FORMAT "%8.3" ECU_ADDRESS 0x400084E4 /end MEASUREMENT
/begin MEASUREMENT tpsvkmf_w "filtered cycle duration of sensor signal upstream cat. (word)" UWORD t10msxs_uw_b655p35 1 100 0.00 655.3500 FORMAT "%8.4" ECU_ADDRESS 0x400084E2 /end MEASUREMENT
/begin MEASUREMENT tpsvkof_w "measured cycle duration of sensor upstream cat, without filter" UWORD t10msxs_uw_b655p35 1 100 0.00 655.3500 FORMAT "%8.4" ECU_ADDRESS 0x400084EE /end MEASUREMENT
/begin MEASUREMENT tsvkod_w "upper limit for cycle duration of sensor upstream cat, decimal value" UWORD t_q0p04 1 100 0.00 2621.400 FORMAT "%8.3" ECU_ADDRESS 0x400084E0 /end MEASUREMENT
/begin MEASUREMENT tsvtpip_w "minimum time period for IUMPR updation" UWORD t10msxs_uw_b655p35 1 100 0.00 655.3500 FORMAT "%8.4" ECU_ADDRESS 0x400084EC
 /begin IF_DATA XCPplus 0x0102
  /begin DAQ_EVENT VARIABLE /begin AVAILABLE_EVENT_LIST EVENT 0 EVENT 1 EVENT 2 EVENT 3 /end AVAILABLE_EVENT_LIST /begin DEFAULT_EVENT_LIST EVENT 1 /end DEFAULT_EVENT_LIST /end DAQ_EVENT
 /end IF_DATA
/end MEASUREMENT
/begin MEASUREMENT tuspnf "filtered time between positive and negative usvk slope, DLSSA" UBYTE t10msxs_ub_b2p55 1 100 0.00 2.550 FORMAT "%5.3" ECU_ADDRESS 0x400088C4 /end MEASUREMENT
/begin MEASUREMENT tuspnfd_w "filtered time between positive and negative slope of upstream sensor, decimal value" UWORD t_q0p04 1 100 0.00 2621.400 FORMAT "%8.3" ECU_ADDRESS 0x400084DE /end MEASUREMENT
/begin MEASUREMENT tuspnxd_w "max. time between pos. and neg. slope of upstream sensor, decimal value" UWORD t_q0p04 1 100 0.00 2621.400 FORMAT "%8.3" ECU_ADDRESS 0x400084DC /end MEASUREMENT
/begin MEASUREMENT TWCD_mfAirEnaCatDiagIK_I.memory "Integrator of air mass flow used for Enabling condition of Catalyst Diagnosis / current integrator value" ULONG m_q1p526Em6_g 1 100 0.00 6553.59999847 FORMAT "%13.8" ECU_ADDRESS 0x40009014 /end MEASUREMENT
/begin MEASUREMENT TWCD_tiPerdDurn "Filtered lambda control period duration" UBYTE t_q0p05 1 100 0.00 12.75 FORMAT "%5.2" ECU_ADDRESS 0x4000889C
 /begin IF_DATA XCPplus 0x0102
  /begin DAQ_EVENT VARIABLE /begin AVAILABLE_EVENT_LIST EVENT 0 EVENT 1 EVENT 2 EVENT 3 /end AVAILABLE_EVENT_LIST /begin DEFAULT_EVENT_LIST EVENT 2 /end DEFAULT_EVENT_LIST /end DAQ_EVENT
 /end IF_DATA
/end MEASUREMENT
/begin MEASUREMENT TWCD_tiPerdDurnCntr "Lambda control period duration counter" UBYTE t_q0p05 1 100 0.00 12.75 FORMAT "%5.2" ECU_ADDRESS 0x4000889B
 /begin IF_DATA XCPplus 0x0102
  /begin DAQ_EVENT VARIABLE /begin AVAILABLE_EVENT_LIST EVENT 0 EVENT 1 EVENT 2 EVENT 3 /end AVAILABLE_EVENT_LIST /begin DEFAULT_EVENT_LIST EVENT 2 /end DEFAULT_EVENT_LIST /end DAQ_EVENT
 /end IF_DATA
/end MEASUREMENT
/begin MEASUREMENT tzdlahi_w "present time counter value for ready flag of dlahi - monitoring" UWORD t1sxs_uw_b65535 1 100 0.00 65535.00 FORMAT "%8.2" ECU_ADDRESS 0x400084F2
 /begin IF_DATA XCPplus 0x0102
  /begin DAQ_EVENT VARIABLE /begin AVAILABLE_EVENT_LIST EVENT 0 EVENT 1 EVENT 2 EVENT 3 /end AVAILABLE_EVENT_LIST /begin DEFAULT_EVENT_LIST EVENT 3 /end DEFAULT_EVENT_LIST /end DAQ_EVENT
 /end IF_DATA
/end MEASUREMENT
/begin MEASUREMENT urddktp "difference of sensor mean values, low pass filtered" SBYTE spg_q0p01_V 1 100 -1.280 1.270 FORMAT "%5.3" ECU_ADDRESS 0x400088A6
 /begin IF_DATA XCPplus 0x0102
  /begin DAQ_EVENT VARIABLE /begin AVAILABLE_EVENT_LIST EVENT 0 EVENT 1 EVENT 2 EVENT 3 /end AVAILABLE_EVENT_LIST /begin DEFAULT_EVENT_LIST EVENT 2 /end DEFAULT_EVENT_LIST /end DAQ_EVENT
 /end IF_DATA
/end MEASUREMENT
/begin MEASUREMENT usftsasa_w "rich established sensor voltage value (Word) upstream cat (new)" UWORD spg_q0p005 1 100 0.00 327.6750 FORMAT "%8.4" ECU_ADDRESS 0x4000C6CA
 /begin IF_DATA XCPplus 0x0102
  /begin DAQ_EVENT VARIABLE /begin AVAILABLE_EVENT_LIST EVENT 0 EVENT 1 EVENT 2 EVENT 3 /end AVAILABLE_EVENT_LIST /begin DEFAULT_EVENT_LIST EVENT 2 /end DEFAULT_EVENT_LIST /end DAQ_EVENT
 /end IF_DATA
/end MEASUREMENT
/begin MEASUREMENT usftshsa_w "rich established sensor voltage value (Word) downstream cat (new), DLSSA" UWORD spg_q0p005 1 100 0.00 327.6750 FORMAT "%8.4" ECU_ADDRESS 0x4000C6C4 /end MEASUREMENT
/begin MEASUREMENT ushdktp "output voltage oxygen sensor downstream catatalyst, low pass filtered" UBYTE spg_q0p005 1 100 0.00 1.275 FORMAT "%5.3" ECU_ADDRESS 0x400088A4
 /begin IF_DATA XCPplus 0x0102
  /begin DAQ_EVENT VARIABLE /begin AVAILABLE_EVENT_LIST EVENT 0 EVENT 1 EVENT 2 EVENT 3 /end AVAILABLE_EVENT_LIST /begin DEFAULT_EVENT_LIST EVENT 2 /end DEFAULT_EVENT_LIST /end DAQ_EVENT
 /end IF_DATA
/end MEASUREMENT
/begin MEASUREMENT ushschub "Sensor voltage after catalyst for lambda control during fuel cut-off phase in the ageing diagnosis" UBYTE spg_q0p005 1 100 0.00 1.275 FORMAT "%5.3" ECU_ADDRESS 0x400088E0 /end MEASUREMENT
/begin MEASUREMENT usmgsasa_w "lean established sensor voltage value (Word) upstream cat (new)" UWORD spg_q0p005 1 100 0.00 327.6750 FORMAT "%8.4" ECU_ADDRESS 0x4000C6C8
 /begin IF_DATA XCPplus 0x0102
  /begin DAQ_EVENT VARIABLE /begin AVAILABLE_EVENT_LIST EVENT 0 EVENT 1 EVENT 2 EVENT 3 /end AVAILABLE_EVENT_LIST /begin DEFAULT_EVENT_LIST EVENT 2 /end DEFAULT_EVENT_LIST /end DAQ_EVENT
 /end IF_DATA
/end MEASUREMENT
/begin MEASUREMENT usmgshsa_w "lean established sensor voltage value (Word) downstream cat (new), DLSSA" UWORD spg_q0p005 1 100 0.00 327.6750 FORMAT "%8.4" ECU_ADDRESS 0x4000C6C6 /end MEASUREMENT
/begin MEASUREMENT zhzkh "Counter for fault measurements of heater coupling downstream main cat" UBYTE dez 1 100 0.00 255.0 FORMAT "%5.1" ECU_ADDRESS 0x400088F0 /end MEASUREMENT
/begin MEASUREMENT zhzkv "Counter for fault measurements of heater coupling upstream cat" UBYTE dez 1 100 0.00 255.0 FORMAT "%5.1" ECU_ADDRESS 0x40008911
 /begin IF_DATA XCPplus 0x0102
  /begin DAQ_EVENT VARIABLE /begin AVAILABLE_EVENT_LIST EVENT 0 EVENT 1 EVENT 2 EVENT 3 /end AVAILABLE_EVENT_LIST /begin DEFAULT_EVENT_LIST EVENT 1 /end DEFAULT_EVENT_LIST /end DAQ_EVENT
 /end IF_DATA
/end MEASUREMENT
/begin MEASUREMENT zhzoffh "counter for heater disconnecting downstream main cat" UBYTE dez 1 100 0.00 255.0 FORMAT "%5.1" ECU_ADDRESS 0x400088EF /end MEASUREMENT
/begin MEASUREMENT zhzoffv "Counter for heater disconnecting upstream cat" UBYTE dez 1 100 0.00 255.0 FORMAT "%5.1" ECU_ADDRESS 0x40008910
 /begin IF_DATA XCPplus 0x0102
  /begin DAQ_EVENT VARIABLE /begin AVAILABLE_EVENT_LIST EVENT 0 EVENT 1 EVENT 2 EVENT 3 /end AVAILABLE_EVENT_LIST /begin DEFAULT_EVENT_LIST EVENT 1 /end DEFAULT_EVENT_LIST /end DAQ_EVENT
 /end IF_DATA
/end MEASUREMENT
/begin MEASUREMENT zlashmo_w "Time counter for modelling zlash_w for IUMPR" UWORD t100msxs_uw_b6553p5 1 100 0.00 6553.500 FORMAT "%8.3" ECU_ADDRESS 0x400084F8 /end MEASUREMENT
/begin MEASUREMENT zlash_w "Time counter for the sensor voltage downstream cat. above/below the set point" UWORD t100msxs_uw_b6553p5 1 100 0.00 6553.500 FORMAT "%8.3" ECU_ADDRESS 0x400084F6 /end MEASUREMENT
/begin MEASUREMENT zlsatp "present cycle counter for ready flag of cycle duration monitoring" UBYTE dez 1 100 0.00 255.0 FORMAT "%5.1" ECU_ADDRESS 0x400088CB
 /begin IF_DATA XCPplus 0x0102
  /begin DAQ_EVENT VARIABLE /begin AVAILABLE_EVENT_LIST EVENT 0 EVENT 1 EVENT 2 EVENT 3 /end AVAILABLE_EVENT_LIST /begin DEFAULT_EVENT_LIST EVENT 1 /end DEFAULT_EVENT_LIST /end DAQ_EVENT
 /end IF_DATA
/end MEASUREMENT
/begin MEASUREMENT zlsatpip "present cycle counter for ready flag of modellized cycle duration monitoring for IUMPR bank 1" UBYTE dez 1 100 0.00 255.0 FORMAT "%5.1" ECU_ADDRESS 0x400088CE
 /begin IF_DATA XCPplus 0x0102
  /begin DAQ_EVENT VARIABLE /begin AVAILABLE_EVENT_LIST EVENT 0 EVENT 1 EVENT 2 EVENT 3 /end AVAILABLE_EVENT_LIST /begin DEFAULT_EVENT_LIST EVENT 1 /end DEFAULT_EVENT_LIST /end DAQ_EVENT
 /end IF_DATA
/end MEASUREMENT
/begin MEASUREMENT zwpvk "waiting cycle counter for cycle duration monitoring" UBYTE dez 1 100 0.00 255.0 FORMAT "%5.1" ECU_ADDRESS 0x400088C9
 /begin IF_DATA XCPplus 0x0102
  /begin DAQ_EVENT VARIABLE /begin AVAILABLE_EVENT_LIST EVENT 0 EVENT 1 EVENT 2 EVENT 3 /end AVAILABLE_EVENT_LIST /begin DEFAULT_EVENT_LIST EVENT 1 /end DEFAULT_EVENT_LIST /end DAQ_EVENT
 /end IF_DATA
/end MEASUREMENT
/begin MEASUREMENT zwpvkip "waiting cycle counter for modellized cycle duration monitoring for IUMPR bank 1" UBYTE dez 1 100 0.00 255.0 FORMAT "%5.1" ECU_ADDRESS 0x400088CD
 /begin IF_DATA XCPplus 0x0102
  /begin DAQ_EVENT VARIABLE /begin AVAILABLE_EVENT_LIST EVENT 0 EVENT 1 EVENT 2 EVENT 3 /end AVAILABLE_EVENT_LIST /begin DEFAULT_EVENT_LIST EVENT 1 /end DEFAULT_EVENT_LIST /end DAQ_EVENT
 /end IF_DATA
/end MEASUREMENT
/begin FUNCTION DKAT "9000.2.0  Diagnosis; catalyst conversion"
 /begin DEF_CHARACTERISTIC ADKATNF AHKATMX AVKATFS CWDKATEN CWKATUM DFC_CtlMsk2.DFC_KAT_C DFC_DisblMsk2.DFC_KAT_C DKATCW DMLDKT DRLKTDP DTKIHKMDKT FALRKTD HYKATA HYKATR KATBFML KATBFMN KATBFN KATBFNM KATBFNP KATBFXM KATBSG KATBSH KATBSHF KATBSHG KFKABMT KFLRDKTOL LSAKTD NDKTSO NDKTSU RLDKTSO RLDKTSU SML05DKUW SNM05DKUB TDKATAKT TKTDVS TMAXKAT TMINKAT TMSUKTD TVKTDTE TWCD_facFilPerdDurn_C TWCD_facPerdDurnFilLam_C TWCD_facPerdDurnFilSnsrU_C TWCD_mfThdEnaCatDiag_C TWCD_ratAccrMax_C TWDKATST TWDKTSF ZDKATAD ZDKATAF ZDKATSH ZDKTBD ZDKTBF ZKTDML ZKTDRL ZTKIHKM /end DEF_CHARACTERISTIC
 /begin IN_MEASUREMENT APP_r B_bevab B_cdkat B_frmax B_frmin B_leandb B_lr B_lrhkp B_lrka B_pwf B_sbbhk B_tehb B_ukg fr_w ml ml_w nmot PrjCon_stLamSensRrCat_b rl SyC_stSub tkihkm tmst tpsvkmf_w tramp tvlr ushkl /end IN_MEASUREMENT
 /begin OUT_MEASUREMENT ahkat avkatf B_dktakt B_dktlp B_dktst B_szkat falrdkt osctvdkt_w /end OUT_MEASUREMENT
 /begin LOC_MEASUREMENT ahkati ahkatn ahktki_w ahktnk akatbn akatbnk B_dkini B_dktbfn B_dktbfx B_dkten B_dktnr B_dktsb B_dktsp B_dktstff B_dkttemp B_dkttk B_erdkt B_scckat B_zdkt dkatakt_w kakbmt katbf katbfi_w katbfs katbftp katbshd_w kbdkt_w lsadkt mldkthp rldkthp tdkttemp tkihkmhp TWCD_mfAirEnaCatDiagIK_I.memory TWCD_tiPerdDurn TWCD_tiPerdDurnCntr urddktp ushdktp /end LOC_MEASUREMENT
 FUNCTION_VERSION "9000.2.0" /end FUNCTION
/begin FUNCTION DKUPPL "35000.1.0 Diagnosis of clutch switch"
 /begin DEF_CHARACTERISTIC DFC_CtlMsk2.DFC_ClthStkOpn_C DFC_DisblMsk2.DFC_ClthStkOpn_C Dkuppl_qStatyVehVN_C Dkuppl_qVNMinDrvState_C Dkuppl_tiClthStuckDeb_C Dkuppl_tiFilVehV_C Dkuppl_tiFilVN_C Dkuppl_vStatyVeh_C /end DEF_CHARACTERISTIC
 /begin IN_MEASUREMENT B_kuppl Epm_nEng SyC_stSub VehV_v /end IN_MEASUREMENT
 /begin LOC_MEASUREMENT B_kupplheal Dkuppl_qVN Dkuppl_qVNFild Dkuppl_stDrvState Dkuppl_stStatyVehV Dkuppl_stStatyVehVN Dkuppl_vFild /end LOC_MEASUREMENT
 FUNCTION_VERSION "35000.1.0" /end FUNCTION
/begin FUNCTION DKVS "9000.4.0  Diagnosis; plausibility test fuel supply system"
 /begin DEF_CHARACTERISTIC DFC_CtlMsk2.DFC_KVSFmax_C DFC_CtlMsk2.DFC_KVSFmin_C DFC_CtlMsk2.DFC_KVSOmax_C DFC_CtlMsk2.DFC_KVSOmin_C DFC_DisblMsk2.DFC_KVSFmax_C DFC_DisblMsk2.DFC_KVSFmin_C DFC_DisblMsk2.DFC_KVSOmax_C DFC_DisblMsk2.DFC_KVSOmin_C DFRAD DFRAE DOFLRAD DORAE DTFRAE DTORAE /end DEF_CHARACTERISTIC
 /begin REF_CHARACTERISTIC FRAMN FRAMX OFLRAMN OFLRAMX /end REF_CHARACTERISTIC
 /begin IN_MEASUREMENT B_lrafraf B_lraoraf B_stendes fra_w msleak_w SyC_stSub /end IN_MEASUREMENT
 /begin OUT_MEASUREMENT B_dfra B_dora B_fraef B_gae B_gaef B_oraef B_tfrae B_torae fraref_w msleakrf_w /end OUT_MEASUREMENT
 /begin LOC_MEASUREMENT B_errorafra B_framn B_framx B_mslkmn B_mslkmx /end LOC_MEASUREMENT
 FUNCTION_VERSION "9000.4.0" /end FUNCTION
/begin FUNCTION DLLR "9000.4.0  Diagnosis: idle speed control, recognising a blocked actuator"
 /begin DEF_CHARACTERISTIC CWDLLR CWDLLRKH DASA DFC_CtlMsk2.DFC_DLLRmax_C DFC_CtlMsk2.DFC_DLLRmin_C DFC_CtlMsk2.DFC_DLLRnpl_C DFC_DisblMsk2.DFC_DLLRmax_C DFC_DisblMsk2.DFC_DLLRmin_C DFC_DisblMsk2.DFC_DLLRnpl_C DNDLLRO DNDLLROKH DNDLLRU DNDLLRUKH DNMOTG FHDLLR INJCOPAT NMOTDLLR NMOTGNP RLMDVERL RLMDVERLKH TADLLR TDLLFG1 TDLLR TDLLRMN TDLLRMNKH TDLLRMX TDLLRMXKH TDLLRNF TDLLRNFKH TMDLLR TMDLLRKH TNSTDLLR /end DEF_CHARACTERISTIC
 /begin IN_MEASUREMENT B_kh B_ll B_nldg B_nmot B_sa B_st B_tehb dmllri_w dns EngDa_tEng EngDa_tStrt evz_austot fho limax_w limin_w mdverl_w nmot_w nstat rl SyC_stSub tans tnse_w vfzg /end IN_MEASUREMENT
 /begin OUT_MEASUREMENT B_dllr B_dllrfg B_dllrkha /end OUT_MEASUREMENT
 /begin LOC_MEASUREMENT B_dllrebd B_esmnllr B_esmxllr B_esnpllr B_tmdllrkh dasactr nmotgneg nmotgpos /end LOC_MEASUREMENT
 FUNCTION_VERSION "9000.4.0" /end FUNCTION
/begin FUNCTION DLSA "9000.11.0 Ageing diagnosis binary oxygen sensors upstream catalyst"
 /begin DEF_CHARACTERISTIC ANZDPVK ANZTP CWDLSAFA DFC_CtlMsk2.DFC_LATP_C DFC_CtlMsk2.DFC_LDLAHI_C DFC_DisblMsk2.DFC_LATP_C DFC_DisblMsk2.DFC_LDLAHI_C DLAHIMDL DLAHIMN DLAHIMX DTSVKO DTSVKZTP HEGOD_ratLamCtrlMaxThres_C HEGOD_ratLamCtrlMinThres_C NTPVKO NTPVKU RLTPVKO RLTPVKU TSTEAA TSVKO TUSPNMX TWDLAHI ZFTSVK /end DEF_CHARACTERISTIC
 /begin REF_CHARACTERISTIC LRHIMX /end REF_CHARACTERISTIC
 /begin IN_MEASUREMENT B_leandb B_lr B_lrhki B_lrtv B_te dlahi nmot PrjCon_stLamSensRrCat_b rl SyC_stSub tramp tvlr tvomdkat zlrh_w /end IN_MEASUREMENT
 /begin OUT_MEASUREMENT B_anztp B_anztpip B_dlahi B_dlatp B_maxlatp dtpsvkmf tplrn tplrp tpsvkmfd_w tpsvkmf_w tsvkod_w tuspnf tuspnfd_w tuspnxd_w /end OUT_MEASUREMENT
 /begin LOC_MEASUREMENT B_dlaff B_lrstat B_lrtpp B_lsastp B_maxdlahi B_mindlahi B_ncdlahi B_nclatp B_nodlahi B_nolatp B_zdlahi B_zmdlahi dlaimod dtpsvkof tlatpip_w tpsvkof_w tsvtpip_w tzdlahi_w zlsatp zlsatpip zwpvk zwpvkip /end LOC_MEASUREMENT
 FUNCTION_VERSION "9000.11.0" /end FUNCTION
/begin FUNCTION DLSAHK "9000.2.0  Ageing diagnosis binary oxygen sensors downstream catalyst"
 /begin DEF_CHARACTERISTIC CWDLSAHK DFC_CtlMsk2.DFC_LASHmn_C DFC_CtlMsk2.DFC_LASHmx_C DFC_DisblMsk2.DFC_LASHmn_C DFC_DisblMsk2.DFC_LASHmx_C DLAMLASHF DLAMLASHM FRMLASHO FRMLASHU HEGO_mEgLamAdjmtThd_C TSALASH TSALSAHK TTLASH TUSCHUB TUSENLASH TUSLASH TUSSA USOVRRN /end DEF_CHARACTERISTIC
 /begin IN_MEASUREMENT B_bevab B_ilmlkax B_imllr B_lrhkgi B_sa B_sbbhk B_ttbmhh frm_w ml_w PrjCon_stLamSensRrCat_b SyC_stSub ubsq ushkl usrhk /end IN_MEASUREMENT
 /begin OUT_MEASUREMENT B_dlash B_lamdiag B_ushkf B_ushkm lamdiag /end OUT_MEASUREMENT
 /begin LOC_MEASUREMENT B_dlashkf B_dlashkm B_dlash_FF B_dshk B_dushsch B_enlash B_enmod B_entest B_lamend B_lammod B_lashken B_maxlash B_minlash B_nclash B_nolashmn B_nolashmx B_sbbhkv B_teslash B_tuschub B_uschers B_ushkfr B_ushkmr B_zmodf B_zmodh B_zmodsch HEGO_mEgLamAdjmtIK_I.memory ushschub zlashmo_w zlash_w /end LOC_MEASUREMENT
 FUNCTION_VERSION "9000.2.0" /end FUNCTION
/begin FUNCTION DLSH "9000.4.0  Electrical diagnosis binary oxygen sensors downstream catalyst"
 /begin DEF_CHARACTERISTIC ANZHZKH ANZHZOFFH DFC_CtlMsk2.DFC_LSHmax_C DFC_CtlMsk2.DFC_LSHmin_C DFC_CtlMsk2.DFC_LSHnpl_C DFC_CtlMsk2.DFC_LSHsig_C DFC_DisblMsk2.DFC_LSHmax_C DFC_DisblMsk2.DFC_LSHmin_C DFC_DisblMsk2.DFC_LSHnpl_C DFC_DisblMsk2.DFC_LSHsig_C DUSHKHZKXF PHLSHMN RIXFSBHK TAMDOGH TAMDUGH TASIGH TMSH TMSHA TNSTDNH TRSAH TTBMH TUSDUH TUSHZFH TUSMAX TUSMD USMAXHXF USMINHXF USREFHXF USREMHXF /end DEF_CHARACTERISTIC
 /begin IN_MEASUREMENT B_atmtpk B_bevab B_frmax B_hsha B_hshe B_hskfhxf B_lsvklt B_mdkat B_nmot B_pwf B_rinavgh B_st B_stendes lamsol phlsnhxf PrjCon_stLamSensRrCat_b rinavgh_w SyC_stSub tkihkm tmot tmotab ubsq ushkl_w /end IN_MEASUREMENT
 /begin OUT_MEASUREMENT B_adsh B_adshs B_dshen B_hzkfh B_lshklt B_maxflsh B_minflsh B_nolsh B_nplflsh B_sbbhk B_sigflsh B_trsah B_ttbmhh B_uhsig HEGO_flgTheoRdnDsSnsrHeatg /end OUT_MEASUREMENT
 /begin LOC_MEASUREMENT B_anzhzkh B_anzhzoh B_hzkhzyk B_hzoffh B_noadsh B_tushzfh usftshsa_w usmgshsa_w zhzkh zhzoffh /end LOC_MEASUREMENT
 FUNCTION_VERSION "9000.4.0" /end FUNCTION
/begin FUNCTION DLSV "9000.25.0 Diagnosis; Readiness for operation of sensor upstream catalyst"
 /begin DEF_CHARACTERISTIC ANZHZKV ANZHZOFFV DFC_CtlMsk2.DFC_HEGOS1B1ElecNpl_C DFC_CtlMsk2.DFC_LSVmax_C DFC_CtlMsk2.DFC_LSVmin_C DFC_CtlMsk2.DFC_LSVnpl_C DFC_CtlMsk2.DFC_LSVsig_C DFC_DisblMsk2.DFC_HEGOS1B1ElecNpl_C DFC_DisblMsk2.DFC_LSVmax_C DFC_DisblMsk2.DFC_LSVmin_C DFC_DisblMsk2.DFC_LSVnpl_C DFC_DisblMsk2.DFC_LSVsig_C DUSVKHZKXF HEGO_mAirStkHiDeb_C HEGO_mAirStkLowDebSensDs_C HEGO_mAirStkLowDeb_C HEGO_nEngSpdThdIdle_C HEGO_resScgMin_C HEGO_stDiagUpSnsr_CW HEGO_stElecDiag_C HEGO_tiDebIdleInactv_C PHLSNVMN RIXFSBVK TAMDOGV TAMDUGV TASIGV TMSV TMSVA TNSTDN TRSA TSEINV TTBMHV TUSDU TUSDUC TUSHZFV TUSMAXV USFHKXF USLNPVXF USMAXVXF USMHKXF USMINVXF USPVRXF USREFXF USREMXF USUNPVXF /end DEF_CHARACTERISTIC
 /begin IN_MEASUREMENT B_atmtpa B_bevab B_frmax B_frmin B_hskfvxf B_hsve B_ll B_lr B_nmot B_pwf B_rinavgv B_sbbhk B_st B_stendes EngDa_tEng EngDa_tStop EngDa_tStrt ExhMod_flgHeatgTspS1B1 lamsol ml_w nmot_w phlsnvxf PrjCon_stLamSensRrCat_b rinavgv_w SyC_stSub taikrm ubsq ushkl_w usvkl_w /end IN_MEASUREMENT
 /begin OUT_MEASUREMENT B_dsven B_hzkfv B_lsvklt B_maxflsv B_minflsv B_nolsv B_nplflsv B_sbbvk B_sigflsv B_trsa B_ttbmhv HEGO_bS1B1ErrElecHtrCpl HEGO_flgTheoRdnSnsrHeatg /end OUT_MEASUREMENT
 /begin LOC_MEASUREMENT B_adsvb B_anzhzkv B_anzhzov B_dsvenel B_eol B_hzkvzyk B_hzoffv B_lsads B_lsfet B_lshub B_refmax B_tushzfv B_uvsig HEGO_flgStuckHiFltCurr HEGO_flgStuckHiFltPrev HEGO_mAirStkHiS1B1 HEGO_mAirStkLowS1B1 usftsasa_w usmgsasa_w zhzkv zhzoffv /end LOC_MEASUREMENT
 FUNCTION_VERSION "9000.25.0" /end FUNCTION
/begin FUNCTION DPLPSR "9500.9.0  Diagnosis plausibilisation manifold pressure sensor"
 /begin DEF_CHARACTERISTIC DFC_CtlMsk2.DFC_DSSRngMax_C DFC_CtlMsk2.DFC_DSSRngMin_C DFC_CtlMsk2.DFC_DSSnpl_C DFC_CtlMsk2.DFC_DSSnplMax_C DFC_CtlMsk2.DFC_DSSnplMin_C DFC_CtlMsk2.DFC_DSSsig_C DFC_DisblMsk2.DFC_DSSRngMax_C DFC_DisblMsk2.DFC_DSSRngMin_C DFC_DisblMsk2.DFC_DSSnpl_C DFC_DisblMsk2.DFC_DSSnplMax_C DFC_DisblMsk2.DFC_DSSnplMin_C DFC_DisblMsk2.DFC_DSSsig_C FKRLDSSM FRLDKRMNHY FRLDKRMXHY NMDPLPSR PIntkVUs_nrCntrSigErr_C PIntkVUs_nrCntrSigHeal_C PIntkVUs_pDeltaSigVld_C PIntkVUs_rThrVlvLimPSigChk_T PSRRNGMN PSRRNGMX RLDKGPLPS RLHYSHLMN RLHYSHLMX TDDPLPSR TDDSSST TDEPLDSS TDSA /end DEF_CHARACTERISTIC
 /begin IN_MEASUREMENT B_edk B_mdoffap B_psrrg B_sa B_syn drldk nmot_w PIntkVUs_pSigMax PIntkVUs_pSigMin psrgwind_w rldkmax_w rldkmin_w rlfgdss_w SyC_stSub tnse_w wdkba /end IN_MEASUREMENT
 /begin OUT_MEASUREMENT B_edss B_epldss B_erngmax B_erngmin B_errmnpl B_errmxpl B_esgnps B_fgadss B_fpsrpl B_healrng B_heplsr B_psrg B_psrpl B_resgnps B_resmaxpl B_resminpl PIntkVUs_stSigChkFrz /end OUT_MEASUREMENT
 /begin LOC_MEASUREMENT PIntkVUs_nrCntrSigChk /end LOC_MEASUREMENT
 FUNCTION_VERSION "9500.9.0" /end FUNCTION
/begin FUNCTION DPS_Tmp "100.0.0   standard powerstage diagnosis" /begin DEF_CHARACTERISTIC DPSWATCHINDEX THP TVP /end DEF_CHARACTERISTIC /begin IN_MEASUREMENT B_PmdInit_msg /end IN_MEASUREMENT
 /begin LOC_MEASUREMENT dps_error dps_errStat dps_errStat_sum_rec dps_errStat_sum_ver dps_index dps_recoveryTime dps_state dps_verifyTime /end LOC_MEASUREMENT
 FUNCTION_VERSION "100.0.0" /end FUNCTION
/begin FUNCTION DSCHED_Cal "1.1.0     Diagnostic Scheduler Calibration"
 /begin DEF_CHARACTERISTIC DSCHED_BsPrio.FId_InhibitAlways_C DSCHED_LimPrio.FId_InhibitAlways_C DSCHED_valOfsPrioOpMode_C /end DEF_CHARACTERISTIC
 /begin OUT_MEASUREMENT DSCHED_DynPrio.FId_Unused DSCHED_DynPrio.FId_InhibitAlways /end OUT_MEASUREMENT
 FUNCTION_VERSION "1.1.0" /end FUNCTION
/begin FUNCTION DSCHED_Eval "30000.8.0 Diagnostic Scheduler Evaluation" /begin DEF_CHARACTERISTIC DSCHED_stMode_C DSCHED_valDflOpMode_C /end DEF_CHARACTERISTIC
 /begin OUT_MEASUREMENT DSCHED_St.FId_Unused DSCHED_St.FId_InhibitAlways DSCHED_WhyExcl.FId_Unused DSCHED_WhyExcl.FId_InhibitAlways /end OUT_MEASUREMENT
 FUNCTION_VERSION "30000.8.0" /end FUNCTION
/begin FUNCTION DSM2AUTOSAR "30000.46.0AUTOSAR Layer to DSM" /begin IN_MEASUREMENT DFES_stErrLamp DFES_stOutstate /end IN_MEASUREMENT
 /begin LOC_MEASUREMENT Dem_BswErrorBufferWriteCounter Dem_BswErrorBufferWriteIndex Dem_PTOSt Dem_stInit /end LOC_MEASUREMENT
 FUNCTION_VERSION "30000.46.0" /end FUNCTION
/begin FUNCTION DSMAux "30000.32.3DSM Auxiliary"
 /begin DEF_CHARACTERISTIC DSMAUX_dtWUCMin_C DSMAUX_tWUCMin_C DSMAUX_xClearMode_C DSMAUX_xClearTrg_C /end DEF_CHARACTERISTIC
 /begin IN_MEASUREMENT SyC_stSub /end IN_MEASUREMENT
 /begin OUT_MEASUREMENT DSMAUX_ctObdDCy_msg DSMAUX_ctWUC DSMAUX_ctWUC_msg DSMAUX_DTRG.DTRG_Time200ms DSMAUX_DTRG.DTRG_SimilarCondHLC DSMAUX_DTRG.DTRG_DrivingCycleFLC DSMAUX_DTRG.DTRG_AlwaysTrue DSMAUX_DTRG.DTRG_MDCatHLC DSMAUX_DTRG.DTRG_MDCatFLC DSMAUX_DTRG.DTRG_MDFLC DSMAUX_DTRG.DTRG_WarmUpCycle DSMAUX_DTRG.DTRG_DrivingCycleHLC DSMAUX_DTRG.DTRG_MDEmiStrtFLC DSMAUX_DTRG.DTRG_NoTrigger DSMAUX_DTRG.DTRG_MDEmiStrtHLC DSMAUX_DTRG.DTRG_MDEmiHLC DSMAUX_DTRG.DTRG_MDEmiFLC DSMAUX_DTRG.DTRG_MDHLC DSMAUX_stDCy DSMAUX_stDCy_msg DSMAUX_stDsmClrActv DSM_TripChgAndClrFinshd DSM_TripChgFinshd /end OUT_MEASUREMENT
 /begin LOC_MEASUREMENT DSMAUX_ctObdDCy DSMAUX_stClrProc DSMAUX_stClrTaskFin DSMAUX_stStrtEnd DSMAUX_stTranGlbJob DSMAUX_stTranGlbRun DSMAUX_stTranReq DSMAUX_tClntStrt DSM_stPostDrive DSM_stReInit /end LOC_MEASUREMENT
 FUNCTION_VERSION "30000.32.3" /end FUNCTION
/begin FUNCTION DSMDur "30000.8.0 DSM Duration Counters"
 /begin DEF_CHARACTERISTIC DSMDur_valEvntQntDist_C DSMDur_valEvntQntTi_C DSMDur_xEnaGlb_CA DSMDur_xRstGlb_CA DSMDur_xSelEvntGlb_CA /end DEF_CHARACTERISTIC
 /begin OUT_MEASUREMENT DSMDur_cntrPID4Dh DSMDur_cntrPID4Eh DSMDur_ctGlb DSMDur_ctPID21h DSMDur_ctPID31h DSMDur_stGlb /end OUT_MEASUREMENT
 /begin LOC_MEASUREMENT DSMDur_ct40WUC DSMDur_lRef DSMDur_lRef10m DSMDur_stPID21h DSMDur_stWUCLst DSMDur_tiRef DSMDur_tiRef60s /end LOC_MEASUREMENT
 FUNCTION_VERSION "30000.8.0" /end FUNCTION
/begin FUNCTION DSMRdy "30000.11.0DSM Readiness"
 /begin DEF_CHARACTERISTIC DSMRdy_Grp.Cat_CA DSMRdy_Grp.HtCat_CA DSMRdy_Grp.EvpSys_CA DSMRdy_Grp.SecAirSys_CA DSMRdy_Grp.O2Sens_CA DSMRdy_Grp.O2SensHt_CA DSMRdy_Grp.EGR_CA DSMRdy_X.PID1ForceLowMsk_C DSMRdy_X.PID1ForceHighMsk_C DSMRdy_X.PID41ForceLowMsk_C DSMRdy_X.PID41ForceHighMsk_C /end DEF_CHARACTERISTIC
 /begin OUT_MEASUREMENT DSMRdy_xPId1 /end OUT_MEASUREMENT
 /begin LOC_MEASUREMENT DSMRdy_stGrpRdy DSMRdy_stGrpRdyDFES DSMRdy_stGrpRdyScan DSMRdy_stGrpSup /end LOC_MEASUREMENT
 FUNCTION_VERSION "30000.11.0" /end FUNCTION
/begin COMPU_METHOD B_TRUE "" TAB_VERB "%6.3" "" COMPU_TAB_REF B_TRUE /end COMPU_METHOD
/begin COMPU_VTAB B_TRUE "" TAB_VERB 2 0 "FALSE" 1 "TRUE" /end COMPU_VTAB
/begin COMPU_METHOD dez "" RAT_FUNC "%6.2" "" COEFFS 0 1 0 0 0 1 /end COMPU_METHOD
/begin COMPU_METHOD DFC_OneToOne "" RAT_FUNC "%6.2" "-" COEFFS 0 1 0 0 0 1 /end COMPU_METHOD
/begin COMPU_METHOD DFC_Verb "" TAB_VERB "%2.1" "-" COMPU_TAB_REF DFC_Verb /end COMPU_METHOD
/begin COMPU_VTAB DFC_Verb "" TAB_VERB 161 0 "DFC_Unused" 4 "DFC_BusDiagBusOff_Can0" 1 "DFC_BusDiagOpenLoad_Can0" 57 "DFC_BypAirActrOcCoil1" 58 "DFC_BypAirActrOcCoil2" 59 "DFC_BypAirActrOlCoil1" 60 "DFC_BypAirActrOlCoil2" 61 "DFC_BypAirActrOt" 62 "DFC_BypAirActrScbCoil1" 63 "DFC_BypAirActrScbCoil2" 64 "DFC_BypAirActrScgCoil1" 65 "DFC_BypAirActrScgCoil2" 39 "DFC_CAN_E_TIMEOUT" 33 "DFC_CANIF_E_CTRL_NOT_SLEEP_ERROR_VALUE" 34 "DFC_CANIF_E_CTRL_STOPPED_ERROR_VALUE" 35 "DFC_CANIF_E_INVALID_DLC_ERROR" 36 "DFC_CANNM_E_CANIF_TRANSMIT_ERROR" 37 "DFC_CANNM_E_INIT_FAILED" 38 "DFC_CANNM_E_NETWORK_TIMEOUT" 66 "DFC_CEngDsTPhysRngHi" 67 "DFC_CEngDsTPhysRngLo" 18 "DFC_CEngDsTPlausSTC" 68 "DFC_CEngDsTSRCMax" 69 "DFC_CEngDsTSRCMin" 19 "DFC_ClthStkOpn" 2 "DFC_Com_ABSInfo_DLC" 3 "DFC_Com_ABSInfo_TO" 40 "DFC_COMM_E_NET_START_IND_CHANNEL_0" 41 "DFC_COMM_E_NET_START_IND_CHANNEL_1" 42 "DFC_COMM_E_NET_START_IND_CHANNEL_2" 43 "DFC_COMM_E_NET_START_IND_CHANNEL_3" 44 "DFC_COMM_E_NET_START_IND_CHANNEL_4" 45 "DFC_COMM_E_NET_START_IND_CHANNEL_5" 5 "DFC_DevLibBattUHi" 6 "DFC_DevLibBattULo" 70 "DFC_DKmax" 71 "DFC_DKmin" 72 "DFC_DLLRmax" 73 "DFC_DLLRmin" 74 "DFC_DLLRnpl" 77 "DFC_DSSmax" 78 "DFC_DSSmin" 79 "DFC_DSSnpl" 80 "DFC_DSSnplMax" 81 "DFC_DSSnplMin" 75 "DFC_DSSRngMax" 76 "DFC_DSSRngMin" 82 "DFC_DSSsig" 83 "DFC_EpmCrSErrSig" 84 "DFC_EpmCrSNoSig" 15 "DFC_EV1max" 16 "DFC_EV1min" 17 "DFC_EV1sig" 20 "DFC_EVX" 94 "DFC_HdLampMax" 95 "DFC_HdLampMin" 96 "DFC_HdLampSig" 85 "DFC_HEGOS1B1ElecNpl" 86 "DFC_HSH" 87 "DFC_HSHEmax" 88 "DFC_HSHEmin" 89 "DFC_HSHEsig" 90 "DFC_HSV" 91 "DFC_HSVEmax" 92 "DFC_HSVEmin" 93 "DFC_HSVEsig" 97 "DFC_IgnCoil1Err" 98 "DFC_IgnCoil2Err" 99 "DFC_IgnIgbtDiagSCG_0" 100 "DFC_IgnIgbtDiagSCG_1" 101 "DFC_IntkAirTAirFltDsPRCMax" 102 "DFC_IntkAirTAirFltDsPRCMin" 103 "DFC_IntkAirTAirFltDsSRCMax" 104 "DFC_IntkAirTAirFltDsSRCMin" 21 "DFC_IntkAirTAirFltDsSTC" 105 "DFC_IntkMnfldPNoSyn" 106 "DFC_KAT" 107 "DFC_KPEmax" 108 "DFC_KPEmin" 109 "DFC_KPEsig" 110 "DFC_KVSFmax" 111 "DFC_KVSFmin" 112 "DFC_KVSOmax" 113 "DFC_KVSOmin" 114 "DFC_LASHmn" 115 "DFC_LASHmx" 116 "DFC_LATP" 117 "DFC_LDLAHI" 118 "DFC_LFS1Max" 119 "DFC_LFS1Min" 120 "DFC_LFS1Sig" 121 "DFC_LSHmax" 122 "DFC_LSHmin" 123 "DFC_LSHnpl" 124 "DFC_LSHsig" 125 "DFC_LSVmax" 126 "DFC_LSVmin" 127 "DFC_LSVnpl" 128 "DFC_LSVsig" 129 "DFC_MDCat" 130 "DFC_MDCatCurr" 131 "DFC_MDCyl" 132 "DFC_MDEmi" 133 "DFC_MDEmiStrt" 134 "DFC_MDMpl" 11 "DFC_MILLmpOL" 12 "DFC_MILLmpOT" 13 "DFC_MILLmpSCB" 14 "DFC_MILLmpSCG" 135 "DFC_MoCADCNTP" 136 "DFC_MoCADCTst" 137 "DFC_MoFSidst" 138 "DFC_OCWDACom" 139 "DFC_OilPPSSwtMax" 140 "DFC_OilPPSSwtMin" 141 "DFC_OilPPSSwtSig" 142 "DFC_OvHEngSpdLimr" 46 "DFC_PDUR_E_INIT_FAILED" 47 "DFC_PDUR_E_PDU_INSTANCE_LOST" 48 "DFC_RBA_IOEXTLIB_KEEPALIVE_DRV" 49 "DFC_RBA_IOEXTLIB_KEEPALIVE_INI" 50 "DFC_rba_IoSigRtc_StopCounter" 52 "DFC_rba_MRly_Diag_Stk_Event" 51 "DFC_rba_MultiStackTrace_Threshold" 53 "DFC_rba_SyC_IrrSwOffTrigEngRun_Event" 54 "DFC_rba_T15_Diag_ComInVld_Event" 55 "DFC_rba_T15_Diag_ComOff_HwOn_Event" 56 "DFC_rba_T15_Diag_ComOn_HwOff_Event" 22 "DFC_RoughRoad" 143 "DFC_RoVComVld" 144 "DFC_RoVSNpl" 145 "DFC_RoVSOL" 146 "DFC_RoVSSCB" 147 "DFC_RoVSSCG" 148 "DFC_SdSTNpl" 149 "DFC_SdSTSCB" 150 "DFC_SdSTSCG" 151 "DFC_SdSTSOL" 23 "DFC_SSpMon1" 24 "DFC_SSpMon1OT" 25 "DFC_SSpMon1OV" 26 "DFC_SSpMon1SCG" 27 "DFC_SSpMon1UV" 28 "DFC_SSpMon2" 29 "DFC_SSpMon2OT" 30 "DFC_SSpMon2OV" 31 "DFC_SSpMon2SCG" 32 "DFC_SSpMon2UV" 7 "DFC_StrtOL" 8 "DFC_StrtOvrTemp" 9 "DFC_StrtSCB" 10 "DFC_StrtSCG" 152 "DFC_TEVEmax" 153 "DFC_TEVEmin" 154 "DFC_TEVEsig" 155 "DFC_TMnpl" 156 "DFC_UBmax" 157 "DFC_UBmin" 158 "DFC_UBnpl" 159 "DFC_VFZsig" 160 "DFC_VFZsig2" DEFAULT_VALUE "---" /end COMPU_VTAB
/begin COMPU_METHOD DFES_OneToOne "" RAT_FUNC "%6.2" "-" COEFFS 0 1 0 0 0 1 /end COMPU_METHOD
/begin COMPU_METHOD DINH_OneToOne "" RAT_FUNC "%6.2" "-" COEFFS 0 1 0 0 0 1 /end COMPU_METHOD
/begin COMPU_METHOD DSCHED_FIdExcCauseVerb "" TAB_VERB "%2.1" "-" COMPU_TAB_REF DSCHED_FIdExcCauseVerb /end COMPU_METHOD
/begin COMPU_VTAB DSCHED_FIdExcCauseVerb "" TAB_VERB 5 0 "No_exclusion" 1 "FId_InhibitAlways" 253 "NO_PRIO" 254 "MODE_IMPOSSIBLE" 255 "NO_RUN" DEFAULT_VALUE "---" /end COMPU_VTAB
/begin COMPU_METHOD DSCHED_StVerb "" TAB_VERB "%6.3" "-" COMPU_TAB_REF DSCHED_StVerb /end COMPU_METHOD
/begin COMPU_VTAB DSCHED_StVerb "" TAB_VERB 64 0 "____________________________" 2 "_____________________RawPerm" 4 "_________________Act________" 6 "_________________Act_RawPerm" 8 "_____________Lck____________" 10 "_____________Lck_____RawPerm" 12 "_____________Lck_Act________" 14 "_____________Lck_Act_RawPerm" 32 "_________Val________________" 34 "_________Val_________RawPerm" 36 "_________Val_____Act________" 38 "_________Val_____Act_RawPerm" 40 "_________Val_Lck____________" 42 "_________Val_Lck_____RawPerm" 44 "_________Val_Lck_Act________" 46 "_________Val_Lck_Act_RawPerm" 64 "____Perm____________________" 66 "____Perm_____________RawPerm" 68 "____Perm_________Act________" 70 "____Perm_________Act_RawPerm" 72 "____Perm_____Lck____________" 74 "____Perm_____Lck_____RawPerm" 76 "____Perm_____Lck_Act________" 78 "____Perm_____Lck_Act_RawPerm" 96 "____Perm_Val________________" 98 "____Perm_Val_________RawPerm" 100 "____Perm_Val_____Act________" 102 "____Perm_Val_____Act_RawPerm" 104 "____Perm_Val_Lck____________" 106 "____Perm_Val_Lck_____RawPerm" 108 "____Perm_Val_Lck_Act________" 110 "____Perm_Val_Lck_Act_RawPerm" 128 "Rdy_________________________" 130 "Rdy__________________RawPerm" 132 "Rdy______________Act________" 134 "Rdy______________Act_RawPerm" 136 "Rdy__________Lck____________" 138 "Rdy__________Lck_____RawPerm" 140 "Rdy__________Lck_Act________" 142 "Rdy__________Lck_Act_RawPerm" 160 "Rdy______Val________________" 162 "Rdy______Val_________RawPerm" 164 "Rdy______Val_____Act________" 166 "Rdy______Val_____Act_RawPerm" 168 "Rdy______Val_Lck____________" 170 "Rdy______Val_Lck_____RawPerm" 172 "Rdy______Val_Lck_Act________" 174 "Rdy______Val_Lck_Act_RawPerm" 192 "Rdy_Perm____________________" 194 "Rdy_Perm_____________RawPerm" 196 "Rdy_Perm_________Act________" 198 "Rdy_Perm_________Act_RawPerm" 200 "Rdy_Perm_____Lck____________" 202 "Rdy_Perm_____Lck_____RawPerm" 204 "Rdy_Perm_____Lck_Act________" 206 "Rdy_Perm_____Lck_Act_RawPerm" 224 "Rdy_Perm_Val________________" 226 "Rdy_Perm_Val_________RawPerm" 228 "Rdy_Perm_Val_____Act________" 230 "Rdy_Perm_Val_____Act_RawPerm" 232 "Rdy_Perm_Val_Lck____________" 234 "Rdy_Perm_Val_Lck_____RawPerm" 236 "Rdy_Perm_Val_Lck_Act________" 238 "Rdy_Perm_Val_Lck_Act_RawPerm" /end COMPU_VTAB
/begin COMPU_METHOD DSM2SG_DFC_SY_Compu "" TAB_VERB "%6.3" "" COMPU_TAB_REF DSM2SG_DFC_SY_Compu /end COMPU_METHOD
/begin COMPU_VTAB DSM2SG_DFC_SY_Compu "" TAB_VERB 2 0 "False" 1 "True" /end COMPU_VTAB
/begin COMPU_METHOD DSM2SG_DSQ_SY_Compu "" TAB_VERB "%6.3" "" COMPU_TAB_REF DSM2SG_DSQ_SY_Compu /end COMPU_METHOD
/begin COMPU_VTAB DSM2SG_DSQ_SY_Compu "" TAB_VERB 2 0 "False" 1 "True" /end COMPU_VTAB
/begin COMPU_METHOD DSM2SG_EXCH_SC_Compu "" TAB_VERB "%6.3" "" COMPU_TAB_REF DSM2SG_EXCH_SC_Compu /end COMPU_METHOD
/begin COMPU_VTAB DSM2SG_EXCH_SC_Compu "" TAB_VERB 2 0 "FALSE" 1 "TRUE" /end COMPU_VTAB
/begin COMPU_METHOD DSM2SG_FID_SY_Compu "" TAB_VERB "%6.3" "" COMPU_TAB_REF DSM2SG_FID_SY_Compu /end COMPU_METHOD
/begin COMPU_VTAB DSM2SG_FID_SY_Compu "" TAB_VERB 2 0 "False" 1 "True" /end COMPU_VTAB
/begin COMPU_METHOD DSMAPL_UNIFIEDDRVGCYC_SC_Compu "" TAB_VERB "%6.3" "" COMPU_TAB_REF DSMAPL_UNIFIEDDRVGCYC_SC_Compu /end COMPU_METHOD
/begin COMPU_VTAB DSMAPL_UNIFIEDDRVGCYC_SC_Compu "" TAB_VERB 2 0 "Not_Unified" 1 "Unified" /end COMPU_VTAB
/begin COMPU_METHOD DSMAPPL_OBSVR_SC_Compu "" TAB_VERB "%6.3" "" COMPU_TAB_REF DSMAPPL_OBSVR_SC_Compu /end COMPU_METHOD
/begin COMPU_VTAB DSMAPPL_OBSVR_SC_Compu "" TAB_VERB 2 0 "False" 1 "True" /end COMPU_VTAB
/begin COMPU_METHOD DSMAUX_stDCyVerb "" TAB_VERB "%6.3" "-" COMPU_TAB_REF DSMAUX_stDCyVerb /end COMPU_METHOD
/begin COMPU_VTAB DSMAUX_stDCyVerb "" TAB_VERB 4 0 "DCy_New" 1 "DCy_Qualified" 2 "DCy_KeyOnCyc" 3 "DCy_Completed" /end COMPU_VTAB
/begin COMPU_METHOD DSMAUX_TCSORT_SY_Compu "" TAB_VERB "%6.3" "" COMPU_TAB_REF DSMAUX_TCSORT_SY_Compu /end COMPU_METHOD
/begin COMPU_VTAB DSMAUX_TCSORT_SY_Compu "" TAB_VERB 2 0 "TCSORT_disabled" 1 "TCSORT_enabled" /end COMPU_VTAB
/begin COMPU_METHOD DSMBAS_CENSUPPDIUMPR_SC_Compu "" TAB_VERB "%6.3" "" COMPU_TAB_REF DSMBAS_CENSUPPDIUMPR_SC_Compu /end COMPU_METHOD
/begin COMPU_VTAB DSMBAS_CENSUPPDIUMPR_SC_Compu "" TAB_VERB 2 0 "Disabled" 1 "Enabled" /end COMPU_VTAB
/begin COMPU_METHOD DSMBAS_CENSUPPDTR_SC_Compu "" TAB_VERB "%6.3" "" COMPU_TAB_REF DSMBAS_CENSUPPDTR_SC_Compu /end COMPU_METHOD
/begin COMPU_VTAB DSMBAS_CENSUPPDTR_SC_Compu "" TAB_VERB 2 0 "Disabled" 1 "Enabled" /end COMPU_VTAB
/begin COMPU_METHOD DSMBAS_IGRABORTCDN_SC_Compu "" TAB_VERB "%6.3" "" COMPU_TAB_REF DSMBAS_IGRABORTCDN_SC_Compu /end COMPU_METHOD
/begin COMPU_VTAB DSMBAS_IGRABORTCDN_SC_Compu "" TAB_VERB 2 0 "False" 1 "True" /end COMPU_VTAB
/begin COMPU_METHOD DSMBAS_KEYONCYCFLCTRIG_SC_Compu "" TAB_VERB "%6.3" "" COMPU_TAB_REF DSMBAS_KEYONCYCFLCTRIG_SC_Compu /end COMPU_METHOD
/begin COMPU_VTAB DSMBAS_KEYONCYCFLCTRIG_SC_Compu "" TAB_VERB 2 0 "False" 1 "True" /end COMPU_VTAB
/begin COMPU_METHOD DSMBAS_KEYONCYCTRANDURGDRV_SC_Compu "" TAB_VERB "%6.3" "" COMPU_TAB_REF DSMBAS_KEYONCYCTRANDURGDRV_SC_Compu /end COMPU_METHOD
/begin COMPU_VTAB DSMBAS_KEYONCYCTRANDURGDRV_SC_Compu "" TAB_VERB 2 0 "False" 1 "True" /end COMPU_VTAB
/begin COMPU_METHOD DSMBAS_PNDRPRTMOD2_SC_Compu "" TAB_VERB "%6.3" "" COMPU_TAB_REF DSMBAS_PNDRPRTMOD2_SC_Compu /end COMPU_METHOD
/begin COMPU_VTAB DSMBAS_PNDRPRTMOD2_SC_Compu "" TAB_VERB 2 0 "CONFIRMED" 1 "PENDING" /end COMPU_VTAB
/begin COMPU_METHOD DSMBAS_PREFAILDINTDEB_SC_Compu "" TAB_VERB "%6.3" "" COMPU_TAB_REF DSMBAS_PREFAILDINTDEB_SC_Compu /end COMPU_METHOD
/begin COMPU_VTAB DSMBAS_PREFAILDINTDEB_SC_Compu "" TAB_VERB 2 0 "Disable" 1 "Enable" /end COMPU_VTAB
/begin COMPU_METHOD DSMBAS_REINIMETHSELN_SC_Compu "" TAB_VERB "%6.3" "" COMPU_TAB_REF DSMBAS_REINIMETHSELN_SC_Compu /end COMPU_METHOD
/begin COMPU_VTAB DSMBAS_REINIMETHSELN_SC_Compu "" TAB_VERB 2 0 "CYCLIC_TASK" 1 "INIDRV_TASK" /end COMPU_VTAB
/begin COMPU_METHOD DSMBAS_TESTFAILDSNCELSTCLR_SC_Compu "" TAB_VERB "%6.3" "" COMPU_TAB_REF DSMBAS_TESTFAILDSNCELSTCLR_SC_Compu /end COMPU_METHOD
/begin COMPU_VTAB DSMBAS_TESTFAILDSNCELSTCLR_SC_Compu "" TAB_VERB 2 0 "False" 1 "True" /end COMPU_VTAB
/begin COMPU_METHOD DSMBAS_VAR_SY_Compu "" TAB_VERB "%6.3" "" COMPU_TAB_REF DSMBAS_VAR_SY_Compu /end COMPU_METHOD
/begin COMPU_VTAB DSMBAS_VAR_SY_Compu "" TAB_VERB 50 0 "kein Kundenbezug" 1 "DAI" 3 "VWW" 4 "POR" 5 "AUD" 6 "OPE" 9 "FIA" 11 "BMW" 14 "PSA" 15 "REN" 17 "ALF" 18 "SAB" 19 "VOL" 20 "NIS" 21 "GMU" 22 "FOR" 26 "IMJ" 36 "MAN" 51 "SEA" 53 "CHR" 54 "JAG" 55 "ROL" 69 "FER" 72 "TOY" 123 "MIT" 147 "HYU" 159 "HON" 160 "MAZ" 183 "CU" 190 "LRG" 204 "VVW" 214 "AVT" 242 "Iveco" 243 "DMC" 248 "SUZ" 270 "KEF" 289 "AMG" 308 "TAT" 319 "MVM" 328 "MM" 385 "UAES" 578 "AL" 590 "SCANIA" 609 "Deutz" 760 "WEICHAI" 828 "RBCD" 999 "ALL" 2887 "Nonox" 9407 "DHC" 9454 "Fuso" /end COMPU_VTAB
/begin COMPU_METHOD DSMBDEP_SY_Compu "" TAB_VERB "%6.3" "" COMPU_TAB_REF DSMBDEP_SY_Compu /end COMPU_METHOD
/begin COMPU_VTAB DSMBDEP_SY_Compu "" TAB_VERB 2 0 "False" 1 "True" /end COMPU_VTAB
/begin COMPU_METHOD DSMDUR_10m_Counter "" RAT_FUNC "%6.4" "km" COEFFS 0 100 0 0 0 1 /end COMPU_METHOD
/begin COMPU_METHOD DSMDur_EvntSel_Verb "" TAB_VERB "%6.3" "-" COMPU_TAB_REF DSMDur_EvntSel_Verb /end COMPU_METHOD
/begin COMPU_VTAB DSMDur_EvntSel_Verb "" TAB_VERB 5 0 "NoCountEvent" 1 "DistanceEvents" 2 "TimeEvents" 4 "WarmUpCycleEvents" 8 "DistanceEvents10m" /end COMPU_VTAB
/begin COMPU_METHOD DSMDUR_MIL_GLB_SY_Compu "" TAB_VERB "%6.3" "" COMPU_TAB_REF DSMDUR_MIL_GLB_SY_Compu /end COMPU_METHOD
/begin COMPU_VTAB DSMDUR_MIL_GLB_SY_Compu "" TAB_VERB 2 0 "FALSE" 1 "TRUE" /end COMPU_VTAB
/begin COMPU_METHOD DSMDur_StDispl_Verb "" TAB_VERB "%6.3" "-" COMPU_TAB_REF DSMDur_StDispl_Verb /end COMPU_METHOD
/begin COMPU_VTAB DSMDur_StDispl_Verb "" TAB_VERB 3 0 "NotEnabled" 1 "CountingEnabled" 2 "ResetCondition" /end COMPU_VTAB
/begin COMPU_METHOD DSMDUR_SUPPID4D_SC_Compu "" TAB_VERB "%6.3" "" COMPU_TAB_REF DSMDUR_SUPPID4D_SC_Compu /end COMPU_METHOD
/begin COMPU_VTAB DSMDUR_SUPPID4D_SC_Compu "" TAB_VERB 2 0 "False" 1 "True" /end COMPU_VTAB
/begin COMPU_METHOD DSMDUR_SUPPID4E_SC_Compu "" TAB_VERB "%6.3" "" COMPU_TAB_REF DSMDUR_SUPPID4E_SC_Compu /end COMPU_METHOD
/begin COMPU_VTAB DSMDUR_SUPPID4E_SC_Compu "" TAB_VERB 2 0 "False" 1 "True" /end COMPU_VTAB
/begin COMPU_METHOD DSMRDY_ENA_FLSYSFORCELABEL_SC_Compu "" TAB_VERB "%6.3" "" COMPU_TAB_REF DSMRDY_ENA_FLSYSFORCELABEL_SC_Compu /end COMPU_METHOD
/begin COMPU_VTAB DSMRDY_ENA_FLSYSFORCELABEL_SC_Compu "" TAB_VERB 2 0 "False" 1 "True" /end COMPU_VTAB
/begin COMPU_METHOD DSMRDY_ENGSPEC_SY_Compu "" TAB_VERB "%6.3" "" COMPU_TAB_REF DSMRDY_ENGSPEC_SY_Compu /end COMPU_METHOD
/begin COMPU_VTAB DSMRDY_ENGSPEC_SY_Compu "" TAB_VERB 2 0 "FALSE" 1 "TRUE" /end COMPU_VTAB
/begin COMPU_METHOD DSMRDY_INHP41_SY_Compu "" RAT_FUNC "%6.2" "" COEFFS 0 1 0 0 0 1 /end COMPU_METHOD
/begin COMPU_METHOD DSMRdy_OneToOne "" RAT_FUNC "%6.2" "-" COEFFS 0 1 0 0 0 1 /end COMPU_METHOD
/begin COMPU_METHOD DSMRDY_SUPPID41_SY_Compu "" TAB_VERB "%6.3" "" COMPU_TAB_REF DSMRDY_SUPPID41_SY_Compu /end COMPU_METHOD
/begin COMPU_VTAB DSMRDY_SUPPID41_SY_Compu "" TAB_VERB 2 0 "FALSE" 1 "TRUE" /end COMPU_VTAB
/begin COMPU_METHOD DSMRDY_VERS_SC_Compu "" TAB_VERB "%6.3" "" COMPU_TAB_REF DSMRDY_VERS_SC_Compu /end COMPU_METHOD
/begin COMPU_VTAB DSMRDY_VERS_SC_Compu "" TAB_VERB 2 0 "DSMRDY_PRE_2009" 1 "DSMRDY_2009" /end COMPU_VTAB
/begin COMPU_METHOD DSM_DISBLGRPSIZE_SY_Compu "" RAT_FUNC "%6.2" "" COEFFS 0 1 0 0 0 1 /end COMPU_METHOD
/begin COMPU_METHOD DSM_DOBD_SC_Compu "" TAB_VERB "%6.3" "" COMPU_TAB_REF DSM_DOBD_SC_Compu /end COMPU_METHOD
/begin COMPU_VTAB DSM_DOBD_SC_Compu "" TAB_VERB 2 0 "False" 1 "True" /end COMPU_VTAB
/begin COMPU_METHOD DSM_DSM2SG_SY_Compu "" TAB_VERB "%6.3" "" COMPU_TAB_REF DSM_DSM2SG_SY_Compu /end COMPU_METHOD
/begin COMPU_VTAB DSM_DSM2SG_SY_Compu "" TAB_VERB 2 0 "False" 1 "True" /end COMPU_VTAB
/begin COMPU_METHOD DSM_FAILCNT_SY_Compu "" TAB_VERB "%6.3" "" COMPU_TAB_REF DSM_FAILCNT_SY_Compu /end COMPU_METHOD
/begin COMPU_VTAB DSM_FAILCNT_SY_Compu "" TAB_VERB 2 0 "False" 1 "True" /end COMPU_VTAB
/begin COMPU_METHOD DSM_FAULTSEQ_SY_Compu "" TAB_VERB "%6.3" "" COMPU_TAB_REF DSM_FAULTSEQ_SY_Compu /end COMPU_METHOD
/begin COMPU_VTAB DSM_FAULTSEQ_SY_Compu "" TAB_VERB 2 0 "False" 1 "True" /end COMPU_VTAB
/begin COMPU_METHOD DSM_GETPRGVERSID_SC_Compu "" TAB_VERB "%6.3" "" COMPU_TAB_REF DSM_GETPRGVERSID_SC_Compu /end COMPU_METHOD
/begin COMPU_VTAB DSM_GETPRGVERSID_SC_Compu "" TAB_VERB 2 0 "False" 1 "True" /end COMPU_VTAB
/begin COMPU_METHOD DSM_GETSTSTRTEND_SC_Compu "" TAB_VERB "%6.3" "" COMPU_TAB_REF DSM_GETSTSTRTEND_SC_Compu /end COMPU_METHOD
/begin COMPU_VTAB DSM_GETSTSTRTEND_SC_Compu "" TAB_VERB 2 0 "False" 1 "True" /end COMPU_VTAB
/begin COMPU_METHOD DSM_HDOBD_SY_Compu "" TAB_VERB "%6.3" "" COMPU_TAB_REF DSM_HDOBD_SY_Compu /end COMPU_METHOD
/begin COMPU_VTAB DSM_HDOBD_SY_Compu "" TAB_VERB 2 0 "False" 1 "True" /end COMPU_VTAB
/begin COMPU_METHOD DSM_INHRLS_SY_Compu "" TAB_VERB "%6.3" "" COMPU_TAB_REF DSM_INHRLS_SY_Compu /end COMPU_METHOD
/begin COMPU_VTAB DSM_INHRLS_SY_Compu "" TAB_VERB 2 0 "0" 1 "1" /end COMPU_VTAB
/begin COMPU_METHOD DSM_MDOBD_SY_Compu "" TAB_VERB "%6.3" "" COMPU_TAB_REF DSM_MDOBD_SY_Compu /end COMPU_METHOD
/begin COMPU_VTAB DSM_MDOBD_SY_Compu "" TAB_VERB 2 0 "False" 1 "True" /end COMPU_VTAB
/begin COMPU_METHOD DSM_PDTCDISBL_SC_Compu "" TAB_VERB "%6.3" "" COMPU_TAB_REF DSM_PDTCDISBL_SC_Compu /end COMPU_METHOD
/begin COMPU_VTAB DSM_PDTCDISBL_SC_Compu "" TAB_VERB 2 0 "False" 1 "True" /end COMPU_VTAB
/begin COMPU_METHOD DSM_PDTCTSTRA_SY_Compu "" TAB_VERB "%6.3" "" COMPU_TAB_REF DSM_PDTCTSTRA_SY_Compu /end COMPU_METHOD
/begin COMPU_VTAB DSM_PDTCTSTRA_SY_Compu "" TAB_VERB 2 0 "DISABLED" 1 "ENABLED" /end COMPU_VTAB
/begin COMPU_METHOD DSM_TESTMODDIAGCODLAMP_SC_Compu "" TAB_VERB "%6.3" "" COMPU_TAB_REF DSM_TESTMODDIAGCODLAMP_SC_Compu /end COMPU_METHOD
/begin COMPU_VTAB DSM_TESTMODDIAGCODLAMP_SC_Compu "" TAB_VERB 2 0 "Disabled" 1 "Enabled" /end COMPU_VTAB
/begin COMPU_METHOD DSM_WUCDET_SY_Compu "" TAB_VERB "%6.3" "" COMPU_TAB_REF DSM_WUCDET_SY_Compu /end COMPU_METHOD
/begin COMPU_VTAB DSM_WUCDET_SY_Compu "" TAB_VERB 6 0 "0" 1 "1" 2 "2" 3 "3" 4 "4" 255 "255" /end COMPU_VTAB
/begin COMPU_METHOD DSTTOEMPTY_SC_Compu "" TAB_VERB "%6.3" "" COMPU_TAB_REF DSTTOEMPTY_SC_Compu /end COMPU_METHOD
/begin COMPU_VTAB DSTTOEMPTY_SC_Compu "" TAB_VERB 2 0 "Disable" 1 "Enable" /end COMPU_VTAB
/begin COMPU_METHOD dTrq "" RAT_FUNC "%6.3" "Nm/s" COEFFS 0 10 0 0 0 1 /end COMPU_METHOD
/begin COMPU_METHOD DTR_LEGIFC_SY_Compu "" TAB_VERB "%6.3" "" COMPU_TAB_REF DTR_LEGIFC_SY_Compu /end COMPU_METHOD
/begin COMPU_VTAB DTR_LEGIFC_SY_Compu "" TAB_VERB 2 0 "DISABLED" 1 "ENABLED" /end COMPU_VTAB
/begin COMPU_METHOD DtTemp_KPerSec_q0p01_COMPU "" RAT_FUNC "%6.4" "K/s" COEFFS 0 100 0 0 0 1 /end COMPU_METHOD
/begin COMPU_METHOD DtyCyc "" RAT_FUNC "%6.4" "%" COEFFS 0 100 0 0 0 1 /end COMPU_METHOD
/begin COMPU_METHOD dt_TempKelv_p_s "" RAT_FUNC "%6.3" "K/s" COEFFS 0 10 0 0 0 1 /end COMPU_METHOD
/begin COMPU_METHOD DVESTA_SY_Compu "" TAB_VERB "%6.3" "" COMPU_TAB_REF DVESTA_SY_Compu /end COMPU_METHOD
/begin COMPU_VTAB DVESTA_SY_Compu "" TAB_VERB 2 0 "False" 1 "True" /end COMPU_VTAB
/begin COMPU_METHOD ECUNUM_SY_Compu "" TAB_VERB "%6.3" "" COMPU_TAB_REF ECUNUM_SY_Compu /end COMPU_METHOD
/begin COMPU_VTAB ECUNUM_SY_Compu "" TAB_VERB 3 1 "ECUNUM_1" 2 "ECUNUM_2" 3 "ECUNUM_3" /end COMPU_VTAB
/begin COMPU_METHOD ECUOFF_TMR_SY_Compu "" TAB_VERB "%6.3" "" COMPU_TAB_REF ECUOFF_TMR_SY_Compu /end COMPU_METHOD
/begin COMPU_VTAB ECUOFF_TMR_SY_Compu "" TAB_VERB 7 0 "0" 1 "1" 2 "2" 3 "3" 4 "4" 5 "5" 6 "6" /end COMPU_VTAB
/begin COMPU_METHOD ECUTYP_SC_Compu "" TAB_VERB "%6.3" "" COMPU_TAB_REF ECUTYP_SC_Compu /end COMPU_METHOD
/begin COMPU_VTAB ECUTYP_SC_Compu "" TAB_VERB 7 0 "EngEcu" 1 "InvrEcu" 2 "VehEcu" 3 "BattEcu" 4 "DosECU" 6 "PmpECU" 7 "TCMEcu" /end COMPU_VTAB
/begin COMPU_METHOD ECU_GENR_SY_Compu "" TAB_VERB "%6.3" "" COMPU_TAB_REF ECU_GENR_SY_Compu /end COMPU_METHOD
/begin COMPU_VTAB ECU_GENR_SY_Compu "" TAB_VERB 7 0 "Mx7" 1 "Mx9" 2 "Mx17" 3 "EDC17" 4 "VMx17" 5 "DCU17" 6 "MDG1C" /end COMPU_VTAB
/begin COMPU_METHOD fak_q0p000244 "" RAT_FUNC "%6.5" "-" COEFFS 0 65536 0 0 0 16 /end COMPU_METHOD
/begin COMPU_METHOD fak_q0p0039_op0p5 "" RAT_FUNC "%6.3" "" COEFFS 0 256 -128 0 0 1 /end COMPU_METHOD
/begin COMPU_METHOD fak_sb_b1 "" RAT_FUNC "%6.4" "-" COEFFS 0 256 0 0 0 2 /end COMPU_METHOD
/begin COMPU_METHOD fak_ub_b1 "" RAT_FUNC "%6.4" "-" COEFFS 0 256 0 0 0 1 /end COMPU_METHOD
/begin COMPU_METHOD fak_ub_b2 "" RAT_FUNC "%8.5" "-" COEFFS 0 256 0 0 0 2 /end COMPU_METHOD
/begin COMPU_METHOD fak_ub_b4 "" RAT_FUNC "%6.4" "-" COEFFS 0 256 0 0 0 4 /end COMPU_METHOD
/begin COMPU_METHOD fak_ub_b8 "" RAT_FUNC "%6.4" "-" COEFFS 0 256 0 0 0 8 /end COMPU_METHOD
/begin COMPU_METHOD fak_ub_q0p01 "" RAT_FUNC "%6.4" "-" COEFFS 0 1 0 0 0 0.01 /end COMPU_METHOD
/begin COMPU_METHOD fak_uw_b16 "" RAT_FUNC "%6.5" "-" COEFFS 0 65536 0 0 0 16 /end COMPU_METHOD
/begin COMPU_METHOD fak_uw_b2 "" RAT_FUNC "%7.6" "-" COEFFS 0 65536 0 0 0 2 /end COMPU_METHOD
/begin COMPU_METHOD fak_uw_b4 "" RAT_FUNC "%7.6" "-" COEFFS 0 65536 0 0 0 4 /end COMPU_METHOD
/begin COMPU_METHOD freq_sw_b512 "" RAT_FUNC "%6.4" "1/s" COEFFS 0 65536 0 0 0 1024 /end COMPU_METHOD
/begin COMPU_METHOD mgrad_sw_b28p44 "" RAT_FUNC "%6.5" "g/s" COEFFS 0 230.4 0 0 0 0.2 /end COMPU_METHOD
/begin COMPU_METHOD mgrad_ub_b221p35 "" RAT_FUNC "%6.2" "mg/s" COEFFS 0 230.4 0 0 0 200 /end COMPU_METHOD
/begin COMPU_METHOD m_q0p0004 "" RAT_FUNC "%6.5" "" COEFFS 0 1 0 0 0 0.0004 /end COMPU_METHOD
/begin COMPU_METHOD m_q0p1_g "" RAT_FUNC "%6.3" "g" COEFFS 0 10 0 0 0 1 /end COMPU_METHOD
/begin COMPU_METHOD m_q0p1_mg "" RAT_FUNC "%6.3" "mg" COEFFS 0 1 0 0 0 0.1 /end COMPU_METHOD
/begin COMPU_METHOD m_q1p526Em6_g "" RAT_FUNC "%8.7" "g" COEFFS 0 655360 0 0 0 1 /end COMPU_METHOD
/begin COMPU_METHOD m_sw_q0p1 "" RAT_FUNC "%6.3" "kg/h" COEFFS 0 1 0 0 0 0.1 /end COMPU_METHOD
/begin COMPU_METHOD m_ub_b1020 "" RAT_FUNC "%6.2" "kg/h" COEFFS 0 1 0 0 0 4 /end COMPU_METHOD
/begin COMPU_METHOD m_ub_b221p35 "" RAT_FUNC "%6.2" "mg" COEFFS 0 230.4 0 0 0 200 /end COMPU_METHOD
/begin COMPU_METHOD m_uw_b6553p5 "" RAT_FUNC "%6.3" "kg/h" COEFFS 0 1 0 0 0 0.1 /end COMPU_METHOD
/begin COMPU_METHOD nmotd_sb_q10 "" RAT_FUNC "%6.1" "1/min" COEFFS 0 1 0 0 0 10 /end COMPU_METHOD
/begin COMPU_METHOD nmot_q0p25 "" RAT_FUNC "%6.3" "1/min" COEFFS 0 4 0 0 0 1 /end COMPU_METHOD
/begin COMPU_METHOD nmot_sw_q0p25 "" RAT_FUNC "%6.3" "1/min" COEFFS 0 1 0 0 0 0.25 /end COMPU_METHOD
/begin COMPU_METHOD nmot_ub_q40 "" RAT_FUNC "%6.1" "1/min" COEFFS 0 1 0 0 0 40 /end COMPU_METHOD
/begin COMPU_METHOD nmot_uw_q0p25 "" RAT_FUNC "%6.3" "1/min" COEFFS 0 1 0 0 0 0.25 /end COMPU_METHOD
/begin COMPU_METHOD OneToOne "" RAT_FUNC "%6.2" "-" COEFFS 0 1 0 0 0 1 /end COMPU_METHOD
/begin COMPU_METHOD p_uw_q0p039 "" RAT_FUNC "%6.4" "hPa" COEFFS 0 256 0 0 0 10 /end COMPU_METHOD
/begin COMPU_METHOD q0p09766_DIV_V "" RAT_FUNC "%6.3" "1/V" COEFFS 0 1024 0 0 0 100 /end COMPU_METHOD
/begin COMPU_METHOD q10p402_mg_DIV_Vs "" RAT_FUNC "%6.1" "mg/(V*s)" COEFFS 0 76608 0 0 0 796875 /end COMPU_METHOD
/begin COMPU_METHOD relDK_ub_b100 "" RAT_FUNC "%6.3" "%DK" COEFFS 0 255 0 0 0 100 /end COMPU_METHOD
/begin COMPU_METHOD rel_q0p012207 "" RAT_FUNC "%6.4" "%" COEFFS 0 8192 0 0 0 100 /end COMPU_METHOD
/begin COMPU_METHOD rel_sb_q0p75 "" RAT_FUNC "%6.3" "%" COEFFS 0 1 0 0 0 0.75 /end COMPU_METHOD
/begin COMPU_METHOD rel_ub_b50 "" RAT_FUNC "%6.3" "%" COEFFS 0 255 0 0 0 50 /end COMPU_METHOD
/begin COMPU_METHOD rel_ub_q0p75 "" RAT_FUNC "%6.3" "%" COEFFS 0 1 0 0 0 0.75 /end COMPU_METHOD
/begin COMPU_METHOD rel_uw_b100 "" RAT_FUNC "%6.4" "%" COEFFS 0 65536 0 0 0 100 /end COMPU_METHOD
/begin COMPU_METHOD rel_uw_b40 "" RAT_FUNC "%6.5" "%" COEFFS 0 65536 0 0 0 40 /end COMPU_METHOD
/begin COMPU_METHOD r_uw_q2 "" RAT_FUNC "%6.2" "Ohm" COEFFS 0 1 0 0 0 2 /end COMPU_METHOD
/begin COMPU_METHOD spg_q0p005 "" RAT_FUNC "%6.4" "V" COEFFS 0 1 0 0 0 0.005 /end COMPU_METHOD
/begin COMPU_METHOD spg_q0p01_V "" RAT_FUNC "%6.4" "V" COEFFS 0 100 0 0 0 1 /end COMPU_METHOD
/begin COMPU_METHOD t100msxs_ub_b25p5 "" RAT_FUNC "%6.3" "s" COEFFS 0 1 0 0 0 0.1 /end COMPU_METHOD
/begin COMPU_METHOD t100msxs_uw_b6553p5 "" RAT_FUNC "%6.3" "s" COEFFS 0 1 0 0 0 0.1 /end COMPU_METHOD
/begin COMPU_METHOD t100msxs_uw_q100 "" RAT_FUNC "%6.3" "s" COEFFS 0 1 0 0 0 0.1 /end COMPU_METHOD
/begin COMPU_METHOD t10msxs_ub_b2p55 "" RAT_FUNC "%6.4" "s" COEFFS 0 1 0 0 0 0.01 /end COMPU_METHOD
/begin COMPU_METHOD t10msxs_uw_b655p35 "" RAT_FUNC "%6.4" "s" COEFFS 0 1 0 0 0 0.01 /end COMPU_METHOD
/begin COMPU_METHOD t1sxs_uw_b65535 "" RAT_FUNC "%6.2" "s" COEFFS 0 1 0 0 0 1 /end COMPU_METHOD
/begin COMPU_METHOD t50msxs_uw_b819p2 "" RAT_FUNC "%6.4" "s" COEFFS 0 1 0 0 0 0.0125 /end COMPU_METHOD
/begin COMPU_METHOD TempDiff_Kelv "" RAT_FUNC "%6.3" "K" COEFFS 0 10 0 0 0 1 /end COMPU_METHOD
/begin COMPU_METHOD Temp_Cels "" RAT_FUNC "%6.1" "deg C" COEFFS 0 10 2731.4 0 0 1 /end COMPU_METHOD
/begin COMPU_METHOD temp_q5 "" RAT_FUNC "%6.2" "Grad C" COEFFS 0 1 0 0 0 5 /end COMPU_METHOD
/begin COMPU_METHOD temp_ub_q0p75_o48 "" RAT_FUNC "%6.2" "Grad C" COEFFS 0 1 48 0 0 0.75 /end COMPU_METHOD
/begin COMPU_METHOD temp_ub_q5_o50 "" RAT_FUNC "%6.2" "Grad C" COEFFS 0 1 50 0 0 5 /end COMPU_METHOD
/begin COMPU_METHOD Time_Min_One2One "" RAT_FUNC "%6.2" "min" COEFFS 0 1 0 0 0 1 /end COMPU_METHOD
/begin COMPU_METHOD t_q0p01 "" RAT_FUNC "%6.4" "s" COEFFS 0 100 0 0 0 1 /end COMPU_METHOD
/begin COMPU_METHOD t_q0p02 "" RAT_FUNC "%6.4" "s" COEFFS 0 100 0 0 0 2 /end COMPU_METHOD
/begin COMPU_METHOD t_q0p04 "" RAT_FUNC "%6.4" "s" COEFFS 0 100 0 0 0 4 /end COMPU_METHOD
/begin COMPU_METHOD t_q0p05 "" RAT_FUNC "%6.4" "s" COEFFS 0 100 0 0 0 5 /end COMPU_METHOD
/begin COMPU_METHOD t_q0p1 "" RAT_FUNC "%6.3" "s" COEFFS 0 10 0 0 0 1 /end COMPU_METHOD
/begin COMPU_METHOD t_q0p2 "" RAT_FUNC "%6.3" "s" COEFFS 0 10 0 0 0 2 /end COMPU_METHOD
/begin COMPU_METHOD VelToN "" RAT_FUNC "%8.7" "(km/h)/rpm" COEFFS 0 100000 0 0 0 1 /end COMPU_METHOD
/begin COMPU_METHOD vel_q0p01 "" RAT_FUNC "%6.4" "km/h" COEFFS 0 100 0 0 0 1 /end COMPU_METHOD
/begin COMPU_METHOD zk50msxs_ub_b12p8 "" RAT_FUNC "%6.3" "s" COEFFS 0 0 256 0 20 0 /end COMPU_METHOD
/begin COMPU_METHOD zk50msxs_uw_b3276p8 "" RAT_FUNC "%6.1" "s" COEFFS 0 0 65536 0 20 0 /end COMPU_METHOD
/begin RECORD_LAYOUT GklWS16 FNC_VALUES 1 SWORD COLUMN_DIR DIRECT /end RECORD_LAYOUT
/begin RECORD_LAYOUT GklWU8 FNC_VALUES 1 UBYTE COLUMN_DIR DIRECT /end RECORD_LAYOUT
/begin RECORD_LAYOUT KfAxU8AyU8SstxU16SstyU16WU16 NO_AXIS_PTS_X 1 UWORD NO_AXIS_PTS_Y 2 UWORD AXIS_PTS_X 3 UWORD INDEX_INCR DIRECT AXIS_PTS_Y 4 UWORD INDEX_INCR DIRECT FNC_VALUES 5 UWORD COLUMN_DIR DIRECT /end RECORD_LAYOUT
/begin RECORD_LAYOUT KfAxU8AyU8SstxU8SstyU8WU8 NO_AXIS_PTS_X 1 UBYTE NO_AXIS_PTS_Y 2 UBYTE AXIS_PTS_X 3 UBYTE INDEX_INCR DIRECT AXIS_PTS_Y 4 UBYTE INDEX_INCR DIRECT FNC_VALUES 5 UBYTE COLUMN_DIR DIRECT /end RECORD_LAYOUT
/begin RECORD_LAYOUT KlAxU8SstxU16WU8_Static NO_AXIS_PTS_X 1 UWORD AXIS_PTS_X 2 UWORD INDEX_INCR DIRECT FNC_VALUES 3 UBYTE COLUMN_DIR DIRECT STATIC_RECORD_LAYOUT /end RECORD_LAYOUT
/begin RECORD_LAYOUT KwSb FNC_VALUES 1 SBYTE COLUMN_DIR DIRECT /end RECORD_LAYOUT
/begin RECORD_LAYOUT KwUb FNC_VALUES 1 UBYTE COLUMN_DIR DIRECT /end RECORD_LAYOUT
/begin RECORD_LAYOUT KwUw FNC_VALUES 1 UWORD COLUMN_DIR DIRECT /end RECORD_LAYOUT
/begin RECORD_LAYOUT KwWS16 FNC_VALUES 1 SWORD COLUMN_DIR DIRECT /end RECORD_LAYOUT
/begin RECORD_LAYOUT KwWS8 FNC_VALUES 1 SBYTE COLUMN_DIR DIRECT /end RECORD_LAYOUT
/begin RECORD_LAYOUT KwWU16 FNC_VALUES 1 UWORD COLUMN_DIR DIRECT /end RECORD_LAYOUT
/begin RECORD_LAYOUT KwWU8 FNC_VALUES 1 UBYTE COLUMN_DIR DIRECT /end RECORD_LAYOUT
/begin RECORD_LAYOUT SstAU8SstU16 NO_AXIS_PTS_X 1 UWORD AXIS_PTS_X 2 UWORD INDEX_INCR DIRECT /end RECORD_LAYOUT
/begin RECORD_LAYOUT SstAU8SstU8 NO_AXIS_PTS_X 1 UBYTE AXIS_PTS_X 2 UBYTE INDEX_INCR DIRECT /end RECORD_LAYOUT
/begin RECORD_LAYOUT ValA_Wu16 FNC_VALUES 1 UWORD COLUMN_DIR DIRECT /end RECORD_LAYOUT
/begin RECORD_LAYOUT ValA_Wu8 FNC_VALUES 1 UBYTE COLUMN_DIR DIRECT /end RECORD_LAYOUT
/begin RECORD_LAYOUT Val_Ws16 FNC_VALUES 1 SWORD COLUMN_DIR DIRECT /end RECORD_LAYOUT
/begin RECORD_LAYOUT Val_Wu16 FNC_VALUES 1 UWORD COLUMN_DIR DIRECT /end RECORD_LAYOUT
/begin RECORD_LAYOUT Val_Wu32 FNC_VALUES 1 ULONG COLUMN_DIR DIRECT /end RECORD_LAYOUT
/begin RECORD_LAYOUT Val_Wu8 FNC_VALUES 1 UBYTE COLUMN_DIR DIRECT /end RECORD_LAYOUT
/end MODULE
/end PROJECT
