ASAP2_VERSION 1 60
/begin PROJECT MSE2_BJ10_0038_00 "MDG1"
/begin HEADER "" VERSION "MSE2_BJ10_0038_00" PROJECT_NO MSE2_BJ10_0038_00 /end HEADER
/begin MODULE DIM ""
/begin MOD_COMMON "" BYTE_ORDER MSB_FIRST ALIGNMENT_BYTE 1 ALIGNMENT_WORD 2 ALIGNMENT_LONG 4 ALIGNMENT_INT64 4 ALIGNMENT_FLOAT32_IEEE 4 ALIGNMENT_FLOAT64_IEEE 4 /end MOD_COMMON
/begin CHARACTERISTIC Com_flgWhlSpdSeln_C "Calibration for slecting front or rearwheel speed" VALUE 0x9085410 KwWU8 1.00000000000 B_TRUE 0.00 1.00000000000 FORMAT "%13.11" /end CHARACTERISTIC
/begin CHARACTERISTIC CWPSTEVE "code word for shutdown of output-stage diagnosis" VALUE 0x9085136 KwWU8 255.0 dez 0.00 255.0 FORMAT "%5.1" /end CHARACTERISTIC
/begin CHARACTERISTIC CWVFZD "Code word for diagnosis of vehicle speed signal" VALUE 0x908513C KwWU8 7.000 dez 0.00 7.000 FORMAT "%5.3" EXTENDED_LIMITS 0.00 255.0 /end CHARACTERISTIC
/begin CHARACTERISTIC DFC_CtlMsk2.DFC_EpmCrSErrSig_C "Behaviour control mask / Behaviour control masks of check DFC_EpmCrSErrSig" VALUE 0x90803EB Val_Wu8 255.0 DFES_OneToOne 0.00 255.0 FORMAT "%5.1" /end CHARACTERISTIC
/begin CHARACTERISTIC DFC_CtlMsk2.DFC_EpmCrSNoSig_C "Behaviour control mask / Behaviour control masks of check DFC_EpmCrSNoSig" VALUE 0x90803EC Val_Wu8 255.0 DFES_OneToOne 0.00 255.0 FORMAT "%5.1" /end CHARACTERISTIC
/begin CHARACTERISTIC DFC_CtlMsk2.DFC_TEVEmax_C "Behaviour control mask / Behaviour control masks of check DFC_TEVEmax" VALUE 0x9080430 Val_Wu8 255.0 DFES_OneToOne 0.00 255.0 FORMAT "%5.1" /end CHARACTERISTIC
/begin CHARACTERISTIC DFC_CtlMsk2.DFC_TEVEmin_C "Behaviour control mask / Behaviour control masks of check DFC_TEVEmin" VALUE 0x9080431 Val_Wu8 255.0 DFES_OneToOne 0.00 255.0 FORMAT "%5.1" /end CHARACTERISTIC
/begin CHARACTERISTIC DFC_CtlMsk2.DFC_TEVEsig_C "Behaviour control mask / Behaviour control masks of check DFC_TEVEsig" VALUE 0x9080432 Val_Wu8 255.0 DFES_OneToOne 0.00 255.0 FORMAT "%5.1" /end CHARACTERISTIC
/begin CHARACTERISTIC DFC_CtlMsk2.DFC_VFZsig_C "Behaviour control mask / Behaviour control masks of check DFC_VFZsig" VALUE 0x9080437 Val_Wu8 255.0 DFES_OneToOne 0.00 255.0 FORMAT "%5.1" /end CHARACTERISTIC
/begin CHARACTERISTIC DFC_CtlMsk2.DFC_VFZsig2_C "Behaviour control mask / Behaviour control masks of check DFC_VFZsig2" VALUE 0x9080438 Val_Wu8 255.0 DFES_OneToOne 0.00 255.0 FORMAT "%5.1" /end CHARACTERISTIC
/begin CHARACTERISTIC DFC_DisblMsk2.DFC_EpmCrSErrSig_C "disable mask / Disable masks of check DFC_EpmCrSErrSig" VALUE 0x9080DBB Val_Wu8 255.0 DFES_OneToOne 0.00 255.0 FORMAT "%5.1" /end CHARACTERISTIC
/begin CHARACTERISTIC DFC_DisblMsk2.DFC_EpmCrSNoSig_C "disable mask / Disable masks of check DFC_EpmCrSNoSig" VALUE 0x9080DBC Val_Wu8 255.0 DFES_OneToOne 0.00 255.0 FORMAT "%5.1" /end CHARACTERISTIC
/begin CHARACTERISTIC DFC_DisblMsk2.DFC_TEVEmax_C "disable mask / Disable masks of check DFC_TEVEmax" VALUE 0x9080E00 Val_Wu8 255.0 DFES_OneToOne 0.00 255.0 FORMAT "%5.1" /end CHARACTERISTIC
/begin CHARACTERISTIC DFC_DisblMsk2.DFC_TEVEmin_C "disable mask / Disable masks of check DFC_TEVEmin" VALUE 0x9080E01 Val_Wu8 255.0 DFES_OneToOne 0.00 255.0 FORMAT "%5.1" /end CHARACTERISTIC
/begin CHARACTERISTIC DFC_DisblMsk2.DFC_TEVEsig_C "disable mask / Disable masks of check DFC_TEVEsig" VALUE 0x9080E02 Val_Wu8 255.0 DFES_OneToOne 0.00 255.0 FORMAT "%5.1" /end CHARACTERISTIC
/begin CHARACTERISTIC DFC_DisblMsk2.DFC_VFZsig_C "disable mask / Disable masks of check DFC_VFZsig" VALUE 0x9080E07 Val_Wu8 255.0 DFES_OneToOne 0.00 255.0 FORMAT "%5.1" /end CHARACTERISTIC
/begin CHARACTERISTIC DFC_DisblMsk2.DFC_VFZsig2_C "disable mask / Disable masks of check DFC_VFZsig2" VALUE 0x9080E08 Val_Wu8 255.0 DFES_OneToOne 0.00 255.0 FORMAT "%5.1" /end CHARACTERISTIC
/begin CHARACTERISTIC DTR_OBDMID.DTR_Dummy_C "OBDId / OBDMId of the corresponding DTR record DTR_Dummy" VALUE 0x9080D1C Val_Wu8 255.0 DFC_OneToOne 0.00 255.0 FORMAT "%5.1" /end CHARACTERISTIC
/begin CHARACTERISTIC DTR_OBDMID.DTR_OBDMID_01_TID_LATP_C "OBDId / OBDMId of the corresponding DTR record DTR_OBDMID_01_TID_LATP" VALUE 0x9080D1D Val_Wu8 255.0 DFC_OneToOne 0.00 255.0 FORMAT "%5.1" /end CHARACTERISTIC
/begin CHARACTERISTIC DTR_OBDMID.DTR_OBDMID_01_TID_OFFST_C "OBDId / OBDMId of the corresponding DTR record DTR_OBDMID_01_TID_OFFST" VALUE 0x9080D1E Val_Wu8 255.0 DFC_OneToOne 0.00 255.0 FORMAT "%5.1" /end CHARACTERISTIC
/begin CHARACTERISTIC DTR_OBDMID.DTR_OBDMID_02_TID_OSCLO_C "OBDId / OBDMId of the corresponding DTR record DTR_OBDMID_02_TID_OSCLO" VALUE 0x9080D1F Val_Wu8 255.0 DFC_OneToOne 0.00 255.0 FORMAT "%5.1" /end CHARACTERISTIC
/begin CHARACTERISTIC DTR_OBDMID.DTR_OBDMID_02_TID_OSCUP_C "OBDId / OBDMId of the corresponding DTR record DTR_OBDMID_02_TID_OSCUP" VALUE 0x9080D20 Val_Wu8 255.0 DFC_OneToOne 0.00 255.0 FORMAT "%5.1" /end CHARACTERISTIC
/begin CHARACTERISTIC DTR_OBDMID.DTR_OBDMID_02_TID_OVRRN_C "OBDId / OBDMId of the corresponding DTR record DTR_OBDMID_02_TID_OVRRN" VALUE 0x9080D21 Val_Wu8 255.0 DFC_OneToOne 0.00 255.0 FORMAT "%5.1" /end CHARACTERISTIC
/begin CHARACTERISTIC DTR_OBDMID.DTR_OBDMID_21_TID_AMPL_C "OBDId / OBDMId of the corresponding DTR record DTR_OBDMID_21_TID_AMPL" VALUE 0x9080D22 Val_Wu8 255.0 DFC_OneToOne 0.00 255.0 FORMAT "%5.1" /end CHARACTERISTIC
/begin CHARACTERISTIC DTR_OBDMID.DTR_OBDMID_41_TID_HTR_C "OBDId / OBDMId of the corresponding DTR record DTR_OBDMID_41_TID_HTR" VALUE 0x9080D23 Val_Wu8 255.0 DFC_OneToOne 0.00 255.0 FORMAT "%5.1" /end CHARACTERISTIC
/begin CHARACTERISTIC DTR_OBDMID.DTR_OBDMID_42_TID_HTR_C "OBDId / OBDMId of the corresponding DTR record DTR_OBDMID_42_TID_HTR" VALUE 0x9080D24 Val_Wu8 255.0 DFC_OneToOne 0.00 255.0 FORMAT "%5.1" /end CHARACTERISTIC
/begin CHARACTERISTIC DTR_OBDMID.DTR_OBDMID_a2_TID_0b_C "OBDId / OBDMId of the corresponding DTR record DTR_OBDMID_a2_TID_0b" VALUE 0x9080D25 Val_Wu8 255.0 DFC_OneToOne 0.00 255.0 FORMAT "%5.1" /end CHARACTERISTIC
/begin CHARACTERISTIC DTR_OBDMID.DTR_OBDMID_a2_TID_0c_C "OBDId / OBDMId of the corresponding DTR record DTR_OBDMID_a2_TID_0c" VALUE 0x9080D26 Val_Wu8 255.0 DFC_OneToOne 0.00 255.0 FORMAT "%5.1" /end CHARACTERISTIC
/begin CHARACTERISTIC DTR_OBDMID.DTR_TID_01_SEN_01_C "OBDId / OBDMId of the corresponding DTR record DTR_TID_01_SEN_01" VALUE 0x9080D27 Val_Wu8 255.0 DFC_OneToOne 0.00 255.0 FORMAT "%5.1" /end CHARACTERISTIC
/begin CHARACTERISTIC DTR_OBDMID.DTR_TID_01_SEN_02_C "OBDId / OBDMId of the corresponding DTR record DTR_TID_01_SEN_02" VALUE 0x9080D28 Val_Wu8 255.0 DFC_OneToOne 0.00 255.0 FORMAT "%5.1" /end CHARACTERISTIC
/begin CHARACTERISTIC DTR_OBDMID.DTR_TID_02_SEN_01_C "OBDId / OBDMId of the corresponding DTR record DTR_TID_02_SEN_01" VALUE 0x9080D29 Val_Wu8 255.0 DFC_OneToOne 0.00 255.0 FORMAT "%5.1" /end CHARACTERISTIC
/begin CHARACTERISTIC DTR_OBDMID.DTR_TID_02_SEN_02_C "OBDId / OBDMId of the corresponding DTR record DTR_TID_02_SEN_02" VALUE 0x9080D2A Val_Wu8 255.0 DFC_OneToOne 0.00 255.0 FORMAT "%5.1" /end CHARACTERISTIC
/begin CHARACTERISTIC DTR_OBDMID.DTR_TID_07_SEN_01_C "OBDId / OBDMId of the corresponding DTR record DTR_TID_07_SEN_01" VALUE 0x9080D2B Val_Wu8 255.0 DFC_OneToOne 0.00 255.0 FORMAT "%5.1" /end CHARACTERISTIC
/begin CHARACTERISTIC DTR_OBDMID.DTR_TID_07_SEN_02_C "OBDId / OBDMId of the corresponding DTR record DTR_TID_07_SEN_02" VALUE 0x9080D2C Val_Wu8 255.0 DFC_OneToOne 0.00 255.0 FORMAT "%5.1" /end CHARACTERISTIC
/begin CHARACTERISTIC DTR_OBDMID.DTR_TID_08_SEN_01_C "OBDId / OBDMId of the corresponding DTR record DTR_TID_08_SEN_01" VALUE 0x9080D2D Val_Wu8 255.0 DFC_OneToOne 0.00 255.0 FORMAT "%5.1" /end CHARACTERISTIC
/begin CHARACTERISTIC DTR_OBDMID.DTR_TID_08_SEN_02_C "OBDId / OBDMId of the corresponding DTR record DTR_TID_08_SEN_02" VALUE 0x9080D2E Val_Wu8 255.0 DFC_OneToOne 0.00 255.0 FORMAT "%5.1" /end CHARACTERISTIC
/begin CHARACTERISTIC DTR_OBDMID.DTR_TID_09_SEN_01_C "OBDId / OBDMId of the corresponding DTR record DTR_TID_09_SEN_01" VALUE 0x9080D2F Val_Wu8 255.0 DFC_OneToOne 0.00 255.0 FORMAT "%5.1" /end CHARACTERISTIC
/begin CHARACTERISTIC DTR_OBDMID.DTR_TID_0A_SEN_01_C "OBDId / OBDMId of the corresponding DTR record DTR_TID_0A_SEN_01" VALUE 0x9080D30 Val_Wu8 255.0 DFC_OneToOne 0.00 255.0 FORMAT "%5.1" /end CHARACTERISTIC
/begin CHARACTERISTIC DTR_Suprt.DTR_Dummy_C "Suprt_info / contains support information of the DTR elements DTR_Dummy" VALUE 0x9080D31 Val_Wu8 1.00000000000 DTR_Suprt_Compu 0.00 1.00000000000 FORMAT "%13.11" /end CHARACTERISTIC
/begin CHARACTERISTIC DTR_Suprt.DTR_OBDMID_01_TID_LATP_C "Suprt_info / contains support information of the DTR elements DTR_OBDMID_01_TID_LATP" VALUE 0x9080D32 Val_Wu8 1.00000000000 DTR_Suprt_Compu 0.00 1.00000000000 FORMAT "%13.11" /end CHARACTERISTIC
/begin CHARACTERISTIC DTR_Suprt.DTR_OBDMID_01_TID_OFFST_C "Suprt_info / contains support information of the DTR elements DTR_OBDMID_01_TID_OFFST" VALUE 0x9080D33 Val_Wu8 1.00000000000 DTR_Suprt_Compu 0.00 1.00000000000 FORMAT "%13.11" /end CHARACTERISTIC
/begin CHARACTERISTIC DTR_Suprt.DTR_OBDMID_02_TID_OSCLO_C "Suprt_info / contains support information of the DTR elements DTR_OBDMID_02_TID_OSCLO" VALUE 0x9080D34 Val_Wu8 1.00000000000 DTR_Suprt_Compu 0.00 1.00000000000 FORMAT "%13.11" /end CHARACTERISTIC
/begin CHARACTERISTIC DTR_Suprt.DTR_OBDMID_02_TID_OSCUP_C "Suprt_info / contains support information of the DTR elements DTR_OBDMID_02_TID_OSCUP" VALUE 0x9080D35 Val_Wu8 1.00000000000 DTR_Suprt_Compu 0.00 1.00000000000 FORMAT "%13.11" /end CHARACTERISTIC
/begin CHARACTERISTIC DTR_Suprt.DTR_OBDMID_02_TID_OVRRN_C "Suprt_info / contains support information of the DTR elements DTR_OBDMID_02_TID_OVRRN" VALUE 0x9080D36 Val_Wu8 1.00000000000 DTR_Suprt_Compu 0.00 1.00000000000 FORMAT "%13.11" /end CHARACTERISTIC
/begin CHARACTERISTIC DTR_Suprt.DTR_OBDMID_21_TID_AMPL_C "Suprt_info / contains support information of the DTR elements DTR_OBDMID_21_TID_AMPL" VALUE 0x9080D37 Val_Wu8 1.00000000000 DTR_Suprt_Compu 0.00 1.00000000000 FORMAT "%13.11" /end CHARACTERISTIC
/begin CHARACTERISTIC DTR_Suprt.DTR_OBDMID_41_TID_HTR_C "Suprt_info / contains support information of the DTR elements DTR_OBDMID_41_TID_HTR" VALUE 0x9080D38 Val_Wu8 1.00000000000 DTR_Suprt_Compu 0.00 1.00000000000 FORMAT "%13.11" /end CHARACTERISTIC
/begin CHARACTERISTIC DTR_Suprt.DTR_OBDMID_42_TID_HTR_C "Suprt_info / contains support information of the DTR elements DTR_OBDMID_42_TID_HTR" VALUE 0x9080D39 Val_Wu8 1.00000000000 DTR_Suprt_Compu 0.00 1.00000000000 FORMAT "%13.11" /end CHARACTERISTIC
/begin CHARACTERISTIC DTR_Suprt.DTR_OBDMID_a2_TID_0b_C "Suprt_info / contains support information of the DTR elements DTR_OBDMID_a2_TID_0b" VALUE 0x9080D3A Val_Wu8 1.00000000000 DTR_Suprt_Compu 0.00 1.00000000000 FORMAT "%13.11" /end CHARACTERISTIC
/begin CHARACTERISTIC DTR_Suprt.DTR_OBDMID_a2_TID_0c_C "Suprt_info / contains support information of the DTR elements DTR_OBDMID_a2_TID_0c" VALUE 0x9080D3B Val_Wu8 1.00000000000 DTR_Suprt_Compu 0.00 1.00000000000 FORMAT "%13.11" /end CHARACTERISTIC
/begin CHARACTERISTIC DTR_Suprt.DTR_TID_01_SEN_01_C "Suprt_info / contains support information of the DTR elements DTR_TID_01_SEN_01" VALUE 0x9080D3C Val_Wu8 1.00000000000 DTR_Suprt_Compu 0.00 1.00000000000 FORMAT "%13.11" /end CHARACTERISTIC
/begin CHARACTERISTIC DTR_Suprt.DTR_TID_01_SEN_02_C "Suprt_info / contains support information of the DTR elements DTR_TID_01_SEN_02" VALUE 0x9080D3D Val_Wu8 1.00000000000 DTR_Suprt_Compu 0.00 1.00000000000 FORMAT "%13.11" /end CHARACTERISTIC
/begin CHARACTERISTIC DTR_Suprt.DTR_TID_02_SEN_01_C "Suprt_info / contains support information of the DTR elements DTR_TID_02_SEN_01" VALUE 0x9080D3E Val_Wu8 1.00000000000 DTR_Suprt_Compu 0.00 1.00000000000 FORMAT "%13.11" /end CHARACTERISTIC
/begin CHARACTERISTIC DTR_Suprt.DTR_TID_02_SEN_02_C "Suprt_info / contains support information of the DTR elements DTR_TID_02_SEN_02" VALUE 0x9080D3F Val_Wu8 1.00000000000 DTR_Suprt_Compu 0.00 1.00000000000 FORMAT "%13.11" /end CHARACTERISTIC
/begin CHARACTERISTIC DTR_Suprt.DTR_TID_07_SEN_01_C "Suprt_info / contains support information of the DTR elements DTR_TID_07_SEN_01" VALUE 0x9080D40 Val_Wu8 1.00000000000 DTR_Suprt_Compu 0.00 1.00000000000 FORMAT "%13.11" /end CHARACTERISTIC
/begin CHARACTERISTIC DTR_Suprt.DTR_TID_07_SEN_02_C "Suprt_info / contains support information of the DTR elements DTR_TID_07_SEN_02" VALUE 0x9080D41 Val_Wu8 1.00000000000 DTR_Suprt_Compu 0.00 1.00000000000 FORMAT "%13.11" /end CHARACTERISTIC
/begin CHARACTERISTIC DTR_Suprt.DTR_TID_08_SEN_01_C "Suprt_info / contains support information of the DTR elements DTR_TID_08_SEN_01" VALUE 0x9080D42 Val_Wu8 1.00000000000 DTR_Suprt_Compu 0.00 1.00000000000 FORMAT "%13.11" /end CHARACTERISTIC
/begin CHARACTERISTIC DTR_Suprt.DTR_TID_08_SEN_02_C "Suprt_info / contains support information of the DTR elements DTR_TID_08_SEN_02" VALUE 0x9080D43 Val_Wu8 1.00000000000 DTR_Suprt_Compu 0.00 1.00000000000 FORMAT "%13.11" /end CHARACTERISTIC
/begin CHARACTERISTIC DTR_Suprt.DTR_TID_09_SEN_01_C "Suprt_info / contains support information of the DTR elements DTR_TID_09_SEN_01" VALUE 0x9080D44 Val_Wu8 1.00000000000 DTR_Suprt_Compu 0.00 1.00000000000 FORMAT "%13.11" /end CHARACTERISTIC
/begin CHARACTERISTIC DTR_Suprt.DTR_TID_0A_SEN_01_C "Suprt_info / contains support information of the DTR elements DTR_TID_0A_SEN_01" VALUE 0x9080D45 Val_Wu8 1.00000000000 DTR_Suprt_Compu 0.00 1.00000000000 FORMAT "%13.11" /end CHARACTERISTIC
/begin CHARACTERISTIC DTR_TID.DTR_Dummy_C "TestId / determines the TestId for the referenced test result DTR_Dummy" VALUE 0x9080D46 Val_Wu8 255.0 DFC_OneToOne 0.00 255.0 FORMAT "%5.1" /end CHARACTERISTIC
/begin CHARACTERISTIC DTR_TID.DTR_OBDMID_01_TID_LATP_C "TestId / determines the TestId for the referenced test result DTR_OBDMID_01_TID_LATP" VALUE 0x9080D47 Val_Wu8 255.0 DFC_OneToOne 0.00 255.0 FORMAT "%5.1" /end CHARACTERISTIC
/begin CHARACTERISTIC DTR_TID.DTR_OBDMID_01_TID_OFFST_C "TestId / determines the TestId for the referenced test result DTR_OBDMID_01_TID_OFFST" VALUE 0x9080D48 Val_Wu8 255.0 DFC_OneToOne 0.00 255.0 FORMAT "%5.1" /end CHARACTERISTIC
/begin CHARACTERISTIC DTR_TID.DTR_OBDMID_02_TID_OSCLO_C "TestId / determines the TestId for the referenced test result DTR_OBDMID_02_TID_OSCLO" VALUE 0x9080D49 Val_Wu8 255.0 DFC_OneToOne 0.00 255.0 FORMAT "%5.1" /end CHARACTERISTIC
/begin CHARACTERISTIC DTR_TID.DTR_OBDMID_02_TID_OSCUP_C "TestId / determines the TestId for the referenced test result DTR_OBDMID_02_TID_OSCUP" VALUE 0x9080D4A Val_Wu8 255.0 DFC_OneToOne 0.00 255.0 FORMAT "%5.1" /end CHARACTERISTIC
/begin CHARACTERISTIC DTR_TID.DTR_OBDMID_02_TID_OVRRN_C "TestId / determines the TestId for the referenced test result DTR_OBDMID_02_TID_OVRRN" VALUE 0x9080D4B Val_Wu8 255.0 DFC_OneToOne 0.00 255.0 FORMAT "%5.1" /end CHARACTERISTIC
/begin CHARACTERISTIC DTR_TID.DTR_OBDMID_21_TID_AMPL_C "TestId / determines the TestId for the referenced test result DTR_OBDMID_21_TID_AMPL" VALUE 0x9080D4C Val_Wu8 255.0 DFC_OneToOne 0.00 255.0 FORMAT "%5.1" /end CHARACTERISTIC
/begin CHARACTERISTIC DTR_TID.DTR_OBDMID_41_TID_HTR_C "TestId / determines the TestId for the referenced test result DTR_OBDMID_41_TID_HTR" VALUE 0x9080D4D Val_Wu8 255.0 DFC_OneToOne 0.00 255.0 FORMAT "%5.1" /end CHARACTERISTIC
/begin CHARACTERISTIC DTR_TID.DTR_OBDMID_42_TID_HTR_C "TestId / determines the TestId for the referenced test result DTR_OBDMID_42_TID_HTR" VALUE 0x9080D4E Val_Wu8 255.0 DFC_OneToOne 0.00 255.0 FORMAT "%5.1" /end CHARACTERISTIC
/begin CHARACTERISTIC DTR_TID.DTR_OBDMID_a2_TID_0b_C "TestId / determines the TestId for the referenced test result DTR_OBDMID_a2_TID_0b" VALUE 0x9080D4F Val_Wu8 255.0 DFC_OneToOne 0.00 255.0 FORMAT "%5.1" /end CHARACTERISTIC
/begin CHARACTERISTIC DTR_TID.DTR_OBDMID_a2_TID_0c_C "TestId / determines the TestId for the referenced test result DTR_OBDMID_a2_TID_0c" VALUE 0x9080D50 Val_Wu8 255.0 DFC_OneToOne 0.00 255.0 FORMAT "%5.1" /end CHARACTERISTIC
/begin CHARACTERISTIC DTR_TID.DTR_TID_01_SEN_01_C "TestId / determines the TestId for the referenced test result DTR_TID_01_SEN_01" VALUE 0x9080D51 Val_Wu8 255.0 DFC_OneToOne 0.00 255.0 FORMAT "%5.1" /end CHARACTERISTIC
/begin CHARACTERISTIC DTR_TID.DTR_TID_01_SEN_02_C "TestId / determines the TestId for the referenced test result DTR_TID_01_SEN_02" VALUE 0x9080D52 Val_Wu8 255.0 DFC_OneToOne 0.00 255.0 FORMAT "%5.1" /end CHARACTERISTIC
/begin CHARACTERISTIC DTR_TID.DTR_TID_02_SEN_01_C "TestId / determines the TestId for the referenced test result DTR_TID_02_SEN_01" VALUE 0x9080D53 Val_Wu8 255.0 DFC_OneToOne 0.00 255.0 FORMAT "%5.1" /end CHARACTERISTIC
/begin CHARACTERISTIC DTR_TID.DTR_TID_02_SEN_02_C "TestId / determines the TestId for the referenced test result DTR_TID_02_SEN_02" VALUE 0x9080D54 Val_Wu8 255.0 DFC_OneToOne 0.00 255.0 FORMAT "%5.1" /end CHARACTERISTIC
/begin CHARACTERISTIC DTR_TID.DTR_TID_07_SEN_01_C "TestId / determines the TestId for the referenced test result DTR_TID_07_SEN_01" VALUE 0x9080D55 Val_Wu8 255.0 DFC_OneToOne 0.00 255.0 FORMAT "%5.1" /end CHARACTERISTIC
/begin CHARACTERISTIC DTR_TID.DTR_TID_07_SEN_02_C "TestId / determines the TestId for the referenced test result DTR_TID_07_SEN_02" VALUE 0x9080D56 Val_Wu8 255.0 DFC_OneToOne 0.00 255.0 FORMAT "%5.1" /end CHARACTERISTIC
/begin CHARACTERISTIC DTR_TID.DTR_TID_08_SEN_01_C "TestId / determines the TestId for the referenced test result DTR_TID_08_SEN_01" VALUE 0x9080D57 Val_Wu8 255.0 DFC_OneToOne 0.00 255.0 FORMAT "%5.1" /end CHARACTERISTIC
/begin CHARACTERISTIC DTR_TID.DTR_TID_08_SEN_02_C "TestId / determines the TestId for the referenced test result DTR_TID_08_SEN_02" VALUE 0x9080D58 Val_Wu8 255.0 DFC_OneToOne 0.00 255.0 FORMAT "%5.1" /end CHARACTERISTIC
/begin CHARACTERISTIC DTR_TID.DTR_TID_09_SEN_01_C "TestId / determines the TestId for the referenced test result DTR_TID_09_SEN_01" VALUE 0x9080D59 Val_Wu8 255.0 DFC_OneToOne 0.00 255.0 FORMAT "%5.1" /end CHARACTERISTIC
/begin CHARACTERISTIC DTR_TID.DTR_TID_0A_SEN_01_C "TestId / determines the TestId for the referenced test result DTR_TID_0A_SEN_01" VALUE 0x9080D5A Val_Wu8 255.0 DFC_OneToOne 0.00 255.0 FORMAT "%5.1" /end CHARACTERISTIC
/begin CHARACTERISTIC EngICO_stEnbl_C "Codeword in EngICO_Co" VALUE 0x9081372 KwUb 255.0 default 0.00 255.0 FORMAT "%5.1" /end CHARACTERISTIC
/begin CHARACTERISTIC EpmCrS_agNEngCurrOffs_C "Offset angle of 180 degree segment from current position for Epm_nEngCurr calculation." VALUE 0x9089FE4 Val_Ws16 1439.978 AngleCrS -720.0000 719.9780 FORMAT "%8.4" /end CHARACTERISTIC
/begin CHARACTERISTIC EpmCrS_agThrMaxMnfldP_CUR "Maximum throttle angle at current engine speed" CURVE 0x9089F56 RB_Curve_S16_S16 1599.976 relDK_q0p02441 -800.0000 799.9756 FORMAT "%8.4"
 /begin AXIS_DESCR STD_AXIS Epm_nEng EngN 6 -16384.00 16383.50 FORMAT "%8.2" DEPOSIT ABSOLUTE /end AXIS_DESCR
/end CHARACTERISTIC
/begin CHARACTERISTIC EpmCrS_dnEngMax_C "max. engine deceleration to calculate the diagnosis for a disturbances of the crankshaft signal" VALUE 0x9089F70 Val_Ws16 32767.00 EngNGrd -16383.50 16383.50 FORMAT "%8.2" EXTENDED_LIMITS -16384.00 16383.50 /end CHARACTERISTIC
/begin CHARACTERISTIC EpmCrS_facGapCrit1_C "factor for gap criteria one" VALUE 0x9089F98 Val_Wu8 15.94 EPM_FAC_PLAUS 0.00 15.94 FORMAT "%5.2" /end CHARACTERISTIC
/begin CHARACTERISTIC EpmCrS_facGapCrit2_C "factor for gap criteria two" VALUE 0x9089F99 Val_Wu8 15.94 EPM_FAC_PLAUS 0.00 15.94 FORMAT "%5.2" /end CHARACTERISTIC
/begin CHARACTERISTIC EpmCrS_facGapPlausHigh_CA "ratio to calculate the upper limit of the gap plausibility check of increment signal" VAL_BLK 0x9089F9A ValA_Wu8 15.94 EPM_FAC_PLAUS 0.00 15.94 FORMAT "%5.2" NUMBER 4 /end CHARACTERISTIC
/begin CHARACTERISTIC EpmCrS_facIncPlausHigh_CA "factor crankshaft signal plausibility check high" VAL_BLK 0x9089F9E ValA_Wu8 15.94 EPM_FAC_PLAUS 0.00 15.94 FORMAT "%5.2" NUMBER 4 /end CHARACTERISTIC
/begin CHARACTERISTIC EpmCrS_facIncPlausLow_CA "factor crankshaft signal plausibility check low" VAL_BLK 0x9089FA2 ValA_Wu8 15.94 EPM_FAC_PLAUS 0.00 15.94 FORMAT "%5.2" NUMBER 4 /end CHARACTERISTIC
/begin CHARACTERISTIC EpmCrS_facPt1BattU_C "Low Pass Filter factor for Battery Volatge for signal loss diagnosis" VALUE 0x9089F72 Val_Wu8 255.0 OneToOne 0.00 255.0 FORMAT "%5.1" /end CHARACTERISTIC
/begin CHARACTERISTIC EpmCrS_flgSwtDiag_C "Switch to enabledisable Crankshaft signal loss diagnosis based on battery voltage and manifold pressure signal" VALUE 0x9089F73 Val_Wu8 255.0 OneToOne 0.00 255.0 FORMAT "%5.1" /end CHARACTERISTIC
/begin CHARACTERISTIC EpmCrS_nDiagOff_C "engine speed threshold to switch off the crankshaft diagnosis" VALUE 0x9089F74 Val_Ws16 8000.000 EngN 0.00 8000.000 FORMAT "%8.3" EXTENDED_LIMITS -16384.00 16383.50 /end CHARACTERISTIC
/begin CHARACTERISTIC EpmCrS_nDiagOn_C "Engine speed to switch on the crankshaft diagnosis" VALUE 0x9089F76 Val_Ws16 8000.000 EngN 0.00 8000.000 FORMAT "%8.3" EXTENDED_LIMITS -16384.00 16383.50 /end CHARACTERISTIC
/begin CHARACTERISTIC EpmCrS_nMaxInc_C "max speed for one increment period" VALUE 0x9089FA6 Val_Ws16 14980.00 EngN 20.00000 15000.00 FORMAT "%8.2" EXTENDED_LIMITS -16384.00 16383.50 /end CHARACTERISTIC
/begin CHARACTERISTIC EpmCrS_nMinBattUDiag_C "Engine speed below which battery voltage based diagnosis is enabled" VALUE 0x9089F78 Val_Ws16 32767.50 EngN -16384.00 16383.50 FORMAT "%8.2" /end CHARACTERISTIC
/begin CHARACTERISTIC EpmCrS_nMinInc_C "min speed for one one increment period" VALUE 0x9089FA8 Val_Ws16 14980.00 EngN 20.00000 15000.00 FORMAT "%8.2" EXTENDED_LIMITS -16384.00 16383.50 /end CHARACTERISTIC
/begin CHARACTERISTIC EpmCrS_nrDebMnfldPPat_C "Number of pressure patterns (pressure drops) required to confirm Engine rotation" VALUE 0x9089F7A Val_Wu8 255.0 OneToOne 0.00 255.0 FORMAT "%5.1" /end CHARACTERISTIC
/begin CHARACTERISTIC EpmCrS_nThreshRange_CA "array of speed thresholds for dynamic plaus" VAL_BLK 0x9089FAC ValA_Ws32 16384.198623855635 EngN2tiIncPer 20.000031000049649 16404.198654855685 FORMAT "%19.13" EXTENDED_LIMITS 0.001940255267673 4166666.4583333433 NUMBER 4 /end CHARACTERISTIC
/begin CHARACTERISTIC EpmCrS_nTiIncPerAvrg_CA "engine speed thresholds to set the number of crankshaft teeth to calculate the average for one tooth time" VAL_BLK 0x9089FBC ValA_Ws16 16363.00 EngN 20.00000 16383.00 FORMAT "%8.2" EXTENDED_LIMITS -16384.00 16383.50 NUMBER 4 /end CHARACTERISTIC
/begin CHARACTERISTIC EpmCrS_numAgClkDeltaCrsvMax_C "Permitted maximum number of angle differences which are above the maximum angle" VALUE 0x9089FC4 Val_Wu8 26.00 OneToOne 6.000 32.00 FORMAT "%5.2" EXTENDED_LIMITS 0.00 255.0 /end CHARACTERISTIC
/begin CHARACTERISTIC EpmCrS_numErrSigIncDef_C "step wide defect debouncing crankshaft disturbance" VALUE 0x9089F7C Val_Ws16 32767.00 OneToOne 0.00 32767.00 FORMAT "%8.2" EXTENDED_LIMITS -32768.00 32767.00 /end CHARACTERISTIC
/begin CHARACTERISTIC EpmCrS_numErrSigIncOK_C "alternative decrement for error healing" VALUE 0x9089F7E Val_Ws16 32767.00 OneToOne 0.00 32767.00 FORMAT "%8.2" EXTENDED_LIMITS -32768.00 32767.00 /end CHARACTERISTIC
/begin CHARACTERISTIC EpmCrS_numErrSigMaxDef_C "max. number of disturbance until fault report crankshaft disturbance" VALUE 0x9089F80 Val_Ws16 32767.00 OneToOne 0.00 32767.00 FORMAT "%8.2" EXTENDED_LIMITS -32768.00 32767.00 /end CHARACTERISTIC
/begin CHARACTERISTIC EpmCrS_numErrSigMinOK_C "min. number of plausible crankshaft revolutions until healing" VALUE 0x9089F82 Val_Ws16 32767.00 OneToOne 0.00 32767.00 FORMAT "%8.2" EXTENDED_LIMITS -32768.00 32767.00 /end CHARACTERISTIC
/begin CHARACTERISTIC EpmCrS_numIgnInc_C "number of teeth to supress crankshaft signal" VALUE 0x9089FC5 Val_Wu8 252.0 OneToOne 3.000 255.0 FORMAT "%5.1" EXTENDED_LIMITS 0.00 255.0 /end CHARACTERISTIC
/begin CHARACTERISTIC EpmCrS_numTiIncPerAvrg_CA "number of crankshaft teeth to calculate average of tooth time" VAL_BLK 0x9089FC6 ValA_Wu8 50.00 OneToOne 0.00 50.00 FORMAT "%5.2" EXTENDED_LIMITS 0.00 255.0 NUMBER 4 /end CHARACTERISTIC
/begin CHARACTERISTIC EpmCrS_pDiffIntkMnfld_C "Minimum increase in manifold pressure to decide the end of intake stroke." VALUE 0x9089F84 Val_Ws16 5119.922 p_uw_q0p078 -2560.000 2559.922 FORMAT "%8.3" /end CHARACTERISTIC
/begin CHARACTERISTIC EpmCrS_pDrpIntkMnfld_C "Minimum manifold pressure drop due to an intake stroke" VALUE 0x9089F86 Val_Ws16 5119.922 p_uw_q0p078 -2560.000 2559.922 FORMAT "%8.3" /end CHARACTERISTIC
/begin CHARACTERISTIC EpmCrS_phiAgClkDeltaMax_C "Permitted maximum angle difference between the relative angle of the angle clock and the relative angle provided by the tooth counter" VALUE 0x9089FCA Val_Ws16 5.009766 AngleCrS 1.999512 7.009277 FORMAT "%8.6" EXTENDED_LIMITS -720.0000 719.9780 /end CHARACTERISTIC
/begin CHARACTERISTIC EpmCrS_stClrCntReSyncAgClkDeltaTot_C "Calibration value to reset the number of released re-synchronizations over all driving cycles" VALUE 0x9089FCC Val_Wu8 255.0 OneToOne 0.00 255.0 FORMAT "%5.1" /end CHARACTERISTIC
/begin CHARACTERISTIC EpmCrS_stDiagT50Reset_C "usage of terminal 50 information for crankshaft diagnosis" VALUE 0x9089F88 Val_Wu8 1.000 OneToOne 0.00 1.000 FORMAT "%5.3" EXTENDED_LIMITS 0.00 255.0 /end CHARACTERISTIC
/begin CHARACTERISTIC EpmCrS_swtEnableDiag_C "Switch off crankshaft diagnosis" VALUE 0x9089F89 Val_Wu8 255.0 OneToOne 0.00 255.0 FORMAT "%5.1" /end CHARACTERISTIC
/begin CHARACTERISTIC EpmCrS_tiGlitchFilter_CA "glitch filter time crankshaft signal" VAL_BLK 0x9089FD0 ValA_Ws32 100000.000000 OneToOne_us 0.00 100000.000000 FORMAT "%13.6" EXTENDED_LIMITS -2147483648.00 2147483647.00 NUMBER 4 /end CHARACTERISTIC
/begin CHARACTERISTIC EpmCrS_tiIgnSig_C "time to supress the crankshaft signal" VALUE 0x9089FE0 Val_Ws32 100000.000000 OneToOne_ms 0.00 100000.000000 FORMAT "%13.6" EXTENDED_LIMITS -2147483648.00 2147483647.00 /end CHARACTERISTIC
/begin CHARACTERISTIC EpmCrS_tiMaxStrtrEngd_C "Maximum possible starter engage duration" VALUE 0x9089F8A Val_Wu8 25.50 t_q0p1 0.00 25.50 FORMAT "%5.2" /end CHARACTERISTIC
/begin CHARACTERISTIC EpmCrS_tiMaxT15Actv_C "Maximum possible T15 ON time for battery based diagnosis to report no signal error" VALUE 0x9089F8B Val_Wu8 25.50 t_q0p1 0.00 25.50 FORMAT "%5.2" /end CHARACTERISTIC
/begin CHARACTERISTIC EpmCrS_tiMinStrtrEngd_C "Duration of short cranking" VALUE 0x9089F8C Val_Wu8 25.50 t_q0p1 0.00 25.50 FORMAT "%5.2" /end CHARACTERISTIC
/begin CHARACTERISTIC EpmCrS_tiMnfldPPatDeb_C "Minimum time duration required to detect manifold pressure pattern" VALUE 0x9089F8D Val_Wu8 25.50 t_q0p1 0.00 25.50 FORMAT "%5.2" /end CHARACTERISTIC
/begin CHARACTERISTIC EpmCrS_uBattMinDiag_C "Minimum battery voltage to enable signal loss diagnosis based on battery voltage profile" VALUE 0x9089F8E Val_Wu8 17.95 spg_ubatt 0.00 17.95 FORMAT "%5.2" /end CHARACTERISTIC
/begin CHARACTERISTIC EpmCrS_uDrpStrtrActv_C "Minimum battery voltage to enable signal loss diagnosis based on battery voltage profile" VALUE 0x9089F8F Val_Wu8 17.95 spg_ubatt 0.00 17.95 FORMAT "%5.2" /end CHARACTERISTIC
/begin CHARACTERISTIC EpmCrS_uDrpStrtrNotActv2_C "Additional calibration for reverse rotation algorithm to set Drop in battery voltage from the initial value when the starter is disengagd" VALUE 0x9089F90 Val_Wu8 17.95 spg_ubatt 0.00 17.95 FORMAT "%5.2" /end CHARACTERISTIC
/begin CHARACTERISTIC EpmCrS_uDrpStrtrNotActv_C "Drop in battery voltage from the initial value when the starter is disengagd" VALUE 0x9089F91 Val_Wu8 17.95 spg_ubatt 0.00 17.95 FORMAT "%5.2" /end CHARACTERISTIC
/begin CHARACTERISTIC EpmCrS_VehV_v_Max_C "Upper limit of car speed to deactivate the diagnosis" VALUE 0x9089F92 Val_Ws16 655.3500 Vel -327.6800 327.6700 FORMAT "%8.4" /end CHARACTERISTIC
/begin CHARACTERISTIC EpmCrS_VehV_v_Min_C "Lower limit of car speed to deactivate the diagnosis" VALUE 0x9089F94 Val_Ws16 655.3500 Vel -327.6800 327.6700 FORMAT "%8.4" /end CHARACTERISTIC
/begin CHARACTERISTIC EpmHCrS_swtNoiseRej_C "Calibration for enabling noise rejection functionality." VALUE 0x9089FE6 Val_Wu8 255.0 OneToOne 0.00 255.0 FORMAT "%5.1" /end CHARACTERISTIC
/begin CHARACTERISTIC EpmHCrS_tiNoSig_C "The time duration between from crank shaft signal lost to Epm driver reset" VALUE 0x9089FE8 Val_Wu16 655.3500 t10msxs_sb_q0p01 0.00 655.3500 FORMAT "%8.4" /end CHARACTERISTIC
/begin CHARACTERISTIC EpmRRS_EnaIgnInj_CW "codeword of reverse rotation detection (engine shut off and starter active detection)" VALUE 0x9089FEA Val_Wu8 7.000 OneToOne 0.00 7.000 FORMAT "%5.3" EXTENDED_LIMITS 0.00 255.0 /end CHARACTERISTIC
/begin CHARACTERISTIC EpmRRS_nEngMax_C "engine speed maximum for reverse rotation detection" VALUE 0x9089FEC Val_Ws16 1000.000 EngN 0.00 1000.000 FORMAT "%8.3" EXTENDED_LIMITS -16384.00 16383.50 /end CHARACTERISTIC
/begin CHARACTERISTIC EpmRRS_phiUndef_C "angle before TDC where reverse rotation detection is undefined" VALUE 0x9089FEE Val_Ws16 90.00000 AngleCrS 0.00 90.00000 FORMAT "%8.5" EXTENDED_LIMITS -720.0000 719.9780 /end CHARACTERISTIC
/begin CHARACTERISTIC EpmRRS_tiMaxToothTime_C "Upper limit for tooth timeout of engine stop detection" VALUE 0x9089FF0 Val_Wu8 970.0 t_q10_ms 30.00 1000. FORMAT "%5.0" EXTENDED_LIMITS 0.00 2550. /end CHARACTERISTIC
/begin CHARACTERISTIC EpmRRS_tiTemp_CUR "max tooth periods with reverse rotation depending on temperature" CURVE 0x9089FF2 Cur_Xs16Ws16 32767.00 OneToOne_us 0.00 32767.00 FORMAT "%8.2" EXTENDED_LIMITS -32768.00 32767.00
 /begin AXIS_DESCR STD_AXIS EngDa_tEng Temp_Cels 5 -3549.940 3003.560 FORMAT "%8.3" DEPOSIT ABSOLUTE /end AXIS_DESCR
/end CHARACTERISTIC
/begin CHARACTERISTIC EpmRRS_vVehMax_C "Engine speed theshold, below that reverse rotation detection is active" VALUE 0x908A008 Val_Ws16 250.0000 vel_q0p01 0.00 250.0000 FORMAT "%8.4" EXTENDED_LIMITS -327.6800 327.6700 /end CHARACTERISTIC
/begin CHARACTERISTIC EpmSeq_phiIntVrtl_CA "Calibration array for absolute virtual synchro positions" VAL_BLK 0x908A00A ValA_Ws16 1439.978 AngleCrS -720.0000 719.9780 FORMAT "%8.4" NUMBER 3 /end CHARACTERISTIC
/begin CHARACTERISTIC EpmSeq_phiInt_CA "interrupt position related to TDC" VAL_BLK 0x908A010 ValA_Ws16 719.9780 AngleCrS 0.00 719.9780 FORMAT "%8.4" EXTENDED_LIMITS -720.0000 719.9780 NUMBER 2 /end CHARACTERISTIC
/begin CHARACTERISTIC EpmSeq_swtInt_C "switch to activate/deactivate functionality of the sequence-manager" VALUE 0x908A014 Val_Wu8 15.00 OneToOne 0.00 15.00 FORMAT "%5.2" EXTENDED_LIMITS 0.00 255.0 /end CHARACTERISTIC
/begin CHARACTERISTIC EpmSeq_swtVrtlInt_C "Switch to enable or disable different features in virtual synchro generation" VALUE 0x908A015 Val_Wu8 15.00 OneToOne 0.00 15.00 FORMAT "%5.2" EXTENDED_LIMITS 0.00 255.0 /end CHARACTERISTIC
/begin CHARACTERISTIC EpmSyn_cntrValChkCrksftToothT_C "Phase validation counter threshold" VALUE 0x908A048 Val_Wu8 255.0 OneToOne 0.00 255.0 FORMAT "%5.1" /end CHARACTERISTIC
/begin CHARACTERISTIC EpmSyn_dnEngMaxCrksftToothT_C "Engine speed gradient threshold for tooth-time gradient calculation" VALUE 0x908A04A Val_Ws16 32767.50 EngNGrd -16384.00 16383.50 FORMAT "%8.2" /end CHARACTERISTIC
/begin CHARACTERISTIC EpmSyn_facAltiCorrnHiToothT_CUR "Altitude correction factor for upper gradient threshold" CURVE 0x908A04C RB_Curve_U8_S8_Static 2.000 fak_q0p01 -1.000 1.000 FORMAT "%5.3" EXTENDED_LIMITS -1.280 1.270
 /begin AXIS_DESCR STD_AXIS fho fak_ub_b4 6 0.00 3.984 FORMAT "%5.3" DEPOSIT ABSOLUTE /end AXIS_DESCR
/end CHARACTERISTIC
/begin CHARACTERISTIC EpmSyn_facAltiCorrnLoToothT_CUR "Altitude correction factor for lower gradient threshold" CURVE 0x908A059 RB_Curve_U8_S8_Static 2.000 fak_q0p01 -1.000 1.000 FORMAT "%5.3" EXTENDED_LIMITS -1.280 1.270
 /begin AXIS_DESCR STD_AXIS fho fak_ub_b4 6 0.00 3.984 FORMAT "%5.3" DEPOSIT ABSOLUTE /end AXIS_DESCR
/end CHARACTERISTIC
/begin CHARACTERISTIC EpmSyn_facWghCrksftPat_C "Weighting factor of synchronization method: EpmSyn_CrksftPat" VALUE 0x908A044 Val_Ws16 511.9922 Fact1 -256.0000 255.9922 FORMAT "%8.4" /end CHARACTERISTIC
/begin CHARACTERISTIC EpmSyn_facWghCrksftToothT_C "Weighting factor of synchronization method: EpmSyn_CrksftToothT" VALUE 0x908A066 Val_Ws16 10.00000 Fact1 0.00 10.00000 FORMAT "%8.5" EXTENDED_LIMITS -256.0000 255.9922 /end CHARACTERISTIC
/begin CHARACTERISTIC EpmSyn_nEngMaxCrkDblIgn_C "Upper threshold of engine speed to activate double ignition mode during start" VALUE 0x908A016 Val_Ws16 700.0000 EngN 0.00 700.0000 FORMAT "%8.4" EXTENDED_LIMITS -16384.00 16383.50 /end CHARACTERISTIC
/begin CHARACTERISTIC EpmSyn_nEngMaxCrksftToothT_C "Maximum engine speed upto which phase detection is possible by crankshaft tooth period evaluation" VALUE 0x908A068 Val_Ws16 3000.000 EngN 0.00 3000.000 FORMAT "%8.3" EXTENDED_LIMITS -16384.00 16383.50 /end CHARACTERISTIC
/begin CHARACTERISTIC EpmSyn_nEngMaxDrvDblIgn_C "Upper threshold of engine speed to activate double ignition mode during drive" VALUE 0x908A018 Val_Ws16 16000.00 EngN 0.00 16000.00 FORMAT "%8.2" EXTENDED_LIMITS -16384.00 16383.50 /end CHARACTERISTIC
/begin CHARACTERISTIC EpmSyn_nEngMinDrvDblIgn_C "Lower threshold of engine speed to activate double ignition mode during drive" VALUE 0x908A01A Val_Ws16 1500.000 EngN 0.00 1500.000 FORMAT "%8.3" EXTENDED_LIMITS -16384.00 16383.50 /end CHARACTERISTIC
/begin CHARACTERISTIC EpmSyn_nrAtmptCrksftToothT_C "Threshold for the number of consecutive gradient check attempts" VALUE 0x908A06A Val_Wu8 255.0 OneToOne 0.00 255.0 FORMAT "%5.1" /end CHARACTERISTIC
/begin CHARACTERISTIC EpmSyn_nrCrSRevDblIgn_C "Minimum number of crank revolutions to activate double ignition mode during start." VALUE 0x908A01C Val_Wu8 8.000 OneToOne 0.00 8.000 FORMAT "%5.3" EXTENDED_LIMITS 0.00 255.0 /end CHARACTERISTIC
/begin CHARACTERISTIC EpmSyn_nrRevStrtDlyCrksftToothT_C "Number of first few crank revolutions to ignore for gradient calculation" VALUE 0x908A06B Val_Wu8 255.0 OneToOne 0.00 255.0 FORMAT "%5.1" /end CHARACTERISTIC
/begin CHARACTERISTIC EpmSyn_nrTthWndwOffsCrksftToothT_C "Offset to the to the tooth time evaluation window to move the window end point around the TDC" VALUE 0x908A06C Val_Ws8 255.0 OneToOne -128.0 127.0 FORMAT "%5.1" /end CHARACTERISTIC
/begin CHARACTERISTIC EpmSyn_numIgnIncCrksftToothT_C "Number of crankshaft teeth ignored before start of phase search." VALUE 0x908A06D Val_Wu8 60.00 OneToOne 0.00 60.00 FORMAT "%5.2" EXTENDED_LIMITS 0.00 255.0 /end CHARACTERISTIC
/begin CHARACTERISTIC EpmSyn_numTthAvrgCrksftToothT_C "Number of teeth used for average tooth period calculation at start and end of the gradient check window" VALUE 0x908A06E Val_Wu8 9.000 OneToOne 1.000 10.00 FORMAT "%5.2" EXTENDED_LIMITS 0.00 255.0 /end CHARACTERISTIC
/begin CHARACTERISTIC EpmSyn_phiIncCor_CUR "Engine speed depending angle error of crankshaft signal" CURVE 0x908A01E Cur_Xs16Ws16 1439.978 AngleCrS -720.0000 719.9780 FORMAT "%8.4"
 /begin AXIS_DESCR STD_AXIS Epm_nEng EngN 4 -16384.00 16383.50 FORMAT "%8.2" DEPOSIT ABSOLUTE /end AXIS_DESCR
/end CHARACTERISTIC
/begin CHARACTERISTIC EpmSyn_rAgQlCrksftPat_C "Quality factor assigned to the calculated angle distribution" VALUE 0x908A046 Val_Ws16 799.9878 Prc -400.0000 399.9878 FORMAT "%8.4" READ_ONLY /end CHARACTERISTIC
/begin CHARACTERISTIC EpmSyn_rAgQlCrksftToothT_CA "Quality factors assigned to the calculated angle distribution" VAL_BLK 0x908A070 ValA_Ws16 799.9878 Prc -400.0000 399.9878 FORMAT "%8.4" NUMBER 1 /end CHARACTERISTIC
/begin CHARACTERISTIC EpmSyn_rAgQlFulSync_CA "Required angle quality for Full synchronization" VAL_BLK 0x908A030 ValA_Ws16 100.0000 Prc 0.00 100.0000 FORMAT "%8.4" EXTENDED_LIMITS -400.0000 399.9878 NUMBER 2 /end CHARACTERISTIC
/begin CHARACTERISTIC EpmSyn_stStgyAgQlLo_CA "Synchronization strategy array to select next configuration in case of low angle quality" VAL_BLK 0x908A034 ValA_Wu8 255.0 OneToOne 0.00 255.0 FORMAT "%5.1" NUMBER 2 /end CHARACTERISTIC
/begin CHARACTERISTIC EpmSyn_stSyncStgy_MAP "Synchronization strategy MAP" MAP 0x908A036 Map_Xu8Yu8Wu8 21.0000000000 EPMSYN_STSYNCSTGY_VERB 0.00 21.0000000000 FORMAT "%13.10"
 /begin AXIS_DESCR STD_AXIS EpmSyn_numActvCfg_mp EPMSYN_NUMSYNCCFG_VERB 2 0.00 10.0000000000 FORMAT "%13.10" DEPOSIT ABSOLUTE /end AXIS_DESCR
 /begin AXIS_DESCR STD_AXIS EpmSyn_numActvMethod_mp EPMSYN_NUMACTVMETHOD_VERB 3 0.00 7.00000000000 FORMAT "%13.11" DEPOSIT ABSOLUTE /end AXIS_DESCR
/end CHARACTERISTIC
/begin CHARACTERISTIC EpmSyn_swtCo_C "Bit coded calibration switch for synchronization coordinator" VALUE 0x908A043 Val_Wu8 255.0 OneToOne 0.00 255.0 FORMAT "%5.1" /end CHARACTERISTIC
/begin CHARACTERISTIC EpmSyn_swtCrksftToothT_C "Calibration switch to enabledisable different partial functions" VALUE 0x908A072 Val_Wu8 255.0 OneToOne 0.00 255.0 FORMAT "%5.1" /end CHARACTERISTIC
/begin CHARACTERISTIC EpmSyn_swtMethToothT_C "Switch to select between the methods to find phase for different tooth time behaviours" VALUE 0x908A073 Val_Wu8 255.0 OneToOne 0.00 255.0 FORMAT "%5.1" /end CHARACTERISTIC
/begin CHARACTERISTIC EpmSyn_tiThdGrdtHiCrksftToothT_MAP "Upper threshold for tooth period slope in the gradient check window for TDC based on engine speed and Engine Temperature" MAP 0x908152C RB_Map_S16S16_S16 655.3500 fak_q0p01 -327.6800 327.6700 FORMAT "%8.4"
 /begin AXIS_DESCR STD_AXIS Epm_nEng EngN 8 -16384.00 16383.50 FORMAT "%8.2" DEPOSIT ABSOLUTE /end AXIS_DESCR
 /begin AXIS_DESCR STD_AXIS EngDa_tEng Temp_Cels 8 -3549.940 3003.560 FORMAT "%8.3" DEPOSIT ABSOLUTE /end AXIS_DESCR
/end CHARACTERISTIC
/begin CHARACTERISTIC EpmSyn_tiThdGrdtLoCrksftToothT_MAP "Lower threshold for tooth period slope in the gradient check window for TDC based on engine speed and Engine Temperature" MAP 0x90815D0 RB_Map_S16S16_S16 655.3500 fak_q0p01 -327.6800 327.6700 FORMAT "%8.4"
 /begin AXIS_DESCR STD_AXIS Epm_nEng EngN 8 -16384.00 16383.50 FORMAT "%8.2" DEPOSIT ABSOLUTE /end AXIS_DESCR
 /begin AXIS_DESCR STD_AXIS EngDa_tEng Temp_Cels 8 -3549.940 3003.560 FORMAT "%8.3" DEPOSIT ABSOLUTE /end AXIS_DESCR
/end CHARACTERISTIC
/begin CHARACTERISTIC EpmSyn_TthWndwCrksftToothT_C "Length of gradient evaluation window in terms of crankshaft teeth" VALUE 0x908A074 Val_Wu8 255.0 OneToOne 0.00 255.0 FORMAT "%5.1" /end CHARACTERISTIC
/begin CHARACTERISTIC NDV "error detection vehicle speed signal / minimum threshold for engine speed" VALUE 0x908513E KwWU16 16383.75 nmot_uw_q0p25 0.00 16383.75 FORMAT "%8.2" /end CHARACTERISTIC
/begin CHARACTERISTIC NDVO "error detection vehicle speed signal, maximum threshold for engine speed" VALUE 0x9085140 KwWU16 16383.75 nmot_uw_q0p25 0.00 16383.75 FORMAT "%8.2" /end CHARACTERISTIC
/begin CHARACTERISTIC RLDVO "error detection vehicle speed signal, maximum threshold for engine load" VALUE 0x9085142 KwWU8 191.3 rel_ub_q0p75 0.00 191.3 FORMAT "%5.1" /end CHARACTERISTIC
/begin CHARACTERISTIC RLDVU "error detection vehicle speed signal, minimum threshold for engine load" VALUE 0x9085143 KwWU8 191.3 rel_ub_q0p75 0.00 191.3 FORMAT "%5.1" /end CHARACTERISTIC
/begin CHARACTERISTIC TATEDMN "Min threshold for purge duty cycle for cycle flag setting" VALUE 0x9085138 KwWU16 102.3984 rel_uw_b102p4 0.00 102.3984 FORMAT "%8.4" /end CHARACTERISTIC
/begin CHARACTERISTIC TATEDMX "Max threshold for purge duty cycle for cycle flag setting" VALUE 0x908513A KwWU16 102.3984 rel_uw_b102p4 0.00 102.3984 FORMAT "%8.4" /end CHARACTERISTIC
/begin CHARACTERISTIC TDV "error detection tachometer signal / time for interrogation" VALUE 0x9085144 KwWU8 25.50 t_q0p1 0.00 25.50 FORMAT "%5.2" /end CHARACTERISTIC
/begin CHARACTERISTIC TENDIAGV "Time debounce to enable diagnosis based on NMAX condition" VALUE 0x9085146 KwWU16 3276.750 t_q0p05 0.00 3276.750 FORMAT "%8.3" /end CHARACTERISTIC
/begin CHARACTERISTIC TMDV "motor temperature threshold for release of vehicle speed diagnosis" VALUE 0x9085148 KwWS16 6553.500 Temp_Cels -3549.940 3003.560 FORMAT "%8.3" /end CHARACTERISTIC
/begin CHARACTERISTIC VDMN "vehicle speed threshold; fault detection vhehicle speed signal" VALUE 0x908514A KwWU16 511.9922 vfzg_uw_b512 0.00 511.9922 FORMAT "%8.4" /end CHARACTERISTIC
/begin CHARACTERISTIC VDMNRE "vehicle speed threshold for fault detection of secondary vehicle speed signal" VALUE 0x908514C KwWU16 3686.344 RBPtCel_v_0p05625_1 0.00 3686.344 FORMAT "%8.3" /end CHARACTERISTIC
/begin MEASUREMENT B_errdiagen "Enable vehicle speed sensor error detection" UBYTE B_TRUE 1 100 0.00 1.00000000000 BIT_MASK 0x1 FORMAT "%13.11" ECU_ADDRESS 0x40008932
 /begin IF_DATA XCPplus 0x0102
  /begin DAQ_EVENT VARIABLE /begin AVAILABLE_EVENT_LIST EVENT 0 EVENT 1 EVENT 2 EVENT 3 /end AVAILABLE_EVENT_LIST /begin DEFAULT_EVENT_LIST EVENT 2 /end DEFAULT_EVENT_LIST /end DAQ_EVENT
 /end IF_DATA
/end MEASUREMENT
/begin MEASUREMENT B_evabu "Condition: Ev- disconnection by monitoring functions" UBYTE B_TRUE 1 100 0.00 1.00000000000 BIT_MASK 0x1 FORMAT "%13.11" ECU_ADDRESS 0x40008722 /end MEASUREMENT
/begin MEASUREMENT B_flgDVFZDSCClr "Bit for DVFZ DSM clear" UBYTE B_TRUE 1 100 0.00 1.00000000000 BIT_MASK 0x1 FORMAT "%13.11" ECU_ADDRESS 0x40008933
 /begin IF_DATA XCPplus 0x0102
  /begin DAQ_EVENT VARIABLE /begin AVAILABLE_EVENT_LIST EVENT 0 EVENT 1 EVENT 2 EVENT 3 /end AVAILABLE_EVENT_LIST /begin DEFAULT_EVENT_LIST EVENT 2 /end DEFAULT_EVENT_LIST /end DAQ_EVENT
 /end IF_DATA
/end MEASUREMENT
/begin MEASUREMENT B_nlzoff "condition to ignition cutoff for monitoring function" UBYTE B_TRUE 1 100 0.00 1.00000000000 BIT_MASK 0x1 FORMAT "%13.11" ECU_ADDRESS 0x40008721 /end MEASUREMENT
/begin MEASUREMENT B_noflr "Condition diagnosis finished with o.k. report" UBYTE B_TRUE 1 100 0.00 1.00000000000 BIT_MASK 0x1 FORMAT "%13.11" ECU_ADDRESS 0x40008931
 /begin IF_DATA XCPplus 0x0102
  /begin DAQ_EVENT VARIABLE /begin AVAILABLE_EVENT_LIST EVENT 0 EVENT 1 EVENT 2 EVENT 3 /end AVAILABLE_EVENT_LIST /begin DEFAULT_EVENT_LIST EVENT 2 /end DEFAULT_EVENT_LIST /end DAQ_EVENT
 /end IF_DATA
/end MEASUREMENT
/begin MEASUREMENT B_sigflr "signal error vehicle speed" UBYTE B_TRUE 1 100 0.00 1.00000000000 BIT_MASK 0x2 FORMAT "%13.11" ECU_ADDRESS 0x40008931
 /begin IF_DATA XCPplus 0x0102
  /begin DAQ_EVENT VARIABLE /begin AVAILABLE_EVENT_LIST EVENT 0 EVENT 1 EVENT 2 EVENT 3 /end AVAILABLE_EVENT_LIST /begin DEFAULT_EVENT_LIST EVENT 2 /end DEFAULT_EVENT_LIST /end DAQ_EVENT
 /end IF_DATA
/end MEASUREMENT
/begin MEASUREMENT Com_avgvfzg_0 "Com variable for avgvfzg_[0] ; Array to store average vehicle speed for last five driving cycles in frame EMS_16" UBYTE vfzg_ub_q1p25 1 100 0.00 318.8 FORMAT "%5.1" ECU_ADDRESS 0x4000876A
 /begin IF_DATA XCPplus 0x0102
  /begin DAQ_EVENT VARIABLE /begin AVAILABLE_EVENT_LIST EVENT 0 EVENT 1 EVENT 2 EVENT 3 /end AVAILABLE_EVENT_LIST /begin DEFAULT_EVENT_LIST EVENT 1 /end DEFAULT_EVENT_LIST /end DAQ_EVENT
 /end IF_DATA
/end MEASUREMENT
/begin MEASUREMENT Com_avgvfzg_1 "com variable for avgvfzg_[1] ; Array to store average vehicle speed for last five driving cycles in frame EMS_16" UBYTE vfzg_ub_q1p25 1 100 0.00 318.8 FORMAT "%5.1" ECU_ADDRESS 0x40008769
 /begin IF_DATA XCPplus 0x0102
  /begin DAQ_EVENT VARIABLE /begin AVAILABLE_EVENT_LIST EVENT 0 EVENT 1 EVENT 2 EVENT 3 /end AVAILABLE_EVENT_LIST /begin DEFAULT_EVENT_LIST EVENT 1 /end DEFAULT_EVENT_LIST /end DAQ_EVENT
 /end IF_DATA
/end MEASUREMENT
/begin MEASUREMENT Com_avgvmlg_0 "com variable for avgvmlg_[0] ; Array to store average fuel consumption (kml) in last five driving cycles in EMS_16" UWORD fak_q0p1 1 100 0.00 6553.500 FORMAT "%8.3" ECU_ADDRESS 0x4000820C
 /begin IF_DATA XCPplus 0x0102
  /begin DAQ_EVENT VARIABLE /begin AVAILABLE_EVENT_LIST EVENT 0 EVENT 1 EVENT 2 EVENT 3 /end AVAILABLE_EVENT_LIST /begin DEFAULT_EVENT_LIST EVENT 1 /end DEFAULT_EVENT_LIST /end DAQ_EVENT
 /end IF_DATA
/end MEASUREMENT
/begin MEASUREMENT Com_avgvmlg_1 "com variable for avgvmlg_[1] ; Array to store average fuel consumption (kml) in last five driving cycles in EMS_16" UWORD fak_q0p1 1 100 0.00 6553.500 FORMAT "%8.3" ECU_ADDRESS 0x4000820A
 /begin IF_DATA XCPplus 0x0102
  /begin DAQ_EVENT VARIABLE /begin AVAILABLE_EVENT_LIST EVENT 0 EVENT 1 EVENT 2 EVENT 3 /end AVAILABLE_EVENT_LIST /begin DEFAULT_EVENT_LIST EVENT 1 /end DEFAULT_EVENT_LIST /end DAQ_EVENT
 /end IF_DATA
/end MEASUREMENT
/begin MEASUREMENT Com_BIDev_flgSidstSt "Com Variable for Side stand active" UBYTE B_TRUE 1 100 0.00 1.00000000000 BIT_MASK 0x1 FORMAT "%13.11" ECU_ADDRESS 0x400063B3
 /begin IF_DATA XCPplus 0x0102
  /begin DAQ_EVENT VARIABLE /begin AVAILABLE_EVENT_LIST EVENT 0 EVENT 1 EVENT 2 EVENT 3 /end AVAILABLE_EVENT_LIST /begin DEFAULT_EVENT_LIST EVENT 1 /end DEFAULT_EVENT_LIST /end DAQ_EVENT
 /end IF_DATA
/end MEASUREMENT
/begin MEASUREMENT Com_B_etmot "com variavle for coolant temperature sensor error status signal" UBYTE B_TRUE 1 100 0.00 1.00000000000 BIT_MASK 0x1 FORMAT "%13.11" ECU_ADDRESS 0x400063B1
 /begin IF_DATA XCPplus 0x0102
  /begin DAQ_EVENT VARIABLE /begin AVAILABLE_EVENT_LIST EVENT 0 EVENT 1 EVENT 2 EVENT 3 /end AVAILABLE_EVENT_LIST /begin DEFAULT_EVENT_LIST EVENT 1 /end DEFAULT_EVENT_LIST /end DAQ_EVENT
 /end IF_DATA
/end MEASUREMENT
/begin MEASUREMENT Com_B_OvHLamp "com variable for over heat lamp signal" UBYTE B_TRUE 1 100 0.00 1.00000000000 BIT_MASK 0x1 FORMAT "%13.11" ECU_ADDRESS 0x400063B2
 /begin IF_DATA XCPplus 0x0102
  /begin DAQ_EVENT VARIABLE /begin AVAILABLE_EVENT_LIST EVENT 0 EVENT 1 EVENT 2 EVENT 3 /end AVAILABLE_EVENT_LIST /begin DEFAULT_EVENT_LIST EVENT 1 /end DEFAULT_EVENT_LIST /end DAQ_EVENT
 /end IF_DATA
/end MEASUREMENT
/begin MEASUREMENT com_dfes_blptn "Diagnostics error blink pattern to be transmitted to cluster" UBYTE dez 1 100 0.00 255.0 FORMAT "%5.1" ARRAY_SIZE 20 ECU_ADDRESS 0x40004830 /end MEASUREMENT
/begin MEASUREMENT com_dfes_blptn_mp "Blink pattern for cluster" UBYTE dez 1 100 0.00 255.0 FORMAT "%5.1" ECU_ADDRESS 0x40006310 /end MEASUREMENT
/begin MEASUREMENT Com_DFES_numDFC "com variable for diag. fault code in frame EMS_5" UBYTE OneToOne 1 100 0.00 255.0 FORMAT "%5.1" ECU_ADDRESS 0x40008768
 /begin IF_DATA XCPplus 0x0102
  /begin DAQ_EVENT VARIABLE /begin AVAILABLE_EVENT_LIST EVENT 0 EVENT 1 EVENT 2 EVENT 3 /end AVAILABLE_EVENT_LIST /begin DEFAULT_EVENT_LIST EVENT 1 /end DEFAULT_EVENT_LIST /end DAQ_EVENT
 /end IF_DATA
/end MEASUREMENT
/begin MEASUREMENT Com_DFES_numDFC0 "Com variable for error name[0]" UBYTE OneToOne 1 100 0.00 255.0 FORMAT "%5.1" ECU_ADDRESS 0x40006362
 /begin IF_DATA XCPplus 0x0102
  /begin DAQ_EVENT VARIABLE /begin AVAILABLE_EVENT_LIST EVENT 0 EVENT 1 EVENT 2 EVENT 3 /end AVAILABLE_EVENT_LIST /begin DEFAULT_EVENT_LIST EVENT 1 /end DEFAULT_EVENT_LIST /end DAQ_EVENT
 /end IF_DATA
/end MEASUREMENT
/begin MEASUREMENT Com_DFES_numDFC1 "Com_DFES_numDFC1" UBYTE OneToOne 1 100 0.00 255.0 FORMAT "%5.1" ECU_ADDRESS 0x40006361
 /begin IF_DATA XCPplus 0x0102
  /begin DAQ_EVENT VARIABLE /begin AVAILABLE_EVENT_LIST EVENT 0 EVENT 1 EVENT 2 EVENT 3 /end AVAILABLE_EVENT_LIST /begin DEFAULT_EVENT_LIST EVENT 1 /end DEFAULT_EVENT_LIST /end DAQ_EVENT
 /end IF_DATA
/end MEASUREMENT
/begin MEASUREMENT Com_DFES_numDFC2 "Com_DFES_numDFC2" UBYTE OneToOne 1 100 0.00 255.0 FORMAT "%5.1" ECU_ADDRESS 0x40006360
 /begin IF_DATA XCPplus 0x0102
  /begin DAQ_EVENT VARIABLE /begin AVAILABLE_EVENT_LIST EVENT 0 EVENT 1 EVENT 2 EVENT 3 /end AVAILABLE_EVENT_LIST /begin DEFAULT_EVENT_LIST EVENT 1 /end DEFAULT_EVENT_LIST /end DAQ_EVENT
 /end IF_DATA
/end MEASUREMENT
/begin MEASUREMENT Com_DFES_numDFC3 "Com_DFES_numDFC3" UBYTE OneToOne 1 100 0.00 255.0 FORMAT "%5.1" ECU_ADDRESS 0x4000635F
 /begin IF_DATA XCPplus 0x0102
  /begin DAQ_EVENT VARIABLE /begin AVAILABLE_EVENT_LIST EVENT 0 EVENT 1 EVENT 2 EVENT 3 /end AVAILABLE_EVENT_LIST /begin DEFAULT_EVENT_LIST EVENT 1 /end DEFAULT_EVENT_LIST /end DAQ_EVENT
 /end IF_DATA
/end MEASUREMENT
/begin MEASUREMENT Com_DFES_numDFC4 "Com_DFES_numDFC4" UBYTE OneToOne 1 100 0.00 255.0 FORMAT "%5.1" ECU_ADDRESS 0x4000635E
 /begin IF_DATA XCPplus 0x0102
  /begin DAQ_EVENT VARIABLE /begin AVAILABLE_EVENT_LIST EVENT 0 EVENT 1 EVENT 2 EVENT 3 /end AVAILABLE_EVENT_LIST /begin DEFAULT_EVENT_LIST EVENT 1 /end DEFAULT_EVENT_LIST /end DAQ_EVENT
 /end IF_DATA
/end MEASUREMENT
/begin MEASUREMENT Com_DFES_stChk "Com variable for Diag. fault status in frame EMS_3" UBYTE OneToOne 1 100 0.00 255.0 FORMAT "%5.1" ECU_ADDRESS 0x40008767
 /begin IF_DATA XCPplus 0x0102
  /begin DAQ_EVENT VARIABLE /begin AVAILABLE_EVENT_LIST EVENT 0 EVENT 1 EVENT 2 EVENT 3 /end AVAILABLE_EVENT_LIST /begin DEFAULT_EVENT_LIST EVENT 1 /end DEFAULT_EVENT_LIST /end DAQ_EVENT
 /end IF_DATA
/end MEASUREMENT
/begin MEASUREMENT Com_DFES_stChk0 "Com variable for error status[0]" UBYTE OneToOne 1 100 0.00 255.0 FORMAT "%5.1" ECU_ADDRESS 0x4000635D
 /begin IF_DATA XCPplus 0x0102
  /begin DAQ_EVENT VARIABLE /begin AVAILABLE_EVENT_LIST EVENT 0 EVENT 1 EVENT 2 EVENT 3 /end AVAILABLE_EVENT_LIST /begin DEFAULT_EVENT_LIST EVENT 1 /end DEFAULT_EVENT_LIST /end DAQ_EVENT
 /end IF_DATA
/end MEASUREMENT
/begin MEASUREMENT Com_DFES_stChk1 "Com variable for error status[1]" UBYTE OneToOne 1 100 0.00 255.0 FORMAT "%5.1" ECU_ADDRESS 0x4000635C
 /begin IF_DATA XCPplus 0x0102
  /begin DAQ_EVENT VARIABLE /begin AVAILABLE_EVENT_LIST EVENT 0 EVENT 1 EVENT 2 EVENT 3 /end AVAILABLE_EVENT_LIST /begin DEFAULT_EVENT_LIST EVENT 1 /end DEFAULT_EVENT_LIST /end DAQ_EVENT
 /end IF_DATA
/end MEASUREMENT
/begin MEASUREMENT Com_DFES_stChk2 "Com variable for error status[2]" UBYTE OneToOne 1 100 0.00 255.0 FORMAT "%5.1" ECU_ADDRESS 0x4000635B
 /begin IF_DATA XCPplus 0x0102
  /begin DAQ_EVENT VARIABLE /begin AVAILABLE_EVENT_LIST EVENT 0 EVENT 1 EVENT 2 EVENT 3 /end AVAILABLE_EVENT_LIST /begin DEFAULT_EVENT_LIST EVENT 1 /end DEFAULT_EVENT_LIST /end DAQ_EVENT
 /end IF_DATA
/end MEASUREMENT
/begin MEASUREMENT Com_DFES_stChk3 "Com variable for error status[3]" UBYTE OneToOne 1 100 0.00 255.0 FORMAT "%5.1" ECU_ADDRESS 0x4000635A
 /begin IF_DATA XCPplus 0x0102
  /begin DAQ_EVENT VARIABLE /begin AVAILABLE_EVENT_LIST EVENT 0 EVENT 1 EVENT 2 EVENT 3 /end AVAILABLE_EVENT_LIST /begin DEFAULT_EVENT_LIST EVENT 1 /end DEFAULT_EVENT_LIST /end DAQ_EVENT
 /end IF_DATA
/end MEASUREMENT
/begin MEASUREMENT Com_DFES_stChk4 "Com variable for error status[4]" UBYTE OneToOne 1 100 0.00 255.0 FORMAT "%5.1" ECU_ADDRESS 0x40006359
 /begin IF_DATA XCPplus 0x0102
  /begin DAQ_EVENT VARIABLE /begin AVAILABLE_EVENT_LIST EVENT 0 EVENT 1 EVENT 2 EVENT 3 /end AVAILABLE_EVENT_LIST /begin DEFAULT_EVENT_LIST EVENT 1 /end DEFAULT_EVENT_LIST /end DAQ_EVENT
 /end IF_DATA
/end MEASUREMENT
/begin MEASUREMENT Com_DIUMPR_ctGenDenom "Com variable for DIUMPR_ctGenDenom ; General denominator in frame EMS_13" UWORD OneToOne 1 100 0.00 65535.00 FORMAT "%8.2" ECU_ADDRESS 0x40008208
 /begin IF_DATA XCPplus 0x0102
  /begin DAQ_EVENT VARIABLE /begin AVAILABLE_EVENT_LIST EVENT 0 EVENT 1 EVENT 2 EVENT 3 /end AVAILABLE_EVENT_LIST /begin DEFAULT_EVENT_LIST EVENT 1 /end DEFAULT_EVENT_LIST /end DAQ_EVENT
 /end IF_DATA
/end MEASUREMENT
/begin MEASUREMENT Com_flgWhlSpdSeln "Speed selection flag for frame ABSInfo" UBYTE B_TRUE 1 100 0.00 1.00000000000 BIT_MASK 0x1 FORMAT "%13.11" ECU_ADDRESS 0x40008766
 /begin IF_DATA XCPplus 0x0102
  /begin DAQ_EVENT VARIABLE /begin AVAILABLE_EVENT_LIST EVENT 0 EVENT 1 EVENT 2 EVENT 3 /end AVAILABLE_EVENT_LIST /begin DEFAULT_EVENT_LIST EVENT 1 /end DEFAULT_EVENT_LIST /end DAQ_EVENT
 /end IF_DATA
/end MEASUREMENT
/begin MEASUREMENT Com_nFuelLevel "Fuel level received from cluster in terms of bar indication" UBYTE dez 1 100 0.00 255.0 FORMAT "%5.1" ECU_ADDRESS 0x4000630F /end MEASUREMENT
/begin MEASUREMENT Com_nGbxPos "Gear position received over CAN" UBYTE dez 1 100 0.00 255.0 FORMAT "%5.1" ECU_ADDRESS 0x4000630E /end MEASUREMENT
/begin MEASUREMENT Com_stgwhs "Com variable for Condition gear change on manual transmission vehicle" UBYTE B_TRUE 1 100 0.00 1.00000000000 BIT_MASK 0x1 FORMAT "%13.11" ECU_ADDRESS 0x40006353
 /begin IF_DATA XCPplus 0x0102
  /begin DAQ_EVENT VARIABLE /begin AVAILABLE_EVENT_LIST EVENT 0 EVENT 1 EVENT 2 EVENT 3 /end AVAILABLE_EVENT_LIST /begin DEFAULT_EVENT_LIST EVENT 1 /end DEFAULT_EVENT_LIST /end DAQ_EVENT
 /end IF_DATA
/end MEASUREMENT
/begin MEASUREMENT Com_stlf1s "Com variable for B_lf1s for the frame ABSInfo" UBYTE B_TRUE 1 100 0.00 1.00000000000 BIT_MASK 0x1 FORMAT "%13.11" ECU_ADDRESS 0x40008765
 /begin IF_DATA XCPplus 0x0102
  /begin DAQ_EVENT VARIABLE /begin AVAILABLE_EVENT_LIST EVENT 0 EVENT 1 EVENT 2 EVENT 3 /end AVAILABLE_EVENT_LIST /begin DEFAULT_EVENT_LIST EVENT 1 /end DEFAULT_EVENT_LIST /end DAQ_EVENT
 /end IF_DATA
/end MEASUREMENT
/begin MEASUREMENT Com_stllri "Com variable for Condition activation of I-part of idle speed control" UBYTE B_TRUE 1 100 0.00 1.00000000000 BIT_MASK 0x1 FORMAT "%13.11" ECU_ADDRESS 0x40006352
 /begin IF_DATA XCPplus 0x0102
  /begin DAQ_EVENT VARIABLE /begin AVAILABLE_EVENT_LIST EVENT 0 EVENT 1 EVENT 2 EVENT 3 /end AVAILABLE_EVENT_LIST /begin DEFAULT_EVENT_LIST EVENT 1 /end DEFAULT_EVENT_LIST /end DAQ_EVENT
 /end IF_DATA
/end MEASUREMENT
/begin MEASUREMENT Com_stmaxlatp "Com variable for B_maxlatp ; Cond. for fault type (max. value) for cycle durat.upstr. cat detect.dyn bank2 in frame EMS_13" UBYTE B_TRUE 1 100 0.00 1.00000000000 BIT_MASK 0x1 FORMAT "%13.11" ECU_ADDRESS 0x40008764
 /begin IF_DATA XCPplus 0x0102
  /begin DAQ_EVENT VARIABLE /begin AVAILABLE_EVENT_LIST EVENT 0 EVENT 1 EVENT 2 EVENT 3 /end AVAILABLE_EVENT_LIST /begin DEFAULT_EVENT_LIST EVENT 1 /end DEFAULT_EVENT_LIST /end DAQ_EVENT
 /end IF_DATA
/end MEASUREMENT
/begin MEASUREMENT Com_stOvHEngShDwn "Com variable for B_OvHEngShDwn (Engine shutdown active) in frame EMS_13" UBYTE B_TRUE 1 100 0.00 1.00000000000 BIT_MASK 0x1 FORMAT "%13.11" ECU_ADDRESS 0x40008763
 /begin IF_DATA XCPplus 0x0102
  /begin DAQ_EVENT VARIABLE /begin AVAILABLE_EVENT_LIST EVENT 0 EVENT 1 EVENT 2 EVENT 3 /end AVAILABLE_EVENT_LIST /begin DEFAULT_EVENT_LIST EVENT 1 /end DEFAULT_EVENT_LIST /end DAQ_EVENT
 /end IF_DATA
/end MEASUREMENT
/begin MEASUREMENT Com_stOvHEngSpdLimr "Com variable for B_OvHEngSpdLimr in frame EMS_4" UBYTE B_TRUE 1 100 0.00 1.00000000000 BIT_MASK 0x1 FORMAT "%13.11" ECU_ADDRESS 0x40008762
 /begin IF_DATA XCPplus 0x0102
  /begin DAQ_EVENT VARIABLE /begin AVAILABLE_EVENT_LIST EVENT 0 EVENT 1 EVENT 2 EVENT 3 /end AVAILABLE_EVENT_LIST /begin DEFAULT_EVENT_LIST EVENT 1 /end DEFAULT_EVENT_LIST /end DAQ_EVENT
 /end IF_DATA
/end MEASUREMENT
/begin MEASUREMENT Com_stte "Com variable for B_te for frame ABSInfo" UBYTE B_TRUE 1 100 0.00 1.00000000000 BIT_MASK 0x1 FORMAT "%13.11" ECU_ADDRESS 0x40008761
 /begin IF_DATA XCPplus 0x0102
  /begin DAQ_EVENT VARIABLE /begin AVAILABLE_EVENT_LIST EVENT 0 EVENT 1 EVENT 2 EVENT 3 /end AVAILABLE_EVENT_LIST /begin DEFAULT_EVENT_LIST EVENT 1 /end DEFAULT_EVENT_LIST /end DAQ_EVENT
 /end IF_DATA
/end MEASUREMENT
/begin MEASUREMENT Com_stWhlSpdInvld "Speed validity bit for selection of rear and front wheel for frame ABSInfo" UBYTE B_TRUE 1 100 0.00 1.00000000000 BIT_MASK 0x1 FORMAT "%13.11" ECU_ADDRESS 0x4000876C
 /begin IF_DATA XCPplus 0x0102
  /begin DAQ_EVENT VARIABLE /begin AVAILABLE_EVENT_LIST EVENT 0 EVENT 1 EVENT 2 EVENT 3 /end AVAILABLE_EVENT_LIST /begin DEFAULT_EVENT_LIST EVENT 1 /end DEFAULT_EVENT_LIST /end DAQ_EVENT
 /end IF_DATA
/end MEASUREMENT
/begin MEASUREMENT Com_vfzg_w "vehicle speed" UWORD vfzg_uw_b512 1 100 0.00 511.9922 FORMAT "%8.4" ECU_ADDRESS 0x40005D8E
 /begin IF_DATA XCPplus 0x0102
  /begin DAQ_EVENT VARIABLE /begin AVAILABLE_EVENT_LIST EVENT 0 EVENT 1 EVENT 2 EVENT 3 /end AVAILABLE_EVENT_LIST /begin DEFAULT_EVENT_LIST EVENT 1 /end DEFAULT_EVENT_LIST /end DAQ_EVENT
 /end IF_DATA
/end MEASUREMENT
/begin MEASUREMENT Com_vsksml_w "com intefacf for EMS_13 Fuel consumption signal" UWORD q1p22Em3_ml_DIV_s 1 100 0.00 79.99878 FORMAT "%8.5" ECU_ADDRESS 0x40005D7A
 /begin IF_DATA XCPplus 0x0102
  /begin DAQ_EVENT VARIABLE /begin AVAILABLE_EVENT_LIST EVENT 0 EVENT 1 EVENT 2 EVENT 3 /end AVAILABLE_EVENT_LIST /begin DEFAULT_EVENT_LIST EVENT 1 /end DEFAULT_EVENT_LIST /end DAQ_EVENT
 /end IF_DATA
/end MEASUREMENT
/begin MEASUREMENT Com_vVehWhlSpdABS "Wheel Speed information from ABS (kmph)" UWORD vfzg_uw_b512 1 100 0.00 511.9922 FORMAT "%8.4" ECU_ADDRESS 0x40008206
 /begin IF_DATA XCPplus 0x0102
  /begin DAQ_EVENT VARIABLE /begin AVAILABLE_EVENT_LIST EVENT 0 EVENT 1 EVENT 2 EVENT 3 /end AVAILABLE_EVENT_LIST /begin DEFAULT_EVENT_LIST EVENT 1 /end DEFAULT_EVENT_LIST /end DAQ_EVENT
 /end IF_DATA
/end MEASUREMENT
/begin MEASUREMENT DSM_bExtMILOnRequ "DSM internal variable to store the copy of the active external MIL request" UBYTE OneToOne 1 100 0.00 255.0 FORMAT "%5.1" ECU_ADDRESS 0x400062FC /end MEASUREMENT
/begin MEASUREMENT DSM_bInstableStatus "DSM internal variable to store the copy of the unstable operation mode (provided by DSM configuration)" UBYTE OneToOne 1 100 0.00 255.0 BIT_MASK 0x1 FORMAT "%5.1" ECU_ADDRESS 0x400062F9 /end MEASUREMENT
/begin MEASUREMENT DSM_bStFuncTst "DSM internal variable to store the copy of the function test requested (provided by DSM configuration)" UBYTE OneToOne 1 100 0.00 255.0 FORMAT "%5.1" ECU_ADDRESS 0x400062FB /end MEASUREMENT
/begin MEASUREMENT DSM_CoEngtiNormalOBD "DSM internal variable to store the copy of the Engine running time - for OBD requirement" ULONG OneToOne 1 100 0.00 4294967295.00 FORMAT "%13.2" ECU_ADDRESS 0x400047D0 /end MEASUREMENT
/begin MEASUREMENT DSM_DisblMode_mp "Actual disable mode to prevent error memory entries (provided by DSM configuration)" UWORD OneToOne 1 100 0.00 65535.00 FORMAT "%8.2" ECU_ADDRESS 0x40009DD0 /end MEASUREMENT
/begin MEASUREMENT DSM_ECUId "DSM internal variable to store the copy of the ECU identifier (e.g. masterslave systems), provided by DSM configuration" UBYTE OneToOne 1 100 0.00 255.0 FORMAT "%5.1" ECU_ADDRESS 0x400062F8 /end MEASUREMENT
/begin MEASUREMENT DSM_lDst "DSM internal variable to store the copy of the driven distance (provided by DSM configuration)" SLONG OneToOne 1 100 -2147483648.00 2147483647.00 FORMAT "%13.2" ECU_ADDRESS 0x400047CC /end MEASUREMENT
/begin MEASUREMENT DSM_pEnv "DSM internal variable to store the copy of the Environment pressure" SWORD Pres_hPa 1 100 -32768.00 32767.00 FORMAT "%8.2" ECU_ADDRESS 0x40005D26 /end MEASUREMENT
/begin MEASUREMENT DSM_rAPP "DSM internal variable to store the copy of the Standardized accelerator pedal position" SWORD Prc 1 100 -400.0000 399.9878 FORMAT "%8.4" ECU_ADDRESS 0x40005D2A /end MEASUREMENT
/begin MEASUREMENT DSM_stCoPrmsOpMode "DSM internal variable to store the copy of the permissible operation modes (provided by DSM configuration)" UWORD OneToOne 1 100 0.00 65535.00 FORMAT "%8.2" ECU_ADDRESS 0x40005D2C /end MEASUREMENT
/begin MEASUREMENT DSM_stStrEnd "OBD Ready for Driving status" UBYTE OneToOne 1 100 0.00 255.0 BIT_MASK 0x1 FORMAT "%5.1" ECU_ADDRESS 0x400062FA /end MEASUREMENT
/begin MEASUREMENT DSM_stWiggle_mp "wiggle test requested by ext. tester (provided by DSM configuration)" UBYTE OneToOne 1 100 0.00 255.0 FORMAT "%5.1" ECU_ADDRESS 0x40009E35 /end MEASUREMENT
/begin MEASUREMENT DSM_tEngDS "DSM internal variable to store the copy of the Coolant temperature at engine output" SWORD Temp_Cels 1 100 -3549.940 3003.560 FORMAT "%8.3" ECU_ADDRESS 0x40005D22 /end MEASUREMENT
/begin MEASUREMENT DSM_tEnv "DSM internal variable to store the copy of the Temperature of environment air" SWORD Temp_Cels 1 100 -3549.940 3003.560 FORMAT "%8.3" ECU_ADDRESS 0x40005D24 /end MEASUREMENT
/begin MEASUREMENT DSM_vVeh "DSM internal variable to store the copy of the Vehicle speed" SWORD Vel 1 100 -327.6800 327.6700 FORMAT "%8.4" ECU_ADDRESS 0x40005D28 /end MEASUREMENT
/begin MEASUREMENT dte_w "difference te (word-size)" UWORD OneToOne 1 100 0.00 65535.00 FORMAT "%8.2" ECU_ADDRESS 0x4000820E /end MEASUREMENT
/begin MEASUREMENT DTR_valLoLim.DTR_Dummy "lower limits (Mode06) / lower limit of diagnostic test result DTR_Dummy" UWORD DFC_OneToOne 1 100 0.00 65535.00 FORMAT "%8.2" ECU_ADDRESS 0x4000CCA8 /end MEASUREMENT
/begin MEASUREMENT DTR_valLoLim.DTR_OBDMID_01_TID_LATP "lower limits (Mode06) / lower limit of diagnostic test result DTR_OBDMID_01_TID_LATP" UWORD DFC_OneToOne 1 100 0.00 65535.00 FORMAT "%8.2" ECU_ADDRESS 0x4000CCAA /end MEASUREMENT
/begin MEASUREMENT DTR_valLoLim.DTR_OBDMID_01_TID_OFFST "lower limits (Mode06) / lower limit of diagnostic test result DTR_OBDMID_01_TID_OFFST" UWORD DFC_OneToOne 1 100 0.00 65535.00 FORMAT "%8.2" ECU_ADDRESS 0x4000CCAC /end MEASUREMENT
/begin MEASUREMENT DTR_valLoLim.DTR_OBDMID_02_TID_OSCLO "lower limits (Mode06) / lower limit of diagnostic test result DTR_OBDMID_02_TID_OSCLO" UWORD DFC_OneToOne 1 100 0.00 65535.00 FORMAT "%8.2" ECU_ADDRESS 0x4000CCAE /end MEASUREMENT
/begin MEASUREMENT DTR_valLoLim.DTR_OBDMID_02_TID_OSCUP "lower limits (Mode06) / lower limit of diagnostic test result DTR_OBDMID_02_TID_OSCUP" UWORD DFC_OneToOne 1 100 0.00 65535.00 FORMAT "%8.2" ECU_ADDRESS 0x4000CCB0 /end MEASUREMENT
/begin MEASUREMENT DTR_valLoLim.DTR_OBDMID_02_TID_OVRRN "lower limits (Mode06) / lower limit of diagnostic test result DTR_OBDMID_02_TID_OVRRN" UWORD DFC_OneToOne 1 100 0.00 65535.00 FORMAT "%8.2" ECU_ADDRESS 0x4000CCB2 /end MEASUREMENT
/begin MEASUREMENT DTR_valLoLim.DTR_OBDMID_21_TID_AMPL "lower limits (Mode06) / lower limit of diagnostic test result DTR_OBDMID_21_TID_AMPL" UWORD DFC_OneToOne 1 100 0.00 65535.00 FORMAT "%8.2" ECU_ADDRESS 0x4000CCB4 /end MEASUREMENT
/begin MEASUREMENT DTR_valLoLim.DTR_OBDMID_41_TID_HTR "lower limits (Mode06) / lower limit of diagnostic test result DTR_OBDMID_41_TID_HTR" UWORD DFC_OneToOne 1 100 0.00 65535.00 FORMAT "%8.2" ECU_ADDRESS 0x4000CCB6 /end MEASUREMENT
/begin MEASUREMENT DTR_valLoLim.DTR_OBDMID_42_TID_HTR "lower limits (Mode06) / lower limit of diagnostic test result DTR_OBDMID_42_TID_HTR" UWORD DFC_OneToOne 1 100 0.00 65535.00 FORMAT "%8.2" ECU_ADDRESS 0x4000CCB8 /end MEASUREMENT
/begin MEASUREMENT DTR_valLoLim.DTR_OBDMID_a2_TID_0b "lower limits (Mode06) / lower limit of diagnostic test result DTR_OBDMID_a2_TID_0b" UWORD DFC_OneToOne 1 100 0.00 65535.00 FORMAT "%8.2" ECU_ADDRESS 0x4000CCBA /end MEASUREMENT
/begin MEASUREMENT DTR_valLoLim.DTR_OBDMID_a2_TID_0c "lower limits (Mode06) / lower limit of diagnostic test result DTR_OBDMID_a2_TID_0c" UWORD DFC_OneToOne 1 100 0.00 65535.00 FORMAT "%8.2" ECU_ADDRESS 0x4000CCBC /end MEASUREMENT
/begin MEASUREMENT DTR_valLoLim.DTR_TID_01_SEN_01 "lower limits (Mode06) / lower limit of diagnostic test result DTR_TID_01_SEN_01" UWORD DFC_OneToOne 1 100 0.00 65535.00 FORMAT "%8.2" ECU_ADDRESS 0x4000CCBE /end MEASUREMENT
/begin MEASUREMENT DTR_valLoLim.DTR_TID_01_SEN_02 "lower limits (Mode06) / lower limit of diagnostic test result DTR_TID_01_SEN_02" UWORD DFC_OneToOne 1 100 0.00 65535.00 FORMAT "%8.2" ECU_ADDRESS 0x4000CCC0 /end MEASUREMENT
/begin MEASUREMENT DTR_valLoLim.DTR_TID_02_SEN_01 "lower limits (Mode06) / lower limit of diagnostic test result DTR_TID_02_SEN_01" UWORD DFC_OneToOne 1 100 0.00 65535.00 FORMAT "%8.2" ECU_ADDRESS 0x4000CCC2 /end MEASUREMENT
/begin MEASUREMENT DTR_valLoLim.DTR_TID_02_SEN_02 "lower limits (Mode06) / lower limit of diagnostic test result DTR_TID_02_SEN_02" UWORD DFC_OneToOne 1 100 0.00 65535.00 FORMAT "%8.2" ECU_ADDRESS 0x4000CCC4 /end MEASUREMENT
/begin MEASUREMENT DTR_valLoLim.DTR_TID_07_SEN_01 "lower limits (Mode06) / lower limit of diagnostic test result DTR_TID_07_SEN_01" UWORD DFC_OneToOne 1 100 0.00 65535.00 FORMAT "%8.2" ECU_ADDRESS 0x4000CCC6 /end MEASUREMENT
/begin MEASUREMENT DTR_valLoLim.DTR_TID_07_SEN_02 "lower limits (Mode06) / lower limit of diagnostic test result DTR_TID_07_SEN_02" UWORD DFC_OneToOne 1 100 0.00 65535.00 FORMAT "%8.2" ECU_ADDRESS 0x4000CCC8 /end MEASUREMENT
/begin MEASUREMENT DTR_valLoLim.DTR_TID_08_SEN_01 "lower limits (Mode06) / lower limit of diagnostic test result DTR_TID_08_SEN_01" UWORD DFC_OneToOne 1 100 0.00 65535.00 FORMAT "%8.2" ECU_ADDRESS 0x4000CCCA /end MEASUREMENT
/begin MEASUREMENT DTR_valLoLim.DTR_TID_08_SEN_02 "lower limits (Mode06) / lower limit of diagnostic test result DTR_TID_08_SEN_02" UWORD DFC_OneToOne 1 100 0.00 65535.00 FORMAT "%8.2" ECU_ADDRESS 0x4000CCCC /end MEASUREMENT
/begin MEASUREMENT DTR_valLoLim.DTR_TID_09_SEN_01 "lower limits (Mode06) / lower limit of diagnostic test result DTR_TID_09_SEN_01" UWORD DFC_OneToOne 1 100 0.00 65535.00 FORMAT "%8.2" ECU_ADDRESS 0x4000CCCE /end MEASUREMENT
/begin MEASUREMENT DTR_valLoLim.DTR_TID_0A_SEN_01 "lower limits (Mode06) / lower limit of diagnostic test result DTR_TID_0A_SEN_01" UWORD DFC_OneToOne 1 100 0.00 65535.00 FORMAT "%8.2" ECU_ADDRESS 0x4000CCD0 /end MEASUREMENT
/begin MEASUREMENT DTR_valTst.DTR_Dummy "last test value (Mode06) / last test result of DTR_Dummy" UWORD DFC_OneToOne 1 100 0.00 65535.00 FORMAT "%8.2" ECU_ADDRESS 0x4000CCFC /end MEASUREMENT
/begin MEASUREMENT DTR_valTst.DTR_OBDMID_01_TID_LATP "last test value (Mode06) / last test result of DTR_OBDMID_01_TID_LATP" UWORD DFC_OneToOne 1 100 0.00 65535.00 FORMAT "%8.2" ECU_ADDRESS 0x4000CCFE /end MEASUREMENT
/begin MEASUREMENT DTR_valTst.DTR_OBDMID_01_TID_OFFST "last test value (Mode06) / last test result of DTR_OBDMID_01_TID_OFFST" UWORD DFC_OneToOne 1 100 0.00 65535.00 FORMAT "%8.2" ECU_ADDRESS 0x4000CD00 /end MEASUREMENT
/begin MEASUREMENT DTR_valTst.DTR_OBDMID_02_TID_OSCLO "last test value (Mode06) / last test result of DTR_OBDMID_02_TID_OSCLO" UWORD DFC_OneToOne 1 100 0.00 65535.00 FORMAT "%8.2" ECU_ADDRESS 0x4000CD02 /end MEASUREMENT
/begin MEASUREMENT DTR_valTst.DTR_OBDMID_02_TID_OSCUP "last test value (Mode06) / last test result of DTR_OBDMID_02_TID_OSCUP" UWORD DFC_OneToOne 1 100 0.00 65535.00 FORMAT "%8.2" ECU_ADDRESS 0x4000CD04 /end MEASUREMENT
/begin MEASUREMENT DTR_valTst.DTR_OBDMID_02_TID_OVRRN "last test value (Mode06) / last test result of DTR_OBDMID_02_TID_OVRRN" UWORD DFC_OneToOne 1 100 0.00 65535.00 FORMAT "%8.2" ECU_ADDRESS 0x4000CD06 /end MEASUREMENT
/begin MEASUREMENT DTR_valTst.DTR_OBDMID_21_TID_AMPL "last test value (Mode06) / last test result of DTR_OBDMID_21_TID_AMPL" UWORD DFC_OneToOne 1 100 0.00 65535.00 FORMAT "%8.2" ECU_ADDRESS 0x4000CD08 /end MEASUREMENT
/begin MEASUREMENT DTR_valTst.DTR_OBDMID_41_TID_HTR "last test value (Mode06) / last test result of DTR_OBDMID_41_TID_HTR" UWORD DFC_OneToOne 1 100 0.00 65535.00 FORMAT "%8.2" ECU_ADDRESS 0x4000CD0A /end MEASUREMENT
/begin MEASUREMENT DTR_valTst.DTR_OBDMID_42_TID_HTR "last test value (Mode06) / last test result of DTR_OBDMID_42_TID_HTR" UWORD DFC_OneToOne 1 100 0.00 65535.00 FORMAT "%8.2" ECU_ADDRESS 0x4000CD0C /end MEASUREMENT
/begin MEASUREMENT DTR_valTst.DTR_OBDMID_a2_TID_0b "last test value (Mode06) / last test result of DTR_OBDMID_a2_TID_0b" UWORD DFC_OneToOne 1 100 0.00 65535.00 FORMAT "%8.2" ECU_ADDRESS 0x4000CD0E /end MEASUREMENT
/begin MEASUREMENT DTR_valTst.DTR_OBDMID_a2_TID_0c "last test value (Mode06) / last test result of DTR_OBDMID_a2_TID_0c" UWORD DFC_OneToOne 1 100 0.00 65535.00 FORMAT "%8.2" ECU_ADDRESS 0x4000CD10 /end MEASUREMENT
/begin MEASUREMENT DTR_valTst.DTR_TID_01_SEN_01 "last test value (Mode06) / last test result of DTR_TID_01_SEN_01" UWORD DFC_OneToOne 1 100 0.00 65535.00 FORMAT "%8.2" ECU_ADDRESS 0x4000CD12 /end MEASUREMENT
/begin MEASUREMENT DTR_valTst.DTR_TID_01_SEN_02 "last test value (Mode06) / last test result of DTR_TID_01_SEN_02" UWORD DFC_OneToOne 1 100 0.00 65535.00 FORMAT "%8.2" ECU_ADDRESS 0x4000CD14 /end MEASUREMENT
/begin MEASUREMENT DTR_valTst.DTR_TID_02_SEN_01 "last test value (Mode06) / last test result of DTR_TID_02_SEN_01" UWORD DFC_OneToOne 1 100 0.00 65535.00 FORMAT "%8.2" ECU_ADDRESS 0x4000CD16 /end MEASUREMENT
/begin MEASUREMENT DTR_valTst.DTR_TID_02_SEN_02 "last test value (Mode06) / last test result of DTR_TID_02_SEN_02" UWORD DFC_OneToOne 1 100 0.00 65535.00 FORMAT "%8.2" ECU_ADDRESS 0x4000CD18 /end MEASUREMENT
/begin MEASUREMENT DTR_valTst.DTR_TID_07_SEN_01 "last test value (Mode06) / last test result of DTR_TID_07_SEN_01" UWORD DFC_OneToOne 1 100 0.00 65535.00 FORMAT "%8.2" ECU_ADDRESS 0x4000CD1A /end MEASUREMENT
/begin MEASUREMENT DTR_valTst.DTR_TID_07_SEN_02 "last test value (Mode06) / last test result of DTR_TID_07_SEN_02" UWORD DFC_OneToOne 1 100 0.00 65535.00 FORMAT "%8.2" ECU_ADDRESS 0x4000CD1C /end MEASUREMENT
/begin MEASUREMENT DTR_valTst.DTR_TID_08_SEN_01 "last test value (Mode06) / last test result of DTR_TID_08_SEN_01" UWORD DFC_OneToOne 1 100 0.00 65535.00 FORMAT "%8.2" ECU_ADDRESS 0x4000CD1E /end MEASUREMENT
/begin MEASUREMENT DTR_valTst.DTR_TID_08_SEN_02 "last test value (Mode06) / last test result of DTR_TID_08_SEN_02" UWORD DFC_OneToOne 1 100 0.00 65535.00 FORMAT "%8.2" ECU_ADDRESS 0x4000CD20 /end MEASUREMENT
/begin MEASUREMENT DTR_valTst.DTR_TID_09_SEN_01 "last test value (Mode06) / last test result of DTR_TID_09_SEN_01" UWORD DFC_OneToOne 1 100 0.00 65535.00 FORMAT "%8.2" ECU_ADDRESS 0x4000CD22 /end MEASUREMENT
/begin MEASUREMENT DTR_valTst.DTR_TID_0A_SEN_01 "last test value (Mode06) / last test result of DTR_TID_0A_SEN_01" UWORD DFC_OneToOne 1 100 0.00 65535.00 FORMAT "%8.2" ECU_ADDRESS 0x4000CD24 /end MEASUREMENT
/begin MEASUREMENT DTR_valUpLim.DTR_Dummy "upper limits (Mode06) / upper limit of diagnostic test result DTR_Dummy" UWORD DFC_OneToOne 1 100 0.00 65535.00 FORMAT "%8.2" ECU_ADDRESS 0x4000CCD2 /end MEASUREMENT
/begin MEASUREMENT DTR_valUpLim.DTR_OBDMID_01_TID_LATP "upper limits (Mode06) / upper limit of diagnostic test result DTR_OBDMID_01_TID_LATP" UWORD DFC_OneToOne 1 100 0.00 65535.00 FORMAT "%8.2" ECU_ADDRESS 0x4000CCD4 /end MEASUREMENT
/begin MEASUREMENT DTR_valUpLim.DTR_OBDMID_01_TID_OFFST "upper limits (Mode06) / upper limit of diagnostic test result DTR_OBDMID_01_TID_OFFST" UWORD DFC_OneToOne 1 100 0.00 65535.00 FORMAT "%8.2" ECU_ADDRESS 0x4000CCD6 /end MEASUREMENT
/begin MEASUREMENT DTR_valUpLim.DTR_OBDMID_02_TID_OSCLO "upper limits (Mode06) / upper limit of diagnostic test result DTR_OBDMID_02_TID_OSCLO" UWORD DFC_OneToOne 1 100 0.00 65535.00 FORMAT "%8.2" ECU_ADDRESS 0x4000CCD8 /end MEASUREMENT
/begin MEASUREMENT DTR_valUpLim.DTR_OBDMID_02_TID_OSCUP "upper limits (Mode06) / upper limit of diagnostic test result DTR_OBDMID_02_TID_OSCUP" UWORD DFC_OneToOne 1 100 0.00 65535.00 FORMAT "%8.2" ECU_ADDRESS 0x4000CCDA /end MEASUREMENT
/begin MEASUREMENT DTR_valUpLim.DTR_OBDMID_02_TID_OVRRN "upper limits (Mode06) / upper limit of diagnostic test result DTR_OBDMID_02_TID_OVRRN" UWORD DFC_OneToOne 1 100 0.00 65535.00 FORMAT "%8.2" ECU_ADDRESS 0x4000CCDC /end MEASUREMENT
/begin MEASUREMENT DTR_valUpLim.DTR_OBDMID_21_TID_AMPL "upper limits (Mode06) / upper limit of diagnostic test result DTR_OBDMID_21_TID_AMPL" UWORD DFC_OneToOne 1 100 0.00 65535.00 FORMAT "%8.2" ECU_ADDRESS 0x4000CCDE /end MEASUREMENT
/begin MEASUREMENT DTR_valUpLim.DTR_OBDMID_41_TID_HTR "upper limits (Mode06) / upper limit of diagnostic test result DTR_OBDMID_41_TID_HTR" UWORD DFC_OneToOne 1 100 0.00 65535.00 FORMAT "%8.2" ECU_ADDRESS 0x4000CCE0 /end MEASUREMENT
/begin MEASUREMENT DTR_valUpLim.DTR_OBDMID_42_TID_HTR "upper limits (Mode06) / upper limit of diagnostic test result DTR_OBDMID_42_TID_HTR" UWORD DFC_OneToOne 1 100 0.00 65535.00 FORMAT "%8.2" ECU_ADDRESS 0x4000CCE2 /end MEASUREMENT
/begin MEASUREMENT DTR_valUpLim.DTR_OBDMID_a2_TID_0b "upper limits (Mode06) / upper limit of diagnostic test result DTR_OBDMID_a2_TID_0b" UWORD DFC_OneToOne 1 100 0.00 65535.00 FORMAT "%8.2" ECU_ADDRESS 0x4000CCE4 /end MEASUREMENT
/begin MEASUREMENT DTR_valUpLim.DTR_OBDMID_a2_TID_0c "upper limits (Mode06) / upper limit of diagnostic test result DTR_OBDMID_a2_TID_0c" UWORD DFC_OneToOne 1 100 0.00 65535.00 FORMAT "%8.2" ECU_ADDRESS 0x4000CCE6 /end MEASUREMENT
/begin MEASUREMENT DTR_valUpLim.DTR_TID_01_SEN_01 "upper limits (Mode06) / upper limit of diagnostic test result DTR_TID_01_SEN_01" UWORD DFC_OneToOne 1 100 0.00 65535.00 FORMAT "%8.2" ECU_ADDRESS 0x4000CCE8 /end MEASUREMENT
/begin MEASUREMENT DTR_valUpLim.DTR_TID_01_SEN_02 "upper limits (Mode06) / upper limit of diagnostic test result DTR_TID_01_SEN_02" UWORD DFC_OneToOne 1 100 0.00 65535.00 FORMAT "%8.2" ECU_ADDRESS 0x4000CCEA /end MEASUREMENT
/begin MEASUREMENT DTR_valUpLim.DTR_TID_02_SEN_01 "upper limits (Mode06) / upper limit of diagnostic test result DTR_TID_02_SEN_01" UWORD DFC_OneToOne 1 100 0.00 65535.00 FORMAT "%8.2" ECU_ADDRESS 0x4000CCEC /end MEASUREMENT
/begin MEASUREMENT DTR_valUpLim.DTR_TID_02_SEN_02 "upper limits (Mode06) / upper limit of diagnostic test result DTR_TID_02_SEN_02" UWORD DFC_OneToOne 1 100 0.00 65535.00 FORMAT "%8.2" ECU_ADDRESS 0x4000CCEE /end MEASUREMENT
/begin MEASUREMENT DTR_valUpLim.DTR_TID_07_SEN_01 "upper limits (Mode06) / upper limit of diagnostic test result DTR_TID_07_SEN_01" UWORD DFC_OneToOne 1 100 0.00 65535.00 FORMAT "%8.2" ECU_ADDRESS 0x4000CCF0 /end MEASUREMENT
/begin MEASUREMENT DTR_valUpLim.DTR_TID_07_SEN_02 "upper limits (Mode06) / upper limit of diagnostic test result DTR_TID_07_SEN_02" UWORD DFC_OneToOne 1 100 0.00 65535.00 FORMAT "%8.2" ECU_ADDRESS 0x4000CCF2 /end MEASUREMENT
/begin MEASUREMENT DTR_valUpLim.DTR_TID_08_SEN_01 "upper limits (Mode06) / upper limit of diagnostic test result DTR_TID_08_SEN_01" UWORD DFC_OneToOne 1 100 0.00 65535.00 FORMAT "%8.2" ECU_ADDRESS 0x4000CCF4 /end MEASUREMENT
/begin MEASUREMENT DTR_valUpLim.DTR_TID_08_SEN_02 "upper limits (Mode06) / upper limit of diagnostic test result DTR_TID_08_SEN_02" UWORD DFC_OneToOne 1 100 0.00 65535.00 FORMAT "%8.2" ECU_ADDRESS 0x4000CCF6 /end MEASUREMENT
/begin MEASUREMENT DTR_valUpLim.DTR_TID_09_SEN_01 "upper limits (Mode06) / upper limit of diagnostic test result DTR_TID_09_SEN_01" UWORD DFC_OneToOne 1 100 0.00 65535.00 FORMAT "%8.2" ECU_ADDRESS 0x4000CCF8 /end MEASUREMENT
/begin MEASUREMENT DTR_valUpLim.DTR_TID_0A_SEN_01 "upper limits (Mode06) / upper limit of diagnostic test result DTR_TID_0A_SEN_01" UWORD DFC_OneToOne 1 100 0.00 65535.00 FORMAT "%8.2" ECU_ADDRESS 0x4000CCFA /end MEASUREMENT
/begin MEASUREMENT EngDa_tEng "Engine temperature" SWORD Temp_Cels 1 100 -3549.940 3003.560 FORMAT "%8.3" ECU_ADDRESS 0x40008F7A
 /begin IF_DATA XCPplus 0x0102
  /begin DAQ_EVENT VARIABLE /begin AVAILABLE_EVENT_LIST EVENT 0 EVENT 1 EVENT 2 EVENT 3 /end AVAILABLE_EVENT_LIST /begin DEFAULT_EVENT_LIST EVENT 2 /end DEFAULT_EVENT_LIST /end DAQ_EVENT
 /end IF_DATA
/end MEASUREMENT
/begin MEASUREMENT EngDa_tStop "Engine temperature at engine stop" SWORD Temp_Cels 1 100 -3549.940 3003.560 FORMAT "%8.3" ECU_ADDRESS 0x4000CDD8
 /begin IF_DATA XCPplus 0x0102
  /begin DAQ_EVENT VARIABLE /begin AVAILABLE_EVENT_LIST EVENT 0 EVENT 1 EVENT 2 EVENT 3 /end AVAILABLE_EVENT_LIST /begin DEFAULT_EVENT_LIST EVENT 2 /end DEFAULT_EVENT_LIST /end DAQ_EVENT
 /end IF_DATA
/end MEASUREMENT
/begin MEASUREMENT EngDa_tStrt "Engine starting temperature" SWORD Temp_Cels 1 100 -3549.940 3003.560 FORMAT "%8.3" ECU_ADDRESS 0x40008F78
 /begin IF_DATA XCPplus 0x0102
  /begin DAQ_EVENT VARIABLE /begin AVAILABLE_EVENT_LIST EVENT 0 EVENT 1 EVENT 2 EVENT 3 /end AVAILABLE_EVENT_LIST /begin DEFAULT_EVENT_LIST EVENT 2 /end DEFAULT_EVENT_LIST /end DAQ_EVENT
 /end IF_DATA
/end MEASUREMENT
/begin MEASUREMENT EpmCrS_agIntOld "Position of previous interrupt occurance (Internal variable used for revolution counter module)" SWORD AngleCrS 1 100 -720.0000 719.9780 FORMAT "%8.4" ECU_ADDRESS 0x40005C6E
 /begin IF_DATA XCPplus 0x0102
  /begin DAQ_EVENT VARIABLE /begin AVAILABLE_EVENT_LIST EVENT 0 EVENT 1 EVENT 2 EVENT 3 /end AVAILABLE_EVENT_LIST /begin DEFAULT_EVENT_LIST EVENT 0 /end DEFAULT_EVENT_LIST /end DAQ_EVENT
 /end IF_DATA
/end MEASUREMENT
/begin MEASUREMENT EpmCrS_bCrSDiagflgClr "Request of FCM-clear for DFC_EpmCrS" UBYTE OneToOne 1 100 0.00 255.0 FORMAT "%5.1" ECU_ADDRESS 0x400062D5
 /begin IF_DATA XCPplus 0x0102
  /begin DAQ_EVENT VARIABLE /begin AVAILABLE_EVENT_LIST EVENT 0 EVENT 1 EVENT 2 EVENT 3 /end AVAILABLE_EVENT_LIST /begin DEFAULT_EVENT_LIST EVENT 2 /end DEFAULT_EVENT_LIST /end DAQ_EVENT
 /end IF_DATA
/end MEASUREMENT
/begin MEASUREMENT EpmCrS_bDisturb "Condition that a signal disturbance has occured" UBYTE OneToOne 1 100 0.00 255.0 FORMAT "%5.1" ECU_ADDRESS 0x400062D4
 /begin IF_DATA XCPplus 0x0102
  /begin DAQ_EVENT VARIABLE /begin AVAILABLE_EVENT_LIST EVENT 0 EVENT 1 EVENT 2 EVENT 3 /end AVAILABLE_EVENT_LIST /begin DEFAULT_EVENT_LIST EVENT 2 /end DEFAULT_EVENT_LIST /end DAQ_EVENT
 /end IF_DATA
/end MEASUREMENT
/begin MEASUREMENT EpmCrS_cntrDebMnfldPPat "Counter incremented every time an intake stroke is detected" UBYTE OneToOne 1 100 0.00 255.0 FORMAT "%5.1" ECU_ADDRESS 0x400062CF
 /begin IF_DATA XCPplus 0x0102
  /begin DAQ_EVENT VARIABLE /begin AVAILABLE_EVENT_LIST EVENT 0 EVENT 1 EVENT 2 EVENT 3 /end AVAILABLE_EVENT_LIST /begin DEFAULT_EVENT_LIST EVENT 0 /end DEFAULT_EVENT_LIST /end DAQ_EVENT
 /end IF_DATA
/end MEASUREMENT
/begin MEASUREMENT EpmCrS_cntrEngRev "Engine revolution counter since synchronisation" UBYTE OneToOne 1 100 0.00 255.0 FORMAT "%5.1" ECU_ADDRESS 0x400063DF
 /begin IF_DATA XCPplus 0x0102
  /begin DAQ_EVENT VARIABLE /begin AVAILABLE_EVENT_LIST EVENT 0 EVENT 1 EVENT 2 EVENT 3 /end AVAILABLE_EVENT_LIST /begin DEFAULT_EVENT_LIST EVENT 0 /end DEFAULT_EVENT_LIST /end DAQ_EVENT
 /end IF_DATA
/end MEASUREMENT
/begin MEASUREMENT EpmCrS_ctAgClkDeltaCrsv_mp "Number of angle differences above the permitted maximum angle" UBYTE OneToOne 1 100 0.00 255.0 FORMAT "%5.1" ECU_ADDRESS 0x40009E33
 /begin IF_DATA XCPplus 0x0102
  /begin DAQ_EVENT VARIABLE /begin AVAILABLE_EVENT_LIST EVENT 0 EVENT 1 EVENT 2 EVENT 3 /end AVAILABLE_EVENT_LIST /begin DEFAULT_EVENT_LIST EVENT 0 /end DEFAULT_EVENT_LIST /end DAQ_EVENT
 /end IF_DATA
/end MEASUREMENT
/begin MEASUREMENT EpmCrS_ctErrSig "debounce counter wrong crankshaft signal" SWORD OneToOne 1 100 -32768.00 32767.00 FORMAT "%8.2" ECU_ADDRESS 0x40005C74
 /begin IF_DATA XCPplus 0x0102
  /begin DAQ_EVENT VARIABLE /begin AVAILABLE_EVENT_LIST EVENT 0 EVENT 1 EVENT 2 EVENT 3 /end AVAILABLE_EVENT_LIST /begin DEFAULT_EVENT_LIST EVENT 2 /end DEFAULT_EVENT_LIST /end DAQ_EVENT
 /end IF_DATA
/end MEASUREMENT
/begin MEASUREMENT EpmCrS_ctErrSigSyncIni "In SyncIni detected number of signal disturbances" SWORD OneToOne 1 100 -32768.00 32767.00 FORMAT "%8.2" ECU_ADDRESS 0x40005C88
 /begin IF_DATA XCPplus 0x0102
  /begin DAQ_EVENT VARIABLE /begin AVAILABLE_EVENT_LIST EVENT 0 EVENT 1 EVENT 2 EVENT 3 /end AVAILABLE_EVENT_LIST /begin DEFAULT_EVENT_LIST EVENT 1 /end DEFAULT_EVENT_LIST /end DAQ_EVENT
 /end IF_DATA
/end MEASUREMENT
/begin MEASUREMENT EpmCrS_ctInc "crankshaft teeth counter" UBYTE OneToOne 1 100 0.00 255.0 FORMAT "%5.1" ECU_ADDRESS 0x400063DE
 /begin IF_DATA XCPplus 0x0102
  /begin DAQ_EVENT VARIABLE /begin AVAILABLE_EVENT_LIST EVENT 0 EVENT 1 EVENT 2 EVENT 3 /end AVAILABLE_EVENT_LIST /begin DEFAULT_EVENT_LIST EVENT 0 /end DEFAULT_EVENT_LIST /end DAQ_EVENT
 /end IF_DATA
/end MEASUREMENT
/begin MEASUREMENT EpmCrS_ctRange "counter for selecting speed limits in dynamic plausibilisation" UBYTE OneToOne 1 100 0.00 255.0 FORMAT "%5.1" ECU_ADDRESS 0x400062BE
 /begin IF_DATA XCPplus 0x0102
  /begin DAQ_EVENT VARIABLE /begin AVAILABLE_EVENT_LIST EVENT 0 EVENT 1 EVENT 2 EVENT 3 /end AVAILABLE_EVENT_LIST /begin DEFAULT_EVENT_LIST EVENT 1 /end DEFAULT_EVENT_LIST /end DAQ_EVENT
 /end IF_DATA
/end MEASUREMENT
/begin MEASUREMENT EpmCrS_ctReSyncAgClkDeltaTot_mp "Number of released re-synchronizations over all driving cycles" UBYTE OneToOne 1 100 0.00 255.0 FORMAT "%5.1" ECU_ADDRESS 0x40009E32
 /begin IF_DATA XCPplus 0x0102
  /begin DAQ_EVENT VARIABLE /begin AVAILABLE_EVENT_LIST EVENT 0 EVENT 1 EVENT 2 EVENT 3 /end AVAILABLE_EVENT_LIST /begin DEFAULT_EVENT_LIST EVENT 0 /end DEFAULT_EVENT_LIST /end DAQ_EVENT
 /end IF_DATA
/end MEASUREMENT
/begin MEASUREMENT EpmCrS_ctReSyncAgClkDelta_mp "Number of released re-synchronizations in the current driving cycle" UBYTE OneToOne 1 100 0.00 255.0 FORMAT "%5.1" ECU_ADDRESS 0x40009E31
 /begin IF_DATA XCPplus 0x0102
  /begin DAQ_EVENT VARIABLE /begin AVAILABLE_EVENT_LIST EVENT 0 EVENT 1 EVENT 2 EVENT 3 /end AVAILABLE_EVENT_LIST /begin DEFAULT_EVENT_LIST EVENT 0 /end DEFAULT_EVENT_LIST /end DAQ_EVENT
 /end IF_DATA
/end MEASUREMENT
/begin MEASUREMENT EpmCrS_ctRev "Revolution counter for CrS diagnosis" UWORD OneToOne 1 100 0.00 65535.00 FORMAT "%8.2" ECU_ADDRESS 0x40005C86
 /begin IF_DATA XCPplus 0x0102
  /begin DAQ_EVENT VARIABLE /begin AVAILABLE_EVENT_LIST EVENT 0 EVENT 1 EVENT 2 EVENT 3 /end AVAILABLE_EVENT_LIST /begin DEFAULT_EVENT_LIST EVENT 2 /end DEFAULT_EVENT_LIST /end DAQ_EVENT
 /end IF_DATA
/end MEASUREMENT
/begin MEASUREMENT EpmCrS_ctRev100msLim_mp "counter of crankshaft revolutions in 100ms limited" SBYTE OneToOne 1 100 -128.0 127.0 FORMAT "%5.1" ECU_ADDRESS 0x40009E34
 /begin IF_DATA XCPplus 0x0102
  /begin DAQ_EVENT VARIABLE /begin AVAILABLE_EVENT_LIST EVENT 0 EVENT 1 EVENT 2 EVENT 3 /end AVAILABLE_EVENT_LIST /begin DEFAULT_EVENT_LIST EVENT 2 /end DEFAULT_EVENT_LIST /end DAQ_EVENT
 /end IF_DATA
/end MEASUREMENT
/begin MEASUREMENT EpmCrS_ctRevCnt "crankshaft revolution counter" UWORD RevCnt 1 100 0.00 4095.938 FORMAT "%8.3" ECU_ADDRESS 0x40005C6C
 /begin IF_DATA XCPplus 0x0102
  /begin DAQ_EVENT VARIABLE /begin AVAILABLE_EVENT_LIST EVENT 0 EVENT 1 EVENT 2 EVENT 3 /end AVAILABLE_EVENT_LIST /begin DEFAULT_EVENT_LIST EVENT 0 /end DEFAULT_EVENT_LIST /end DAQ_EVENT
 /end IF_DATA
/end MEASUREMENT
/begin MEASUREMENT EpmCrS_ctRevIni "crankshaft revolutions since synchronisation" SWORD OneToOne 1 100 -32768.00 32767.00 FORMAT "%8.2" ECU_ADDRESS 0x40005DC0
 /begin IF_DATA XCPplus 0x0102
  /begin DAQ_EVENT VARIABLE /begin AVAILABLE_EVENT_LIST EVENT 0 EVENT 1 EVENT 2 EVENT 3 /end AVAILABLE_EVENT_LIST /begin DEFAULT_EVENT_LIST EVENT 0 /end DEFAULT_EVENT_LIST /end DAQ_EVENT
 /end IF_DATA
/end MEASUREMENT
/begin MEASUREMENT EpmCrS_ctRevStrt "crankshaft revolution since switch off start BIT" SWORD OneToOne 1 100 -32768.00 32767.00 FORMAT "%8.2" ECU_ADDRESS 0x40005DBE
 /begin IF_DATA XCPplus 0x0102
  /begin DAQ_EVENT VARIABLE /begin AVAILABLE_EVENT_LIST EVENT 0 EVENT 1 EVENT 2 EVENT 3 /end AVAILABLE_EVENT_LIST /begin DEFAULT_EVENT_LIST EVENT 0 /end DEFAULT_EVENT_LIST /end DAQ_EVENT
 /end IF_DATA
/end MEASUREMENT
/begin MEASUREMENT EpmCrS_ctRevStrtExtd "crankshaft revolution since switch off start BIT" SLONG OneToOne 1 100 -2147483648.00 2147483647.00 FORMAT "%13.2" ECU_ADDRESS 0x400048E0
 /begin IF_DATA XCPplus 0x0102
  /begin DAQ_EVENT VARIABLE /begin AVAILABLE_EVENT_LIST EVENT 0 EVENT 1 EVENT 2 EVENT 3 /end AVAILABLE_EVENT_LIST /begin DEFAULT_EVENT_LIST EVENT 0 /end DEFAULT_EVENT_LIST /end DAQ_EVENT
 /end IF_DATA
/end MEASUREMENT
/begin MEASUREMENT EpmCrS_ctRevWaitDiag "healing debounce counter wrong crankshaft signal" SWORD OneToOne 1 100 -32768.00 32767.00 FORMAT "%8.2" ECU_ADDRESS 0x40005C84
 /begin IF_DATA XCPplus 0x0102
  /begin DAQ_EVENT VARIABLE /begin AVAILABLE_EVENT_LIST EVENT 0 EVENT 1 EVENT 2 EVENT 3 /end AVAILABLE_EVENT_LIST /begin DEFAULT_EVENT_LIST EVENT 2 /end DEFAULT_EVENT_LIST /end DAQ_EVENT
 /end IF_DATA
/end MEASUREMENT
/begin MEASUREMENT EpmCrS_dnEngFltSyncIni "Engine speed gradient at SyncIni" SWORD EngNGrd 1 100 -16384.00 16383.50 FORMAT "%8.2" ECU_ADDRESS 0x40005C80
 /begin IF_DATA XCPplus 0x0102
  /begin DAQ_EVENT VARIABLE /begin AVAILABLE_EVENT_LIST EVENT 0 EVENT 1 EVENT 2 EVENT 3 /end AVAILABLE_EVENT_LIST /begin DEFAULT_EVENT_LIST EVENT 0 /end DEFAULT_EVENT_LIST /end DAQ_EVENT
 /end IF_DATA
/end MEASUREMENT
/begin MEASUREMENT EpmCrS_flgBattUDiag "Flag to enable Battery voltage Diagnosis" UBYTE OneToOne 1 100 0.00 255.0 FORMAT "%5.1" ECU_ADDRESS 0x400062CE
 /begin IF_DATA XCPplus 0x0102
  /begin DAQ_EVENT VARIABLE /begin AVAILABLE_EVENT_LIST EVENT 0 EVENT 1 EVENT 2 EVENT 3 /end AVAILABLE_EVENT_LIST /begin DEFAULT_EVENT_LIST EVENT 0 /end DEFAULT_EVENT_LIST /end DAQ_EVENT
 /end IF_DATA
/end MEASUREMENT
/begin MEASUREMENT EpmCrS_flgDiMnfldPEvln "flag to enable MAP signal evaluation for diagnosis" UBYTE OneToOne 1 100 0.00 255.0 FORMAT "%5.1" ECU_ADDRESS 0x400062CD
 /begin IF_DATA XCPplus 0x0102
  /begin DAQ_EVENT VARIABLE /begin AVAILABLE_EVENT_LIST EVENT 0 EVENT 1 EVENT 2 EVENT 3 /end AVAILABLE_EVENT_LIST /begin DEFAULT_EVENT_LIST EVENT 0 /end DEFAULT_EVENT_LIST /end DAQ_EVENT
 /end IF_DATA
/end MEASUREMENT
/begin MEASUREMENT EpmCrS_flgDiPPatSrch "Flag to disable pattern (pressure dip) search" UBYTE OneToOne 1 100 0.00 255.0 FORMAT "%5.1" ECU_ADDRESS 0x400062CC
 /begin IF_DATA XCPplus 0x0102
  /begin DAQ_EVENT VARIABLE /begin AVAILABLE_EVENT_LIST EVENT 0 EVENT 1 EVENT 2 EVENT 3 /end AVAILABLE_EVENT_LIST /begin DEFAULT_EVENT_LIST EVENT 0 /end DEFAULT_EVENT_LIST /end DAQ_EVENT
 /end IF_DATA
/end MEASUREMENT
/begin MEASUREMENT EpmCrS_flgDiStrtrEvln "Flag to be set based on starter engage evaluation" UBYTE OneToOne 1 100 0.00 255.0 FORMAT "%5.1" ECU_ADDRESS 0x400062CB
 /begin IF_DATA XCPplus 0x0102
  /begin DAQ_EVENT VARIABLE /begin AVAILABLE_EVENT_LIST EVENT 0 EVENT 1 EVENT 2 EVENT 3 /end AVAILABLE_EVENT_LIST /begin DEFAULT_EVENT_LIST EVENT 0 /end DEFAULT_EVENT_LIST /end DAQ_EVENT
 /end IF_DATA
/end MEASUREMENT
/begin MEASUREMENT EpmCrS_flgMnfldPDiag "Flag to be enable for Manifold pressure based diagnosis" UBYTE OneToOne 1 100 0.00 255.0 FORMAT "%5.1" ECU_ADDRESS 0x400062CA
 /begin IF_DATA XCPplus 0x0102
  /begin DAQ_EVENT VARIABLE /begin AVAILABLE_EVENT_LIST EVENT 0 EVENT 1 EVENT 2 EVENT 3 /end AVAILABLE_EVENT_LIST /begin DEFAULT_EVENT_LIST EVENT 0 /end DEFAULT_EVENT_LIST /end DAQ_EVENT
 /end IF_DATA
/end MEASUREMENT
/begin MEASUREMENT EpmCrS_flgMnfldPPatDeb "Flag represent number of patterns (pressure dips) detected" UBYTE OneToOne 1 100 0.00 255.0 FORMAT "%5.1" ECU_ADDRESS 0x400062C9
 /begin IF_DATA XCPplus 0x0102
  /begin DAQ_EVENT VARIABLE /begin AVAILABLE_EVENT_LIST EVENT 0 EVENT 1 EVENT 2 EVENT 3 /end AVAILABLE_EVENT_LIST /begin DEFAULT_EVENT_LIST EVENT 0 /end DEFAULT_EVENT_LIST /end DAQ_EVENT
 /end IF_DATA
/end MEASUREMENT
/begin MEASUREMENT EpmCrS_flgMnfldPPatDetd "Flag to be enable first pressure pattern (pressure dip) detected" UBYTE OneToOne 1 100 0.00 255.0 FORMAT "%5.1" ECU_ADDRESS 0x400062C8
 /begin IF_DATA XCPplus 0x0102
  /begin DAQ_EVENT VARIABLE /begin AVAILABLE_EVENT_LIST EVENT 0 EVENT 1 EVENT 2 EVENT 3 /end AVAILABLE_EVENT_LIST /begin DEFAULT_EVENT_LIST EVENT 0 /end DEFAULT_EVENT_LIST /end DAQ_EVENT
 /end IF_DATA
/end MEASUREMENT
/begin MEASUREMENT EpmCrS_flgMnfldPVld "Flag to check valid manifold pressure" UBYTE OneToOne 1 100 0.00 255.0 FORMAT "%5.1" ECU_ADDRESS 0x400062C7
 /begin IF_DATA XCPplus 0x0102
  /begin DAQ_EVENT VARIABLE /begin AVAILABLE_EVENT_LIST EVENT 0 EVENT 1 EVENT 2 EVENT 3 /end AVAILABLE_EVENT_LIST /begin DEFAULT_EVENT_LIST EVENT 1 /end DEFAULT_EVENT_LIST /end DAQ_EVENT
 /end IF_DATA
/end MEASUREMENT
/begin MEASUREMENT EpmCrS_flgNMinChk "Flag to be enable for minimum battery voltage" UBYTE OneToOne 1 100 0.00 255.0 FORMAT "%5.1" ECU_ADDRESS 0x400062C6
 /begin IF_DATA XCPplus 0x0102
  /begin DAQ_EVENT VARIABLE /begin AVAILABLE_EVENT_LIST EVENT 0 EVENT 1 EVENT 2 EVENT 3 /end AVAILABLE_EVENT_LIST /begin DEFAULT_EVENT_LIST EVENT 0 /end DEFAULT_EVENT_LIST /end DAQ_EVENT
 /end IF_DATA
/end MEASUREMENT
/begin MEASUREMENT EpmCrS_flgStrtrActv "Flag to set be based on starter active" UBYTE OneToOne 1 100 0.00 255.0 FORMAT "%5.1" ECU_ADDRESS 0x400062C2
 /begin IF_DATA XCPplus 0x0102
  /begin DAQ_EVENT VARIABLE /begin AVAILABLE_EVENT_LIST EVENT 0 EVENT 1 EVENT 2 EVENT 3 /end AVAILABLE_EVENT_LIST /begin DEFAULT_EVENT_LIST EVENT 1 /end DEFAULT_EVENT_LIST /end DAQ_EVENT
 /end IF_DATA
/end MEASUREMENT
/begin MEASUREMENT EpmCrS_flgStrtrActv2 "Additional starter flag based on the battery drop EpmCrS_uDrpStrtrNotActv2_C for reverse rotation enable condition." UBYTE OneToOne 1 100 0.00 255.0 FORMAT "%5.1" ECU_ADDRESS 0x400062C1
 /begin IF_DATA XCPplus 0x0102
  /begin DAQ_EVENT VARIABLE /begin AVAILABLE_EVENT_LIST EVENT 0 EVENT 1 EVENT 2 EVENT 3 /end AVAILABLE_EVENT_LIST /begin DEFAULT_EVENT_LIST EVENT 1 /end DEFAULT_EVENT_LIST /end DAQ_EVENT
 /end IF_DATA
/end MEASUREMENT
/begin MEASUREMENT EpmCrS_flgStrtrStDeb "Starter Debounce status flag" UBYTE OneToOne 1 100 0.00 255.0 FORMAT "%5.1" ECU_ADDRESS 0x400062C5
 /begin IF_DATA XCPplus 0x0102
  /begin DAQ_EVENT VARIABLE /begin AVAILABLE_EVENT_LIST EVENT 0 EVENT 1 EVENT 2 EVENT 3 /end AVAILABLE_EVENT_LIST /begin DEFAULT_EVENT_LIST EVENT 0 /end DEFAULT_EVENT_LIST /end DAQ_EVENT
 /end IF_DATA
/end MEASUREMENT
/begin MEASUREMENT EpmCrS_flgTiMaxT15Actv "Maximum possible T15 ON time reached" UBYTE B_TRUE 1 100 0.00 1.00000000000 BIT_MASK 0x1 FORMAT "%13.11" ECU_ADDRESS 0x40008720
 /begin IF_DATA XCPplus 0x0102
  /begin DAQ_EVENT VARIABLE /begin AVAILABLE_EVENT_LIST EVENT 0 EVENT 1 EVENT 2 EVENT 3 /end AVAILABLE_EVENT_LIST /begin DEFAULT_EVENT_LIST EVENT 1 /end DEFAULT_EVENT_LIST /end DAQ_EVENT
 /end IF_DATA
/end MEASUREMENT
/begin MEASUREMENT EpmCrS_numIncPerSeg "The number of crankshaft teeth in the cylinder-segment EpmCrS_phiSeg" UWORD OneToOne 1 100 0.00 65535.00 FORMAT "%8.2" ECU_ADDRESS 0x40005D8A
 /begin IF_DATA XCPplus 0x0102
  /begin DAQ_EVENT VARIABLE /begin AVAILABLE_EVENT_LIST EVENT 0 EVENT 1 EVENT 2 EVENT 3 /end AVAILABLE_EVENT_LIST /begin DEFAULT_EVENT_LIST EVENT 0 /end DEFAULT_EVENT_LIST /end DAQ_EVENT
 /end IF_DATA
/end MEASUREMENT
/begin MEASUREMENT EpmCrS_numIntOld "Type of previous interrupt occurred (Internal variable used for revolution counter module)" UBYTE EpmSeq_numInt_Compu 1 100 0.00 32.0000000000 FORMAT "%13.10" ECU_ADDRESS 0x400062BD
 /begin IF_DATA XCPplus 0x0102
  /begin DAQ_EVENT VARIABLE /begin AVAILABLE_EVENT_LIST EVENT 0 EVENT 1 EVENT 2 EVENT 3 /end AVAILABLE_EVENT_LIST /begin DEFAULT_EVENT_LIST EVENT 0 /end DEFAULT_EVENT_LIST /end DAQ_EVENT
 /end IF_DATA
/end MEASUREMENT
/begin MEASUREMENT EpmCrS_numSeg "counter of part segments" UBYTE OneToOne 1 100 0.00 255.0 FORMAT "%5.1" ECU_ADDRESS 0x400063DD
 /begin IF_DATA XCPplus 0x0102
  /begin DAQ_EVENT VARIABLE /begin AVAILABLE_EVENT_LIST EVENT 0 EVENT 1 EVENT 2 EVENT 3 /end AVAILABLE_EVENT_LIST /begin DEFAULT_EVENT_LIST EVENT 0 /end DEFAULT_EVENT_LIST /end DAQ_EVENT
 /end IF_DATA
/end MEASUREMENT
/begin MEASUREMENT EpmCrS_numTiIncPerAvrg_mp "current number of crankshaft teeth to calculate average of tooth time" ULONG OneToOne 1 100 0.00 4294967295.00 FORMAT "%13.2" ECU_ADDRESS 0x40009D38
 /begin IF_DATA XCPplus 0x0102
  /begin DAQ_EVENT VARIABLE /begin AVAILABLE_EVENT_LIST EVENT 0 EVENT 1 EVENT 2 EVENT 3 /end AVAILABLE_EVENT_LIST /begin DEFAULT_EVENT_LIST EVENT 2 /end DEFAULT_EVENT_LIST /end DAQ_EVENT
 /end IF_DATA
/end MEASUREMENT
/begin MEASUREMENT EpmCrS_phiAgClk "Relative angle of the engine position provided by the angle clock" SWORD AngleCrS 1 100 -720.0000 719.9780 FORMAT "%8.4" ECU_ADDRESS 0x40005DBC
 /begin IF_DATA XCPplus 0x0102
  /begin DAQ_EVENT VARIABLE /begin AVAILABLE_EVENT_LIST EVENT 0 EVENT 1 EVENT 2 EVENT 3 /end AVAILABLE_EVENT_LIST /begin DEFAULT_EVENT_LIST EVENT 0 /end DEFAULT_EVENT_LIST /end DAQ_EVENT
 /end IF_DATA
/end MEASUREMENT
/begin MEASUREMENT EpmCrS_phiAgClkDelta_mp "Angle difference between the relative angle of the angle clock and the relative angle provided by the tooth counter" SWORD AngleCrS 1 100 -720.0000 719.9780 FORMAT "%8.4" ECU_ADDRESS 0x40009DCE
 /begin IF_DATA XCPplus 0x0102
  /begin DAQ_EVENT VARIABLE /begin AVAILABLE_EVENT_LIST EVENT 0 EVENT 1 EVENT 2 EVENT 3 /end AVAILABLE_EVENT_LIST /begin DEFAULT_EVENT_LIST EVENT 0 /end DEFAULT_EVENT_LIST /end DAQ_EVENT
 /end IF_DATA
/end MEASUREMENT
/begin MEASUREMENT EpmCrS_phiIgnInc "crankshaft angle faded out due to debouncing, during start" SWORD AngleCrS 1 100 -720.0000 719.9780 FORMAT "%8.4" ECU_ADDRESS 0x40005C70 /end MEASUREMENT
/begin MEASUREMENT EpmCrS_phiInc "Relative angle of the engine position provided by the tooth counter" SWORD AngleCrS 1 100 -720.0000 719.9780 FORMAT "%8.4" ECU_ADDRESS 0x40005DBA
 /begin IF_DATA XCPplus 0x0102
  /begin DAQ_EVENT VARIABLE /begin AVAILABLE_EVENT_LIST EVENT 0 EVENT 1 EVENT 2 EVENT 3 /end AVAILABLE_EVENT_LIST /begin DEFAULT_EVENT_LIST EVENT 0 /end DEFAULT_EVENT_LIST /end DAQ_EVENT
 /end IF_DATA
/end MEASUREMENT
/begin MEASUREMENT EpmCrS_phiIntSeg "endposition of the current halfsegment" SWORD AngleCrS 1 100 -720.0000 719.9780 FORMAT "%8.4" ECU_ADDRESS 0x40005DB8
 /begin IF_DATA XCPplus 0x0102
  /begin DAQ_EVENT VARIABLE /begin AVAILABLE_EVENT_LIST EVENT 0 EVENT 1 EVENT 2 EVENT 3 /end AVAILABLE_EVENT_LIST /begin DEFAULT_EVENT_LIST EVENT 0 /end DEFAULT_EVENT_LIST /end DAQ_EVENT
 /end IF_DATA
/end MEASUREMENT
/begin MEASUREMENT EpmCrS_phiSeg "Cylinder segment length" SWORD AngleCrS 1 100 -720.0000 719.9780 FORMAT "%8.4" ECU_ADDRESS 0x40005DB6
 /begin IF_DATA XCPplus 0x0102
  /begin DAQ_EVENT VARIABLE /begin AVAILABLE_EVENT_LIST EVENT 0 EVENT 1 EVENT 2 EVENT 3 /end AVAILABLE_EVENT_LIST /begin DEFAULT_EVENT_LIST EVENT 0 /end DEFAULT_EVENT_LIST /end DAQ_EVENT
 /end IF_DATA
/end MEASUREMENT
/begin MEASUREMENT EpmCrS_pMaxIntkMnfld "Maximum intake manifold pressure" UWORD p_uw_q0p078 1 100 0.00 5119.922 FORMAT "%8.3" ECU_ADDRESS 0x40005C7E
 /begin IF_DATA XCPplus 0x0102
  /begin DAQ_EVENT VARIABLE /begin AVAILABLE_EVENT_LIST EVENT 0 EVENT 1 EVENT 2 EVENT 3 /end AVAILABLE_EVENT_LIST /begin DEFAULT_EVENT_LIST EVENT 0 /end DEFAULT_EVENT_LIST /end DAQ_EVENT
 /end IF_DATA
/end MEASUREMENT
/begin MEASUREMENT EpmCrS_pMinIntkMnfld "Minimum intake manifold pressure" UWORD p_uw_q0p078 1 100 0.00 5119.922 FORMAT "%8.3" ECU_ADDRESS 0x40005C7C
 /begin IF_DATA XCPplus 0x0102
  /begin DAQ_EVENT VARIABLE /begin AVAILABLE_EVENT_LIST EVENT 0 EVENT 1 EVENT 2 EVENT 3 /end AVAILABLE_EVENT_LIST /begin DEFAULT_EVENT_LIST EVENT 0 /end DEFAULT_EVENT_LIST /end DAQ_EVENT
 /end IF_DATA
/end MEASUREMENT
/begin MEASUREMENT EpmCrS_stDiag "state of crankshaft signal diagnosis" UBYTE EpmCrS_Diag_State 1 100 0.00 1.00000000000 FORMAT "%13.11" ECU_ADDRESS 0x400063DC
 /begin IF_DATA XCPplus 0x0102
  /begin DAQ_EVENT VARIABLE /begin AVAILABLE_EVENT_LIST EVENT 0 EVENT 1 EVENT 2 EVENT 3 /end AVAILABLE_EVENT_LIST /begin DEFAULT_EVENT_LIST EVENT 2 /end DEFAULT_EVENT_LIST /end DAQ_EVENT
 /end IF_DATA
/end MEASUREMENT
/begin MEASUREMENT EpmCrS_stDiagErrSig "current state of error wrong crankshaft signal" UBYTE EpmCrS_DiagResult_State 1 100 0.00 4.00000000000 FORMAT "%13.11" ECU_ADDRESS 0x400062C0
 /begin IF_DATA XCPplus 0x0102
  /begin DAQ_EVENT VARIABLE /begin AVAILABLE_EVENT_LIST EVENT 0 EVENT 1 EVENT 2 EVENT 3 /end AVAILABLE_EVENT_LIST /begin DEFAULT_EVENT_LIST EVENT 2 /end DEFAULT_EVENT_LIST /end DAQ_EVENT
 /end IF_DATA
/end MEASUREMENT
/begin MEASUREMENT EpmCrS_stDiagNoSig "current state of error NoSig" UBYTE EpmCrS_DiagResult_State 1 100 0.00 4.00000000000 FORMAT "%13.11" ECU_ADDRESS 0x400062BF
 /begin IF_DATA XCPplus 0x0102
  /begin DAQ_EVENT VARIABLE /begin AVAILABLE_EVENT_LIST EVENT 0 EVENT 1 EVENT 2 EVENT 3 /end AVAILABLE_EVENT_LIST /begin DEFAULT_EVENT_LIST EVENT 2 /end DEFAULT_EVENT_LIST /end DAQ_EVENT
 /end IF_DATA
/end MEASUREMENT
/begin MEASUREMENT EpmCrS_stSigDiagSrc "reason of cranksahft error" UWORD OneToOne 1 100 0.00 65535.00 FORMAT "%8.2" ECU_ADDRESS 0x40005C72
 /begin IF_DATA XCPplus 0x0102
  /begin DAQ_EVENT VARIABLE /begin AVAILABLE_EVENT_LIST EVENT 0 EVENT 1 EVENT 2 EVENT 3 /end AVAILABLE_EVENT_LIST /begin DEFAULT_EVENT_LIST EVENT 0 /end DEFAULT_EVENT_LIST /end DAQ_EVENT
 /end IF_DATA
/end MEASUREMENT
/begin MEASUREMENT EpmCrS_stSigMode "state of crankshaft signal evaluation" UBYTE EpmHCrS_stSigMode_State_t 1 100 0.00 8.00000000000 FORMAT "%13.11" ECU_ADDRESS 0x400063DB
 /begin IF_DATA XCPplus 0x0102
  /begin DAQ_EVENT VARIABLE /begin AVAILABLE_EVENT_LIST EVENT 0 EVENT 1 EVENT 2 EVENT 3 /end AVAILABLE_EVENT_LIST /begin DEFAULT_EVENT_LIST EVENT 0 /end DEFAULT_EVENT_LIST /end DAQ_EVENT
 /end IF_DATA
/end MEASUREMENT
/begin MEASUREMENT EpmCrS_tiIncPer "current tooth-time on crankshaft" SLONG GptaClc6_ti_COMPU 1 100 -858993459.200 858993458.800 FORMAT "%13.3" ECU_ADDRESS 0x400048E4
 /begin IF_DATA XCPplus 0x0102
  /begin DAQ_EVENT VARIABLE /begin AVAILABLE_EVENT_LIST EVENT 0 EVENT 1 EVENT 2 EVENT 3 /end AVAILABLE_EVENT_LIST /begin DEFAULT_EVENT_LIST EVENT 1 /end DEFAULT_EVENT_LIST /end DAQ_EVENT
 /end IF_DATA
/end MEASUREMENT
/begin MEASUREMENT EpmCrS_tiMnfldPPatDeb "Time duration to detect Manifold pressure patterns." UWORD t_q0p002 1 100 0.00 131.0700 FORMAT "%8.4" ECU_ADDRESS 0x40005C7A
 /begin IF_DATA XCPplus 0x0102
  /begin DAQ_EVENT VARIABLE /begin AVAILABLE_EVENT_LIST EVENT 0 EVENT 1 EVENT 2 EVENT 3 /end AVAILABLE_EVENT_LIST /begin DEFAULT_EVENT_LIST EVENT 0 /end DEFAULT_EVENT_LIST /end DAQ_EVENT
 /end IF_DATA
/end MEASUREMENT
/begin MEASUREMENT EpmCrS_tiSeg "cylinder segment time" SLONG Per_Dur 1 100 -2147483648.00 2147483647.00 FORMAT "%13.2" ECU_ADDRESS 0x400048DC
 /begin IF_DATA XCPplus 0x0102
  /begin DAQ_EVENT VARIABLE /begin AVAILABLE_EVENT_LIST EVENT 0 EVENT 1 EVENT 2 EVENT 3 /end AVAILABLE_EVENT_LIST /begin DEFAULT_EVENT_LIST EVENT 0 /end DEFAULT_EVENT_LIST /end DAQ_EVENT
 /end IF_DATA
/end MEASUREMENT
/begin MEASUREMENT EpmCrS_tiSegCurr "half cylinder segment time" SLONG Per_Dur 1 100 -2147483648.00 2147483647.00 FORMAT "%13.2" ECU_ADDRESS 0x400048D8
 /begin IF_DATA XCPplus 0x0102
  /begin DAQ_EVENT VARIABLE /begin AVAILABLE_EVENT_LIST EVENT 0 EVENT 1 EVENT 2 EVENT 3 /end AVAILABLE_EVENT_LIST /begin DEFAULT_EVENT_LIST EVENT 0 /end DEFAULT_EVENT_LIST /end DAQ_EVENT
 /end IF_DATA
/end MEASUREMENT
/begin MEASUREMENT EpmCrS_tiSegCurr1 "180 degree segment time." SLONG Per_Dur 1 100 -2147483648.00 2147483647.00 FORMAT "%13.2" ECU_ADDRESS 0x40004774
 /begin IF_DATA XCPplus 0x0102
  /begin DAQ_EVENT VARIABLE /begin AVAILABLE_EVENT_LIST EVENT 0 EVENT 1 EVENT 2 EVENT 3 /end AVAILABLE_EVENT_LIST /begin DEFAULT_EVENT_LIST EVENT 0 /end DEFAULT_EVENT_LIST /end DAQ_EVENT
 /end IF_DATA
/end MEASUREMENT
/begin MEASUREMENT EpmCrS_tiStrtrEngd "timer for detecting invalid cranking and short cranking" UWORD t_q0p01 1 100 0.00 655.3500 FORMAT "%8.4" ECU_ADDRESS 0x40005C78
 /begin IF_DATA XCPplus 0x0102
  /begin DAQ_EVENT VARIABLE /begin AVAILABLE_EVENT_LIST EVENT 0 EVENT 1 EVENT 2 EVENT 3 /end AVAILABLE_EVENT_LIST /begin DEFAULT_EVENT_LIST EVENT 1 /end DEFAULT_EVENT_LIST /end DAQ_EVENT
 /end IF_DATA
/end MEASUREMENT
/begin MEASUREMENT EpmCrS_uBattDrp "Drop in battery voltage" SWORD spg_ubatt 1 100 -2306.867 2306.797 FORMAT "%8.3" ECU_ADDRESS 0x40005C76
 /begin IF_DATA XCPplus 0x0102
  /begin DAQ_EVENT VARIABLE /begin AVAILABLE_EVENT_LIST EVENT 0 EVENT 1 EVENT 2 EVENT 3 /end AVAILABLE_EVENT_LIST /begin DEFAULT_EVENT_LIST EVENT 0 /end DEFAULT_EVENT_LIST /end DAQ_EVENT
 /end IF_DATA
/end MEASUREMENT
/begin MEASUREMENT EpmCrS_uBattFild "Filter battery voltage" UBYTE spg_ubatt 1 100 0.00 17.95 FORMAT "%5.2" ECU_ADDRESS 0x400062C4
 /begin IF_DATA XCPplus 0x0102
  /begin DAQ_EVENT VARIABLE /begin AVAILABLE_EVENT_LIST EVENT 0 EVENT 1 EVENT 2 EVENT 3 /end AVAILABLE_EVENT_LIST /begin DEFAULT_EVENT_LIST EVENT 1 /end DEFAULT_EVENT_LIST /end DAQ_EVENT
 /end IF_DATA
/end MEASUREMENT
/begin MEASUREMENT EpmCrS_uBattMax "Maximum battery voltage" UBYTE spg_ubatt 1 100 0.00 17.95 FORMAT "%5.2" ECU_ADDRESS 0x400062C3
 /begin IF_DATA XCPplus 0x0102
  /begin DAQ_EVENT VARIABLE /begin AVAILABLE_EVENT_LIST EVENT 0 EVENT 1 EVENT 2 EVENT 3 /end AVAILABLE_EVENT_LIST /begin DEFAULT_EVENT_LIST EVENT 0 /end DEFAULT_EVENT_LIST /end DAQ_EVENT
 /end IF_DATA
/end MEASUREMENT
/begin MEASUREMENT EpmHCrS_agClkTimeout "angle clock value valid at WAITGAP and GAPFOUND at any instance" ULONG OneToOne 1 100 0.00 4294967295.00 FORMAT "%13.2" ECU_ADDRESS 0x40004770
 /begin IF_DATA XCPplus 0x0102
  /begin DAQ_EVENT VARIABLE /begin AVAILABLE_EVENT_LIST EVENT 0 EVENT 1 EVENT 2 EVENT 3 /end AVAILABLE_EVENT_LIST /begin DEFAULT_EVENT_LIST EVENT 1 /end DEFAULT_EVENT_LIST /end DAQ_EVENT
 /end IF_DATA
/end MEASUREMENT
/begin MEASUREMENT EpmHCrS_AgIncTrans "Angle stamps at crankshaft active edge" ULONG OneToOne 1 100 0.00 4294967295.00 FORMAT "%13.2" ECU_ADDRESS 0x40005134 /end MEASUREMENT
/begin MEASUREMENT EpmHCrS_CntrCrSEdge_mp "Edge counter when noise rejection is enabled" ULONG OneToOne 1 100 0.00 4294967295.00 FORMAT "%13.2" ECU_ADDRESS 0x40009D34 /end MEASUREMENT
/begin MEASUREMENT EpmHCrS_flgNoiseRej "Status flag of noise rejection" UBYTE OneToOne 1 100 0.00 255.0 FORMAT "%5.1" ECU_ADDRESS 0x400062BC /end MEASUREMENT
/begin MEASUREMENT EpmHCrS_stNoiseRej "Noise rejection state variable" UBYTE EpmHCrS_stNoiseRej_State_t 1 100 0.00 4.00000000000 FORMAT "%13.11" ECU_ADDRESS 0x40005138 /end MEASUREMENT
/begin MEASUREMENT EpmHCrS_stNoiseRej_mp "Measurement point vriable for noise rejection state machine." UBYTE OneToOne 1 100 0.00 255.0 FORMAT "%5.1" ECU_ADDRESS 0x40009E30 /end MEASUREMENT
/begin MEASUREMENT EpmHCrS_stSigErr "Bit coded error state of the crankshaft signal evaluation" UWORD OneToOne 1 100 0.00 65535.00 FORMAT "%8.2" ECU_ADDRESS 0x40006018
 /begin IF_DATA XCPplus 0x0102
  /begin DAQ_EVENT VARIABLE /begin AVAILABLE_EVENT_LIST EVENT 0 EVENT 1 EVENT 2 EVENT 3 /end AVAILABLE_EVENT_LIST /begin DEFAULT_EVENT_LIST EVENT 0 /end DEFAULT_EVENT_LIST /end DAQ_EVENT
 /end IF_DATA
/end MEASUREMENT
/begin MEASUREMENT EpmHCrS_stSigMode "State of HW driver of crankshaft signal evaluation" UBYTE EpmHCrS_stSigMode_State_t 1 100 0.00 8.00000000000 FORMAT "%13.11" ECU_ADDRESS 0x4000513C /end MEASUREMENT
/begin MEASUREMENT EpmHCrS_swtGapTout "Switch to set timeout factor for gap or normal tooth" UBYTE OneToOne 1 100 0.00 255.0 FORMAT "%5.1" ECU_ADDRESS 0x400064B4 /end MEASUREMENT
/begin MEASUREMENT EpmHCrS_tiNoSig "The time duration between from crank shaft signal lost to Epm driver reset" UWORD t10msxs_sb_q0p01 1 100 0.00 655.3500 FORMAT "%8.4" ECU_ADDRESS 0x40005C6A
 /begin IF_DATA XCPplus 0x0102
  /begin DAQ_EVENT VARIABLE /begin AVAILABLE_EVENT_LIST EVENT 0 EVENT 1 EVENT 2 EVENT 3 /end AVAILABLE_EVENT_LIST /begin DEFAULT_EVENT_LIST EVENT 1 /end DEFAULT_EVENT_LIST /end DAQ_EVENT
 /end IF_DATA
/end MEASUREMENT
/begin MEASUREMENT EpmHInt_AgIncTrans "Angle stamp at crankshaft active edge where EPM interrupt is triggered" ULONG AngleCrS 1 100 0.00 94371839.9781 FORMAT "%13.4" ECU_ADDRESS 0x40005164 /end MEASUREMENT
/begin MEASUREMENT EpmHInt_ctErrTaskAct "Sync pre task activation error counter" UBYTE OneToOne 1 100 0.00 255.0 FORMAT "%5.1" ECU_ADDRESS 0x400062BB /end MEASUREMENT
/begin MEASUREMENT EpmRRS_actInc_mp "current increment counter, related to 0°CrS" UWORD OneToOne 1 100 0.00 65535.00 FORMAT "%8.2" ECU_ADDRESS 0x40009DCC
 /begin IF_DATA XCPplus 0x0102
  /begin DAQ_EVENT VARIABLE /begin AVAILABLE_EVENT_LIST EVENT 0 EVENT 1 EVENT 2 EVENT 3 /end AVAILABLE_EVENT_LIST /begin DEFAULT_EVENT_LIST EVENT 1 /end DEFAULT_EVENT_LIST /end DAQ_EVENT
 /end IF_DATA
/end MEASUREMENT
/begin MEASUREMENT EpmRRS_bEngSwOff "Emergency switch off due to reverse running engine" UBYTE OneToOne 1 100 0.00 255.0 BIT_MASK 0x1 FORMAT "%5.1" ECU_ADDRESS 0x400063AF
 /begin IF_DATA XCPplus 0x0102
  /begin DAQ_EVENT VARIABLE /begin AVAILABLE_EVENT_LIST EVENT 0 EVENT 1 EVENT 2 EVENT 3 /end AVAILABLE_EVENT_LIST /begin DEFAULT_EVENT_LIST EVENT 1 /end DEFAULT_EVENT_LIST /end DAQ_EVENT
 /end IF_DATA
/end MEASUREMENT
/begin MEASUREMENT EpmRRS_phiEngRR "Angle of first engine direction change" SWORD AngleCrS 1 100 -720.0000 719.9780 FORMAT "%8.4" ECU_ADDRESS 0x40005C68
 /begin IF_DATA XCPplus 0x0102
  /begin DAQ_EVENT VARIABLE /begin AVAILABLE_EVENT_LIST EVENT 0 EVENT 1 EVENT 2 EVENT 3 /end AVAILABLE_EVENT_LIST /begin DEFAULT_EVENT_LIST EVENT 1 /end DEFAULT_EVENT_LIST /end DAQ_EVENT
 /end IF_DATA
/end MEASUREMENT
/begin MEASUREMENT EpmRRS_phiGapPos "Gap positions based on the calibrated zero position" SWORD AngleCrS 1 100 -720.0000 719.9780 FORMAT "%8.4" ARRAY_SIZE 2 ECU_ADDRESS 0x40005C64
 /begin IF_DATA XCPplus 0x0102
  /begin DAQ_EVENT VARIABLE /begin AVAILABLE_EVENT_LIST EVENT 0 EVENT 1 EVENT 2 EVENT 3 /end AVAILABLE_EVENT_LIST /begin DEFAULT_EVENT_LIST EVENT 1 /end DEFAULT_EVENT_LIST /end DAQ_EVENT
 /end IF_DATA
/end MEASUREMENT
/begin MEASUREMENT EpmRRS_stAgDetect "State of reverse rotation detection" UBYTE EpmRRS_stAgDetect_t 1 100 0.00 2.00000000000 FORMAT "%13.11" ECU_ADDRESS 0x400062BA
 /begin IF_DATA XCPplus 0x0102
  /begin DAQ_EVENT VARIABLE /begin AVAILABLE_EVENT_LIST EVENT 0 EVENT 1 EVENT 2 EVENT 3 /end AVAILABLE_EVENT_LIST /begin DEFAULT_EVENT_LIST EVENT 1 /end DEFAULT_EVENT_LIST /end DAQ_EVENT
 /end IF_DATA
/end MEASUREMENT
/begin MEASUREMENT EpmRRS_stEnable "State of switch-on conditions of reverse rotation detection" UBYTE OneToOne 1 100 0.00 255.0 FORMAT "%5.1" ECU_ADDRESS 0x400062B9
 /begin IF_DATA XCPplus 0x0102
  /begin DAQ_EVENT VARIABLE /begin AVAILABLE_EVENT_LIST EVENT 0 EVENT 1 EVENT 2 EVENT 3 /end AVAILABLE_EVENT_LIST /begin DEFAULT_EVENT_LIST EVENT 1 /end DEFAULT_EVENT_LIST /end DAQ_EVENT
 /end IF_DATA
/end MEASUREMENT
/begin MEASUREMENT EpmRRS_stEngStop "Engine has stopped after tooth timeout" UBYTE OneToOne 1 100 0.00 255.0 FORMAT "%5.1" ECU_ADDRESS 0x400062B8
 /begin IF_DATA XCPplus 0x0102
  /begin DAQ_EVENT VARIABLE /begin AVAILABLE_EVENT_LIST EVENT 0 EVENT 1 EVENT 2 EVENT 3 /end AVAILABLE_EVENT_LIST /begin DEFAULT_EVENT_LIST EVENT 1 /end DEFAULT_EVENT_LIST /end DAQ_EVENT
 /end IF_DATA
/end MEASUREMENT
/begin MEASUREMENT EpmRRS_stRotDir "Rotation direction of engine" UBYTE EpmRRS_stRotDir_t 1 100 0.00 3.00000000000 FORMAT "%13.11" ECU_ADDRESS 0x400063DA
 /begin IF_DATA XCPplus 0x0102
  /begin DAQ_EVENT VARIABLE /begin AVAILABLE_EVENT_LIST EVENT 0 EVENT 1 EVENT 2 EVENT 3 /end AVAILABLE_EVENT_LIST /begin DEFAULT_EVENT_LIST EVENT 1 /end DEFAULT_EVENT_LIST /end DAQ_EVENT
 /end IF_DATA
/end MEASUREMENT
/begin MEASUREMENT EpmSeq_flgStrtVirtSyn "Flag used to check the state of virtual synchro generation" UBYTE OneToOne 1 100 0.00 255.0 FORMAT "%5.1" ECU_ADDRESS 0x400062B6
 /begin IF_DATA XCPplus 0x0102
  /begin DAQ_EVENT VARIABLE /begin AVAILABLE_EVENT_LIST EVENT 0 EVENT 1 EVENT 2 EVENT 3 /end AVAILABLE_EVENT_LIST /begin DEFAULT_EVENT_LIST EVENT 0 /end DEFAULT_EVENT_LIST /end DAQ_EVENT
 /end IF_DATA
/end MEASUREMENT
/begin MEASUREMENT EpmSeq_flgVirtSynFirst "Flag used to check state of Virtual First Synchro generation" UBYTE OneToOne 1 100 0.00 255.0 BIT_MASK 0x1 FORMAT "%5.1" ECU_ADDRESS 0x400062B5
 /begin IF_DATA XCPplus 0x0102
  /begin DAQ_EVENT VARIABLE /begin AVAILABLE_EVENT_LIST EVENT 0 EVENT 1 EVENT 2 EVENT 3 /end AVAILABLE_EVENT_LIST /begin DEFAULT_EVENT_LIST EVENT 0 /end DEFAULT_EVENT_LIST /end DAQ_EVENT
 /end IF_DATA
/end MEASUREMENT
/begin MEASUREMENT EpmSeq_MaxVrtlPhiSeg "Maximum segment length between two consecutive synchros including main synchro." SWORD AngleCrS 1 100 -720.0000 719.9780 FORMAT "%8.4" ECU_ADDRESS 0x40005C60 /end MEASUREMENT
/begin MEASUREMENT EpmSeq_numIncDiffInt "Difference between 2 synchro-interrupts in crankshafttooth" SWORD OneToOne 1 100 -32768.00 32767.00 FORMAT "%8.2" ARRAY_SIZE 2 ECU_ADDRESS 0x40005DB2
 /begin IF_DATA XCPplus 0x0102
  /begin DAQ_EVENT VARIABLE /begin AVAILABLE_EVENT_LIST EVENT 0 EVENT 1 EVENT 2 EVENT 3 /end AVAILABLE_EVENT_LIST /begin DEFAULT_EVENT_LIST EVENT 0 /end DEFAULT_EVENT_LIST /end DAQ_EVENT
 /end IF_DATA
/end MEASUREMENT
/begin MEASUREMENT EpmSeq_numInt "type of current interrupt" UBYTE EpmSeq_numInt_Compu 1 100 0.00 16.0000000000 FORMAT "%13.10" ECU_ADDRESS 0x400063D9
 /begin IF_DATA XCPplus 0x0102
  /begin DAQ_EVENT VARIABLE /begin AVAILABLE_EVENT_LIST EVENT 0 EVENT 1 EVENT 2 EVENT 3 /end AVAILABLE_EVENT_LIST /begin DEFAULT_EVENT_LIST EVENT 0 /end DEFAULT_EVENT_LIST /end DAQ_EVENT
 /end IF_DATA
/end MEASUREMENT
/begin MEASUREMENT EpmSeq_numIntTyp "type of current interrupt" UBYTE OneToOne 1 100 0.00 255.0 FORMAT "%5.1" ECU_ADDRESS 0x400063D8 /end MEASUREMENT
/begin MEASUREMENT EpmSeq_numMainSyncIdx "Index corresponding to main synchro poistion" UBYTE OneToOne 1 100 0.00 255.0 FORMAT "%5.1" ECU_ADDRESS 0x400063D7 /end MEASUREMENT
/begin MEASUREMENT EpmSeq_phiIntMainAbslt "Abolute position of main synchro" SWORD AngleCrS 1 100 -720.0000 719.9780 FORMAT "%8.4" ECU_ADDRESS 0x40005C62 /end MEASUREMENT
/begin MEASUREMENT EpmSeq_phiNxtInt "angle of the next syncrointerrupt" SWORD AngleCrS 1 100 0.00 719.9780 FORMAT "%8.4" ECU_ADDRESS 0x40006024
 /begin IF_DATA XCPplus 0x0102
  /begin DAQ_EVENT VARIABLE /begin AVAILABLE_EVENT_LIST EVENT 0 EVENT 1 EVENT 2 EVENT 3 /end AVAILABLE_EVENT_LIST /begin DEFAULT_EVENT_LIST EVENT 0 /end DEFAULT_EVENT_LIST /end DAQ_EVENT
 /end IF_DATA
/end MEASUREMENT
/begin MEASUREMENT EpmSeq_stInt "status of sequencemanager" UBYTE EpmSeq_stInt_Compu 1 100 0.00 8.00000000000 FORMAT "%13.11" ECU_ADDRESS 0x400064C3
 /begin IF_DATA XCPplus 0x0102
  /begin DAQ_EVENT VARIABLE /begin AVAILABLE_EVENT_LIST EVENT 0 EVENT 1 EVENT 2 EVENT 3 /end AVAILABLE_EVENT_LIST /begin DEFAULT_EVENT_LIST EVENT 0 /end DEFAULT_EVENT_LIST /end DAQ_EVENT
 /end IF_DATA
/end MEASUREMENT
/begin MEASUREMENT EpmSeq_swtInt "switch to activate S_0 interrupt functionality of the sequence-manager" UBYTE OneToOne 1 100 0.00 255.0 FORMAT "%5.1" ECU_ADDRESS 0x400062B7
 /begin IF_DATA XCPplus 0x0102
  /begin DAQ_EVENT VARIABLE /begin AVAILABLE_EVENT_LIST EVENT 0 EVENT 1 EVENT 2 EVENT 3 /end AVAILABLE_EVENT_LIST /begin DEFAULT_EVENT_LIST EVENT 0 /end DEFAULT_EVENT_LIST /end DAQ_EVENT
 /end IF_DATA
/end MEASUREMENT
/begin MEASUREMENT EpmSrv_stCnvAgT2Ag_mp "Internal state of the function EpmSrv_CnvAgT2Ag" UBYTE EpmSrv_stCnvAgT2Ag_t 1 100 0.00 255.000000000 FORMAT "%13.9" ECU_ADDRESS 0x40009E2F /end MEASUREMENT
/begin MEASUREMENT EpmSyn_cntrFailrCrksftToothT "Counter for consecutive failed gradient checks" UBYTE OneToOne 1 100 0.00 255.0 FORMAT "%5.1" ECU_ADDRESS 0x400062B2
 /begin IF_DATA XCPplus 0x0102
  /begin DAQ_EVENT VARIABLE /begin AVAILABLE_EVENT_LIST EVENT 0 EVENT 1 EVENT 2 EVENT 3 /end AVAILABLE_EVENT_LIST /begin DEFAULT_EVENT_LIST EVENT 0 /end DEFAULT_EVENT_LIST /end DAQ_EVENT
 /end IF_DATA
/end MEASUREMENT
/begin MEASUREMENT EpmSyn_cntrValChkCrksftToothT "Phase validation counter" UBYTE OneToOne 1 100 0.00 255.0 FORMAT "%5.1" ECU_ADDRESS 0x400062B1
 /begin IF_DATA XCPplus 0x0102
  /begin DAQ_EVENT VARIABLE /begin AVAILABLE_EVENT_LIST EVENT 0 EVENT 1 EVENT 2 EVENT 3 /end AVAILABLE_EVENT_LIST /begin DEFAULT_EVENT_LIST EVENT 0 /end DEFAULT_EVENT_LIST /end DAQ_EVENT
 /end IF_DATA
/end MEASUREMENT
/begin MEASUREMENT EpmSyn_ctCalcAgQlLo_mp "Count of Active configuration synchronized with low angle quality" UBYTE OneToOne 1 100 0.00 255.0 FORMAT "%5.1" ECU_ADDRESS 0x40009E2E
 /begin IF_DATA XCPplus 0x0102
  /begin DAQ_EVENT VARIABLE /begin AVAILABLE_EVENT_LIST EVENT 0 EVENT 1 EVENT 2 EVENT 3 /end AVAILABLE_EVENT_LIST /begin DEFAULT_EVENT_LIST EVENT 0 /end DEFAULT_EVENT_LIST /end DAQ_EVENT
 /end IF_DATA
/end MEASUREMENT
/begin MEASUREMENT EpmSyn_ctIncAccCrksftToothT_mp "Measuremnt which gives whether engine in accelaration or not" UBYTE OneToOne 1 100 0.00 255.0 FORMAT "%5.1" ECU_ADDRESS 0x40009E25
 /begin IF_DATA XCPplus 0x0102
  /begin DAQ_EVENT VARIABLE /begin AVAILABLE_EVENT_LIST EVENT 0 EVENT 1 EVENT 2 EVENT 3 /end AVAILABLE_EVENT_LIST /begin DEFAULT_EVENT_LIST EVENT 0 /end DEFAULT_EVENT_LIST /end DAQ_EVENT
 /end IF_DATA
/end MEASUREMENT
/begin MEASUREMENT EpmSyn_ctIncDecCrksftToothT_mp "Measuremnt which gives whether engine in deccelaration or not" UBYTE OneToOne 1 100 0.00 255.0 FORMAT "%5.1" ECU_ADDRESS 0x40009E24
 /begin IF_DATA XCPplus 0x0102
  /begin DAQ_EVENT VARIABLE /begin AVAILABLE_EVENT_LIST EVENT 0 EVENT 1 EVENT 2 EVENT 3 /end AVAILABLE_EVENT_LIST /begin DEFAULT_EVENT_LIST EVENT 0 /end DEFAULT_EVENT_LIST /end DAQ_EVENT
 /end IF_DATA
/end MEASUREMENT
/begin MEASUREMENT EpmSyn_ctIncDiffCrksftToothT_mp "Number of crankshaft teeth from last detected Gap to current position" SWORD OneToOne 1 100 -32768.00 32767.00 FORMAT "%8.2" ECU_ADDRESS 0x40009DB6
 /begin IF_DATA XCPplus 0x0102
  /begin DAQ_EVENT VARIABLE /begin AVAILABLE_EVENT_LIST EVENT 0 EVENT 1 EVENT 2 EVENT 3 /end AVAILABLE_EVENT_LIST /begin DEFAULT_EVENT_LIST EVENT 0 /end DEFAULT_EVENT_LIST /end DAQ_EVENT
 /end IF_DATA
/end MEASUREMENT
/begin MEASUREMENT EpmSyn_ctIncGapCrksftToothT_mp "Crankshaft increment counter at last detected gap" SWORD OneToOne 1 100 -32768.00 32767.00 FORMAT "%8.2" ECU_ADDRESS 0x40009DB4
 /begin IF_DATA XCPplus 0x0102
  /begin DAQ_EVENT VARIABLE /begin AVAILABLE_EVENT_LIST EVENT 0 EVENT 1 EVENT 2 EVENT 3 /end AVAILABLE_EVENT_LIST /begin DEFAULT_EVENT_LIST EVENT 0 /end DEFAULT_EVENT_LIST /end DAQ_EVENT
 /end IF_DATA
/end MEASUREMENT
/begin MEASUREMENT EpmSyn_ctIncRGapCrksftToothT_mp "Crankshaft increment counter at reference gap" SWORD OneToOne 1 100 -32768.00 32767.00 FORMAT "%8.2" ECU_ADDRESS 0x40009DB2
 /begin IF_DATA XCPplus 0x0102
  /begin DAQ_EVENT VARIABLE /begin AVAILABLE_EVENT_LIST EVENT 0 EVENT 1 EVENT 2 EVENT 3 /end AVAILABLE_EVENT_LIST /begin DEFAULT_EVENT_LIST EVENT 0 /end DEFAULT_EVENT_LIST /end DAQ_EVENT
 /end IF_DATA
/end MEASUREMENT
/begin MEASUREMENT EpmSyn_ctIncRTdcCrksftToothT_mp "Crankshaft increment counter at reference TDC" SWORD OneToOne 1 100 -32768.00 32767.00 FORMAT "%8.2" ECU_ADDRESS 0x40009DB0
 /begin IF_DATA XCPplus 0x0102
  /begin DAQ_EVENT VARIABLE /begin AVAILABLE_EVENT_LIST EVENT 0 EVENT 1 EVENT 2 EVENT 3 /end AVAILABLE_EVENT_LIST /begin DEFAULT_EVENT_LIST EVENT 0 /end DEFAULT_EVENT_LIST /end DAQ_EVENT
 /end IF_DATA
/end MEASUREMENT
/begin MEASUREMENT EpmSyn_ctIncStrCrksftToothT_mp "Crankshaft increment counter at start of TDC search" SWORD OneToOne 1 100 -32768.00 32767.00 FORMAT "%8.2" ECU_ADDRESS 0x40009DAE
 /begin IF_DATA XCPplus 0x0102
  /begin DAQ_EVENT VARIABLE /begin AVAILABLE_EVENT_LIST EVENT 0 EVENT 1 EVENT 2 EVENT 3 /end AVAILABLE_EVENT_LIST /begin DEFAULT_EVENT_LIST EVENT 0 /end DEFAULT_EVENT_LIST /end DAQ_EVENT
 /end IF_DATA
/end MEASUREMENT
/begin MEASUREMENT EpmSyn_ctIncTmpCrksftToothT_mp "Crankshaft increment counter at last buffer entry" UWORD OneToOne 1 100 0.00 65535.00 FORMAT "%8.2" ECU_ADDRESS 0x40009DAC
 /begin IF_DATA XCPplus 0x0102
  /begin DAQ_EVENT VARIABLE /begin AVAILABLE_EVENT_LIST EVENT 0 EVENT 1 EVENT 2 EVENT 3 /end AVAILABLE_EVENT_LIST /begin DEFAULT_EVENT_LIST EVENT 0 /end DEFAULT_EVENT_LIST /end DAQ_EVENT
 /end IF_DATA
/end MEASUREMENT
/begin MEASUREMENT EpmSyn_ctRatQl_mp "Count of equal quality angles in the active configuration" UBYTE OneToOne 1 100 0.00 255.0 FORMAT "%5.1" ECU_ADDRESS 0x40009E2D
 /begin IF_DATA XCPplus 0x0102
  /begin DAQ_EVENT VARIABLE /begin AVAILABLE_EVENT_LIST EVENT 0 EVENT 1 EVENT 2 EVENT 3 /end AVAILABLE_EVENT_LIST /begin DEFAULT_EVENT_LIST EVENT 0 /end DEFAULT_EVENT_LIST /end DAQ_EVENT
 /end IF_DATA
/end MEASUREMENT
/begin MEASUREMENT EpmSyn_facWghSum_mp "Sum of all weighting factors of all active methods in current configuration." SWORD Fact1 1 100 -256.0000 255.9922 FORMAT "%8.4" ECU_ADDRESS 0x40009DCA
 /begin IF_DATA XCPplus 0x0102
  /begin DAQ_EVENT VARIABLE /begin AVAILABLE_EVENT_LIST EVENT 0 EVENT 1 EVENT 2 EVENT 3 /end AVAILABLE_EVENT_LIST /begin DEFAULT_EVENT_LIST EVENT 0 /end DEFAULT_EVENT_LIST /end DAQ_EVENT
 /end IF_DATA
/end MEASUREMENT
/begin MEASUREMENT EpmSyn_flgEnaCrksftToothT "Flag to check enable conditions for Tooth time algorithm are met" UBYTE OneToOne 1 100 0.00 255.0 BIT_MASK 0x1 FORMAT "%5.1" ECU_ADDRESS 0x400062B0
 /begin IF_DATA XCPplus 0x0102
  /begin DAQ_EVENT VARIABLE /begin AVAILABLE_EVENT_LIST EVENT 0 EVENT 1 EVENT 2 EVENT 3 /end AVAILABLE_EVENT_LIST /begin DEFAULT_EVENT_LIST EVENT 0 /end DEFAULT_EVENT_LIST /end DAQ_EVENT
 /end IF_DATA
/end MEASUREMENT
/begin MEASUREMENT EpmSyn_idxWrTmpCrksftToothT_mp "Index to latest buffer entry in crankshaft buffer" SWORD OneToOne 1 100 -32768.00 32767.00 FORMAT "%8.2" ECU_ADDRESS 0x40009DAA
 /begin IF_DATA XCPplus 0x0102
  /begin DAQ_EVENT VARIABLE /begin AVAILABLE_EVENT_LIST EVENT 0 EVENT 1 EVENT 2 EVENT 3 /end AVAILABLE_EVENT_LIST /begin DEFAULT_EVENT_LIST EVENT 0 /end DEFAULT_EVENT_LIST /end DAQ_EVENT
 /end IF_DATA
/end MEASUREMENT
/begin MEASUREMENT EpmSyn_IncStr2TdcCrksftToothT_mp "Number of increments to next reference TDC" SWORD OneToOne 1 100 -32768.00 32767.00 FORMAT "%8.2" ECU_ADDRESS 0x40009DA8
 /begin IF_DATA XCPplus 0x0102
  /begin DAQ_EVENT VARIABLE /begin AVAILABLE_EVENT_LIST EVENT 0 EVENT 1 EVENT 2 EVENT 3 /end AVAILABLE_EVENT_LIST /begin DEFAULT_EVENT_LIST EVENT 0 /end DEFAULT_EVENT_LIST /end DAQ_EVENT
 /end IF_DATA
/end MEASUREMENT
/begin MEASUREMENT EpmSyn_IncStr2WinEndCrksftToothT_mp "Number of increments from start to window end" SWORD OneToOne 1 100 -32768.00 32767.00 FORMAT "%8.2" ECU_ADDRESS 0x40009DA6
 /begin IF_DATA XCPplus 0x0102
  /begin DAQ_EVENT VARIABLE /begin AVAILABLE_EVENT_LIST EVENT 0 EVENT 1 EVENT 2 EVENT 3 /end AVAILABLE_EVENT_LIST /begin DEFAULT_EVENT_LIST EVENT 0 /end DEFAULT_EVENT_LIST /end DAQ_EVENT
 /end IF_DATA
/end MEASUREMENT
/begin MEASUREMENT EpmSyn_IncTdc2CurCrksftToothT_mp "Number of increments from last reference TDC to current position" SWORD OneToOne 1 100 -32768.00 32767.00 FORMAT "%8.2" ECU_ADDRESS 0x40009DA4
 /begin IF_DATA XCPplus 0x0102
  /begin DAQ_EVENT VARIABLE /begin AVAILABLE_EVENT_LIST EVENT 0 EVENT 1 EVENT 2 EVENT 3 /end AVAILABLE_EVENT_LIST /begin DEFAULT_EVENT_LIST EVENT 0 /end DEFAULT_EVENT_LIST /end DAQ_EVENT
 /end IF_DATA
/end MEASUREMENT
/begin MEASUREMENT EpmSyn_IncWinEnd2CurCrksftToothT_mp "Number of increments from window end point to current position" SWORD OneToOne 1 100 -32768.00 32767.00 FORMAT "%8.2" ECU_ADDRESS 0x40009DA2
 /begin IF_DATA XCPplus 0x0102
  /begin DAQ_EVENT VARIABLE /begin AVAILABLE_EVENT_LIST EVENT 0 EVENT 1 EVENT 2 EVENT 3 /end AVAILABLE_EVENT_LIST /begin DEFAULT_EVENT_LIST EVENT 0 /end DEFAULT_EVENT_LIST /end DAQ_EVENT
 /end IF_DATA
/end MEASUREMENT
/begin MEASUREMENT EpmSyn_nrGrdChkCrksftToothT_mp "Total number of gradient checks performed." UWORD OneToOne 1 100 0.00 65535.00 FORMAT "%8.2" ECU_ADDRESS 0x40009DA0
 /begin IF_DATA XCPplus 0x0102
  /begin DAQ_EVENT VARIABLE /begin AVAILABLE_EVENT_LIST EVENT 0 EVENT 1 EVENT 2 EVENT 3 /end AVAILABLE_EVENT_LIST /begin DEFAULT_EVENT_LIST EVENT 0 /end DEFAULT_EVENT_LIST /end DAQ_EVENT
 /end IF_DATA
/end MEASUREMENT
/begin MEASUREMENT EpmSyn_nrGrdFailCrksftToothT_mp "Total number of Gradient checks failed" UWORD OneToOne 1 100 0.00 65535.00 FORMAT "%8.2" ECU_ADDRESS 0x40009D9E
 /begin IF_DATA XCPplus 0x0102
  /begin DAQ_EVENT VARIABLE /begin AVAILABLE_EVENT_LIST EVENT 0 EVENT 1 EVENT 2 EVENT 3 /end AVAILABLE_EVENT_LIST /begin DEFAULT_EVENT_LIST EVENT 0 /end DEFAULT_EVENT_LIST /end DAQ_EVENT
 /end IF_DATA
/end MEASUREMENT
/begin MEASUREMENT EpmSyn_nrSynFailCrksftToothT_mp "Total number of synchronization failures" UWORD OneToOne 1 100 0.00 65535.00 FORMAT "%8.2" ECU_ADDRESS 0x40009D9C
 /begin IF_DATA XCPplus 0x0102
  /begin DAQ_EVENT VARIABLE /begin AVAILABLE_EVENT_LIST EVENT 0 EVENT 1 EVENT 2 EVENT 3 /end AVAILABLE_EVENT_LIST /begin DEFAULT_EVENT_LIST EVENT 0 /end DEFAULT_EVENT_LIST /end DAQ_EVENT
 /end IF_DATA
/end MEASUREMENT
/begin MEASUREMENT EpmSyn_nrSynSucCrksftToothT_mp "Total number of successful synchronizations" UWORD OneToOne 1 100 0.00 65535.00 FORMAT "%8.2" ECU_ADDRESS 0x40009D9A
 /begin IF_DATA XCPplus 0x0102
  /begin DAQ_EVENT VARIABLE /begin AVAILABLE_EVENT_LIST EVENT 0 EVENT 1 EVENT 2 EVENT 3 /end AVAILABLE_EVENT_LIST /begin DEFAULT_EVENT_LIST EVENT 0 /end DEFAULT_EVENT_LIST /end DAQ_EVENT
 /end IF_DATA
/end MEASUREMENT
/begin MEASUREMENT EpmSyn_numActvCfg_mp "Current Active configuration number" UBYTE EPMSYN_NUMSYNCCFG_VERB 1 100 0.00 10.0000000000 FORMAT "%13.10" ECU_ADDRESS 0x40009E2C
 /begin IF_DATA XCPplus 0x0102
  /begin DAQ_EVENT VARIABLE /begin AVAILABLE_EVENT_LIST EVENT 0 EVENT 1 EVENT 2 EVENT 3 /end AVAILABLE_EVENT_LIST /begin DEFAULT_EVENT_LIST EVENT 0 /end DEFAULT_EVENT_LIST /end DAQ_EVENT
 /end IF_DATA
/end MEASUREMENT
/begin MEASUREMENT EpmSyn_numActvMethod_mp "Active method number" UBYTE EPMSYN_NUMACTVMETHOD_VERB 1 100 0.00 7.00000000000 FORMAT "%13.11" ECU_ADDRESS 0x40009E2B /end MEASUREMENT
/begin MEASUREMENT EpmSyn_numCalcCo "Next calculated configuration number" ULONG OneToOne 1 100 0.00 4294967295.00 FORMAT "%13.2" ECU_ADDRESS 0x400048C4
 /begin IF_DATA XCPplus 0x0102
  /begin DAQ_EVENT VARIABLE /begin AVAILABLE_EVENT_LIST EVENT 0 EVENT 1 EVENT 2 EVENT 3 /end AVAILABLE_EVENT_LIST /begin DEFAULT_EVENT_LIST EVENT 0 /end DEFAULT_EVENT_LIST /end DAQ_EVENT
 /end IF_DATA
/end MEASUREMENT
/begin MEASUREMENT EpmSyn_numIntTyp "Interrupt-type that caused the current EPM-interrupt on the CPU" ULONG OneToOne 1 100 0.00 4294967295.00 FORMAT "%13.2" ECU_ADDRESS 0x400048C0
 /begin IF_DATA XCPplus 0x0102
  /begin DAQ_EVENT VARIABLE /begin AVAILABLE_EVENT_LIST EVENT 0 EVENT 1 EVENT 2 EVENT 3 /end AVAILABLE_EVENT_LIST /begin DEFAULT_EVENT_LIST EVENT 0 /end DEFAULT_EVENT_LIST /end DAQ_EVENT
 /end IF_DATA
/end MEASUREMENT
/begin MEASUREMENT EpmSyn_numNxtCfgAgQlLo_mp "Next Configuration number in case current configuration synchronized, but with low angle quality." UBYTE EPMSYN_NUMSYNCCFG_VERB 1 100 0.00 10.0000000000 FORMAT "%13.10" ECU_ADDRESS 0x40009E2A
 /begin IF_DATA XCPplus 0x0102
  /begin DAQ_EVENT VARIABLE /begin AVAILABLE_EVENT_LIST EVENT 0 EVENT 1 EVENT 2 EVENT 3 /end AVAILABLE_EVENT_LIST /begin DEFAULT_EVENT_LIST EVENT 0 /end DEFAULT_EVENT_LIST /end DAQ_EVENT
 /end IF_DATA
/end MEASUREMENT
/begin MEASUREMENT EpmSyn_numNxtCfgSyncFail_mp "Next Configuration Number if the Current Active Configuration failed" UBYTE EPMSYN_NUMSYNCCFG_VERB 1 100 0.00 10.0000000000 FORMAT "%13.10" ECU_ADDRESS 0x40009E29
 /begin IF_DATA XCPplus 0x0102
  /begin DAQ_EVENT VARIABLE /begin AVAILABLE_EVENT_LIST EVENT 0 EVENT 1 EVENT 2 EVENT 3 /end AVAILABLE_EVENT_LIST /begin DEFAULT_EVENT_LIST EVENT 0 /end DEFAULT_EVENT_LIST /end DAQ_EVENT
 /end IF_DATA
/end MEASUREMENT
/begin MEASUREMENT EpmSyn_numNxtCfg_mp "Next configuration to be selected" UBYTE EPMSYN_NUMSYNCCFG_VERB 1 100 0.00 10.0000000000 FORMAT "%13.10" ECU_ADDRESS 0x40009E28
 /begin IF_DATA XCPplus 0x0102
  /begin DAQ_EVENT VARIABLE /begin AVAILABLE_EVENT_LIST EVENT 0 EVENT 1 EVENT 2 EVENT 3 /end AVAILABLE_EVENT_LIST /begin DEFAULT_EVENT_LIST EVENT 0 /end DEFAULT_EVENT_LIST /end DAQ_EVENT
 /end IF_DATA
/end MEASUREMENT
/begin MEASUREMENT EpmSyn_numSyncFaildAgQlLo_mp "Number of times all the activated methods synchronized with low angle quality" UWORD OneToOne 1 100 0.00 65535.00 FORMAT "%8.2" ECU_ADDRESS 0x40009DC8
 /begin IF_DATA XCPplus 0x0102
  /begin DAQ_EVENT VARIABLE /begin AVAILABLE_EVENT_LIST EVENT 0 EVENT 1 EVENT 2 EVENT 3 /end AVAILABLE_EVENT_LIST /begin DEFAULT_EVENT_LIST EVENT 0 /end DEFAULT_EVENT_LIST /end DAQ_EVENT
 /end IF_DATA
/end MEASUREMENT
/begin MEASUREMENT EpmSyn_numVaidThCrksftToothT_mp "Number of valid crankshaft teeth in buffer" SWORD OneToOne 1 100 -32768.00 32767.00 FORMAT "%8.2" ECU_ADDRESS 0x40009D98
 /begin IF_DATA XCPplus 0x0102
  /begin DAQ_EVENT VARIABLE /begin AVAILABLE_EVENT_LIST EVENT 0 EVENT 1 EVENT 2 EVENT 3 /end AVAILABLE_EVENT_LIST /begin DEFAULT_EVENT_LIST EVENT 0 /end DEFAULT_EVENT_LIST /end DAQ_EVENT
 /end IF_DATA
/end MEASUREMENT
/begin MEASUREMENT EpmSyn_phiAbs "Current absolute engine position" SWORD AngleCrS 1 100 -720.0000 719.9780 FORMAT "%8.4" ECU_ADDRESS 0x40005DB0
 /begin IF_DATA XCPplus 0x0102
  /begin DAQ_EVENT VARIABLE /begin AVAILABLE_EVENT_LIST EVENT 0 EVENT 1 EVENT 2 EVENT 3 /end AVAILABLE_EVENT_LIST /begin DEFAULT_EVENT_LIST EVENT 0 /end DEFAULT_EVENT_LIST /end DAQ_EVENT
 /end IF_DATA
/end MEASUREMENT
/begin MEASUREMENT EpmSyn_phiAbsCrksftPat_mp "Current absolute engine position determined by crankshaft pattern evaluation" SWORD AngleCrS 1 100 -720.0000 719.9780 FORMAT "%8.4" ARRAY_SIZE 2 ECU_ADDRESS 0x40009DBC
 /begin IF_DATA XCPplus 0x0102
  /begin DAQ_EVENT VARIABLE /begin AVAILABLE_EVENT_LIST EVENT 0 EVENT 1 EVENT 2 EVENT 3 /end AVAILABLE_EVENT_LIST /begin DEFAULT_EVENT_LIST EVENT 0 /end DEFAULT_EVENT_LIST /end DAQ_EVENT
 /end IF_DATA
/end MEASUREMENT
/begin MEASUREMENT EpmSyn_phiAbsCrksftToothT_mp "Current absolute engine position angle" SWORD AngleCrS 1 100 -720.0000 719.9780 FORMAT "%8.4" ARRAY_SIZE 1 ECU_ADDRESS 0x40009D96
 /begin IF_DATA XCPplus 0x0102
  /begin DAQ_EVENT VARIABLE /begin AVAILABLE_EVENT_LIST EVENT 0 EVENT 1 EVENT 2 EVENT 3 /end AVAILABLE_EVENT_LIST /begin DEFAULT_EVENT_LIST EVENT 0 /end DEFAULT_EVENT_LIST /end DAQ_EVENT
 /end IF_DATA
/end MEASUREMENT
/begin MEASUREMENT EpmSyn_phiIncCor_mp "Correction value to transform the ECU-internal angle base into the physical angle base of the engine" SWORD AngleCrS 1 100 -720.0000 719.9780 FORMAT "%8.4" ECU_ADDRESS 0x40009DC6
 /begin IF_DATA XCPplus 0x0102
  /begin DAQ_EVENT VARIABLE /begin AVAILABLE_EVENT_LIST EVENT 0 EVENT 1 EVENT 2 EVENT 3 /end AVAILABLE_EVENT_LIST /begin DEFAULT_EVENT_LIST EVENT 0 /end DEFAULT_EVENT_LIST /end DAQ_EVENT
 /end IF_DATA
/end MEASUREMENT
/begin MEASUREMENT EpmSyn_phiInt "Position of syncro interrupt" SWORD AngleCrS 1 100 -720.0000 719.9780 FORMAT "%8.4" ECU_ADDRESS 0x40005DAE
 /begin IF_DATA XCPplus 0x0102
  /begin DAQ_EVENT VARIABLE /begin AVAILABLE_EVENT_LIST EVENT 0 EVENT 1 EVENT 2 EVENT 3 /end AVAILABLE_EVENT_LIST /begin DEFAULT_EVENT_LIST EVENT 0 /end DEFAULT_EVENT_LIST /end DAQ_EVENT
 /end IF_DATA
/end MEASUREMENT
/begin MEASUREMENT EpmSyn_phiOffs "Synchronisation offset" SWORD AngleCrS 1 100 -720.0000 719.9780 FORMAT "%8.4" ECU_ADDRESS 0x40005C5C
 /begin IF_DATA XCPplus 0x0102
  /begin DAQ_EVENT VARIABLE /begin AVAILABLE_EVENT_LIST EVENT 0 EVENT 1 EVENT 2 EVENT 3 /end AVAILABLE_EVENT_LIST /begin DEFAULT_EVENT_LIST EVENT 0 /end DEFAULT_EVENT_LIST /end DAQ_EVENT
 /end IF_DATA
/end MEASUREMENT
/begin MEASUREMENT EpmSyn_phiOffsCor "correction of the synchronisation offset EpmSyn_phiOffsCor" SWORD AngleCrS 1 100 -720.0000 719.9780 FORMAT "%8.4" ECU_ADDRESS 0x40005C5A
 /begin IF_DATA XCPplus 0x0102
  /begin DAQ_EVENT VARIABLE /begin AVAILABLE_EVENT_LIST EVENT 0 EVENT 1 EVENT 2 EVENT 3 /end AVAILABLE_EVENT_LIST /begin DEFAULT_EVENT_LIST EVENT 0 /end DEFAULT_EVENT_LIST /end DAQ_EVENT
 /end IF_DATA
/end MEASUREMENT
/begin MEASUREMENT EpmSyn_phiOffsCrksftToothT_mp "Synchronization offset" SWORD AngleCrS 1 100 -720.0000 719.9780 FORMAT "%8.4" ARRAY_SIZE 1 ECU_ADDRESS 0x40009D94
 /begin IF_DATA XCPplus 0x0102
  /begin DAQ_EVENT VARIABLE /begin AVAILABLE_EVENT_LIST EVENT 0 EVENT 1 EVENT 2 EVENT 3 /end AVAILABLE_EVENT_LIST /begin DEFAULT_EVENT_LIST EVENT 0 /end DEFAULT_EVENT_LIST /end DAQ_EVENT
 /end IF_DATA
/end MEASUREMENT
/begin MEASUREMENT EpmSyn_phiOffsDblIgn_mp "Offset angle calculated by Double ignition mode" SWORD AngleCrS 1 100 -720.0000 719.9780 FORMAT "%8.4" ECU_ADDRESS 0x40009DC4
 /begin IF_DATA XCPplus 0x0102
  /begin DAQ_EVENT VARIABLE /begin AVAILABLE_EVENT_LIST EVENT 0 EVENT 1 EVENT 2 EVENT 3 /end AVAILABLE_EVENT_LIST /begin DEFAULT_EVENT_LIST EVENT 0 /end DEFAULT_EVENT_LIST /end DAQ_EVENT
 /end IF_DATA
/end MEASUREMENT
/begin MEASUREMENT EpmSyn_rAgQlCrksftPat_mp "Quality factor assigned to the calculated angle distribution" SWORD Prc 1 100 -400.0000 399.9878 FORMAT "%8.4" ARRAY_SIZE 2 ECU_ADDRESS 0x40009DB8
 /begin IF_DATA XCPplus 0x0102
  /begin DAQ_EVENT VARIABLE /begin AVAILABLE_EVENT_LIST EVENT 0 EVENT 1 EVENT 2 EVENT 3 /end AVAILABLE_EVENT_LIST /begin DEFAULT_EVENT_LIST EVENT 0 /end DEFAULT_EVENT_LIST /end DAQ_EVENT
 /end IF_DATA
/end MEASUREMENT
/begin MEASUREMENT EpmSyn_rAgQlCrksftToothT_mp "Quality factors assigned to the calculated angle distribution" SWORD Prc 1 100 -400.0000 399.9878 FORMAT "%8.4" ARRAY_SIZE 1 ECU_ADDRESS 0x40009D92
 /begin IF_DATA XCPplus 0x0102
  /begin DAQ_EVENT VARIABLE /begin AVAILABLE_EVENT_LIST EVENT 0 EVENT 1 EVENT 2 EVENT 3 /end AVAILABLE_EVENT_LIST /begin DEFAULT_EVENT_LIST EVENT 0 /end DEFAULT_EVENT_LIST /end DAQ_EVENT
 /end IF_DATA
/end MEASUREMENT
/begin MEASUREMENT EpmSyn_rAgQlFulSync_mp "Required angle quality for Full Sync with current Active Configuration" SWORD Prc 1 100 -400.0000 399.9878 FORMAT "%8.4" ECU_ADDRESS 0x40009DC2
 /begin IF_DATA XCPplus 0x0102
  /begin DAQ_EVENT VARIABLE /begin AVAILABLE_EVENT_LIST EVENT 0 EVENT 1 EVENT 2 EVENT 3 /end AVAILABLE_EVENT_LIST /begin DEFAULT_EVENT_LIST EVENT 0 /end DEFAULT_EVENT_LIST /end DAQ_EVENT
 /end IF_DATA
/end MEASUREMENT
/begin MEASUREMENT EpmSyn_rAgQl_mp "Calculated angle Quality factor for the active configuration" SWORD Prc 1 100 -400.0000 399.9878 FORMAT "%8.4" ECU_ADDRESS 0x40009DC0
 /begin IF_DATA XCPplus 0x0102
  /begin DAQ_EVENT VARIABLE /begin AVAILABLE_EVENT_LIST EVENT 0 EVENT 1 EVENT 2 EVENT 3 /end AVAILABLE_EVENT_LIST /begin DEFAULT_EVENT_LIST EVENT 0 /end DEFAULT_EVENT_LIST /end DAQ_EVENT
 /end IF_DATA
/end MEASUREMENT
/begin MEASUREMENT EpmSyn_RGap2TdcCrksftToothT_mp "Number of crankshaft increments from reference gap to TDC" SWORD OneToOne 1 100 -32768.00 32767.00 FORMAT "%8.2" ECU_ADDRESS 0x40009D90
 /begin IF_DATA XCPplus 0x0102
  /begin DAQ_EVENT VARIABLE /begin AVAILABLE_EVENT_LIST EVENT 0 EVENT 1 EVENT 2 EVENT 3 /end AVAILABLE_EVENT_LIST /begin DEFAULT_EVENT_LIST EVENT 0 /end DEFAULT_EVENT_LIST /end DAQ_EVENT
 /end IF_DATA
/end MEASUREMENT
/begin MEASUREMENT EpmSyn_stEnaCrksftToothT_mp "Activation of the synchronization method is released by the synchronization coordinator (when TRUE)" UBYTE OneToOne 1 100 0.00 255.0 BIT_MASK 0x1 FORMAT "%5.1" ECU_ADDRESS 0x40009E22
 /begin IF_DATA XCPplus 0x0102
  /begin DAQ_EVENT VARIABLE /begin AVAILABLE_EVENT_LIST EVENT 0 EVENT 1 EVENT 2 EVENT 3 /end AVAILABLE_EVENT_LIST /begin DEFAULT_EVENT_LIST EVENT 0 /end DEFAULT_EVENT_LIST /end DAQ_EVENT
 /end IF_DATA
/end MEASUREMENT
/begin MEASUREMENT EpmSyn_stEnaDblIgn "Condition: Activate double ignition mode" UBYTE OneToOne 1 100 0.00 255.0 BIT_MASK 0x1 FORMAT "%5.1" ECU_ADDRESS 0x400063AE
 /begin IF_DATA XCPplus 0x0102
  /begin DAQ_EVENT VARIABLE /begin AVAILABLE_EVENT_LIST EVENT 0 EVENT 1 EVENT 2 EVENT 3 /end AVAILABLE_EVENT_LIST /begin DEFAULT_EVENT_LIST EVENT 0 /end DEFAULT_EVENT_LIST /end DAQ_EVENT
 /end IF_DATA
/end MEASUREMENT
/begin MEASUREMENT EpmSyn_stITDCDetCrksftToothT "Ignition TDC position identified by crankshaft tooth time evaluation" UBYTE OneToOne 1 100 0.00 255.0 BIT_MASK 0x1 FORMAT "%5.1" ECU_ADDRESS 0x400063AC
 /begin IF_DATA XCPplus 0x0102
  /begin DAQ_EVENT VARIABLE /begin AVAILABLE_EVENT_LIST EVENT 0 EVENT 1 EVENT 2 EVENT 3 /end AVAILABLE_EVENT_LIST /begin DEFAULT_EVENT_LIST EVENT 0 /end DEFAULT_EVENT_LIST /end DAQ_EVENT
 /end IF_DATA
/end MEASUREMENT
/begin MEASUREMENT EpmSyn_stPhaCorrn "Condition: Corrections after phase detection" UBYTE OneToOne 1 100 0.00 255.0 BIT_MASK 0x1 FORMAT "%5.1" ECU_ADDRESS 0x400063AA
 /begin IF_DATA XCPplus 0x0102
  /begin DAQ_EVENT VARIABLE /begin AVAILABLE_EVENT_LIST EVENT 0 EVENT 1 EVENT 2 EVENT 3 /end AVAILABLE_EVENT_LIST /begin DEFAULT_EVENT_LIST EVENT 0 /end DEFAULT_EVENT_LIST /end DAQ_EVENT
 /end IF_DATA
/end MEASUREMENT
/begin MEASUREMENT EpmSyn_stPhaSyncn "Status of Phase synchronization" UBYTE OneToOne 1 100 0.00 255.0 BIT_MASK 0x1 FORMAT "%5.1" ECU_ADDRESS 0x400063A9
 /begin IF_DATA XCPplus 0x0102
  /begin DAQ_EVENT VARIABLE /begin AVAILABLE_EVENT_LIST EVENT 0 EVENT 1 EVENT 2 EVENT 3 /end AVAILABLE_EVENT_LIST /begin DEFAULT_EVENT_LIST EVENT 0 /end DEFAULT_EVENT_LIST /end DAQ_EVENT
 /end IF_DATA
/end MEASUREMENT
/begin MEASUREMENT EpmSyn_stRecalcnCrksftToothT_mp "Phase recalculation request from synchronization coordinator" UBYTE OneToOne 1 100 0.00 255.0 BIT_MASK 0x1 FORMAT "%5.1" ECU_ADDRESS 0x40009E21
 /begin IF_DATA XCPplus 0x0102
  /begin DAQ_EVENT VARIABLE /begin AVAILABLE_EVENT_LIST EVENT 0 EVENT 1 EVENT 2 EVENT 3 /end AVAILABLE_EVENT_LIST /begin DEFAULT_EVENT_LIST EVENT 0 /end DEFAULT_EVENT_LIST /end DAQ_EVENT
 /end IF_DATA
/end MEASUREMENT
/begin MEASUREMENT EpmSyn_stRevCrSDblIgn "Minimum number of crank revolutions over to activate double ignition mode" UBYTE OneToOne 1 100 0.00 255.0 BIT_MASK 0x1 FORMAT "%5.1" ECU_ADDRESS 0x400062B3
 /begin IF_DATA XCPplus 0x0102
  /begin DAQ_EVENT VARIABLE /begin AVAILABLE_EVENT_LIST EVENT 0 EVENT 1 EVENT 2 EVENT 3 /end AVAILABLE_EVENT_LIST /begin DEFAULT_EVENT_LIST EVENT 0 /end DEFAULT_EVENT_LIST /end DAQ_EVENT
 /end IF_DATA
/end MEASUREMENT
/begin MEASUREMENT EpmSyn_stStrtDlyToothT "Flag to indicate the delay in running the tooth-time based sync technique" UBYTE OneToOne 1 100 0.00 255.0 BIT_MASK 0x1 FORMAT "%5.1" ECU_ADDRESS 0x400062AF
 /begin IF_DATA XCPplus 0x0102
  /begin DAQ_EVENT VARIABLE /begin AVAILABLE_EVENT_LIST EVENT 0 EVENT 1 EVENT 2 EVENT 3 /end AVAILABLE_EVENT_LIST /begin DEFAULT_EVENT_LIST EVENT 0 /end DEFAULT_EVENT_LIST /end DAQ_EVENT
 /end IF_DATA
/end MEASUREMENT
/begin MEASUREMENT EpmSyn_stSync "Status of engine synchronization" UBYTE EpmSyn_stSync_W 1 100 0.00 5.00000000000 FORMAT "%13.11" ECU_ADDRESS 0x400063D6
 /begin IF_DATA XCPplus 0x0102
  /begin DAQ_EVENT VARIABLE /begin AVAILABLE_EVENT_LIST EVENT 0 EVENT 1 EVENT 2 EVENT 3 /end AVAILABLE_EVENT_LIST /begin DEFAULT_EVENT_LIST EVENT 0 /end DEFAULT_EVENT_LIST /end DAQ_EVENT
 /end IF_DATA
/end MEASUREMENT
/begin MEASUREMENT EpmSyn_stSyncCrksftPat_mp "Status of engine synchronization by crankshaft pattern method" UBYTE EpmSyn_stSync_W 1 100 0.00 5.00000000000 FORMAT "%13.11" ECU_ADDRESS 0x40009E27
 /begin IF_DATA XCPplus 0x0102
  /begin DAQ_EVENT VARIABLE /begin AVAILABLE_EVENT_LIST EVENT 0 EVENT 1 EVENT 2 EVENT 3 /end AVAILABLE_EVENT_LIST /begin DEFAULT_EVENT_LIST EVENT 0 /end DEFAULT_EVENT_LIST /end DAQ_EVENT
 /end IF_DATA
/end MEASUREMENT
/begin MEASUREMENT EpmSyn_stSyncCrksftToothT_mp "Status of synchronization" UBYTE EpmSyn_stSync_W 1 100 0.00 5.00000000000 FORMAT "%13.11" ECU_ADDRESS 0x40009E23
 /begin IF_DATA XCPplus 0x0102
  /begin DAQ_EVENT VARIABLE /begin AVAILABLE_EVENT_LIST EVENT 0 EVENT 1 EVENT 2 EVENT 3 /end AVAILABLE_EVENT_LIST /begin DEFAULT_EVENT_LIST EVENT 0 /end DEFAULT_EVENT_LIST /end DAQ_EVENT
 /end IF_DATA
/end MEASUREMENT
/begin MEASUREMENT EpmSyn_stSyncEnaCrksftPat_mp "CrankShaft pattern activation request from synchronization co-ordinator" UBYTE OneToOne 1 100 0.00 255.0 BIT_MASK 0x1 FORMAT "%5.1" ECU_ADDRESS 0x40009E26
 /begin IF_DATA XCPplus 0x0102
  /begin DAQ_EVENT VARIABLE /begin AVAILABLE_EVENT_LIST EVENT 0 EVENT 1 EVENT 2 EVENT 3 /end AVAILABLE_EVENT_LIST /begin DEFAULT_EVENT_LIST EVENT 0 /end DEFAULT_EVENT_LIST /end DAQ_EVENT
 /end IF_DATA
/end MEASUREMENT
/begin MEASUREMENT EpmSyn_stTDCDetCrksftToothT "TDC position identified by crankshaft tooth time evaluation" UBYTE OneToOne 1 100 0.00 255.0 BIT_MASK 0x1 FORMAT "%5.1" ECU_ADDRESS 0x400063A8
 /begin IF_DATA XCPplus 0x0102
  /begin DAQ_EVENT VARIABLE /begin AVAILABLE_EVENT_LIST EVENT 0 EVENT 1 EVENT 2 EVENT 3 /end AVAILABLE_EVENT_LIST /begin DEFAULT_EVENT_LIST EVENT 0 /end DEFAULT_EVENT_LIST /end DAQ_EVENT
 /end IF_DATA
/end MEASUREMENT
/begin MEASUREMENT EpmSyn_swtMethToothT "Switch to select between the methods to find phase for different tooth time behaviours" UBYTE OneToOne 1 100 0.00 255.0 BIT_MASK 0x1 FORMAT "%5.1" ECU_ADDRESS 0x400063A6
 /begin IF_DATA XCPplus 0x0102
  /begin DAQ_EVENT VARIABLE /begin AVAILABLE_EVENT_LIST EVENT 0 EVENT 1 EVENT 2 EVENT 3 /end AVAILABLE_EVENT_LIST /begin DEFAULT_EVENT_LIST EVENT 0 /end DEFAULT_EVENT_LIST /end DAQ_EVENT
 /end IF_DATA
/end MEASUREMENT
/begin MEASUREMENT EpmSyn_tiTthEndCrksftToothT_mp "Average crankshaft tooth period at end of the gradient check window" SLONG OneToOne_us 1 100 -2147483648.00 2147483647.00 FORMAT "%13.2" ECU_ADDRESS 0x40009D30
 /begin IF_DATA XCPplus 0x0102
  /begin DAQ_EVENT VARIABLE /begin AVAILABLE_EVENT_LIST EVENT 0 EVENT 1 EVENT 2 EVENT 3 /end AVAILABLE_EVENT_LIST /begin DEFAULT_EVENT_LIST EVENT 0 /end DEFAULT_EVENT_LIST /end DAQ_EVENT
 /end IF_DATA
/end MEASUREMENT
/begin MEASUREMENT EpmSyn_tiTthGrdCrksftToothT_mp "Tooth period gradient in gradient check window" SWORD fak_q0p01 1 100 -327.6800 327.6700 FORMAT "%8.4" ECU_ADDRESS 0x40009D8E
 /begin IF_DATA XCPplus 0x0102
  /begin DAQ_EVENT VARIABLE /begin AVAILABLE_EVENT_LIST EVENT 0 EVENT 1 EVENT 2 EVENT 3 /end AVAILABLE_EVENT_LIST /begin DEFAULT_EVENT_LIST EVENT 0 /end DEFAULT_EVENT_LIST /end DAQ_EVENT
 /end IF_DATA
/end MEASUREMENT
/begin MEASUREMENT EpmSyn_tiTthPerCrksftToothT_mp "Crankshaft tooth period buffer" SLONG OneToOne_us 1 100 -2147483648.00 2147483647.00 FORMAT "%13.2" ARRAY_SIZE 72 ECU_ADDRESS 0x40009C10
 /begin IF_DATA XCPplus 0x0102
  /begin DAQ_EVENT VARIABLE /begin AVAILABLE_EVENT_LIST EVENT 0 EVENT 1 EVENT 2 EVENT 3 /end AVAILABLE_EVENT_LIST /begin DEFAULT_EVENT_LIST EVENT 0 /end DEFAULT_EVENT_LIST /end DAQ_EVENT
 /end IF_DATA
/end MEASUREMENT
/begin MEASUREMENT EpmSyn_tiTthStrtCrksftToothT_mp "Average crankshaft tooth period at start of the gradient check window" SLONG OneToOne_us 1 100 -2147483648.00 2147483647.00 FORMAT "%13.2" ECU_ADDRESS 0x40009C0C
 /begin IF_DATA XCPplus 0x0102
  /begin DAQ_EVENT VARIABLE /begin AVAILABLE_EVENT_LIST EVENT 0 EVENT 1 EVENT 2 EVENT 3 /end AVAILABLE_EVENT_LIST /begin DEFAULT_EVENT_LIST EVENT 0 /end DEFAULT_EVENT_LIST /end DAQ_EVENT
 /end IF_DATA
/end MEASUREMENT
/begin MEASUREMENT EpmSyn_tThRatHiCrksftToothT_mp "Upper threshold for tooth period slope in the gradient check window for TDC" SWORD fak_q0p01 1 100 -327.6800 327.6700 FORMAT "%8.4" ECU_ADDRESS 0x40009D8C
 /begin IF_DATA XCPplus 0x0102
  /begin DAQ_EVENT VARIABLE /begin AVAILABLE_EVENT_LIST EVENT 0 EVENT 1 EVENT 2 EVENT 3 /end AVAILABLE_EVENT_LIST /begin DEFAULT_EVENT_LIST EVENT 0 /end DEFAULT_EVENT_LIST /end DAQ_EVENT
 /end IF_DATA
/end MEASUREMENT
/begin MEASUREMENT EpmSyn_tThRatLoCrksftToothT_mp "Lower threshold for tooth period slope in the gradient check window for TDC" SWORD fak_q0p01 1 100 -327.6800 327.6700 FORMAT "%8.4" ECU_ADDRESS 0x40009D8A
 /begin IF_DATA XCPplus 0x0102
  /begin DAQ_EVENT VARIABLE /begin AVAILABLE_EVENT_LIST EVENT 0 EVENT 1 EVENT 2 EVENT 3 /end AVAILABLE_EVENT_LIST /begin DEFAULT_EVENT_LIST EVENT 0 /end DEFAULT_EVENT_LIST /end DAQ_EVENT
 /end IF_DATA
/end MEASUREMENT
/begin MEASUREMENT Epm_ctSyn "Synchro events counter" UBYTE OneToOne 1 100 0.00 255.0 FORMAT "%5.1" ECU_ADDRESS 0x400062B4
 /begin IF_DATA XCPplus 0x0102
  /begin DAQ_EVENT VARIABLE /begin AVAILABLE_EVENT_LIST EVENT 0 EVENT 1 EVENT 2 EVENT 3 /end AVAILABLE_EVENT_LIST /begin DEFAULT_EVENT_LIST EVENT 0 /end DEFAULT_EVENT_LIST /end DAQ_EVENT
 /end IF_DATA
/end MEASUREMENT
/begin MEASUREMENT Epm_phiToNxtSyn "Distance from current to next synchro event" SWORD AngleCrS 1 100 -720.0000 719.9780 FORMAT "%8.4" ECU_ADDRESS 0x40005C5E
 /begin IF_DATA XCPplus 0x0102
  /begin DAQ_EVENT VARIABLE /begin AVAILABLE_EVENT_LIST EVENT 0 EVENT 1 EVENT 2 EVENT 3 /end AVAILABLE_EVENT_LIST /begin DEFAULT_EVENT_LIST EVENT 0 /end DEFAULT_EVENT_LIST /end DAQ_EVENT
 /end IF_DATA
/end MEASUREMENT
/begin MEASUREMENT Epm_stSync "state of synchronization" UBYTE Epm_stSync_W 1 100 0.00 30.0000000000 FORMAT "%13.10" ECU_ADDRESS 0x400063CF
 /begin IF_DATA XCPplus 0x0102
  /begin DAQ_EVENT VARIABLE /begin AVAILABLE_EVENT_LIST EVENT 0 EVENT 1 EVENT 2 EVENT 3 /end AVAILABLE_EVENT_LIST /begin DEFAULT_EVENT_LIST EVENT 0 /end DEFAULT_EVENT_LIST /end DAQ_EVENT
 /end IF_DATA
/end MEASUREMENT
/begin MEASUREMENT ufls_w "Fuel level" UBYTE fak_q0p1 1 100 0.00 25.50 FORMAT "%5.2" ECU_ADDRESS 0x4000876B /end MEASUREMENT
/begin FUNCTION DSM_Conf "30000.12.0_386.1.0DSM Kernel configuration"
 /begin IN_MEASUREMENT APP_r BasSvr_bFuncTstReq CEngDsT_t CoEng_bObdTmrInctg CoEng_st CoEng_tiNormalOBD EnvT_t Epm_nEng GlbDa_lTotDst PEnv_p VehV_v /end IN_MEASUREMENT
 /begin LOC_MEASUREMENT DSM_bExtMILOnRequ DSM_bInstableStatus DSM_bStFuncTst DSM_CoEngtiNormalOBD DSM_DisblMode_mp DSM_ECUId DSM_lDst DSM_pEnv DSM_rAPP DSM_stCoPrmsOpMode DSM_stStrEnd DSM_stWiggle_mp DSM_tEngDS DSM_tEnv DSM_vVeh /end LOC_MEASUREMENT
 FUNCTION_VERSION "30000.12.0_386.1.0" /end FUNCTION
/begin FUNCTION DSM_DTRCompu "1.23.0    DSM DTR computation methods" FUNCTION_VERSION "1.23.0" /end FUNCTION
/begin FUNCTION DSQ "30000.3.0 Diagnostic Signal Quality" FUNCTION_VERSION "30000.3.0" /end FUNCTION
/begin FUNCTION DTEVE "9100.2.0  Diagnosis; power stage of canister purge valve"
 /begin DEF_CHARACTERISTIC CWPSTEVE DFC_CtlMsk2.DFC_TEVEmax_C DFC_CtlMsk2.DFC_TEVEmin_C DFC_CtlMsk2.DFC_TEVEsig_C DFC_DisblMsk2.DFC_TEVEmax_C DFC_DisblMsk2.DFC_TEVEmin_C DFC_DisblMsk2.DFC_TEVEsig_C TATEDMN TATEDMX /end DEF_CHARACTERISTIC
 /begin REF_CHARACTERISTIC TVP /end REF_CHARACTERISTIC
 /begin IN_MEASUREMENT B_desee SyC_stSub tateout_w /end IN_MEASUREMENT
 FUNCTION_VERSION "9100.2.0" /end FUNCTION
/begin FUNCTION DTR "30000.5.0 Diagnostic Test Results for Service 0x06"
 /begin DEF_CHARACTERISTIC DTR_OBDMID.DTR_Dummy_C DTR_OBDMID.DTR_OBDMID_01_TID_LATP_C DTR_OBDMID.DTR_OBDMID_01_TID_OFFST_C DTR_OBDMID.DTR_OBDMID_02_TID_OSCLO_C DTR_OBDMID.DTR_OBDMID_02_TID_OSCUP_C DTR_OBDMID.DTR_OBDMID_02_TID_OVRRN_C DTR_OBDMID.DTR_OBDMID_21_TID_AMPL_C DTR_OBDMID.DTR_OBDMID_41_TID_HTR_C DTR_OBDMID.DTR_OBDMID_42_TID_HTR_C DTR_OBDMID.DTR_OBDMID_a2_TID_0b_C DTR_OBDMID.DTR_OBDMID_a2_TID_0c_C DTR_OBDMID.DTR_TID_01_SEN_01_C DTR_OBDMID.DTR_TID_01_SEN_02_C DTR_OBDMID.DTR_TID_02_SEN_01_C DTR_OBDMID.DTR_TID_02_SEN_02_C DTR_OBDMID.DTR_TID_07_SEN_01_C DTR_OBDMID.DTR_TID_07_SEN_02_C DTR_OBDMID.DTR_TID_08_SEN_01_C DTR_OBDMID.DTR_TID_08_SEN_02_C DTR_OBDMID.DTR_TID_09_SEN_01_C DTR_OBDMID.DTR_TID_0A_SEN_01_C DTR_Suprt.DTR_Dummy_C DTR_Suprt.DTR_OBDMID_01_TID_LATP_C DTR_Suprt.DTR_OBDMID_01_TID_OFFST_C DTR_Suprt.DTR_OBDMID_02_TID_OSCLO_C DTR_Suprt.DTR_OBDMID_02_TID_OSCUP_C DTR_Suprt.DTR_OBDMID_02_TID_OVRRN_C DTR_Suprt.DTR_OBDMID_21_TID_AMPL_C DTR_Suprt.DTR_OBDMID_41_TID_HTR_C DTR_Suprt.DTR_OBDMID_42_TID_HTR_C DTR_Suprt.DTR_OBDMID_a2_TID_0b_C DTR_Suprt.DTR_OBDMID_a2_TID_0c_C DTR_Suprt.DTR_TID_01_SEN_01_C DTR_Suprt.DTR_TID_01_SEN_02_C DTR_Suprt.DTR_TID_02_SEN_01_C DTR_Suprt.DTR_TID_02_SEN_02_C DTR_Suprt.DTR_TID_07_SEN_01_C DTR_Suprt.DTR_TID_07_SEN_02_C DTR_Suprt.DTR_TID_08_SEN_01_C DTR_Suprt.DTR_TID_08_SEN_02_C DTR_Suprt.DTR_TID_09_SEN_01_C DTR_Suprt.DTR_TID_0A_SEN_01_C DTR_TID.DTR_Dummy_C DTR_TID.DTR_OBDMID_01_TID_LATP_C DTR_TID.DTR_OBDMID_01_TID_OFFST_C DTR_TID.DTR_OBDMID_02_TID_OSCLO_C DTR_TID.DTR_OBDMID_02_TID_OSCUP_C DTR_TID.DTR_OBDMID_02_TID_OVRRN_C DTR_TID.DTR_OBDMID_21_TID_AMPL_C DTR_TID.DTR_OBDMID_41_TID_HTR_C DTR_TID.DTR_OBDMID_42_TID_HTR_C DTR_TID.DTR_OBDMID_a2_TID_0b_C DTR_TID.DTR_OBDMID_a2_TID_0c_C DTR_TID.DTR_TID_01_SEN_01_C DTR_TID.DTR_TID_01_SEN_02_C DTR_TID.DTR_TID_02_SEN_01_C DTR_TID.DTR_TID_02_SEN_02_C DTR_TID.DTR_TID_07_SEN_01_C DTR_TID.DTR_TID_07_SEN_02_C DTR_TID.DTR_TID_08_SEN_01_C DTR_TID.DTR_TID_08_SEN_02_C DTR_TID.DTR_TID_09_SEN_01_C DTR_TID.DTR_TID_0A_SEN_01_C /end DEF_CHARACTERISTIC
 /begin LOC_MEASUREMENT DTR_valLoLim.DTR_Dummy DTR_valLoLim.DTR_OBDMID_01_TID_LATP DTR_valLoLim.DTR_OBDMID_01_TID_OFFST DTR_valLoLim.DTR_OBDMID_02_TID_OSCLO DTR_valLoLim.DTR_OBDMID_02_TID_OSCUP DTR_valLoLim.DTR_OBDMID_02_TID_OVRRN DTR_valLoLim.DTR_OBDMID_21_TID_AMPL DTR_valLoLim.DTR_OBDMID_41_TID_HTR DTR_valLoLim.DTR_OBDMID_42_TID_HTR DTR_valLoLim.DTR_OBDMID_a2_TID_0b DTR_valLoLim.DTR_OBDMID_a2_TID_0c DTR_valLoLim.DTR_TID_01_SEN_01 DTR_valLoLim.DTR_TID_01_SEN_02 DTR_valLoLim.DTR_TID_02_SEN_01 DTR_valLoLim.DTR_TID_02_SEN_02 DTR_valLoLim.DTR_TID_07_SEN_01 DTR_valLoLim.DTR_TID_07_SEN_02 DTR_valLoLim.DTR_TID_08_SEN_01 DTR_valLoLim.DTR_TID_08_SEN_02 DTR_valLoLim.DTR_TID_09_SEN_01 DTR_valLoLim.DTR_TID_0A_SEN_01 DTR_valTst.DTR_Dummy DTR_valTst.DTR_OBDMID_01_TID_LATP DTR_valTst.DTR_OBDMID_01_TID_OFFST DTR_valTst.DTR_OBDMID_02_TID_OSCLO DTR_valTst.DTR_OBDMID_02_TID_OSCUP DTR_valTst.DTR_OBDMID_02_TID_OVRRN DTR_valTst.DTR_OBDMID_21_TID_AMPL DTR_valTst.DTR_OBDMID_41_TID_HTR DTR_valTst.DTR_OBDMID_42_TID_HTR DTR_valTst.DTR_OBDMID_a2_TID_0b DTR_valTst.DTR_OBDMID_a2_TID_0c DTR_valTst.DTR_TID_01_SEN_01 DTR_valTst.DTR_TID_01_SEN_02 DTR_valTst.DTR_TID_02_SEN_01 DTR_valTst.DTR_TID_02_SEN_02 DTR_valTst.DTR_TID_07_SEN_01 DTR_valTst.DTR_TID_07_SEN_02 DTR_valTst.DTR_TID_08_SEN_01 DTR_valTst.DTR_TID_08_SEN_02 DTR_valTst.DTR_TID_09_SEN_01 DTR_valTst.DTR_TID_0A_SEN_01 DTR_valUpLim.DTR_Dummy DTR_valUpLim.DTR_OBDMID_01_TID_LATP DTR_valUpLim.DTR_OBDMID_01_TID_OFFST DTR_valUpLim.DTR_OBDMID_02_TID_OSCLO DTR_valUpLim.DTR_OBDMID_02_TID_OSCUP DTR_valUpLim.DTR_OBDMID_02_TID_OVRRN DTR_valUpLim.DTR_OBDMID_21_TID_AMPL DTR_valUpLim.DTR_OBDMID_41_TID_HTR DTR_valUpLim.DTR_OBDMID_42_TID_HTR DTR_valUpLim.DTR_OBDMID_a2_TID_0b DTR_valUpLim.DTR_OBDMID_a2_TID_0c DTR_valUpLim.DTR_TID_01_SEN_01 DTR_valUpLim.DTR_TID_01_SEN_02 DTR_valUpLim.DTR_TID_02_SEN_01 DTR_valUpLim.DTR_TID_02_SEN_02 DTR_valUpLim.DTR_TID_07_SEN_01 DTR_valUpLim.DTR_TID_07_SEN_02 DTR_valUpLim.DTR_TID_08_SEN_01 DTR_valUpLim.DTR_TID_08_SEN_02 DTR_valUpLim.DTR_TID_09_SEN_01 DTR_valUpLim.DTR_TID_0A_SEN_01 /end LOC_MEASUREMENT
 FUNCTION_VERSION "30000.5.0" /end FUNCTION
/begin FUNCTION DVFZ "9000.3.0_386.1.0Diagnosis; plausibility test vehicle speed"
 /begin DEF_CHARACTERISTIC CWVFZD DFC_CtlMsk2.DFC_VFZsig_C DFC_CtlMsk2.DFC_VFZsig2_C DFC_DisblMsk2.DFC_VFZsig_C DFC_DisblMsk2.DFC_VFZsig2_C NDV NDVO RLDVO RLDVU TDV TENDIAGV TMDV VDMN VDMNRE /end DEF_CHARACTERISTIC
 /begin REF_CHARACTERISTIC VehV_swtSig_C /end REF_CHARACTERISTIC
 /begin IN_MEASUREMENT B_nmax B_sa B_vehpulse Com_flgABSFrntwhlSpdVld Com_flgABSRewhlSpdVld Com_vABSFrntWhlSpd Com_vABSReWhlSpd EngDa_tEng nmot_w rl vfzroh_w /end IN_MEASUREMENT
 /begin OUT_MEASUREMENT B_noflr B_sigflr /end OUT_MEASUREMENT
 /begin LOC_MEASUREMENT B_errdiagen B_flgDVFZDSCClr /end LOC_MEASUREMENT
 FUNCTION_VERSION "9000.3.0_386.1.0" /end FUNCTION
/begin FUNCTION EngDa_TEng "9000.5.0  Engine temperature" /begin IN_MEASUREMENT SyC_stSub tmot tmotab tmst /end IN_MEASUREMENT /begin OUT_MEASUREMENT EngDa_tEng EngDa_tStop EngDa_tStrt /end OUT_MEASUREMENT FUNCTION_VERSION "9000.5.0" /end FUNCTION
/begin FUNCTION EngECU_Eng "35000.0.0_386.10.0process for calculating engine CAN messages" /begin DEF_CHARACTERISTIC Com_flgWhlSpdSeln_C /end DEF_CHARACTERISTIC
 /begin IN_MEASUREMENT avgvfzg avgvmlg BIDev_flgSidstSt B_etmot B_gwhs B_lf1s B_llri B_maxlatp B_OvHEngShDwn B_OvHEngSpdLimr B_OvHLamp B_te Com_flgABSFrntwhlSpdVld Com_flgABSRewhlSpdVld Com_stABSEvntAct Com_stABSWarnLmp Com_vABSFrntWhlSpd Com_vABSReWhlSpd StSys_stResCond SyC_stSub T15_st vfzg_w vsksml_w /end IN_MEASUREMENT
 /begin OUT_MEASUREMENT Com_avgvfzg_0 Com_avgvfzg_1 Com_avgvmlg_0 Com_avgvmlg_1 Com_BIDev_flgSidstSt Com_B_etmot Com_B_OvHLamp Com_DFES_numDFC Com_DFES_numDFC0 Com_DFES_numDFC1 Com_DFES_numDFC2 Com_DFES_numDFC3 Com_DFES_numDFC4 Com_DFES_stChk Com_DFES_stChk0 Com_DFES_stChk1 Com_DFES_stChk2 Com_DFES_stChk3 Com_DFES_stChk4 Com_DIUMPR_ctGenDenom Com_flgWhlSpdSeln Com_stgwhs Com_stlf1s Com_stllri Com_stmaxlatp Com_stOvHEngShDwn Com_stOvHEngSpdLimr Com_stte Com_stWhlSpdInvld Com_vfzg_w Com_vsksml_w Com_vVehWhlSpdABS /end OUT_MEASUREMENT
 /begin LOC_MEASUREMENT com_dfes_blptn com_dfes_blptn_mp Com_nFuelLevel Com_nGbxPos dte_w ufls_w /end LOC_MEASUREMENT
 FUNCTION_VERSION "35000.0.0_386.10.0" /end FUNCTION
/begin FUNCTION EngICO_Co "9101.2.0  Extended Monitoring: Injection Cut Off" /begin DEF_CHARACTERISTIC EngICO_stEnbl_C /end DEF_CHARACTERISTIC /begin IN_MEASUREMENT MoFSidst_flgSidstErrMsg /end IN_MEASUREMENT /begin OUT_MEASUREMENT B_evabu B_nlzoff /end OUT_MEASUREMENT FUNCTION_VERSION "9101.2.0" /end FUNCTION
/begin FUNCTION EpmCrS_Diag "30000.8.0 Diagnosis of crankhaft signal"
 /begin DEF_CHARACTERISTIC DFC_CtlMsk2.DFC_EpmCrSErrSig_C DFC_CtlMsk2.DFC_EpmCrSNoSig_C DFC_DisblMsk2.DFC_EpmCrSErrSig_C DFC_DisblMsk2.DFC_EpmCrSNoSig_C EpmCrS_agThrMaxMnfldP_CUR EpmCrS_dnEngMax_C EpmCrS_facPt1BattU_C EpmCrS_flgSwtDiag_C EpmCrS_nDiagOff_C EpmCrS_nDiagOn_C EpmCrS_nMinBattUDiag_C EpmCrS_nrDebMnfldPPat_C EpmCrS_numErrSigIncDef_C EpmCrS_numErrSigIncOK_C EpmCrS_numErrSigMaxDef_C EpmCrS_numErrSigMinOK_C EpmCrS_pDiffIntkMnfld_C EpmCrS_pDrpIntkMnfld_C EpmCrS_stDiagT50Reset_C EpmCrS_swtEnableDiag_C EpmCrS_tiMaxStrtrEngd_C EpmCrS_tiMaxT15Actv_C EpmCrS_tiMinStrtrEngd_C EpmCrS_tiMnfldPPatDeb_C EpmCrS_uBattMinDiag_C EpmCrS_uDrpStrtrActv_C EpmCrS_uDrpStrtrNotActv2_C EpmCrS_uDrpStrtrNotActv_C EpmCrS_VehV_v_Max_C EpmCrS_VehV_v_Min_C /end DEF_CHARACTERISTIC
 /begin REF_CHARACTERISTIC EpmRRS_nEngMax_C /end REF_CHARACTERISTIC
 /begin IN_MEASUREMENT B_psrrg B_stend CoEng_st EpmCrS_stSigMode EpmHCrS_stSigErr EpmHCrS_stSigMode EpmSeq_numIntTyp Epm_dnEngFlt Epm_nEng Epm_nEng10ms Epm_stOpMode PIntkVUs_pRawFast Strt_stStaActv SyC_stSub T15_st VehV_v wdkba_w wub /end IN_MEASUREMENT
 /begin OUT_MEASUREMENT EpmCrS_ctErrSig EpmCrS_flgStrtrActv EpmCrS_flgStrtrActv2 EpmCrS_stDiag EpmCrS_stDiagErrSig EpmCrS_stDiagNoSig EpmCrS_stSigDiagSrc /end OUT_MEASUREMENT
 /begin LOC_MEASUREMENT EpmCrS_bCrSDiagflgClr EpmCrS_bDisturb EpmCrS_cntrDebMnfldPPat EpmCrS_ctErrSigSyncIni EpmCrS_ctRev EpmCrS_ctRev100msLim_mp EpmCrS_ctRevWaitDiag EpmCrS_dnEngFltSyncIni EpmCrS_flgBattUDiag EpmCrS_flgDiMnfldPEvln EpmCrS_flgDiPPatSrch EpmCrS_flgDiStrtrEvln EpmCrS_flgMnfldPDiag EpmCrS_flgMnfldPPatDeb EpmCrS_flgMnfldPPatDetd EpmCrS_flgMnfldPVld EpmCrS_flgNMinChk EpmCrS_flgStrtrStDeb EpmCrS_flgTiMaxT15Actv EpmCrS_pMaxIntkMnfld EpmCrS_pMinIntkMnfld EpmCrS_tiMnfldPPatDeb EpmCrS_tiStrtrEngd EpmCrS_uBattDrp EpmCrS_uBattFild EpmCrS_uBattMax /end LOC_MEASUREMENT
 FUNCTION_VERSION "30000.8.0" /end FUNCTION
/begin FUNCTION EpmCrS_Plaus "30000.4.1 dynamic plausibility of crankshaft-signal"
 /begin DEF_CHARACTERISTIC EpmCrS_facGapCrit1_C EpmCrS_facGapCrit2_C EpmCrS_facGapPlausHigh_CA EpmCrS_facIncPlausHigh_CA EpmCrS_facIncPlausLow_CA EpmCrS_nMaxInc_C EpmCrS_nMinInc_C EpmCrS_nThreshRange_CA EpmCrS_nTiIncPerAvrg_CA EpmCrS_numAgClkDeltaCrsvMax_C EpmCrS_numIgnInc_C EpmCrS_numTiIncPerAvrg_CA EpmCrS_phiAgClkDeltaMax_C EpmCrS_stClrCntReSyncAgClkDeltaTot_C EpmCrS_tiGlitchFilter_CA EpmCrS_tiIgnSig_C /end DEF_CHARACTERISTIC
 /begin IN_MEASUREMENT EpmCrS_phiAgClk EpmCrS_phiInc EpmCrS_stSigMode Epm_nEng Epm_stOpMode /end IN_MEASUREMENT
 /begin OUT_MEASUREMENT EpmCrS_phiIgnInc EpmCrS_tiIncPer /end OUT_MEASUREMENT
 /begin LOC_MEASUREMENT EpmCrS_ctAgClkDeltaCrsv_mp EpmCrS_ctRange EpmCrS_ctReSyncAgClkDeltaTot_mp EpmCrS_ctReSyncAgClkDelta_mp EpmCrS_numTiIncPerAvrg_mp EpmCrS_phiAgClkDelta_mp /end LOC_MEASUREMENT
 FUNCTION_VERSION "30000.4.1" /end FUNCTION
/begin FUNCTION EpmCrS_RevCnt "30000.2.0 calculation of the crankshaft-revolutioncounter" /begin REF_CHARACTERISTIC EpmSeq_swtInt_C /end REF_CHARACTERISTIC
 /begin IN_MEASUREMENT CoEng_st EpmCrS_numSeg EpmCrS_stSigMode EpmSeq_numInt EpmSyn_phiInt Epm_nEng Epm_numCylInt Epm_stSync /end IN_MEASUREMENT
 /begin OUT_MEASUREMENT EpmCrS_cntrEngRev EpmCrS_ctRevIni EpmCrS_ctRevStrt EpmCrS_ctRevStrtExtd /end OUT_MEASUREMENT
 /begin LOC_MEASUREMENT EpmCrS_agIntOld EpmCrS_ctRevCnt EpmCrS_numIntOld /end LOC_MEASUREMENT
 FUNCTION_VERSION "30000.2.0" /end FUNCTION
/begin FUNCTION EpmCrS_Seg "30000.4.0 calculation of crankshaft-segmenttimes" /begin DEF_CHARACTERISTIC EpmCrS_agNEngCurrOffs_C /end DEF_CHARACTERISTIC /begin REF_CHARACTERISTIC EpmSeq_phiInt_CA EpmSeq_swtInt_C /end REF_CHARACTERISTIC
 /begin IN_MEASUREMENT EpmHCrS_stSigMode EpmHInt_AgIncTrans EpmSeq_numInt EpmSeq_numIntTyp EpmSyn_phiInt Epm_ctCyl Epm_numCylInt Epm_stOpMode /end IN_MEASUREMENT
 /begin OUT_MEASUREMENT EpmCrS_ctInc EpmCrS_numIncPerSeg EpmCrS_numSeg EpmCrS_phiAgClk EpmCrS_phiInc EpmCrS_phiIntSeg EpmCrS_phiSeg EpmCrS_stSigMode EpmCrS_tiSeg EpmCrS_tiSegCurr EpmCrS_tiSegCurr1 /end OUT_MEASUREMENT
 FUNCTION_VERSION "30000.4.0" /end FUNCTION
/begin FUNCTION EpmHCrS_Interface "30000.4.0 Interface for EpmHCrS" /begin IN_MEASUREMENT EpmSyn_phiOffs EpmSyn_phiOffsCor /end IN_MEASUREMENT FUNCTION_VERSION "30000.4.0" /end FUNCTION
/begin FUNCTION EpmHCrS_SigBuf "30000.5.0 signalbuffer crankshaft" /begin IN_MEASUREMENT EpmCrS_phiSeg EpmSyn_phiInt /end IN_MEASUREMENT FUNCTION_VERSION "30000.5.0" /end FUNCTION
/begin FUNCTION EpmHCrS_SigEval "30000.8.0 signal evaluation of crankshaft" /begin DEF_CHARACTERISTIC EpmHCrS_swtNoiseRej_C EpmHCrS_tiNoSig_C /end DEF_CHARACTERISTIC /begin IN_MEASUREMENT EpmCrS_flgStrtrActv EpmCrS_stSigMode EpmSyn_phiInt /end IN_MEASUREMENT /begin OUT_MEASUREMENT EpmHCrS_AgIncTrans EpmHCrS_stSigErr EpmHCrS_stSigMode /end OUT_MEASUREMENT
 /begin LOC_MEASUREMENT EpmHCrS_agClkTimeout EpmHCrS_CntrCrSEdge_mp EpmHCrS_flgNoiseRej EpmHCrS_stNoiseRej EpmHCrS_stNoiseRej_mp EpmHCrS_swtGapTout EpmHCrS_tiNoSig /end LOC_MEASUREMENT
 FUNCTION_VERSION "30000.8.0" /end FUNCTION
/begin FUNCTION EpmHInt_IntGen "30000.9.0 interruptgenerator for EPM" /begin REF_CHARACTERISTIC EpmSeq_swtVrtlInt_C /end REF_CHARACTERISTIC
 /begin IN_MEASUREMENT EpmHCrS_stSigMode EpmSeq_flgStrtVirtSyn EpmSeq_flgVirtSynFirst EpmSeq_numMainSyncIdx /end IN_MEASUREMENT
 /begin OUT_MEASUREMENT EpmHInt_AgIncTrans EpmHInt_ctErrTaskAct /end OUT_MEASUREMENT
 FUNCTION_VERSION "30000.9.0" /end FUNCTION
/begin FUNCTION EpmHwe_Ini "30000.2.0 Hardware encapsulation init" FUNCTION_VERSION "30000.2.0" /end FUNCTION
/begin FUNCTION EpmHwe_Srv "100.4.1   Service Library" FUNCTION_VERSION "100.4.1" /end FUNCTION
/begin FUNCTION EpmRRS_AgDetect "30000.10.0Engine Position Management Reverse Rotation and Stop Angle Detection"
 /begin DEF_CHARACTERISTIC EpmRRS_EnaIgnInj_CW EpmRRS_nEngMax_C EpmRRS_phiUndef_C EpmRRS_tiMaxToothTime_C EpmRRS_tiTemp_CUR EpmRRS_vVehMax_C /end DEF_CHARACTERISTIC
 /begin REF_CHARACTERISTIC Epm_phiGap2Zero_C Epm_phiTdc1_C /end REF_CHARACTERISTIC
 /begin IN_MEASUREMENT EngDa_tEng EpmCrS_flgStrtrActv EpmCrS_flgStrtrActv2 EpmSyn_phiOffs Epm_nEng10ms Epm_phiDiffTDC Epm_stSync Strt_stStaActv VehV_v /end IN_MEASUREMENT
 /begin OUT_MEASUREMENT EpmRRS_bEngSwOff EpmRRS_stEngStop EpmRRS_stRotDir /end OUT_MEASUREMENT
 /begin LOC_MEASUREMENT EpmRRS_actInc_mp EpmRRS_phiEngRR EpmRRS_phiGapPos EpmRRS_stAgDetect EpmRRS_stEnable /end LOC_MEASUREMENT
 FUNCTION_VERSION "30000.10.0" /end FUNCTION
/begin FUNCTION EpmSeq_StateMn "30000.9.0 statemachine of interrupt control"
 /begin DEF_CHARACTERISTIC EpmSeq_phiIntVrtl_CA EpmSeq_phiInt_CA EpmSeq_swtInt_C EpmSeq_swtVrtlInt_C /end DEF_CHARACTERISTIC
 /begin REF_CHARACTERISTIC Epm_phiTdc1_C /end REF_CHARACTERISTIC
 /begin IN_MEASUREMENT EpmSyn_phiAbs EpmSyn_phiInt EpmSyn_stPhaCorrn Epm_ctCyl Epm_numCylInt Epm_phiCyl Epm_stOpMode /end IN_MEASUREMENT
 /begin OUT_MEASUREMENT EpmSeq_flgStrtVirtSyn EpmSeq_flgVirtSynFirst EpmSeq_MaxVrtlPhiSeg EpmSeq_numIncDiffInt EpmSeq_numInt EpmSeq_numIntTyp EpmSeq_numMainSyncIdx EpmSeq_phiNxtInt EpmSeq_stInt Epm_ctSyn Epm_phiToNxtSyn /end OUT_MEASUREMENT
 /begin LOC_MEASUREMENT EpmSeq_phiIntMainAbslt EpmSeq_swtInt /end LOC_MEASUREMENT
 FUNCTION_VERSION "30000.9.0" /end FUNCTION
/begin FUNCTION EpmSrv_Lib "30000.3.0 service library for EPM" /begin REF_CHARACTERISTIC Epm_numFireSeg_C /end REF_CHARACTERISTIC /begin IN_MEASUREMENT EpmSyn_phiOffs Epm_numCylInt Epm_phiCyl /end IN_MEASUREMENT /begin LOC_MEASUREMENT EpmSrv_stCnvAgT2Ag_mp /end LOC_MEASUREMENT FUNCTION_VERSION "30000.3.0" /end FUNCTION
/begin FUNCTION EpmSyn_Co "1.13.0    Synchronization coordinator"
 /begin DEF_CHARACTERISTIC EpmSyn_nEngMaxCrkDblIgn_C EpmSyn_nEngMaxDrvDblIgn_C EpmSyn_nEngMinDrvDblIgn_C EpmSyn_nrCrSRevDblIgn_C EpmSyn_phiIncCor_CUR EpmSyn_rAgQlFulSync_CA EpmSyn_stStgyAgQlLo_CA EpmSyn_stSyncStgy_MAP EpmSyn_swtCo_C /end DEF_CHARACTERISTIC
 /begin REF_CHARACTERISTIC Epm_phiGap2Zero_C /end REF_CHARACTERISTIC
 /begin IN_MEASUREMENT EpmCrS_ctInc EpmCrS_stSigMode EpmRRS_bEngSwOff Epm_nEng Epm_nEng10ms /end IN_MEASUREMENT
 /begin OUT_MEASUREMENT EpmSyn_numIntTyp EpmSyn_phiAbs EpmSyn_phiInt EpmSyn_phiOffs EpmSyn_phiOffsCor EpmSyn_stEnaDblIgn EpmSyn_stPhaCorrn EpmSyn_stPhaSyncn EpmSyn_stSync Epm_stSync /end OUT_MEASUREMENT
 /begin LOC_MEASUREMENT EpmSyn_ctCalcAgQlLo_mp EpmSyn_ctRatQl_mp EpmSyn_facWghSum_mp EpmSyn_numActvCfg_mp EpmSyn_numActvMethod_mp EpmSyn_numCalcCo EpmSyn_numNxtCfgAgQlLo_mp EpmSyn_numNxtCfgSyncFail_mp EpmSyn_numNxtCfg_mp EpmSyn_numSyncFaildAgQlLo_mp EpmSyn_phiIncCor_mp EpmSyn_phiOffsDblIgn_mp EpmSyn_rAgQlFulSync_mp EpmSyn_rAgQl_mp EpmSyn_stRevCrSDblIgn /end LOC_MEASUREMENT
 FUNCTION_VERSION "1.13.0" /end FUNCTION
/begin FUNCTION EpmSyn_CrksftPat "1.3.0     Synchonization of the engine by crankshaft sensor signal pattern analysis" /begin DEF_CHARACTERISTIC EpmSyn_facWghCrksftPat_C EpmSyn_rAgQlCrksftPat_C /end DEF_CHARACTERISTIC /begin REF_CHARACTERISTIC Epm_phiGap2Zero_C /end REF_CHARACTERISTIC /begin IN_MEASUREMENT EpmCrS_ctInc /end IN_MEASUREMENT
 /begin LOC_MEASUREMENT EpmSyn_phiAbsCrksftPat_mp EpmSyn_rAgQlCrksftPat_mp EpmSyn_stSyncCrksftPat_mp EpmSyn_stSyncEnaCrksftPat_mp /end LOC_MEASUREMENT
 FUNCTION_VERSION "1.3.0" /end FUNCTION
/begin FUNCTION EpmSyn_CrksftToothT "30000.6.0 Synchronization of the engine by the evaluation of the tooth periods in the crankshaft signal"
 /begin DEF_CHARACTERISTIC EpmSyn_cntrValChkCrksftToothT_C EpmSyn_dnEngMaxCrksftToothT_C EpmSyn_facAltiCorrnHiToothT_CUR EpmSyn_facAltiCorrnLoToothT_CUR EpmSyn_facWghCrksftToothT_C EpmSyn_nEngMaxCrksftToothT_C EpmSyn_nrAtmptCrksftToothT_C EpmSyn_nrRevStrtDlyCrksftToothT_C EpmSyn_nrTthWndwOffsCrksftToothT_C EpmSyn_numIgnIncCrksftToothT_C EpmSyn_numTthAvrgCrksftToothT_C EpmSyn_rAgQlCrksftToothT_CA EpmSyn_swtCrksftToothT_C EpmSyn_swtMethToothT_C EpmSyn_tiThdGrdtHiCrksftToothT_MAP EpmSyn_tiThdGrdtLoCrksftToothT_MAP EpmSyn_TthWndwCrksftToothT_C /end DEF_CHARACTERISTIC
 /begin REF_CHARACTERISTIC Epm_phiGap2Zero_C Epm_phiTdc1_C /end REF_CHARACTERISTIC
 /begin IN_MEASUREMENT EngDa_tEng EpmCrS_ctInc EpmCrS_stSigMode EpmSyn_stEnaDblIgn Epm_dnEng Epm_nEng Epm_numCylInt fho /end IN_MEASUREMENT
 /begin OUT_MEASUREMENT EpmSyn_stITDCDetCrksftToothT EpmSyn_stTDCDetCrksftToothT /end OUT_MEASUREMENT
 /begin LOC_MEASUREMENT EpmSyn_cntrFailrCrksftToothT EpmSyn_cntrValChkCrksftToothT EpmSyn_ctIncAccCrksftToothT_mp EpmSyn_ctIncDecCrksftToothT_mp EpmSyn_ctIncDiffCrksftToothT_mp EpmSyn_ctIncGapCrksftToothT_mp EpmSyn_ctIncRGapCrksftToothT_mp EpmSyn_ctIncRTdcCrksftToothT_mp EpmSyn_ctIncStrCrksftToothT_mp EpmSyn_ctIncTmpCrksftToothT_mp EpmSyn_flgEnaCrksftToothT EpmSyn_idxWrTmpCrksftToothT_mp EpmSyn_IncStr2TdcCrksftToothT_mp EpmSyn_IncStr2WinEndCrksftToothT_mp EpmSyn_IncTdc2CurCrksftToothT_mp EpmSyn_IncWinEnd2CurCrksftToothT_mp EpmSyn_nrGrdChkCrksftToothT_mp EpmSyn_nrGrdFailCrksftToothT_mp EpmSyn_nrSynFailCrksftToothT_mp EpmSyn_nrSynSucCrksftToothT_mp EpmSyn_numVaidThCrksftToothT_mp EpmSyn_phiAbsCrksftToothT_mp EpmSyn_phiOffsCrksftToothT_mp EpmSyn_rAgQlCrksftToothT_mp EpmSyn_RGap2TdcCrksftToothT_mp EpmSyn_stEnaCrksftToothT_mp EpmSyn_stRecalcnCrksftToothT_mp EpmSyn_stStrtDlyToothT EpmSyn_stSyncCrksftToothT_mp EpmSyn_swtMethToothT EpmSyn_tiTthEndCrksftToothT_mp EpmSyn_tiTthGrdCrksftToothT_mp EpmSyn_tiTthPerCrksftToothT_mp EpmSyn_tiTthStrtCrksftToothT_mp EpmSyn_tThRatHiCrksftToothT_mp EpmSyn_tThRatLoCrksftToothT_mp /end LOC_MEASUREMENT
 FUNCTION_VERSION "30000.6.0" /end FUNCTION
/begin COMPU_METHOD AngleCrS "" RAT_FUNC "%6.4" "deg CrS" COEFFS 0 45.5111111111 0 0 0 1 /end COMPU_METHOD
/begin COMPU_METHOD B_TRUE "" TAB_VERB "%6.3" "" COMPU_TAB_REF B_TRUE /end COMPU_METHOD
/begin COMPU_VTAB B_TRUE "" TAB_VERB 2 0 "FALSE" 1 "TRUE" /end COMPU_VTAB
/begin COMPU_METHOD dez "" RAT_FUNC "%6.2" "" COEFFS 0 1 0 0 0 1 /end COMPU_METHOD
/begin COMPU_METHOD DFC_OneToOne "" RAT_FUNC "%6.2" "-" COEFFS 0 1 0 0 0 1 /end COMPU_METHOD
/begin COMPU_METHOD DFES_OneToOne "" RAT_FUNC "%6.2" "-" COEFFS 0 1 0 0 0 1 /end COMPU_METHOD
/begin COMPU_METHOD DTR_Suprt_Compu "" TAB_VERB "%6.3" "-" COMPU_TAB_REF DTR_Suprt_Compu /end COMPU_METHOD
/begin COMPU_VTAB DTR_Suprt_Compu "" TAB_VERB 2 0 "Not supported" 1 "Supported" /end COMPU_VTAB
/begin COMPU_METHOD EffGrad "" RAT_FUNC "%7.6" "1/s" COEFFS 0 10000 0 0 0 1 /end COMPU_METHOD
/begin COMPU_METHOD EGOCATUS_SC_Compu "" TAB_VERB "%6.3" "" COMPU_TAB_REF EGOCATUS_SC_Compu /end COMPU_METHOD
/begin COMPU_VTAB EGOCATUS_SC_Compu "" TAB_VERB 2 0 "LSMini_Absent" 1 "LSMini_Present" /end COMPU_VTAB
/begin COMPU_METHOD EGRVLV_TYPAVL_SY_Compu "" TAB_VERB "%6.3" "" COMPU_TAB_REF EGRVLV_TYPAVL_SY_Compu /end COMPU_METHOD
/begin COMPU_VTAB EGRVLV_TYPAVL_SY_Compu "" TAB_VERB 2 0 "FALSE" 1 "TRUE" /end COMPU_VTAB
/begin COMPU_METHOD EGTFact "" RAT_FUNC "%6.5" "-" COEFFS 0 1000 0 0 0 1 /end COMPU_METHOD
/begin COMPU_METHOD EGTSwt "" RAT_FUNC "%10.9" "-" COEFFS 0 16384000 0 0 0 1 /end COMPU_METHOD
/begin COMPU_METHOD EGTSwt_S16 "" RAT_FUNC "%7.6" "-" COEFFS 0 16384 0 0 0 1 /end COMPU_METHOD
/begin COMPU_METHOD ENADATASETID_CALPAR_SC_Compu "" TAB_VERB "%6.3" "" COMPU_TAB_REF ENADATASETID_CALPAR_SC_Compu /end COMPU_METHOD
/begin COMPU_VTAB ENADATASETID_CALPAR_SC_Compu "" TAB_VERB 2 0 "False" 1 "True" /end COMPU_VTAB
/begin COMPU_METHOD Energy "" RAT_FUNC "%6.2" "kJ" COEFFS 0 1 0 0 0 1 /end COMPU_METHOD
/begin COMPU_METHOD Energy_J_HiRes "" RAT_FUNC "%6.2" "J" COEFFS 0 1 0 0 0 1 /end COMPU_METHOD
/begin COMPU_METHOD Energy_q0p0001 "" RAT_FUNC "%7.6" "kJ" COEFFS 0 10000 0 0 0 1 /end COMPU_METHOD
/begin COMPU_METHOD Energy_q0p001_COMPU "" RAT_FUNC "%6.5" "kJ" COEFFS 0 1000 0 0 0 1 /end COMPU_METHOD
/begin COMPU_METHOD EngN "" RAT_FUNC "%6.3" "rpm" COEFFS 0 2 0 0 0 1 /end COMPU_METHOD
/begin COMPU_METHOD EngN2tiIncPer "" RAT_FUNC "%8.0" "rpm" COEFFS 0 0 1 0 2.40000012e-007 0 /end COMPU_METHOD
/begin COMPU_METHOD EngNGrd "" RAT_FUNC "%6.3" "rpm/s" COEFFS 0 2 0 0 0 1 /end COMPU_METHOD
/begin COMPU_METHOD EngNRmp_Hi "" RAT_FUNC "%6.3" "rpm" COEFFS 0 10 0 0 0 1 /end COMPU_METHOD
/begin COMPU_METHOD EngN_HiRes "" RAT_FUNC "%6.4" "rpm" COEFFS 0 32 0 0 0 1 /end COMPU_METHOD
/begin COMPU_METHOD ENGRESTRT_SY_Compu "" TAB_VERB "%6.3" "" COMPU_TAB_REF ENGRESTRT_SY_Compu /end COMPU_METHOD
/begin COMPU_VTAB ENGRESTRT_SY_Compu "" TAB_VERB 2 0 "False" 1 "True" /end COMPU_VTAB
/begin COMPU_METHOD ENGSPD_SWTENA_SY_Compu "" TAB_VERB "%6.3" "" COMPU_TAB_REF ENGSPD_SWTENA_SY_Compu /end COMPU_METHOD
/begin COMPU_VTAB ENGSPD_SWTENA_SY_Compu "" TAB_VERB 2 0 "FALSE" 1 "TRUE" /end COMPU_VTAB
/begin COMPU_METHOD ENGTVRNTSELN_SC_Compu "" TAB_VERB "%6.3" "" COMPU_TAB_REF ENGTVRNTSELN_SC_Compu /end COMPU_METHOD
/begin COMPU_VTAB ENGTVRNTSELN_SC_Compu "" TAB_VERB 3 1 "Coolant_Temperature" 2 "Oil_Temperature" 3 "Cylinder_Temperature" /end COMPU_VTAB
/begin COMPU_METHOD EnrgPerMass "" RAT_FUNC "%6.3" "MJ/Kg" COEFFS 0 10 0 0 0 1 /end COMPU_METHOD
/begin COMPU_METHOD EnrgPrMol_q0p001_COMPU "" RAT_FUNC "%6.5" "J/mol" COEFFS 0 1000 0 0 0 1 /end COMPU_METHOD
/begin COMPU_METHOD EPMCAS_FACPLAUS_DSTX_SC_Compu "" RAT_FUNC "%6.2" "" COEFFS 0 1 0 0 0 1 /end COMPU_METHOD
/begin COMPU_METHOD EPMCAS_NUMSEGLEN_SC_Compu "" RAT_FUNC "%6.2" "" COEFFS 0 1 0 0 0 1 /end COMPU_METHOD
/begin COMPU_METHOD EPMCAS_NUMSEG_SC_Compu "" RAT_FUNC "%6.2" "" COEFFS 0 1 0 0 0 1 /end COMPU_METHOD
/begin COMPU_METHOD EPMCAS_PHINCOR_CURX_SC_Compu "" RAT_FUNC "%6.2" "" COEFFS 0 1 0 0 0 1 /end COMPU_METHOD
/begin COMPU_METHOD EPMCAS_PHITEMPCOR05_DSTX_SC_Compu "" RAT_FUNC "%6.2" "" COEFFS 0 1 0 0 0 1 /end COMPU_METHOD
/begin COMPU_METHOD EpmCrS_DiagResult_State "" TAB_VERB "%6.3" "" COMPU_TAB_REF EpmCrS_DiagResult_State /end COMPU_METHOD
/begin COMPU_VTAB EpmCrS_DiagResult_State "" TAB_VERB 5 0 "EPMCRS_DIAG_PENDING" 1 "EPMCRS_DIAG_DEBHEAL" 2 "EPMCRS_DIAG_HEAL" 3 "EPMCRS_DIAG_DEBSET" 4 "EPMCRS_DIAG_SET" /end COMPU_VTAB
/begin COMPU_METHOD EpmCrS_Diag_State "" TAB_VERB "%6.3" "" COMPU_TAB_REF EpmCrS_Diag_State /end COMPU_METHOD
/begin COMPU_VTAB EpmCrS_Diag_State "" TAB_VERB 2 0 "EPMCRS_DIAG_OFF" 1 "EPMCRS_DIAG_ON" /end COMPU_VTAB
/begin COMPU_METHOD EPMCRS_NUMINCOUT_SC_Compu "" RAT_FUNC "%6.2" "" COEFFS 0 1 0 0 0 1 /end COMPU_METHOD
/begin COMPU_METHOD EPMCRS_PLSWIDTHAPPLACTVD_SC_Compu "" TAB_VERB "%6.3" "" COMPU_TAB_REF EPMCRS_PLSWIDTHAPPLACTVD_SC_Compu /end COMPU_METHOD
/begin COMPU_VTAB EPMCRS_PLSWIDTHAPPLACTVD_SC_Compu "" TAB_VERB 2 0 "0" 1 "1" /end COMPU_VTAB
/begin COMPU_METHOD EPMCRS_REVSTRTCONT_SC_Compu "" TAB_VERB "%6.3" "" COMPU_TAB_REF EPMCRS_REVSTRTCONT_SC_Compu /end COMPU_METHOD
/begin COMPU_VTAB EPMCRS_REVSTRTCONT_SC_Compu "" TAB_VERB 2 0 "False" 1 "True" /end COMPU_VTAB
/begin COMPU_METHOD EPMCRS_TIINCOUTPVBL_SC_Compu "" TAB_VERB "%6.3" "" COMPU_TAB_REF EPMCRS_TIINCOUTPVBL_SC_Compu /end COMPU_METHOD
/begin COMPU_VTAB EPMCRS_TIINCOUTPVBL_SC_Compu "" TAB_VERB 3 1 "TIINC" 2 "TIINCLRES" 3 "TIINC_TIINCLRES" /end COMPU_VTAB
/begin COMPU_METHOD EPMCRS_TIINCOUT_SC_Compu "" TAB_VERB "%6.3" "" COMPU_TAB_REF EPMCRS_TIINCOUT_SC_Compu /end COMPU_METHOD
/begin COMPU_VTAB EPMCRS_TIINCOUT_SC_Compu "" TAB_VERB 2 0 "False" 1 "True" /end COMPU_VTAB
/begin COMPU_METHOD EpmHCrS_stNoiseRej_State_t "" TAB_VERB "%6.3" "" COMPU_TAB_REF EpmHCrS_stNoiseRej_State_t /end COMPU_METHOD
/begin COMPU_VTAB EpmHCrS_stNoiseRej_State_t "" TAB_VERB 5 0 "GAPCRIT1" 1 "GAPCRIT2" 2 "FIRSTGAP" 3 "TOOTHBEFOREWAITGAP" 4 "WAITGAPTOOTH" /end COMPU_VTAB
/begin COMPU_METHOD EpmHCrS_stSigMode_State_t "" TAB_VERB "%6.3" "" COMPU_TAB_REF EpmHCrS_stSigMode_State_t /end COMPU_METHOD
/begin COMPU_VTAB EpmHCrS_stSigMode_State_t "" TAB_VERB 9 0 "HALT" 1 "WAITSIG" 2 "IGNTIME" 3 "IGNEDGE" 4 "WAITGAP" 5 "KEEPDGISYNC" 6 "GAPFOUND" 7 "TIMERMODE" 8 "DISBLNEWSYNC" /end COMPU_VTAB
/begin COMPU_METHOD EPMHWE_RTM_SY_Compu "" TAB_VERB "%6.3" "" COMPU_TAB_REF EPMHWE_RTM_SY_Compu /end COMPU_METHOD
/begin COMPU_VTAB EPMHWE_RTM_SY_Compu "" TAB_VERB 2 0 "NO_RTM" 1 "RTM" /end COMPU_VTAB
/begin COMPU_METHOD EPMHWE_SWTCPU_SY_Compu "" TAB_VERB "%6.3" "" COMPU_TAB_REF EPMHWE_SWTCPU_SY_Compu /end COMPU_METHOD
/begin COMPU_VTAB EPMHWE_SWTCPU_SY_Compu "" TAB_VERB 2 0 "PCP" 1 "CPU" /end COMPU_VTAB
/begin COMPU_METHOD EpmRRS_stAgDetect_t "" TAB_VERB "%6.3" "" COMPU_TAB_REF EpmRRS_stAgDetect_t /end COMPU_METHOD
/begin COMPU_VTAB EpmRRS_stAgDetect_t "" TAB_VERB 3 0 "EPMRRS_DISABLE" 1 "EPMRRS_ENABLE" 2 "EPMRRS_CONFIRM" /end COMPU_VTAB
/begin COMPU_METHOD EpmRRS_stRotDir_t "" TAB_VERB "%6.3" "" COMPU_TAB_REF EpmRRS_stRotDir_t /end COMPU_METHOD
/begin COMPU_VTAB EpmRRS_stRotDir_t "" TAB_VERB 4 0 "AMBI" 1 "FORWARD" 2 "BACKWARD" 3 "STOPPED" /end COMPU_VTAB
/begin COMPU_METHOD EPMRRS_SY_Compu "" TAB_VERB "%6.3" "" COMPU_TAB_REF EPMRRS_SY_Compu /end COMPU_METHOD
/begin COMPU_VTAB EPMRRS_SY_Compu "" TAB_VERB 3 0 "NO_RRS" 1 "REV" 2 "REV_STOP" /end COMPU_VTAB
/begin COMPU_METHOD EPMRRS_TITEMP_CURX_SC_Compu "" RAT_FUNC "%6.2" "" COEFFS 0 1 0 0 0 1 /end COMPU_METHOD
/begin COMPU_METHOD EPMRVSROTYMETH_SY_Compu "" TAB_VERB "%6.3" "" COMPU_TAB_REF EPMRVSROTYMETH_SY_Compu /end COMPU_METHOD
/begin COMPU_VTAB EPMRVSROTYMETH_SY_Compu "" TAB_VERB 2 0 "TOOTHPERD" 1 "PLSTI" /end COMPU_VTAB
/begin COMPU_METHOD EpmSeq_numInt_Compu "" TAB_VERB "%6.3" "" COMPU_TAB_REF EpmSeq_numInt_Compu /end COMPU_METHOD
/begin COMPU_VTAB EpmSeq_numInt_Compu "" TAB_VERB 9 0 "S_0" 1 "S_1" 2 "S_0_FIRST" 3 "S_1_FIRST" 6 "S_0_FIRST_START" 7 "S_1_FIRST_START" 8 "S_EPM" 16 "S_INI" 32 "S_0_H" /end COMPU_VTAB
/begin COMPU_METHOD EpmSeq_stInt_Compu "" TAB_VERB "%6.3" "" COMPU_TAB_REF EpmSeq_stInt_Compu /end COMPU_METHOD
/begin COMPU_VTAB EpmSeq_stInt_Compu "" TAB_VERB 6 0 "ST_S_0" 1 "ST_S_1" 4 "ST_S_0_START" 5 "ST_S_1_START" 8 "ST_EPM" 32 "ST_S_0_H" /end COMPU_VTAB
/begin COMPU_METHOD EpmSrv_stCnvAgT2Ag_t "" TAB_VERB "%6.3" "" COMPU_TAB_REF EpmSrv_stCnvAgT2Ag_t /end COMPU_METHOD
/begin COMPU_VTAB EpmSrv_stCnvAgT2Ag_t "" TAB_VERB 30 0 "0" 1 "1" 2 "2" 3 "3" 4 "4" 5 "5" 6 "6" 7 "7" 8 "8" 9 "9" 10 "10" 11 "11" 12 "12" 13 "13" 14 "14" 15 "15" 16 "16" 17 "17" 18 "18" 19 "19" 20 "20" 21 "21" 22 "22" 23 "23" 24 "24" 25 "AVRGSPD" 26 "EXTRAPOLATION" 253 "ERRORSTGY" 254 "ERRORCRS" 255 "ERRORMIAP" /end COMPU_VTAB
/begin COMPU_METHOD EPMSYN_CAMSFTPATACTV_SC_Compu "" TAB_VERB "%6.3" "" COMPU_TAB_REF EPMSYN_CAMSFTPATACTV_SC_Compu /end COMPU_METHOD
/begin COMPU_VTAB EPMSYN_CAMSFTPATACTV_SC_Compu "" TAB_VERB 2 0 "False" 1 "True" /end COMPU_VTAB
/begin COMPU_METHOD EPMSYN_CPPACTV_SC_Compu "" TAB_VERB "%6.3" "" COMPU_TAB_REF EPMSYN_CPPACTV_SC_Compu /end COMPU_METHOD
/begin COMPU_VTAB EPMSYN_CPPACTV_SC_Compu "" TAB_VERB 2 0 "False" 1 "True" /end COMPU_VTAB
/begin COMPU_METHOD EPMSYN_CRKSFTPATACTV_SC_Compu "" TAB_VERB "%6.3" "" COMPU_TAB_REF EPMSYN_CRKSFTPATACTV_SC_Compu /end COMPU_METHOD
/begin COMPU_VTAB EPMSYN_CRKSFTPATACTV_SC_Compu "" TAB_VERB 2 0 "False" 1 "True" /end COMPU_VTAB
/begin COMPU_METHOD EPMSYN_CRKSFTTOOTHTACTV_SC_Compu "" TAB_VERB "%6.3" "" COMPU_TAB_REF EPMSYN_CRKSFTTOOTHTACTV_SC_Compu /end COMPU_METHOD
/begin COMPU_VTAB EPMSYN_CRKSFTTOOTHTACTV_SC_Compu "" TAB_VERB 2 0 "False" 1 "True" /end COMPU_VTAB
/begin COMPU_METHOD EPMSYN_DBLIGNACTV_SC_Compu "" TAB_VERB "%6.3" "" COMPU_TAB_REF EPMSYN_DBLIGNACTV_SC_Compu /end COMPU_METHOD
/begin COMPU_VTAB EPMSYN_DBLIGNACTV_SC_Compu "" TAB_VERB 2 0 "False" 1 "True" /end COMPU_VTAB
/begin COMPU_METHOD EPMSYN_INJRLS_SC_Compu "" TAB_VERB "%6.3" "" COMPU_TAB_REF EPMSYN_INJRLS_SC_Compu /end COMPU_METHOD
/begin COMPU_VTAB EPMSYN_INJRLS_SC_Compu "" TAB_VERB 2 0 "INJRLS_ALWAYS" 1 "INJRLS_AFTERANGLE" /end COMPU_VTAB
/begin COMPU_METHOD EPMSYN_INTKMNFLDPACTV_SC_Compu "" TAB_VERB "%6.3" "" COMPU_TAB_REF EPMSYN_INTKMNFLDPACTV_SC_Compu /end COMPU_METHOD
/begin COMPU_VTAB EPMSYN_INTKMNFLDPACTV_SC_Compu "" TAB_VERB 2 0 "False" 1 "True" /end COMPU_VTAB
/begin COMPU_METHOD EPMSYN_MISFACTVTEST_SC_Compu "" TAB_VERB "%6.3" "" COMPU_TAB_REF EPMSYN_MISFACTVTEST_SC_Compu /end COMPU_METHOD
/begin COMPU_VTAB EPMSYN_MISFACTVTEST_SC_Compu "" TAB_VERB 2 0 "False" 1 "True" /end COMPU_VTAB
/begin COMPU_METHOD EPMSYN_NRSYNCNCFG_SC_Compu "" RAT_FUNC "%6.2" "" COEFFS 0 1 0 0 0 1 /end COMPU_METHOD
/begin COMPU_METHOD EPMSYN_NUMACTVMETHOD_VERB "" TAB_VERB "%6.3" "" COMPU_TAB_REF EPMSYN_NUMACTVMETHOD_VERB /end COMPU_METHOD
/begin COMPU_VTAB EPMSYN_NUMACTVMETHOD_VERB "" TAB_VERB 8 0 "CRKSFTPAT" 1 "CAMSFTPAT" 2 "CRKSFTTOOTHT" 3 "INTKMNFLDP" 4 "DBLIGN" 5 "TESTINJ" 6 "CPP" 7 "MISFACTVTEST" /end COMPU_VTAB
/begin COMPU_METHOD EPMSYN_NUMSYNCCFG_VERB "" TAB_VERB "%6.3" "" COMPU_TAB_REF EPMSYN_NUMSYNCCFG_VERB /end COMPU_METHOD
/begin COMPU_VTAB EPMSYN_NUMSYNCCFG_VERB "" TAB_VERB 11 0 "CFG0" 1 "CFG1" 2 "CFG2" 3 "CFG3" 4 "CFG4" 5 "CFG5" 6 "CFG6" 7 "CFG7" 8 "CFG8" 9 "CFG9" 10 "CFG10" /end COMPU_VTAB
/begin COMPU_METHOD EPMSYN_PHIINCCOR_CURX_SC_Compu "" RAT_FUNC "%6.2" "" COEFFS 0 1 0 0 0 1 /end COMPU_METHOD
/begin COMPU_METHOD EPMSYN_STSYNCSTGY_VERB "" TAB_VERB "%6.3" "" COMPU_TAB_REF EPMSYN_STSYNCSTGY_VERB /end COMPU_METHOD
/begin COMPU_VTAB EPMSYN_STSYNCSTGY_VERB "" TAB_VERB 7 16 "ACTV_NXT_CFG0" 17 "ACTV_NXT_CFG1" 18 "ACTV_NXT_CFG2" 19 "ACTV_NXT_CFG3" 20 "ACTV_NXT_CFG4" 21 "ACTV_NXT_CFG5" 0 "NOT_ACTV" /end COMPU_VTAB
/begin COMPU_METHOD EpmSyn_stSync_W "" TAB_VERB "%6.3" "" COMPU_TAB_REF EpmSyn_stSync_W /end COMPU_METHOD
/begin COMPU_VTAB EpmSyn_stSync_W "" TAB_VERB 6 0 "EPMSYN_NOTACTV" 1 "EPMSYN_ACTV" 2 "EPMSYN_SYNC" 3 "EPMSYN_NOSYNC" 4 "EPMSYN_DBLIGN" 5 "EPMSYN_TSTINJ" /end COMPU_VTAB
/begin COMPU_METHOD EPMSYN_TESTINJACTV_SC_Compu "" TAB_VERB "%6.3" "" COMPU_TAB_REF EPMSYN_TESTINJACTV_SC_Compu /end COMPU_METHOD
/begin COMPU_VTAB EPMSYN_TESTINJACTV_SC_Compu "" TAB_VERB 2 0 "False" 1 "True" /end COMPU_VTAB
/begin COMPU_METHOD EPM_ATS_SY_Compu "" TAB_VERB "%6.3" "" COMPU_TAB_REF EPM_ATS_SY_Compu /end COMPU_METHOD
/begin COMPU_VTAB EPM_ATS_SY_Compu "" TAB_VERB 2 0 "NO_ACCESS" 1 "ACCESS" /end COMPU_VTAB
/begin COMPU_METHOD EPM_CUSTADP_SC_Compu "" TAB_VERB "%6.3" "" COMPU_TAB_REF EPM_CUSTADP_SC_Compu /end COMPU_METHOD
/begin COMPU_VTAB EPM_CUSTADP_SC_Compu "" TAB_VERB 2 0 "False" 1 "True" /end COMPU_VTAB
/begin COMPU_METHOD EPM_DIAGSPC_SY_Compu "" TAB_VERB "%6.3" "" COMPU_TAB_REF EPM_DIAGSPC_SY_Compu /end COMPU_METHOD
/begin COMPU_VTAB EPM_DIAGSPC_SY_Compu "" TAB_VERB 4 0 "NOSPC" 1 "SPCCRS" 2 "SPCCAS" 3 "SPCCRSCAS" /end COMPU_VTAB
/begin COMPU_METHOD EPM_FAC_PLAUS "" RAT_FUNC "%6.4" "-" COEFFS 0 16 0 0 0 1 /end COMPU_METHOD
/begin COMPU_METHOD EPM_KEEPDGISYNC_SC_Compu "" TAB_VERB "%6.3" "" COMPU_TAB_REF EPM_KEEPDGISYNC_SC_Compu /end COMPU_METHOD
/begin COMPU_VTAB EPM_KEEPDGISYNC_SC_Compu "" TAB_VERB 2 0 "STD" 1 "KEEPDGISYNC" /end COMPU_VTAB
/begin COMPU_METHOD EPM_MEASURE_SY_Compu "" TAB_VERB "%6.3" "" COMPU_TAB_REF EPM_MEASURE_SY_Compu /end COMPU_METHOD
/begin COMPU_VTAB EPM_MEASURE_SY_Compu "" TAB_VERB 3 0 "NO_MP" 1 "TEST_MP" 2 "RAW_AG_TEST_MP" /end COMPU_VTAB
/begin COMPU_METHOD EPM_NRAGEVE_SC_Compu "" RAT_FUNC "%6.2" "" COEFFS 0 1 0 0 0 1 /end COMPU_METHOD
/begin COMPU_METHOD EPM_NRVIRTSYN_SC_Compu "" RAT_FUNC "%6.2" "" COEFFS 0 1 0 0 0 1 /end COMPU_METHOD
/begin COMPU_METHOD EPM_RVSROTPRED_SC_Compu "" TAB_VERB "%6.3" "" COMPU_TAB_REF EPM_RVSROTPRED_SC_Compu /end COMPU_METHOD
/begin COMPU_VTAB EPM_RVSROTPRED_SC_Compu "" TAB_VERB 2 0 "Deactvd" 1 "Inct_Ti_Thd" /end COMPU_VTAB
/begin COMPU_METHOD EPM_SPD_CALC_SY_Compu "" TAB_VERB "%6.3" "" COMPU_TAB_REF EPM_SPD_CALC_SY_Compu /end COMPU_METHOD
/begin COMPU_VTAB EPM_SPD_CALC_SY_Compu "" TAB_VERB 4 0 "SPD_IN_IGNEDGE" 1 "SPD_IN_WAITGAP" 2 "SPD_LOW_NEG" 3 "SPD_LOW_NEG_HIRES" /end COMPU_VTAB
/begin COMPU_METHOD EPM_STRTSELECT_SC_Compu "" TAB_VERB "%6.3" "" COMPU_TAB_REF EPM_STRTSELECT_SC_Compu /end COMPU_METHOD
/begin COMPU_VTAB EPM_STRTSELECT_SC_Compu "" TAB_VERB 5 0 "NO_SELECT" 1 "SEL_StaActV_C" 2 "SEL_StaActV_CA02" 3 "SEL_StaActV_CA03" 4 "SEL_StaActV_CA04" /end COMPU_VTAB
/begin COMPU_METHOD Epm_stSync_W "" TAB_VERB "%6.3" "" COMPU_TAB_REF Epm_stSync_W /end COMPU_METHOD
/begin COMPU_VTAB Epm_stSync_W "" TAB_VERB 5 0 "EPM_NO_SYNC" 10 "EPM_ALE_SYNC" 20 "EPM_CAS_SYNC" 21 "EPM_DIRSTALE_SYNC" 30 "EPM_FULL_SYNC" /end COMPU_VTAB
/begin COMPU_METHOD EPM_SYNCSLV_SY_Compu "" TAB_VERB "%6.3" "" COMPU_TAB_REF EPM_SYNCSLV_SY_Compu /end COMPU_METHOD
/begin COMPU_VTAB EPM_SYNCSLV_SY_Compu "" TAB_VERB 2 0 "NO_SLV_SYNC" 1 "SLV_VIA_CAN_SYNC" /end COMPU_VTAB
/begin COMPU_METHOD EPM_TDCDSTCLB_SC_Compu "" TAB_VERB "%6.3" "" COMPU_TAB_REF EPM_TDCDSTCLB_SC_Compu /end COMPU_METHOD
/begin COMPU_VTAB EPM_TDCDSTCLB_SC_Compu "" TAB_VERB 2 0 "STANDARD" 1 "ARRAY" /end COMPU_VTAB
/begin COMPU_METHOD EPM_TIMING_SY_Compu "" TAB_VERB "%6.3" "" COMPU_TAB_REF EPM_TIMING_SY_Compu /end COMPU_METHOD
/begin COMPU_VTAB EPM_TIMING_SY_Compu "" TAB_VERB 3 0 "STD" 1 "HE_ONEBOX" 2 "RC_MASLV" /end COMPU_VTAB
/begin COMPU_METHOD EPM_VAR_SY_Compu "" TAB_VERB "%6.3" "" COMPU_TAB_REF EPM_VAR_SY_Compu /end COMPU_METHOD
/begin COMPU_VTAB EPM_VAR_SY_Compu "" TAB_VERB 44 1 "DAI" 3 "VWW" 4 "POR" 5 "AUD" 6 "OPE" 9 "FIA" 11 "BMW" 14 "PSA" 15 "REN" 17 "ALF" 18 "SAB" 19 "VOL" 20 "NIS" 21 "GMU" 22 "FOR" 26 "ISZ" 36 "MAN" 51 "SEA" 53 "CHR" 54 "JAG" 55 "ROL" 69 "FER" 72 "TOY" 123 "MIT" 147 "HYU" 159 "HON" 160 "MAZ" 183 "CU" 190 "LRG" 204 "VVW" 214 "AVT" 242 "Iveco" 243 "DMC" 248 "SUZ" 270 "KEF" 289 "AMG" 308 "TAT" 319 "MVM" 385 "UAES" 828 "RBCD" 999 "ALL" 2887 "Nonox" 9454 "Fuso" 9740 "Navistar" /end COMPU_VTAB
/begin COMPU_METHOD ERRLMP_ATSINTVMOD_SY_Compu "" TAB_VERB "%6.3" "" COMPU_TAB_REF ERRLMP_ATSINTVMOD_SY_Compu /end COMPU_METHOD
/begin COMPU_VTAB ERRLMP_ATSINTVMOD_SY_Compu "" TAB_VERB 2 0 "FALSE" 1 "TRUE" /end COMPU_VTAB
/begin COMPU_METHOD ERRLMP_CUST_SY_Compu "" TAB_VERB "%6.3" "" COMPU_TAB_REF ERRLMP_CUST_SY_Compu /end COMPU_METHOD
/begin COMPU_VTAB ERRLMP_CUST_SY_Compu "" TAB_VERB 5 0 "ERRLMP_RB" 1 "ERRLMP_VAG" 2 "ERRLMP_BMW" 3 "ERRLMP_DAcom" 4 "ERRLMP_MSE" /end COMPU_VTAB
/begin COMPU_METHOD ERRLMP_UNIFY_SC_Compu "" TAB_VERB "%6.3" "" COMPU_TAB_REF ERRLMP_UNIFY_SC_Compu /end COMPU_METHOD
/begin COMPU_VTAB ERRLMP_UNIFY_SC_Compu "" TAB_VERB 2 0 "False" 1 "True" /end COMPU_VTAB
/begin COMPU_METHOD ESC_ACTVTSYNTSKCHAIN_SC_Compu "" TAB_VERB "%6.3" "" COMPU_TAB_REF ESC_ACTVTSYNTSKCHAIN_SC_Compu /end COMPU_METHOD
/begin COMPU_VTAB ESC_ACTVTSYNTSKCHAIN_SC_Compu "" TAB_VERB 2 0 "DEACTIVE" 1 "ACTIVE" /end COMPU_VTAB
/begin COMPU_METHOD ESC_SYNCTASK_SC_Compu "" TAB_VERB "%6.3" "" COMPU_TAB_REF ESC_SYNCTASK_SC_Compu /end COMPU_METHOD
/begin COMPU_VTAB ESC_SYNCTASK_SC_Compu "" TAB_VERB 3 0 "0" 1 "1" 2 "2" /end COMPU_VTAB
/begin COMPU_METHOD Eta "" RAT_FUNC "%6.4" "Nm/(mg/cyc)" COEFFS 0 128 0 0 0 1 /end COMPU_METHOD
/begin COMPU_METHOD Eta1 "" RAT_FUNC "%6.4" "-" COEFFS 0 128 0 0 0 1 /end COMPU_METHOD
/begin COMPU_METHOD Eta2 "" RAT_FUNC "%6.4" "" COEFFS 0 128 0 0 0 1 /end COMPU_METHOD
/begin COMPU_METHOD ETCtlGovKi_fac "" RAT_FUNC "%8.7" "-" COEFFS 0 429496.7296 0 0 0 1 /end COMPU_METHOD
/begin COMPU_METHOD ETCtlGovKp_fac "" RAT_FUNC "%7.6" "-" COEFFS 0 25600 0 0 0 1 /end COMPU_METHOD
/begin COMPU_METHOD ETCtlGov_p0q001 "" RAT_FUNC "%6.5" "-" COEFFS 0 1000 0 0 0 1 /end COMPU_METHOD
/begin COMPU_METHOD ETC_Act_SY_Compu "" TAB_VERB "%6.3" "" COMPU_TAB_REF ETC_Act_SY_Compu /end COMPU_METHOD
/begin COMPU_VTAB ETC_Act_SY_Compu "" TAB_VERB 2 0 "False" 1 "True" /end COMPU_VTAB
/begin COMPU_METHOD ETH_SC_Compu "" TAB_VERB "%6.3" "" COMPU_TAB_REF ETH_SC_Compu /end COMPU_METHOD
/begin COMPU_VTAB ETH_SC_Compu "" TAB_VERB 2 0 "False" 1 "True" /end COMPU_VTAB
/begin COMPU_METHOD ETKS_SY_Compu "" TAB_VERB "%6.3" "" COMPU_TAB_REF ETKS_SY_Compu /end COMPU_METHOD
/begin COMPU_VTAB ETKS_SY_Compu "" TAB_VERB 2 0 "No ETKS" 1 "ETKS" /end COMPU_VTAB
/begin COMPU_METHOD EVTYP_SY_Compu "" TAB_VERB "%6.3" "" COMPU_TAB_REF EVTYP_SY_Compu /end COMPU_METHOD
/begin COMPU_VTAB EVTYP_SY_Compu "" TAB_VERB 2 0 "NOEV" 1 "EV" /end COMPU_VTAB
/begin COMPU_METHOD EXH2BNKACTVNTYPSEL_SC_Compu "" TAB_VERB "%6.3" "" COMPU_TAB_REF EXH2BNKACTVNTYPSEL_SC_Compu /end COMPU_METHOD
/begin COMPU_VTAB EXH2BNKACTVNTYPSEL_SC_Compu "" TAB_VERB 2 0 "False" 1 "True" /end COMPU_VTAB
/begin COMPU_METHOD EXHBNKNUM_SY_Compu "" RAT_FUNC "%6.2" "" COEFFS 0 1 0 0 0 1 /end COMPU_METHOD
/begin COMPU_METHOD EXHMODCFG_SC_Compu "" TAB_VERB "%6.3" "" COMPU_TAB_REF EXHMODCFG_SC_Compu /end COMPU_METHOD
/begin COMPU_VTAB EXHMODCFG_SC_Compu "" TAB_VERB 2 0 "0" 1 "1" /end COMPU_VTAB
/begin COMPU_METHOD EXHMOD_TSPS1_SC_Compu "" TAB_VERB "%6.3" "" COMPU_TAB_REF EXHMOD_TSPS1_SC_Compu /end COMPU_METHOD
/begin COMPU_VTAB EXHMOD_TSPS1_SC_Compu "" TAB_VERB 2 0 "False" 1 "True" /end COMPU_VTAB
/begin COMPU_METHOD FacReactVel_COMPU "" RAT_FUNC "%6.2" "mol/s/m" COEFFS 0 1 0 0 0 1 /end COMPU_METHOD
/begin COMPU_METHOD FacReactVel_q100p0_COMPU "" RAT_FUNC "%6.0" "mol/s/m" COEFFS 0 0.01 0 0 0 1 /end COMPU_METHOD
/begin COMPU_METHOD Fact1 "" RAT_FUNC "%6.4" "-" COEFFS 0 128 0 0 0 1 /end COMPU_METHOD
/begin COMPU_METHOD fak_q0p01 "" RAT_FUNC "%6.4" "" COEFFS 0 100 0 0 0 1 /end COMPU_METHOD
/begin COMPU_METHOD fak_q0p1 "" RAT_FUNC "%6.3" "-" COEFFS 0 1 0 0 0 0.1 /end COMPU_METHOD
/begin COMPU_METHOD fak_ub_b4 "" RAT_FUNC "%6.4" "-" COEFFS 0 256 0 0 0 4 /end COMPU_METHOD
/begin COMPU_METHOD GptaClc6_ti_COMPU "" RAT_FUNC "%6.3" "us" COEFFS 0 2.5 0 0 0 1 /end COMPU_METHOD
/begin COMPU_METHOD nmot_uw_q0p25 "" RAT_FUNC "%6.3" "1/min" COEFFS 0 1 0 0 0 0.25 /end COMPU_METHOD
/begin COMPU_METHOD OneToOne "" RAT_FUNC "%6.2" "-" COEFFS 0 1 0 0 0 1 /end COMPU_METHOD
/begin COMPU_METHOD OneToOne_ms "" RAT_FUNC "%6.2" "ms" COEFFS 0 1 0 0 0 1 /end COMPU_METHOD
/begin COMPU_METHOD OneToOne_us "" RAT_FUNC "%6.2" "us" COEFFS 0 1 0 0 0 1 /end COMPU_METHOD
/begin COMPU_METHOD Per_Dur "" RAT_FUNC "%6.2" "usec" COEFFS 0 1 0 0 0 1 /end COMPU_METHOD
/begin COMPU_METHOD Prc "" RAT_FUNC "%6.4" "%" COEFFS 0 81.92 0 0 0 1 /end COMPU_METHOD
/begin COMPU_METHOD Pres_hPa "" RAT_FUNC "%6.2" "hPa" COEFFS 0 1 0 0 0 1 /end COMPU_METHOD
/begin COMPU_METHOD p_uw_q0p078 "" RAT_FUNC "%6.4" "hPa" COEFFS 0 256 0 0 0 20 /end COMPU_METHOD
/begin COMPU_METHOD q1p22Em3_ml_DIV_s "" RAT_FUNC "%6.4" "ml/s" COEFFS 0 8192 0 0 0 10 /end COMPU_METHOD
/begin COMPU_METHOD RBPtCel_v_0p05625_1 "" RAT_FUNC "%6.4" "km/h" COEFFS 0 640 0 0 0 36 /end COMPU_METHOD
/begin COMPU_METHOD relDK_q0p02441 "" RAT_FUNC "%6.4" "%DK" COEFFS 0 65536 0 0 0 1600 /end COMPU_METHOD
/begin COMPU_METHOD rel_ub_q0p75 "" RAT_FUNC "%6.3" "%" COEFFS 0 1 0 0 0 0.75 /end COMPU_METHOD
/begin COMPU_METHOD rel_uw_b102p4 "" RAT_FUNC "%6.4" "" COEFFS 0 65536 0 0 0 102.4 /end COMPU_METHOD
/begin COMPU_METHOD RevCnt "" RAT_FUNC "%6.4" "-" COEFFS 0 16 0 0 0 1 /end COMPU_METHOD
/begin COMPU_METHOD spg_ubatt "" RAT_FUNC "%6.4" "V" COEFFS 0 14.2045454545455 0 0 0 1 /end COMPU_METHOD
/begin COMPU_METHOD t10msxs_sb_q0p01 "" RAT_FUNC "%6.4" "s" COEFFS 0 1 0 0 0 0.01 /end COMPU_METHOD
/begin COMPU_METHOD Temp_Cels "" RAT_FUNC "%6.1" "deg C" COEFFS 0 10 2731.4 0 0 1 /end COMPU_METHOD
/begin COMPU_METHOD t_q0p002 "" RAT_FUNC "%6.4" "s" COEFFS 0 1000 0 0 0 2 /end COMPU_METHOD
/begin COMPU_METHOD t_q0p01 "" RAT_FUNC "%6.4" "s" COEFFS 0 100 0 0 0 1 /end COMPU_METHOD
/begin COMPU_METHOD t_q0p05 "" RAT_FUNC "%6.4" "s" COEFFS 0 100 0 0 0 5 /end COMPU_METHOD
/begin COMPU_METHOD t_q0p1 "" RAT_FUNC "%6.3" "s" COEFFS 0 10 0 0 0 1 /end COMPU_METHOD
/begin COMPU_METHOD t_q10_ms "" RAT_FUNC "%6.1" "ms" COEFFS 0 1 0 0 0 10 /end COMPU_METHOD
/begin COMPU_METHOD Vel "" RAT_FUNC "%6.4" "km/h" COEFFS 0 100 0 0 0 1 /end COMPU_METHOD
/begin COMPU_METHOD vel_q0p01 "" RAT_FUNC "%6.4" "km/h" COEFFS 0 100 0 0 0 1 /end COMPU_METHOD
/begin COMPU_METHOD vfzg_ub_q1p25 "" RAT_FUNC "%6.2" "km/h" COEFFS 0 1 0 0 0 1.25 /end COMPU_METHOD
/begin COMPU_METHOD vfzg_uw_b512 "" RAT_FUNC "%6.4" "km/h" COEFFS 0 65536 0 0 0 512 /end COMPU_METHOD
/begin COMPU_METHOD default "" RAT_FUNC "%6.2" "" COEFFS 0 1 0 0 0 1 /end COMPU_METHOD
/*********** End of merged RECORD_LAYOUT blocks ***********/
/begin RECORD_LAYOUT Cur_Xs16Ws16 NO_AXIS_PTS_X 1 SWORD AXIS_PTS_X 2 SWORD INDEX_INCR DIRECT FNC_VALUES 3 SWORD COLUMN_DIR DIRECT /end RECORD_LAYOUT
/begin RECORD_LAYOUT KwUb FNC_VALUES 1 UBYTE COLUMN_DIR DIRECT /end RECORD_LAYOUT
/begin RECORD_LAYOUT KwWS16 FNC_VALUES 1 SWORD COLUMN_DIR DIRECT /end RECORD_LAYOUT
/begin RECORD_LAYOUT KwWU16 FNC_VALUES 1 UWORD COLUMN_DIR DIRECT /end RECORD_LAYOUT
/begin RECORD_LAYOUT KwWU8 FNC_VALUES 1 UBYTE COLUMN_DIR DIRECT /end RECORD_LAYOUT
/begin RECORD_LAYOUT Map_Xu8Yu8Wu8 NO_AXIS_PTS_X 1 UBYTE NO_AXIS_PTS_Y 2 UBYTE AXIS_PTS_X 3 UBYTE INDEX_INCR DIRECT AXIS_PTS_Y 4 UBYTE INDEX_INCR DIRECT FNC_VALUES 5 UBYTE COLUMN_DIR DIRECT /end RECORD_LAYOUT
/begin RECORD_LAYOUT RB_Curve_S16_S16 NO_AXIS_PTS_X 1 SWORD AXIS_PTS_X 2 SWORD INDEX_INCR DIRECT FNC_VALUES 3 SWORD COLUMN_DIR DIRECT /end RECORD_LAYOUT
/begin RECORD_LAYOUT RB_Curve_U8_S8_Static NO_AXIS_PTS_X 1 UBYTE AXIS_PTS_X 2 UBYTE INDEX_INCR DIRECT FNC_VALUES 3 SBYTE COLUMN_DIR DIRECT STATIC_RECORD_LAYOUT /end RECORD_LAYOUT
/begin RECORD_LAYOUT RB_Map_S16S16_S16 NO_AXIS_PTS_X 1 SWORD NO_AXIS_PTS_Y 2 SWORD AXIS_PTS_X 3 SWORD INDEX_INCR DIRECT AXIS_PTS_Y 4 SWORD INDEX_INCR DIRECT FNC_VALUES 5 SWORD COLUMN_DIR DIRECT /end RECORD_LAYOUT
/begin RECORD_LAYOUT ValA_Ws16 FNC_VALUES 1 SWORD COLUMN_DIR DIRECT /end RECORD_LAYOUT
/begin RECORD_LAYOUT ValA_Ws32 FNC_VALUES 1 SLONG COLUMN_DIR DIRECT /end RECORD_LAYOUT
/begin RECORD_LAYOUT ValA_Wu8 FNC_VALUES 1 UBYTE COLUMN_DIR DIRECT /end RECORD_LAYOUT
/begin RECORD_LAYOUT Val_Ws16 FNC_VALUES 1 SWORD COLUMN_DIR DIRECT /end RECORD_LAYOUT
/begin RECORD_LAYOUT Val_Ws32 FNC_VALUES 1 SLONG COLUMN_DIR DIRECT /end RECORD_LAYOUT
/begin RECORD_LAYOUT Val_Ws8 FNC_VALUES 1 SBYTE COLUMN_DIR DIRECT /end RECORD_LAYOUT
/begin RECORD_LAYOUT Val_Wu16 FNC_VALUES 1 UWORD COLUMN_DIR DIRECT /end RECORD_LAYOUT
/begin RECORD_LAYOUT Val_Wu8 FNC_VALUES 1 UBYTE COLUMN_DIR DIRECT /end RECORD_LAYOUT
/end MODULE
/end PROJECT
