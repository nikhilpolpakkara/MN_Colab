/*-- Generated by ICE 2.3.2 --*/
/* Created by DAMOS++ V5.8.15.2 Win10 */
ASAP2_VERSION 1 60
/begin PROJECT MSE2_BJ10_0038_00 "MDG1"
/begin HEADER "" VERSION "MSE2_BJ10_0038_00" PROJECT_NO MSE2_BJ10_0038_00 /end HEADER
/begin MODULE DIM ""
/begin MOD_PAR "MDG1" VERSION "MSE2_BJ10_0038_00" ADDR_EPK 0x9080228 EPK "36/1/MDG1/386///MSE2_BJ10_0038_00///" CUSTOMER_NO "386" USER "" PHONE_NO "" ECU "MDG1" CPU_TYPE "JDP"
 /begin MEMORY_SEGMENT Pst9040000 "" RESERVED FLASH INTERN 0x9040000 0x40000 -1 -1 -1 -1 -1 /end MEMORY_SEGMENT
 /begin MEMORY_SEGMENT Pst9000000 "" RESERVED FLASH INTERN 0x9000000 0x20 -1 -1 -1 -1 -1 /end MEMORY_SEGMENT
 /begin MEMORY_SEGMENT Pst9000020 "" RESERVED FLASH INTERN 0x9000020 0x1FFE0 -1 -1 -1 -1 -1 /end MEMORY_SEGMENT
 /begin MEMORY_SEGMENT Pst9020000 "" RESERVED FLASH INTERN 0x9020000 0xC000 -1 -1 -1 -1 -1 /end MEMORY_SEGMENT
 /begin MEMORY_SEGMENT Pst90C0000 "" CODE FLASH INTERN 0x90C0000 0xA9A80 -1 -1 -1 -1 -1
  /begin IF_DATA XCPplus 0x0102
   /begin SEGMENT 0 0x01 0x00 0x00 0x00
    /begin CHECKSUM XCP_CRC_32 /* checksum: add bytes to 16bit result */ MAX_BLOCK_SIZE 0xFFFFFFFF /end CHECKSUM
    /begin PAGE 0x00 ECU_ACCESS_WITH_XCP_ONLY XCP_READ_ACCESS_WITH_ECU_ONLY XCP_WRITE_ACCESS_NOT_ALLOWED /end PAGE
   /end SEGMENT
  /end IF_DATA
 /end MEMORY_SEGMENT
 /begin MEMORY_SEGMENT Pst9169A80 "" RESERVED FLASH INTERN 0x9169A80 0x540 -1 -1 -1 -1 -1 /end MEMORY_SEGMENT
 /begin MEMORY_SEGMENT Pst90BFAE0 "" RESERVED FLASH INTERN 0x90BFAE0 0x520 -1 -1 -1 -1 -1 /end MEMORY_SEGMENT
 /begin MEMORY_SEGMENT Dst9080000 "" DATA FLASH INTERN 0x9080000 0x3FAE0 -1 -1 -1 -1 -1
  /begin IF_DATA XCPplus 0x0102
   /begin SEGMENT 1 0x02 0x00 0x00 0x00
    /begin CHECKSUM XCP_CRC_32 /* checksum: add bytes to 16bit result */ MAX_BLOCK_SIZE 0xFFFFFFFF /end CHECKSUM
    /begin PAGE 0x00 ECU_ACCESS_DONT_CARE XCP_READ_ACCESS_DONT_CARE XCP_WRITE_ACCESS_NOT_ALLOWED /end PAGE
    /begin PAGE 0x01 ECU_ACCESS_DONT_CARE XCP_READ_ACCESS_DONT_CARE XCP_WRITE_ACCESS_WITH_ECU_ONLY /end PAGE
   /end SEGMENT
  /end IF_DATA
 /end MEMORY_SEGMENT
 /begin MEMORY_SEGMENT Ram40000000 "" VARIABLES RAM INTERN 0x40000000 0x10000 -1 -1 -1 -1 -1
  /begin IF_DATA XCPplus 0x0102
   /begin SEGMENT 2 0x00 0x00 0x00 0x00 /end SEGMENT
  /end IF_DATA
 /end MEMORY_SEGMENT
 /begin CALIBRATION_METHOD /* name calibration methode */ "DataSetId" /* version calibration metode */ 256 /begin CALIBRATION_HANDLE /* adr data set id characteristic */ 0x9089ED2 /end CALIBRATION_HANDLE /end CALIBRATION_METHOD
 SYSTEM_CONSTANT "ACCPED_VEL_INTPOL" "1"
 SYSTEM_CONSTANT "EXTERNAL HEXFILE POST TREATMENT NAME" "hpt_hexmodX_v820.dll"
 SYSTEM_CONSTANT "EXTERNAL HEXFILE POST TREATMENT PARAMETER" "BLK_START=0x9000020"
 SYSTEM_CONSTANT "ACCPED_VN_INTPOL" "0"
 SYSTEM_CONSTANT "ACTYP_MECHELEC" "4"
 SYSTEM_CONSTANT "ADDHTR_CONST" "360"
 SYSTEM_CONSTANT "ADDLEONV_SC" "0"
 SYSTEM_CONSTANT "AGCTRL_CRKAGWINMAP_SC" "1"
 SYSTEM_CONSTANT "AGCTRL_SYNCNCPV_SC" "1"
 SYSTEM_CONSTANT "AIRCHRGMDL_SC" "2"
 SYSTEM_CONSTANT "AIRCTL_NUMBUFDDTEGRLPPOS" "26"
 SYSTEM_CONSTANT "AIRMASS_2_RES_REV" "10"
 SYSTEM_CONSTANT "AIRMSPRTIMEQ0P0003_RES" "0.0003"
 SYSTEM_CONSTANT "AIRMSQ0P1_RES" "0.1"
 SYSTEM_CONSTANT "AIRMSQ0P1_RES_REV" "10"
 SYSTEM_CONSTANT "AIRSYS_AIRCHRGMIN_SC" "0"
 SYSTEM_CONSTANT "AIRSYS_AREAEFFONE" "1"
 SYSTEM_CONSTANT "AIRSYS_AREAEFFONE_SY" "1"
 SYSTEM_CONSTANT "AIRSYS_MINDEADTIME_SY" "1"
 SYSTEM_CONSTANT "AIRSYS_TEMPTHRPST" "300"
 SYSTEM_CONSTANT "AIRSYS_TEMPTHRPST_SY" "300"
 SYSTEM_CONSTANT "ALTCRNT_LIM_RES" "0.25"
 SYSTEM_CONSTANT "ALTCRNT_OUT_RES" "0.125"
 SYSTEM_CONSTANT "ALTLD_RES" "3.125"
 SYSTEM_CONSTANT "ALTVLTG_OFS" "10.6"
 SYSTEM_CONSTANT "ALTVLTG_RES_SY" "0.1"
 SYSTEM_CONSTANT "ALT_CHPTEMP_OFS" "-32"
 SYSTEM_CONSTANT "ALT_CHPTEMP_RES" "8"
 SYSTEM_CONSTANT "AMPC_RES_REV" "10"
 SYSTEM_CONSTANT "AMPT_NOXLDUNLD_RES" "0.0001"
 SYSTEM_CONSTANT "AMPT_NOXLDUNLD_RES_REV" "10000"
 SYSTEM_CONSTANT "AMPT_NOXRGN_MIN" "0"
 SYSTEM_CONSTANT "AMPT_NOXRGN_RES" "0.0005"
 SYSTEM_CONSTANT "AMPT_NOXRGN_RES_REV" "2000"
 SYSTEM_CONSTANT "AMPT_NOX_RES" "1e-005"
 SYSTEM_CONSTANT "AMPT_NOX_RES_REV" "100000"
 SYSTEM_CONSTANT "AMPT_RES_2" "3.2e-005"
 SYSTEM_CONSTANT "AMPT_RES_2_REV" "31250"
 SYSTEM_CONSTANT "AMPT_SOX1_MIN" "0"
 SYSTEM_CONSTANT "AMPT_SOX1_RES" "0.003"
 SYSTEM_CONSTANT "APPPEDLOVRDENBL_SC" "0"
 SYSTEM_CONSTANT "ARVERS_SC" "1"
 SYSTEM_CONSTANT "ASDCTL_LEADPAHFILTGENA_SC" "1"
 SYSTEM_CONSTANT "ASMOD_FACRSTOICH" "14.5"
 SYSTEM_CONSTANT "ASMOD_HTFLW_RES" "2"
 SYSTEM_CONSTANT "ASMOD_NUMEOMCOEMI_SY" "3"
 SYSTEM_CONSTANT "ASMOD_PHC" "3"
 SYSTEM_CONSTANT "ASMOD_QLMBD" "100"
 SYSTEM_CONSTANT "ASMOD_RGN" "4"
 SYSTEM_CONSTANT "ASMOD_RM" "2"
 SYSTEM_CONSTANT "ATSENA_SC" "1"
 SYSTEM_CONSTANT "ATS_BRK_APP_SC" "0"
 SYSTEM_CONSTANT "ATS_RCCACT_SC" "0"
 SYSTEM_CONSTANT "ATS_RCCSUPPORT" "0"
 SYSTEM_CONSTANT "ATS_SPCTMR_SC" "0"
 SYSTEM_CONSTANT "AUTSTOP_AVL_SC" "0"
 SYSTEM_CONSTANT "BASEMAP_INTRPNFAC_FIVE" "5"
 SYSTEM_CONSTANT "BASEMAP_INTRPNFAC_SIX" "6"
 SYSTEM_CONSTANT "BBSTVE_SY" "0"
 SYSTEM_CONSTANT "BNL6_SY" "0"
 SYSTEM_CONSTANT "BUEK_SY" "0"
 SYSTEM_CONSTANT "BYPASS_SY" "1"
 SYSTEM_CONSTANT "CALORIFIC_VALUE" "42.5"
 SYSTEM_CONSTANT "CALORY_RES_REV" "1"
 SYSTEM_CONSTANT "CALWUP_SY" "1"
 SYSTEM_CONSTANT "CAMLIFT_RES_REV" "256"
 SYSTEM_CONSTANT "CAMPAR_A_RES_REV" "1024"
 SYSTEM_CONSTANT "CAMSFT_VARIINTK_SC" "0"
 SYSTEM_CONSTANT "CAMSFT_VARIOUTL_SC" "0"
 SYSTEM_CONSTANT "CAMSLP_RES_REV" "1024"
 SYSTEM_CONSTANT "CANNM_SC" "1"
 SYSTEM_CONSTANT "CANSM_SC" "1"
 SYSTEM_CONSTANT "CANTP_SC" "1"
 SYSTEM_CONSTANT "CASTYP_SY" "0"
 SYSTEM_CONSTANT "CAS_ADAP_SY" "0"
 SYSTEM_CONSTANT "CAS_ANGLE_SY" "0"
 SYSTEM_CONSTANT "CAS_BACKUP_SY" "0"
 SYSTEM_CONSTANT "CAS_DELAY_SC" "0"
 SYSTEM_CONSTANT "CAS_DIAG_SY" "0"
 SYSTEM_CONSTANT "CAS_I1_SY" "0"
 SYSTEM_CONSTANT "CAS_I2_SY" "0"
 SYSTEM_CONSTANT "CAS_O1_SY" "0"
 SYSTEM_CONSTANT "CAS_O2_SY" "0"
 SYSTEM_CONSTANT "CAS_OUT_SY" "0"
 SYSTEM_CONSTANT "CAS_SEGCOR_SY" "0"
 SYSTEM_CONSTANT "CATHEATGTYP_SC" "1"
 SYSTEM_CONSTANT "CDAWOSWILVLV_SC" "0"
 SYSTEM_CONSTANT "CDGEN_ENV_SC" "1"
 SYSTEM_CONSTANT "CENGDST_ATS_SY" "0"
 SYSTEM_CONSTANT "CENGDST_COOLTLAMPDIAG_SC" "0"
 SYSTEM_CONSTANT "CENGDST_ENAOVRHEATCHK_SC" "1"
 SYSTEM_CONSTANT "CHDT_SY" "0"
 SYSTEM_CONSTANT "CJ721_SC" "0"
 SYSTEM_CONSTANT "CJ722_SC" "0"
 SYSTEM_CONSTANT "CJ950_SY" "0"
 SYSTEM_CONSTANT "CJ960_SC" "0"
 SYSTEM_CONSTANT "CLUSWT_TYPAVL_SC" "1"
 SYSTEM_CONSTANT "CMBEGYUTL_SC" "0"
 SYSTEM_CONSTANT "CMBEGY_NRGAPAFT_SC" "1"
 SYSTEM_CONSTANT "CMBEGY_NRGAPBEF_SC" "0"
 SYSTEM_CONSTANT "CMBTYP_DS" "0"
 SYSTEM_CONSTANT "CMBTYP_GS" "1"
 SYSTEM_CONSTANT "CMBTYP_SY" "1"
 SYSTEM_CONSTANT "CNVTCOEFFCATAIR_RES_REV" "50"
 SYSTEM_CONSTANT "COEFFVRNT_SC" "0"
 SYSTEM_CONSTANT "COENG_RUNNING" "3"
 SYSTEM_CONSTANT "COLDSTRTHEATGCTRL_SC" "0"
 SYSTEM_CONSTANT "COMDIA_BITFAIFSUPRT_SC" "0"
 SYSTEM_CONSTANT "COMM_SC" "1"
 SYSTEM_CONSTANT "COMPACCPED_ON" "1"
 SYSTEM_CONSTANT "COMPACCPED_SY" "0"
 SYSTEM_CONSTANT "COM_SC" "1"
 SYSTEM_CONSTANT "CONV_MGS2KGS" "1000000"
 SYSTEM_CONSTANT "COVOMVERS_SC" "1"
 SYSTEM_CONSTANT "CRSSENSTYP_SY" "0"
 SYSTEM_CONSTANT "CRSTYP_SY" "0"
 SYSTEM_CONSTANT "CRS_ALTPIN_SY" "0"
 SYSTEM_CONSTANT "CRS_ANGLECOR_SY" "0"
 SYSTEM_CONSTANT "CRS_BACKUP_CASTYP_SY" "0"
 SYSTEM_CONSTANT "CRS_BACKUP_DYN_SY" "0"
 SYSTEM_CONSTANT "CRS_BACKUP_SY" "0"
 SYSTEM_CONSTANT "CRS_CY30CONF_SY" "0"
 SYSTEM_CONSTANT "CRS_DIAG_DETAIL_SY" "0"
 SYSTEM_CONSTANT "CRS_DIAG_SYNCINJLOST_SY" "0"
 SYSTEM_CONSTANT "CRS_MIAP_SY" "0"
 SYSTEM_CONSTANT "CRS_SSP_SY" "0"
 SYSTEM_CONSTANT "CRS_TAA_SY" "0"
 SYSTEM_CONSTANT "CRS_TOOTHAVRG_SY" "1"
 SYSTEM_CONSTANT "CRYPTOLIB_SC" "0"
 SYSTEM_CONSTANT "CURR_RES" "1"
 SYSTEM_CONSTANT "CVN_USE_ENVRAM" "1"
 SYSTEM_CONSTANT "CVOCFG_SC" "0"
 SYSTEM_CONSTANT "CY150_SC" "0"
 SYSTEM_CONSTANT "CY320_SY" "0"
 SYSTEM_CONSTANT "CY327_SY" "0"
 SYSTEM_CONSTANT "CYLINDINJ_SY" "0"
 SYSTEM_CONSTANT "DCS_OVRDS_ENGPRT" "1"
 SYSTEM_CONSTANT "DDRC_DTRFRZINFHEALDEB_SY" "0"
 SYSTEM_CONSTANT "DDRC_DTRUPDSUP_SY" "0"
 SYSTEM_CONSTANT "DDRC_NUM_DFC_EVTROW" "1"
 SYSTEM_CONSTANT "DDRC_NUM_DFC_EVTROW_SML" "0"
 SYSTEM_CONSTANT "DDRC_NUM_DFC_EVTUD" "0"
 SYSTEM_CONSTANT "DDRC_NUM_DFC_EVTUD_SML" "3"
 SYSTEM_CONSTANT "DDRC_NUM_DFC_TIROW" "3"
 SYSTEM_CONSTANT "DDRC_NUM_DFC_TIROW_SML" "0"
 SYSTEM_CONSTANT "DDRC_NUM_DFC_TIUD" "6"
 SYSTEM_CONSTANT "DDRC_NUM_DFC_TIUD_SML" "4"
 SYSTEM_CONSTANT "DDVOL_RES" "10"
 SYSTEM_CONSTANT "DEDIA_VRNTCONF_SY" "0"
 SYSTEM_CONSTANT "DEFDSTRTTMNGFORDIGSENS_SY" "0"
 SYSTEM_CONSTANT "DEM_SC" "0"
 SYSTEM_CONSTANT "DENSFINE_RES_REV" "500"
 SYSTEM_CONSTANT "DEVLIB_4WINDIACMPNENA_SY" "0"
 SYSTEM_CONSTANT "DEVLIB_ACTRPRTAIRHTRCHK_SY" "0"
 SYSTEM_CONSTANT "DEVLIB_ACTRPRTCMPNENA_SY" "0"
 SYSTEM_CONSTANT "DEVLIB_ACTRPRTGLWCTLCHK_SY" "0"
 SYSTEM_CONSTANT "DEVLIB_DBG_SY" "0"
 SYSTEM_CONSTANT "DEVLIB_DGK_ACTV" "1"
 SYSTEM_CONSTANT "DEVLIB_DGK_NOTACTV" "0"
 SYSTEM_CONSTANT "DEVLIB_DIACTLLINECMPNENA_SY" "0"
 SYSTEM_CONSTANT "DEVLIB_FRZVAL_MODE" "1"
 SYSTEM_CONSTANT "DEVLIB_HBRGADVHWSEL_SY" "0"
 SYSTEM_CONSTANT "DEVLIB_HBRGENA_SY" "0"
 SYSTEM_CONSTANT "DEVLIB_JMPVAL_MODE" "2"
 SYSTEM_CONSTANT "DEVLIB_PHYSRNGCHK_SY" "0"
 SYSTEM_CONSTANT "DEVLIB_PSOFFOPNLD_SY" "0"
 SYSTEM_CONSTANT "DEVLIB_PSSTATEMOCSOPINI_SY" "0"
 SYSTEM_CONSTANT "DEVLIB_PWRSTGSTATEMOCSOPCHK_SY" "0"
 SYSTEM_CONSTANT "DEVLIB_RMPVAL_MODE" "4"
 SYSTEM_CONSTANT "DEVLIB_SENSVAL_MODE" "0"
 SYSTEM_CONSTANT "DFC_CALPRMSTATDISBLMSK_SC" "0"
 SYSTEM_CONSTANT "DFC_CTLDISBLLAYOUT_SY" "1"
 SYSTEM_CONSTANT "DFC_CTLMSKBYTES_SY" "1"
 SYSTEM_CONSTANT "DFC_CTLMSK_RESCANCMSK" "1"
 SYSTEM_CONSTANT "DFC_CTLMSK_RESINIMSK" "1"
 SYSTEM_CONSTANT "DFC_DISBLMSKBYTES_SY" "1"
 SYSTEM_CONSTANT "DFES_ACTVENHMTSIMCONDPID9F_SC" "0"
 SYSTEM_CONSTANT "DFES_ACTVSIMRCDNPID03_SC" "0"
 SYSTEM_CONSTANT "DFES_ADDLMILMOD_SC" "0"
 SYSTEM_CONSTANT "DFES_AGINGCTR_VAR1" "0"
 SYSTEM_CONSTANT "DFES_BLINKPATENA_SC" "0"
 SYSTEM_CONSTANT "DFES_BLKENTRY_SY" "0"
 SYSTEM_CONSTANT "DFES_COMMILDEB_SY" "0"
 SYSTEM_CONSTANT "DFES_DTC_TSTFAIL_SY" "0"
 SYSTEM_CONSTANT "DFES_EOLCLR_SY" "1"
 SYSTEM_CONSTANT "DFES_EXTDFLT_SY" "0"
 SYSTEM_CONSTANT "DFES_IRV_SY" "0"
 SYSTEM_CONSTANT "DFES_MONITORING_LEN_SY" "1"
 SYSTEM_CONSTANT "DFES_NUMENTRIES_SY" "20"
 SYSTEM_CONSTANT "DFES_NUM_COMMON_ENV_DID" "0"
 SYSTEM_CONSTANT "DFES_NUM_COMMON_ENV_SIGNALS" "0"
 SYSTEM_CONSTANT "DFES_NUM_ENTRY_U8_BITBASE" "3"
 SYSTEM_CONSTANT "DFES_NUM_ENV_BLK" "1"
 SYSTEM_CONSTANT "DFES_NUM_ENV_BYT" "1"
 SYSTEM_CONSTANT "DFES_NUM_ENV_DID" "0"
 SYSTEM_CONSTANT "DFES_NUM_ENV_SIGNALS" "1"
 SYSTEM_CONSTANT "DFES_NUM_EXFRZFR_BYT" "0"
 SYSTEM_CONSTANT "DFES_NUM_FRFR_DID" "0"
 SYSTEM_CONSTANT "DFES_NUM_FRZFR_BYT" "27"
 SYSTEM_CONSTANT "DFES_PDTC_SY" "0"
 SYSTEM_CONSTANT "DFES_PRVTSTRDLT_SY" "0"
 SYSTEM_CONSTANT "DFES_SIMCOND_READONLY" "1"
 SYSTEM_CONSTANT "DFES_SIMCOND_SY" "0"
 SYSTEM_CONSTANT "DFES_VIS_BUF_SY" "1"
 SYSTEM_CONSTANT "DIAACTR_ELECCTRLLINEDIAGCPTENA_SC" "0"
 SYSTEM_CONSTANT "DIAACTR_ELECHBRDGDIAGENA_SC" "0"
 SYSTEM_CONSTANT "DIAACTR_ELECPSDIAGCMPNENA_SC" "1"
 SYSTEM_CONSTANT "DIAACTR_ELECPSDIAGERRINFO_SC" "0"
 SYSTEM_CONSTANT "DIAACTR_ERRTYPE_NRMAX" "4"
 SYSTEM_CONSTANT "DIAACTR_ERRTYPE_OL" "3"
 SYSTEM_CONSTANT "DIAACTR_ERRTYPE_OT" "4"
 SYSTEM_CONSTANT "DIAACTR_ERRTYPE_SCB" "1"
 SYSTEM_CONSTANT "DIAACTR_ERRTYPE_SCG" "2"
 SYSTEM_CONSTANT "DIAACTR_ERRTYPE_UNDEFINED" "0"
 SYSTEM_CONSTANT "DIAACTR_SIGTYPE_DIGOUT" "1"
 SYSTEM_CONSTANT "DIAACTR_SIGTYPE_PMD" "3"
 SYSTEM_CONSTANT "DIAACTR_SIGTYPE_PWMOUT" "2"
 SYSTEM_CONSTANT "DIAACTR_SIGTYPE_UNDEFINED" "0"
 SYSTEM_CONSTANT "DIABAS_ATSLRGIDSUPRT_SC" "0"
 SYSTEM_CONSTANT "DIABAS_ATSSUSP_SC" "1"
 SYSTEM_CONSTANT "DIABAS_ATS_SC" "1"
 SYSTEM_CONSTANT "DIABAS_AVS_SY" "0"
 SYSTEM_CONSTANT "DIABAS_CALIDCVNCTRL_SC" "1"
 SYSTEM_CONSTANT "DIABAS_CALIDCVNLENSEQ_SC" "0"
 SYSTEM_CONSTANT "DIABAS_CRCTAB_SY" "0"
 SYSTEM_CONSTANT "DIABAS_CUSVAR_SC" "0"
 SYSTEM_CONSTANT "DIABAS_IFFLOATSIG_SC" "0"
 SYSTEM_CONSTANT "DIABAS_PNDRPRTMOD2_SC" "1"
 SYSTEM_CONSTANT "DIABAS_PRMIDAUTVIEW_SC" "0"
 SYSTEM_CONSTANT "DIABAS_SCRCTL_RCNT_RESET_SY" "0"
 SYSTEM_CONSTANT "DIABAS_SRV8_SC" "0"
 SYSTEM_CONSTANT "DIAGCOM_CALCAN_SC" "0"
 SYSTEM_CONSTANT "DIAG_PROTOCOL_SY" "1"
 SYSTEM_CONSTANT "DINH_DEF25DEB0DI_SC" "0"
 SYSTEM_CONSTANT "DINH_FID_VIEW_SC" "0"
 SYSTEM_CONSTANT "DINH_MONINHBCNT_SC" "3"
 SYSTEM_CONSTANT "DINH_NEWTRIPWITHFCMCLR_SC" "0"
 SYSTEM_CONSTANT "DIPO_SY" "1"
 SYSTEM_CONSTANT "DISTAB_SY" "0"
 SYSTEM_CONSTANT "DIUMPR_500MD_SY" "0"
 SYSTEM_CONSTANT "DIUMPR_COLDSTARTDEN_SC" "0"
 SYSTEM_CONSTANT "DIUMPR_CTGEN_READONLY" "1"
 SYSTEM_CONSTANT "DIUMPR_CTGEN_TIFUENGOPMIN_RW" "0"
 SYSTEM_CONSTANT "DIUMPR_DATAFROMCAN_SC" "0"
 SYSTEM_CONSTANT "DIUMPR_DSTTRVLDSNCERST_SC" "0"
 SYSTEM_CONSTANT "DIUMPR_EVAPDENOMTIPRPSYSOFF_SC" "0"
 SYSTEM_CONSTANT "DIUMPR_EVAPDEN_SY" "0"
 SYSTEM_CONSTANT "DIUMPR_FUENGOPERTI_SC" "0"
 SYSTEM_CONSTANT "DIUMPR_NUMDENOMIDXGRP_SY" "0"
 SYSTEM_CONSTANT "DIUMPR_NUMMSGGRPS" "0"
 SYSTEM_CONSTANT "DIUMPR_NUMRATCFG" "12"
 SYSTEM_CONSTANT "DIUMPR_NUMRATCLB" "0"
 SYSTEM_CONSTANT "DIUMPR_NUMSIGCLB" "0"
 SYSTEM_CONSTANT "DIUMPR_NUM_GROUPS_SY" "10"
 SYSTEM_CONSTANT "DKPROSG_SY" "0"
 SYSTEM_CONSTANT "DM_SOX2_RES_FL" "0.004"
 SYSTEM_CONSTANT "DOIP_SC" "0"
 SYSTEM_CONSTANT "DPDIFFTMP_RES" "100"
 SYSTEM_CONSTANT "DPDIFF_RES" "0.1"
 SYSTEM_CONSTANT "DPRC_100" "100"
 SYSTEM_CONSTANT "DPRC_M_100" "-100"
 SYSTEM_CONSTANT "DPS_EV1E" "0"
 SYSTEM_CONSTANT "DPS_HDLAMP" "0"
 SYSTEM_CONSTANT "DPS_HSHE" "1"
 SYSTEM_CONSTANT "DPS_HSVE" "0"
 SYSTEM_CONSTANT "DPS_KPE" "0"
 SYSTEM_CONSTANT "DPS_LUES1E" "0"
 SYSTEM_CONSTANT "DPS_OilPPSSwt" "0"
 SYSTEM_CONSTANT "DPS_STRTR" "0"
 SYSTEM_CONSTANT "DPS_TEVE" "0"
 SYSTEM_CONSTANT "DRCTSTRT_SY" "0"
 SYSTEM_CONSTANT "DRESFLW_RES" "0.001"
 SYSTEM_CONSTANT "DRESFLW_RES_REV" "1000"
 SYSTEM_CONSTANT "DRVMOD_SC" "1"
 SYSTEM_CONSTANT "DRVPRGSWT_NUMSPRT" "0"
 SYSTEM_CONSTANT "DSCHED_COEOMEXT_SC" "0"
 SYSTEM_CONSTANT "DSCHED_COEOM_SY" "0"
 SYSTEM_CONSTANT "DSCHED_DFCSPEC_SY" "0"
 SYSTEM_CONSTANT "DSCHED_FIDMAXPRIOLST_SY" "0"
 SYSTEM_CONSTANT "DSCHED_FTI_SY" "0"
 SYSTEM_CONSTANT "DSCHED_PRIOACTVJMP_SY" "0"
 SYSTEM_CONSTANT "DSCHED_PRIODFCSTLDF_SY" "0"
 SYSTEM_CONSTANT "DSCHED_PRIODFCSTTST_SY" "0"
 SYSTEM_CONSTANT "DSCHED_PRIOPHYSURGENCY_SY" "0"
 SYSTEM_CONSTANT "DSCHED_PRIORMPCALC_SY" "0"
 SYSTEM_CONSTANT "DSCHED_RATECALC_SY" "0"
 SYSTEM_CONSTANT "DSCHED_WTT_SY" "0"
 SYSTEM_CONSTANT "DSM2AUTOSAR_ASWPF_SC" "0"
 SYSTEM_CONSTANT "DSM2AUTOSAR_DCMIF_SC" "0"
 SYSTEM_CONSTANT "DSM2AUTOSAR_DEMBSWERRORBUFFERSIZE" "30"
 SYSTEM_CONSTANT "DSM2AUTOSAR_DEV_ERROR_DETECT" "1"
 SYSTEM_CONSTANT "DSM2AUTOSAR_SC" "1"
 SYSTEM_CONSTANT "DSM2AUTOSAR_SECFCM_SC" "0"
 SYSTEM_CONSTANT "DSM2SG_DFC_SY" "0"
 SYSTEM_CONSTANT "DSM2SG_DSQ_SY" "0"
 SYSTEM_CONSTANT "DSM2SG_EXCH_SC" "0"
 SYSTEM_CONSTANT "DSM2SG_FID_SY" "0"
 SYSTEM_CONSTANT "DSMAPL_UNIFIEDDRVGCYC_SC" "0"
 SYSTEM_CONSTANT "DSMAPPL_OBSVR_SC" "0"
 SYSTEM_CONSTANT "DSMAUX_READONLY" "1"
 SYSTEM_CONSTANT "DSMAUX_ROEBUFLEN" "0"
 SYSTEM_CONSTANT "DSMAUX_ROEBUFUSEENVRAM" "0"
 SYSTEM_CONSTANT "DSMAUX_TCSORT_SY" "0"
 SYSTEM_CONSTANT "DSMBAS_CENSUPPDIUMPR_SC" "0"
 SYSTEM_CONSTANT "DSMBAS_CENSUPPDTR_SC" "0"
 SYSTEM_CONSTANT "DSMBAS_IGRABORTCDN_SC" "1"
 SYSTEM_CONSTANT "DSMBAS_KEYONCYCFLCTRIG_SC" "0"
 SYSTEM_CONSTANT "DSMBAS_KEYONCYCTRANDURGDRV_SC" "0"
 SYSTEM_CONSTANT "DSMBAS_PNDRPRTMOD2_SC" "0"
 SYSTEM_CONSTANT "DSMBAS_PREFAILDINTDEB_SC" "0"
 SYSTEM_CONSTANT "DSMBAS_REINIMETHSELN_SC" "0"
 SYSTEM_CONSTANT "DSMBAS_TESTFAILDSNCELSTCLR_SC" "0"
 SYSTEM_CONSTANT "DSMBDEP_SY" "0"
 SYSTEM_CONSTANT "DSMCONF_DFCCTTSTD" "0"
 SYSTEM_CONSTANT "DSMCONF_DTCTABLE_DTCM" "0"
 SYSTEM_CONSTANT "DSMCONF_DTCTABLE_DTCX" "0"
 SYSTEM_CONSTANT "DSMCONF_NUM_CLASSES" "22"
 SYSTEM_CONSTANT "DSMCONF_SUPGLBCTLMSK" "0"
 SYSTEM_CONSTANT "DSMCONF_SUPGLBDBLV" "1"
 SYSTEM_CONSTANT "DSMCONF_SUPGLBDISBLMSK" "0"
 SYSTEM_CONSTANT "DSMCONF_SUPGLBDTCFUNCUNIT" "1"
 SYSTEM_CONSTANT "DSMCONF_SUPGLBDTCGROUP" "1"
 SYSTEM_CONSTANT "DSMCONF_SUPGLBDTCSEVERITY" "1"
 SYSTEM_CONSTANT "DSMCONF_SUPGLBENVREF" "1"
 SYSTEM_CONSTANT "DSMCONF_SUPGLBFAULTTYP" "1"
 SYSTEM_CONSTANT "DSMCONF_SUPGLBFLTCLS" "0"
 SYSTEM_CONSTANT "DSMCONF_SUP_DFC_STUNCFMDTHISKEYONCYC" "0"
 SYSTEM_CONSTANT "DSMCONF_SUP_TNPSCPU" "0"
 SYSTEM_CONSTANT "DSMCONF_SUP_TNPSDTCC" "0"
 SYSTEM_CONSTANT "DSMDUR_GLB_CNT_ENBL" "1"
 SYSTEM_CONSTANT "DSMDUR_MIL_GLB_SY" "1"
 SYSTEM_CONSTANT "DSMDUR_SUPPID4D_SC" "1"
 SYSTEM_CONSTANT "DSMDUR_SUPPID4E_SC" "1"
 SYSTEM_CONSTANT "DSMRDY_ENA_FLSYSFORCELABEL_SC" "0"
 SYSTEM_CONSTANT "DSMRDY_ENGSPEC_SY" "0"
 SYSTEM_CONSTANT "DSMRDY_ENVCOND_SUP" "0"
 SYSTEM_CONSTANT "DSMRDY_FIDINH_SUP" "0"
 SYSTEM_CONSTANT "DSMRDY_INHP41_SY" "0"
 SYSTEM_CONSTANT "DSMRDY_READONLY" "0"
 SYSTEM_CONSTANT "DSMRDY_READONLYGRP" "0"
 SYSTEM_CONSTANT "DSMRDY_SIZE_LST_AC" "1"
 SYSTEM_CONSTANT "DSMRDY_SIZE_LST_Cat" "15"
 SYSTEM_CONSTANT "DSMRDY_SIZE_LST_ComprCmpnt" "1"
 SYSTEM_CONSTANT "DSMRDY_SIZE_LST_EGR" "15"
 SYSTEM_CONSTANT "DSMRDY_SIZE_LST_EvpSys" "15"
 SYSTEM_CONSTANT "DSMRDY_SIZE_LST_FlSys" "1"
 SYSTEM_CONSTANT "DSMRDY_SIZE_LST_HtCat" "15"
 SYSTEM_CONSTANT "DSMRDY_SIZE_LST_Misf" "1"
 SYSTEM_CONSTANT "DSMRDY_SIZE_LST_O2Sens" "15"
 SYSTEM_CONSTANT "DSMRDY_SIZE_LST_O2SensHt" "15"
 SYSTEM_CONSTANT "DSMRDY_SIZE_LST_SecAirSys" "15"
 SYSTEM_CONSTANT "DSMRDY_STDCONFIG" "1"
 SYSTEM_CONSTANT "DSMRDY_SUPPID41_SY" "0"
 SYSTEM_CONSTANT "DSMRDY_VERS_SC" "0"
 SYSTEM_CONSTANT "DSM_CONF_SUP_DFC_STCLCTLDF" "0"
 SYSTEM_CONSTANT "DSM_CONF_SUP_DSMRDY_CT" "0"
 SYSTEM_CONSTANT "DSM_CONF_SUP_DSMRDY_XWHY" "0"
 SYSTEM_CONSTANT "DSM_DISBLGRPSIZE_SY" "0"
 SYSTEM_CONSTANT "DSM_DOBD_SC" "0"
 SYSTEM_CONSTANT "DSM_DSM2SG_SY" "0"
 SYSTEM_CONSTANT "DSM_FAILCNT_SY" "0"
 SYSTEM_CONSTANT "DSM_FAULTSEQ_SY" "0"
 SYSTEM_CONSTANT "DSM_GETPRGVERSID_SC" "1"
 SYSTEM_CONSTANT "DSM_GETSTSTRTEND_SC" "0"
 SYSTEM_CONSTANT "DSM_HDOBD_SY" "0"
 SYSTEM_CONSTANT "DSM_INHRLS_SY" "0"
 SYSTEM_CONSTANT "DSM_MDOBD_SY" "0"
 SYSTEM_CONSTANT "DSM_NUMDFC" "161"
 SYSTEM_CONSTANT "DSM_NUMFID" "87"
 SYSTEM_CONSTANT "DSM_PDTCDISBL_SC" "0"
 SYSTEM_CONSTANT "DSM_PDTCTSTRA_SY" "0"
 SYSTEM_CONSTANT "DSM_TESTMODDIAGCODLAMP_SC" "0"
 SYSTEM_CONSTANT "DSM_WUCDET_SY" "0"
 SYSTEM_CONSTANT "DSTTOEMPTY_SC" "0"
 SYSTEM_CONSTANT "DTR_FACTKLINE" "13"
 SYSTEM_CONSTANT "DTR_FACT_RES_REV" "8192"
 SYSTEM_CONSTANT "DTR_LEGIFC_SY" "0"
 SYSTEM_CONSTANT "DTR_NUM_ELEMENTS" "21"
 SYSTEM_CONSTANT "DTTEMP_300" "300"
 SYSTEM_CONSTANT "DTTEMP_M_300" "-300"
 SYSTEM_CONSTANT "DTY_CYC_ZERO" "0"
 SYSTEM_CONSTANT "DT_KELV_RES" "0.1"
 SYSTEM_CONSTANT "DVESTA_SY" "0"
 SYSTEM_CONSTANT "DVOL_RES" "0.1"
 SYSTEM_CONSTANT "D_FLCONS_RES" "0.01"
 SYSTEM_CONSTANT "ECUNUM_SY" "1"
 SYSTEM_CONSTANT "ECUOFF_TMR_SY" "0"
 SYSTEM_CONSTANT "ECUTYP_SC" "0"
 SYSTEM_CONSTANT "ECU_GENR_SY" "6"
 SYSTEM_CONSTANT "EGOCATUS_SC" "0"
 SYSTEM_CONSTANT "EGRVLV_TYPAVL_SY" "0"
 SYSTEM_CONSTANT "EGTCOND_ACTV_BP" "0"
 SYSTEM_CONSTANT "EGTSWT_FACT" "16384000"
 SYSTEM_CONSTANT "EGTSWT_FACT_S16" "16384"
 SYSTEM_CONSTANT "EGTSWT_NRM_EXP" "14"
 SYSTEM_CONSTANT "EGTSWT_RES" "6.103515625e-008"
 SYSTEM_CONSTANT "EGTSWT_RES_S16" "6.103515625e-005"
 SYSTEM_CONSTANT "ENADATASETID_CALPAR_SC" "1"
 SYSTEM_CONSTANT "ENERGY_J_HI_RES" "1"
 SYSTEM_CONSTANT "ENERGY_Q0P0001_RES" "0.0001"
 SYSTEM_CONSTANT "ENERGY_Q0P0001_RES_REV" "10000"
 SYSTEM_CONSTANT "ENERGY_Q0P001_RES" "0.001"
 SYSTEM_CONSTANT "ENERGY_Q0P001_RES_REV" "1000"
 SYSTEM_CONSTANT "ENERGY_RES" "1"
 SYSTEM_CONSTANT "ENGN2TIINCPERLOW_FACT" "16"
 SYSTEM_CONSTANT "ENGN2TIINCPERLOW_SHFT" "4"
 SYSTEM_CONSTANT "ENGRESTRT_SY" "0"
 SYSTEM_CONSTANT "ENGSPD_SWTENA_SY" "0"
 SYSTEM_CONSTANT "ENGTVRNTSELN_SC" "1"
 SYSTEM_CONSTANT "ENRGPERMASS_RES" "0.1"
 SYSTEM_CONSTANT "EPMCAS_FACPLAUS_DSTX_SC" "2"
 SYSTEM_CONSTANT "EPMCAS_NUMSEGLEN_SC" "2"
 SYSTEM_CONSTANT "EPMCAS_NUMSEG_SC" "2"
 SYSTEM_CONSTANT "EPMCAS_PHINCOR_CURX_SC" "2"
 SYSTEM_CONSTANT "EPMCAS_PHITEMPCOR05_DSTX_SC" "2"
 SYSTEM_CONSTANT "EPMCRS_NUMINCOUT_SC" "36"
 SYSTEM_CONSTANT "EPMCRS_NUMTHRESH" "4"
 SYSTEM_CONSTANT "EPMCRS_NUMVAL" "4"
 SYSTEM_CONSTANT "EPMCRS_PLSWIDTHAPPLACTVD_SC" "1"
 SYSTEM_CONSTANT "EPMCRS_REVSTRTCONT_SC" "0"
 SYSTEM_CONSTANT "EPMCRS_TIINCOUTPVBL_SC" "1"
 SYSTEM_CONSTANT "EPMCRS_TIINCOUT_SC" "0"
 SYSTEM_CONSTANT "EPMHCRS_FALLING_EDGE" "0"
 SYSTEM_CONSTANT "EPMHCRS_NUMGAP" "1"
 SYSTEM_CONSTANT "EPMHCRS_NUMINC" "36"
 SYSTEM_CONSTANT "EPMHCRS_NUMINCGAP" "3"
 SYSTEM_CONSTANT "EPMHCRS_RISING_EDGE" "1"
 SYSTEM_CONSTANT "EPMHCRS_SIGBUF_MAX" "137"
 SYSTEM_CONSTANT "EPMHCRS_SIGBUF_NUMGAP_MAX" "4"
 SYSTEM_CONSTANT "EPMHWE_RTM_SY" "0"
 SYSTEM_CONSTANT "EPMHWE_SWTCPU_SY" "1"
 SYSTEM_CONSTANT "EPMRRS_NUMPER" "16"
 SYSTEM_CONSTANT "EPMRRS_SY" "1"
 SYSTEM_CONSTANT "EPMRRS_TITEMP_CURX_SC" "2"
 SYSTEM_CONSTANT "EPMRVSROTYMETH_SY" "0"
 SYSTEM_CONSTANT "EPMSRV_FACAG" "144"
 SYSTEM_CONSTANT "EPMSYN_CAMSFTPATACTV_SC" "0"
 SYSTEM_CONSTANT "EPMSYN_CAMSFTPAT_ID" "1"
 SYSTEM_CONSTANT "EPMSYN_CPPACTV_SC" "0"
 SYSTEM_CONSTANT "EPMSYN_CPP_ID" "6"
 SYSTEM_CONSTANT "EPMSYN_CRKSFTPATACTV_SC" "1"
 SYSTEM_CONSTANT "EPMSYN_CRKSFTPAT_ID" "0"
 SYSTEM_CONSTANT "EPMSYN_CRKSFTTOOTHTACTV_SC" "1"
 SYSTEM_CONSTANT "EPMSYN_CRKSFTTOOTHT_ID" "2"
 SYSTEM_CONSTANT "EPMSYN_DBLIGNACTV_SC" "1"
 SYSTEM_CONSTANT "EPMSYN_DBLIGN_ID" "4"
 SYSTEM_CONSTANT "EPMSYN_INJRLS_SC" "1"
 SYSTEM_CONSTANT "EPMSYN_INTKMNFLDPACTV_SC" "1"
 SYSTEM_CONSTANT "EPMSYN_INTKMNFLDP_ID" "3"
 SYSTEM_CONSTANT "EPMSYN_MISFACTVTEST_ID" "7"
 SYSTEM_CONSTANT "EPMSYN_MISFACTVTEST_SC" "0"
 SYSTEM_CONSTANT "EPMSYN_NRSYNCNCFG_SC" "2"
 SYSTEM_CONSTANT "EPMSYN_NUMSYNCMETHODS" "3"
 SYSTEM_CONSTANT "EPMSYN_PHIINCCOR_CURX" "4"
 SYSTEM_CONSTANT "EPMSYN_PHIINCCOR_CURX_SC" "2"
 SYSTEM_CONSTANT "EPMSYN_TESTINJACTV_SC" "0"
 SYSTEM_CONSTANT "EPMSYN_TSTINJ_ID" "5"
 SYSTEM_CONSTANT "EPM_ATS_SY" "0"
 SYSTEM_CONSTANT "EPM_CUSTADP_SC" "0"
 SYSTEM_CONSTANT "EPM_DIAGSPC_SY" "0"
 SYSTEM_CONSTANT "EPM_KEEPDGISYNC_SC" "0"
 SYSTEM_CONSTANT "EPM_MEASURE_SY" "0"
 SYSTEM_CONSTANT "EPM_NENG10MSMAX" "2550"
 SYSTEM_CONSTANT "EPM_NENGLRESMAX" "10200"
 SYSTEM_CONSTANT "EPM_NRAGEVE_SC" "0"
 SYSTEM_CONSTANT "EPM_NRVIRTSYN_SC" "3"
 SYSTEM_CONSTANT "EPM_NUMCRSREVWCY" "2"
 SYSTEM_CONSTANT "EPM_NUMCRSREVWCY_SY" "2"
 SYSTEM_CONSTANT "EPM_PHICRSREV" "360"
 SYSTEM_CONSTANT "EPM_PHIMAXMSK" "32767"
 SYSTEM_CONSTANT "EPM_PHIMAX_SY" "32767"
 SYSTEM_CONSTANT "EPM_RVSROTPRED_SC" "0"
 SYSTEM_CONSTANT "EPM_SPD_CALC_SY" "1"
 SYSTEM_CONSTANT "EPM_STRTSELECT_SC" "1"
 SYSTEM_CONSTANT "EPM_SYNCSLV_SY" "0"
 SYSTEM_CONSTANT "EPM_TDCDSTCLB_SC" "0"
 SYSTEM_CONSTANT "EPM_TIMING_SY" "0"
 SYSTEM_CONSTANT "EPM_TI_SHORTINT" "2500"
 SYSTEM_CONSTANT "ERRLMP_ATSINTVMOD_SY" "0"
 SYSTEM_CONSTANT "ERRLMP_CUST_SY" "0"
 SYSTEM_CONSTANT "ERRLMP_UNIFY_SC" "0"
 SYSTEM_CONSTANT "ESC_ACTVTSYNTSKCHAIN_SC" "0"
 SYSTEM_CONSTANT "ESC_DT_NESTING_DEPTH" "10"
 SYSTEM_CONSTANT "ESC_SYNCTASK_SC" "0"
 SYSTEM_CONSTANT "ETA_THM_ENG_ONE" "1"
 SYSTEM_CONSTANT "ETCLB_NUM_RAILP_CLB_PNT" "2"
 SYSTEM_CONSTANT "ETCTL_ACTV_BP" "0"
 SYSTEM_CONSTANT "ETC_Act_SY" "0"
 SYSTEM_CONSTANT "ETH_SC" "0"
 SYSTEM_CONSTANT "ETKS_SY" "0"
 SYSTEM_CONSTANT "ETS_INJPOI1" "4"
 SYSTEM_CONSTANT "ETS_PFLT2_1" "31"
 SYSTEM_CONSTANT "EVTYP_SY" "0"
 SYSTEM_CONSTANT "EXH2BNKACTVNTYPSEL_SC" "0"
 SYSTEM_CONSTANT "EXHBNKNUM_SY" "1"
 SYSTEM_CONSTANT "EXHMODCFG_SC" "1"
 SYSTEM_CONSTANT "EXHMOD_TSPS1_SC" "1"
 SYSTEM_CONSTANT "FACT16_EXP" "16"
 SYSTEM_CONSTANT "FACT16_RES_REV" "65536"
 SYSTEM_CONSTANT "FACT1_ZERO" "0"
 SYSTEM_CONSTANT "FACT26_EXP" "26"
 SYSTEM_CONSTANT "FACT26_RES_REV" "67108864"
 SYSTEM_CONSTANT "FACT6_RES_REV" "500"
 SYSTEM_CONSTANT "FACT9_RES_REV" "5000"
 SYSTEM_CONSTANT "FACTLOW1_RES_REV" "25"
 SYSTEM_CONSTANT "FACT_NSCAGETOT_RES" "3"
 SYSTEM_CONSTANT "FACT_NSCAGE_RES" "0.001"
 SYSTEM_CONSTANT "FACT_NSCEFF_RES" "0.0001"
 SYSTEM_CONSTANT "FACT_NSCEFF_RES_REV" "10000"
 SYSTEM_CONSTANT "FACT_NSC_MAX" "1"
 SYSTEM_CONSTANT "FACT_NSC_MIN" "0"
 SYSTEM_CONSTANT "FACT_NSC_RES" "0.001"
 SYSTEM_CONSTANT "FACT_NSC_RES_REV" "1000"
 SYSTEM_CONSTANT "FACT_OIL_VOLSNGLDIFF" "32000"
 SYSTEM_CONSTANT "FACT_Q0P001_RES" "0.001"
 SYSTEM_CONSTANT "FACT_Q0P001_RES_REV" "1000"
 SYSTEM_CONSTANT "FACT_VOLNSC_RES" "1e-006"
 SYSTEM_CONSTANT "FAC_AG_CRS_HI_RESO" "128"
 SYSTEM_CONSTANT "FAC_MASSINJ_TO_QNTINJ" "10000"
 SYSTEM_CONSTANT "FAC_QNTADJ_TO_QNTINJ_0" "1000"
 SYSTEM_CONSTANT "FAC_QNTADJ_TO_QNTINJ_1" "1500"
 SYSTEM_CONSTANT "FAC_QNTADJ_TO_QNTINJ_2" "2500"
 SYSTEM_CONSTANT "FAC_QNTADJ_TO_QNTINJ_3" "5000"
 SYSTEM_CONSTANT "FAC_QNTADJ_TO_QNTINJ_RES" "100"
 SYSTEM_CONSTANT "FAC_T_INC_PER_DUR_HI_RESO" "256"
 SYSTEM_CONSTANT "FANCTL_HOTLMP" "0"
 SYSTEM_CONSTANT "FANCTL_HOTLMPWRN" "1"
 SYSTEM_CONSTANT "FDE_SC" "0"
 SYSTEM_CONSTANT "FFVE100_SC" "0"
 SYSTEM_CONSTANT "FIM_SC" "0"
 SYSTEM_CONSTANT "FLCONS1_RES" "0.01"
 SYSTEM_CONSTANT "FLCONS2_RES" "1"
 SYSTEM_CONSTANT "FLCONS2_RES_HIGH_REV" "20"
 SYSTEM_CONSTANT "FLCONS2_RES_REV" "1"
 SYSTEM_CONSTANT "FLCONS3_MIN" "0"
 SYSTEM_CONSTANT "FLEXPSCTRLRNR_SC" "0"
 SYSTEM_CONSTANT "FLMA_MULTIPNTFUGRIDADPN_SC" "1"
 SYSTEM_CONSTANT "FLMA_RSTADPNVALSNSRERR_SC" "0"
 SYSTEM_CONSTANT "FLMNG_R_STOICH_CONF" "14.5"
 SYSTEM_CONSTANT "FLOWFCTCRITAIR" "0.48417899"
 SYSTEM_CONSTANT "FLSPLG_FUPMPTYP_SC" "0"
 SYSTEM_CONSTANT "FLSPLSYSTST_SC" "0"
 SYSTEM_CONSTANT "FLVOL_RES" "0.05"
 SYSTEM_CONSTANT "FLXR_SY" "0"
 SYSTEM_CONSTANT "FRNM_SC" "0"
 SYSTEM_CONSTANT "FRTP_SC" "0"
 SYSTEM_CONSTANT "GBXNPOS_SY" "1"
 SYSTEM_CONSTANT "GBXPOS_HWINPCFG_SC" "4"
 SYSTEM_CONSTANT "GBXPOS_NEUTLRNG_SC" "1"
 SYSTEM_CONSTANT "GBXPOS_SC" "0"
 SYSTEM_CONSTANT "GDI_SY" "0"
 SYSTEM_CONSTANT "GEAR0" "0"
 SYSTEM_CONSTANT "GEAR1" "1"
 SYSTEM_CONSTANT "GEAR2" "2"
 SYSTEM_CONSTANT "GEAR3" "3"
 SYSTEM_CONSTANT "GEAR4" "4"
 SYSTEM_CONSTANT "GEAR5" "5"
 SYSTEM_CONSTANT "GEAR6" "6"
 SYSTEM_CONSTANT "GEAR7" "7"
 SYSTEM_CONSTANT "GEARBX_NUMGEAR_MAX" "6"
 SYSTEM_CONSTANT "GEARDETNSNSR_TYPAVL_SC" "0"
 SYSTEM_CONSTANT "GEARDPDTIA_SC" "0"
 SYSTEM_CONSTANT "GLWCTL_TIME_MS_RES" "10"
 SYSTEM_CONSTANT "HBR_SC" "0"
 SYSTEM_CONSTANT "HCMPT_Q0P0000004_ZERO" "0"
 SYSTEM_CONSTANT "HDLMPRLY_SY" "1"
 SYSTEM_CONSTANT "HEAT_CAPACITY_RES_REV" "10"
 SYSTEM_CONSTANT "HEGODDYNSIMN_SY" "1"
 SYSTEM_CONSTANT "HEGO_STDDIAGPS_SC" "1"
 SYSTEM_CONSTANT "HEM_SY" "0"
 SYSTEM_CONSTANT "HESRV_CSTNCCHKECU1" "1"
 SYSTEM_CONSTANT "HESRV_CSTNCCHKECU2" "2"
 SYSTEM_CONSTANT "HESRV_HCU" "3"
 SYSTEM_CONSTANT "HESRV_HETYP_SY" "255"
 SYSTEM_CONSTANT "HESRV_NOTUSED" "0"
 SYSTEM_CONSTANT "HESRV_VCU" "2"
 SYSTEM_CONSTANT "HEVCHGR_SY" "0"
 SYSTEM_CONSTANT "HEVPLINAVL_SC" "0"
 SYSTEM_CONSTANT "HEVTYP_SY" "0"
 SYSTEM_CONSTANT "HWDPD_SC" "0"
 SYSTEM_CONSTANT "I15031_ELEMSTRTSIZE_SC" "257"
 SYSTEM_CONSTANT "I15031_OBD_CNTL_SC" "0"
 SYSTEM_CONSTANT "I15031_PID6B_SC" "0"
 SYSTEM_CONSTANT "I15031_PID6F_SC" "0"
 SYSTEM_CONSTANT "I15031_PID94_SC" "0"
 SYSTEM_CONSTANT "I15031_PID_RANGE_ARRAY_SIZE" "8"
 SYSTEM_CONSTANT "I15031_SRV8_SY" "0"
 SYSTEM_CONSTANT "I15031_ST_SUPP_PID_SC" "0"
 SYSTEM_CONSTANT "I15031_VISYSIZE_SC" "256"
 SYSTEM_CONSTANT "I27145_CANID_SC" "0"
 SYSTEM_CONSTANT "I27145_SC" "0"
 SYSTEM_CONSTANT "IDEAL_GAS_VOL" "22.4"
 SYSTEM_CONSTANT "IDLESCRWADJMT_SC" "0"
 SYSTEM_CONSTANT "IGNARCDURMONI_SY" "0"
 SYSTEM_CONSTANT "IGNCLMPVLTGDURMON_SC" "0"
 SYSTEM_CONSTANT "IGNCL_INTCALCNXTCHL_SC" "0"
 SYSTEM_CONSTANT "IGNCL_QAG_SY" "1"
 SYSTEM_CONSTANT "INIT_ZERO" "0"
 SYSTEM_CONSTANT "INJCRV_ANGLE" "0"
 SYSTEM_CONSTANT "INJCRV_TIME" "1"
 SYSTEM_CONSTANT "INJDDPFI_DEBUGGING" "0"
 SYSTEM_CONSTANT "INJMSQ0P1_RES" "0.1"
 SYSTEM_CONSTANT "INJMSQ0P2_RES" "0.2"
 SYSTEM_CONSTANT "INJSYG_FUCNSDISP_SC" "1"
 SYSTEM_CONSTANT "INJSYG_FUTOG_SC" "0"
 SYSTEM_CONSTANT "INJSYG_INTRPTIDFUTOGSDLD_SC" "0"
 SYSTEM_CONSTANT "INJSYS_TWNINJR_SC" "0"
 SYSTEM_CONSTANT "INJSYS_TWOSTEPINJ_SC" "0"
 SYSTEM_CONSTANT "INJTIME_US_ZERO" "0"
 SYSTEM_CONSTANT "INJVLV_ABE_ACTIVE" "0"
 SYSTEM_CONSTANT "INJVLV_ABE_NOTACTIVE" "1"
 SYSTEM_CONSTANT "INJVLV_ATS_SY" "1"
 SYSTEM_CONSTANT "INJVLV_FSTRCVAFTFCO_SY" "0"
 SYSTEM_CONSTANT "INJVLV_ONOFF_ATS_SC" "0"
 SYSTEM_CONSTANT "INJVLV_PSIC_SC" "0"
 SYSTEM_CONSTANT "INJVLV_PSNR_SC" "0"
 SYSTEM_CONSTANT "INJ_MASS100_MAX" "100"
 SYSTEM_CONSTANT "INJ_MASSCYC_MAX" "327.67"
 SYSTEM_CONSTANT "INJ_MASSCYC_MIN" "0"
 SYSTEM_CONSTANT "INJ_MASSCYC_RES" "0.01"
 SYSTEM_CONSTANT "INJ_MASSCYC_RES_INV" "100"
 SYSTEM_CONSTANT "INJ_MASSCYC_RES_REV" "100"
 SYSTEM_CONSTANT "INJ_MASSCYC_ZERO" "0"
 SYSTEM_CONSTANT "INJ_MASSINJ_RES" "0.01"
 SYSTEM_CONSTANT "INJ_MASSMIN_MAX" "10"
 SYSTEM_CONSTANT "INJ_MASSPII1_MAX" "10"
 SYSTEM_CONSTANT "INJ_MASSPII2_MAX" "10"
 SYSTEM_CONSTANT "INJ_MASSPII3_MAX" "10"
 SYSTEM_CONSTANT "INJ_MASSPOI0_MAX" "10"
 SYSTEM_CONSTANT "INJ_MASSPOI1_MAX" "10"
 SYSTEM_CONSTANT "INJ_MASSPOI2_MAX" "10"
 SYSTEM_CONSTANT "INJ_MASSPOI3_MAX" "10"
 SYSTEM_CONSTANT "INJ_MASS_MAX" "327.67"
 SYSTEM_CONSTANT "INJ_MASS_MIN" "0"
 SYSTEM_CONSTANT "INJ_MASS_ONE" "1"
 SYSTEM_CONSTANT "INJ_MASS_RES" "0.01"
 SYSTEM_CONSTANT "INJ_MASS_RES_INV" "100"
 SYSTEM_CONSTANT "INJ_MASS_ZERO" "0"
 SYSTEM_CONSTANT "INJ_QNTINJ_MAX" "100"
 SYSTEM_CONSTANT "INJ_QNTINJ_MIN" "0"
 SYSTEM_CONSTANT "INJ_QNTINJ_RES" "0.01"
 SYSTEM_CONSTANT "INJ_QNTINJ_ZERO" "0"
 SYSTEM_CONSTANT "INJ_QNT_RES" "0.1"
 SYSTEM_CONSTANT "INTKAIRT_AIRFILDS_SC" "1"
 SYSTEM_CONSTANT "INTKAIRT_SNSR1POS_SC" "1"
 SYSTEM_CONSTANT "IOEXTDEV_CJ260_SC" "0"
 SYSTEM_CONSTANT "IOEXTDEV_PORTEXP_SC" "1"
 SYSTEM_CONSTANT "IPDUM_SC" "0"
 SYSTEM_CONSTANT "IPOADPNMAPRADMAX" "2"
 SYSTEM_CONSTANT "IUMPR_SY" "1"
 SYSTEM_CONSTANT "IUMPR_VERS_SY" "1"
 SYSTEM_CONSTANT "IVPFIPS_TESTPLSENA_SC" "1"
 SYSTEM_CONSTANT "I_COIL_MAX" "5000"
 SYSTEM_CONSTANT "I_COIL_MIN" "0"
 SYSTEM_CONSTANT "J1939TP_SC" "0"
 SYSTEM_CONSTANT "KAPPADRYAIR" "1.4"
 SYSTEM_CONSTANT "KAPPA_DRYAIR" "1.4"
 SYSTEM_CONSTANT "KD_PRAIL2Q_1_MAX" "0.5"
 SYSTEM_CONSTANT "KD_PRAIL2Q_1_NRM" "4"
 SYSTEM_CONSTANT "KD_PRC_RES" "0.000125"
 SYSTEM_CONSTANT "KGH_TO_KGS" "3600"
 SYSTEM_CONSTANT "KILLSWT_SC" "0"
 SYSTEM_CONSTANT "KLINE_SY" "0"
 SYSTEM_CONSTANT "KP_LMBDREC2INJMASS_1_MAX" "250"
 SYSTEM_CONSTANT "KP_LMBDREC2INJMASS_1_NRM" "2"
 SYSTEM_CONSTANT "KP_LMBDREC2INJMASS_1_RES_REV" "4"
 SYSTEM_CONSTANT "KP_PRAIL2Q_1_MAX" "0.2"
 SYSTEM_CONSTANT "KP_PRAIL2Q_1_NRM" "2"
 SYSTEM_CONSTANT "L9779_SC" "1"
 SYSTEM_CONSTANT "L9959_SC" "0"
 SYSTEM_CONSTANT "L9966_SC" "0"
 SYSTEM_CONSTANT "LAMBDAREC_RESVAL" "0.001"
 SYSTEM_CONSTANT "LAMBDA_INJMASS_RES" "1450"
 SYSTEM_CONSTANT "LAMBDA_MIN" "0"
 SYSTEM_CONSTANT "LAMBDA_ONE" "1"
 SYSTEM_CONSTANT "LAMBDA_REC_ZERO" "0"
 SYSTEM_CONSTANT "LAMBDA_TEN" "10"
 SYSTEM_CONSTANT "LAMBDA_ZERO" "0"
 SYSTEM_CONSTANT "LAMCTLDESVAL_NUM" "2"
 SYSTEM_CONSTANT "LAMCTLGOV_NUM" "2"
 SYSTEM_CONSTANT "LAMCTLMON_DVT_MAX" "10"
 SYSTEM_CONSTANT "LAMCTLMON_NUM_RM" "2"
 SYSTEM_CONSTANT "LAMCTLMON_TIME_MAX" "20"
 SYSTEM_CONSTANT "LAMCTLPRECTL_NUM" "2"
 SYSTEM_CONSTANT "LAMCTL_ACTVMONFDBKCTL_BP" "1"
 SYSTEM_CONSTANT "LAMCTL_DFL" "0"
 SYSTEM_CONSTANT "LAMCTL_SWTACTV_BP" "0"
 SYSTEM_CONSTANT "LAMCTRLADDLPROPJMP_SC" "1"
 SYSTEM_CONSTANT "LAMCTRLCONF_SC" "2"
 SYSTEM_CONSTANT "LENGTH_M_PER_KM" "1000"
 SYSTEM_CONSTANT "LINNM_SC" "0"
 SYSTEM_CONSTANT "LIN_SY" "0"
 SYSTEM_CONSTANT "LLIM_ACTIVE" "3"
 SYSTEM_CONSTANT "LLIM_OFF" "1"
 SYSTEM_CONSTANT "LLIM_STANDBY" "2"
 SYSTEM_CONSTANT "LSFX4_SY" "1"
 SYSTEM_CONSTANT "LSM_SY" "0"
 SYSTEM_CONSTANT "LSU_CT_SENSORS_MAX" "4"
 SYSTEM_CONSTANT "LSU_CT_SENSORS_TWFLW_SYS" "1"
 SYSTEM_CONSTANT "MASK_POSNALTV" "1"
 SYSTEM_CONSTANT "MASK_POSNIDLE" "1"
 SYSTEM_CONSTANT "MASK_POSNPFLTRGN" "1"
 SYSTEM_CONSTANT "MASK_POSNSTD" "1"
 SYSTEM_CONSTANT "MASS_CONV_G2MG" "1000"
 SYSTEM_CONSTANT "MASS_CONV_KG2G" "1000"
 SYSTEM_CONSTANT "MASS_MOL_EG" "28.5"
 SYSTEM_CONSTANT "MASS_Q1_RES_REV" "1"
 SYSTEM_CONSTANT "MDG1BSWBASELINE_SC" "110"
 SYSTEM_CONSTANT "MDG1CPUDEVICE_SC" "1"
 SYSTEM_CONSTANT "MDG1CPUHOUSING_SC" "3"
 SYSTEM_CONSTANT "MDG1CPUSTEP_SC" "0"
 SYSTEM_CONSTANT "MDG1CPUVENDOR_SC" "2"
 SYSTEM_CONSTANT "MDG1MSGCNCPT_SC" "0"
 SYSTEM_CONSTANT "MEM_CENDIAGACTVD_SC" "0"
 SYSTEM_CONSTANT "MEM_DIAGACTVDEXTD_SC" "0"
 SYSTEM_CONSTANT "MILLMP_2HZBLINK_SC" "0"
 SYSTEM_CONSTANT "MILLMP_ENGSTRTWITH2SECCDN_SC" "1"
 SYSTEM_CONSTANT "MILLMP_PWRSTG_SY" "1"
 SYSTEM_CONSTANT "MILLMP_SUPRT_ATS_SY" "1"
 SYSTEM_CONSTANT "MISFDETD_AVL_SY" "0"
 SYSTEM_CONSTANT "MISFDET_ACTVTESTSUSPCMISFCNTR_SC" "0"
 SYSTEM_CONSTANT "MISFDET_ACTVTEST_SC" "0"
 SYSTEM_CONSTANT "MISFDET_ADPNDATAEEP_SC" "0"
 SYSTEM_CONSTANT "MISFDET_BNKIMBAL_SC" "0"
 SYSTEM_CONSTANT "MISFDET_CNTMISFNOID_SC" "1"
 SYSTEM_CONSTANT "MISFDET_DMFDSTBC_SC" "0"
 SYSTEM_CONSTANT "MISFDET_DNADPNNRRNGNENG_SC" "2"
 SYSTEM_CONSTANT "MISFDET_DNADPNNRRNGTQ_SC" "2"
 SYSTEM_CONSTANT "MISFDET_DNADPN_SC" "0"
 SYSTEM_CONSTANT "MISFDET_DNCALCNTQBAL_SC" "0"
 SYSTEM_CONSTANT "MISFDET_DNDIFSIG_SC" "0"
 SYSTEM_CONSTANT "MISFDET_DNPRECTRL_SC" "0"
 SYSTEM_CONSTANT "MISFDET_DUALINJTEST_SC" "0"
 SYSTEM_CONSTANT "MISFDET_FUREACVN_SC" "0"
 SYSTEM_CONSTANT "MISFDET_HEM_SC" "0"
 SYSTEM_CONSTANT "MISFDET_LAMBASDDETN_SC" "0"
 SYSTEM_CONSTANT "MISFDET_NODNFLTD_SC" "0"
 SYSTEM_CONSTANT "MISFDET_NOTEQUIDIGN_SC" "0"
 SYSTEM_CONSTANT "MISFDET_NREOMMASK_SC" "1"
 SYSTEM_CONSTANT "MISFDET_NRSEGPOSN" "1"
 SYSTEM_CONSTANT "MISFDET_NRTRSMTYP_SC" "0"
 SYSTEM_CONSTANT "MISFDET_NUMCYLMAX_SC" "1"
 SYSTEM_CONSTANT "MISFDET_NUMCYLVIRTMAX_SC" "2"
 SYSTEM_CONSTANT "MISFDET_ONECYL_SC" "1"
 SYSTEM_CONSTANT "MISFDET_PATDETNTOOTHBASD_SC" "0"
 SYSTEM_CONSTANT "MISFDET_PATDETN_SC" "0"
 SYSTEM_CONSTANT "MISFDET_PFLTACTV_SC" "0"
 SYSTEM_CONSTANT "MISFDET_REDFCTDSL_SC" "0"
 SYSTEM_CONSTANT "MISFDET_REDFCT_SC" "0"
 SYSTEM_CONSTANT "MISFDET_ROUGHROADDIAG_SC" "0"
 SYSTEM_CONSTANT "MISFDET_ROUGHROADTYP_SC" "7"
 SYSTEM_CONSTANT "MISFDET_SEGPOSNALTV" "0"
 SYSTEM_CONSTANT "MISFDET_SEGPOSNCYL_SC" "0"
 SYSTEM_CONSTANT "MISFDET_SEGPOSNIDLE" "0"
 SYSTEM_CONSTANT "MISFDET_SEGPOSNPFLTRGN" "0"
 SYSTEM_CONSTANT "MISFDET_SEGPOSNSTD" "0"
 SYSTEM_CONSTANT "MISFDET_SEGSHIFTGPFRGN_SC" "0"
 SYSTEM_CONSTANT "MISFDET_SEGSHIFTIDLE_SC" "0"
 SYSTEM_CONSTANT "MISFDET_SEGSHIFT_SC" "0"
 SYSTEM_CONSTANT "MISFDET_SEGTIADPN_SC" "0"
 SYSTEM_CONSTANT "MISFDET_SEGTICALCNTYP_SC" "0"
 SYSTEM_CONSTANT "MISFDET_SEGTIDLYMAX_SC" "3"
 SYSTEM_CONSTANT "MISFDET_SUSPCEMIEXCDC_SC" "0"
 SYSTEM_CONSTANT "MISFDET_TWOWHLIF_SC" "1"
 SYSTEM_CONSTANT "MISFDET_TYP_SC" "0"
 SYSTEM_CONSTANT "MNFLDAIRPADCCBK_SC" "0"
 SYSTEM_CONSTANT "MOCADC_CHKACTV_MSK" "8"
 SYSTEM_CONSTANT "MOCADC_DEF_MSK" "128"
 SYSTEM_CONSTANT "MOCADC_NTPACTV_MSK" "1"
 SYSTEM_CONSTANT "MOCADC_NTPERR_MSK" "64"
 SYSTEM_CONSTANT "MOCADC_NTPREL_MSK" "2"
 SYSTEM_CONSTANT "MOCADC_TSTERR_MSK" "4"
 SYSTEM_CONSTANT "MOCCOM_CO_NUM_ANSW" "16"
 SYSTEM_CONSTANT "MOCCPU_CO_CTINI" "1"
 SYSTEM_CONSTANT "MOCCPU_CO_IPOTST_CURX" "20"
 SYSTEM_CONSTANT "MOCCPU_CO_LONIBBLE" "15"
 SYSTEM_CONSTANT "MOCCPU_CO_LSB" "1"
 SYSTEM_CONSTANT "MOCCPU_CO_MAXS16_ASFLOAT" "65536"
 SYSTEM_CONSTANT "MOCCPU_CO_MSB16" "32768"
 SYSTEM_CONSTANT "MOCCPU_CO_QUERY15" "3855"
 SYSTEM_CONSTANT "MOCCPU_CO_QUERY_MSK" "15"
 SYSTEM_CONSTANT "MOCCPU_CO_ZERO" "0"
 SYSTEM_CONSTANT "MOCCPU_IT_SY" "0"
 SYSTEM_CONSTANT "MOCEMM_CO_TESTREQ" "51"
 SYSTEM_CONSTANT "MOCFC_GTMCLKMON_SC" "0"
 SYSTEM_CONSTANT "MOCFC_GTMCONNTYP_SC" "1"
 SYSTEM_CONSTANT "MOCFC_NRCYCBLK_SC" "2"
 SYSTEM_CONSTANT "MOCFC_POSTBLDCHKS_SC" "0"
 SYSTEM_CONSTANT "MOCFC_SCCERRREACTN_SC" "0"
 SYSTEM_CONSTANT "MOCGTM_NRCMPERRBITS" "4"
 SYSTEM_CONSTANT "MOCMEM_CONF_NOF_CALLDEPTHCHK" "5"
 SYSTEM_CONSTANT "MOCMEM_CONF_NOF_CALLDEPTHCHK_EXTDTSK" "5"
 SYSTEM_CONSTANT "MOCMEM_CONF_NOF_RAMCHK" "32"
 SYSTEM_CONSTANT "MOCMEM_CONF_NOF_ROMCHK" "250"
 SYSTEM_CONSTANT "MOCMEM_CO_CHKSUM_VAL_START" "4294967295"
 SYSTEM_CONSTANT "MOCMEM_CO_NOCHECK" "85"
 SYSTEM_CONSTANT "MOCMEM_CO_PATTERN" "2863311530"
 SYSTEM_CONSTANT "MOCMEM_CO_PATTERN_55_IDX" "1"
 SYSTEM_CONSTANT "MOCMEM_CO_PATTERN_AA_IDX" "0"
 SYSTEM_CONSTANT "MOCMEM_CO_PATTERN_CPL" "1431655765"
 SYSTEM_CONSTANT "MOCMEM_CO_PATTERN_NUMBER" "2"
 SYSTEM_CONSTANT "MOCMEM_CO_RAM_TEST_ERRSIMN" "51"
 SYSTEM_CONSTANT "MOCMEM_CO_ROM_TEST_ERRSIMN" "51"
 SYSTEM_CONSTANT "MOCMEM_CO_STACK_CSA_TEST_ERRSIMN" "50"
 SYSTEM_CONSTANT "MOEXE_CO_NUM_CPUSEQ" "1"
 SYSTEM_CONSTANT "MOLMASS_RES" "0.01"
 SYSTEM_CONSTANT "MO_2ECU_BP" "0"
 SYSTEM_CONSTANT "MO_AXLEHEV_BP" "2"
 SYSTEM_CONSTANT "MO_CMNDSLGSLSW_SC" "1"
 SYSTEM_CONSTANT "MO_ECOM_MSK" "128"
 SYSTEM_CONSTANT "MO_EMEM_MSK" "8"
 SYSTEM_CONSTANT "MO_EPCP_MSK" "64"
 SYSTEM_CONSTANT "MO_ERAM_MSK" "1"
 SYSTEM_CONSTANT "MO_EROMSPG_MSK" "2"
 SYSTEM_CONSTANT "MO_EROMXPG_MSK" "4"
 SYSTEM_CONSTANT "MO_EXTDTSK_SC" "0"
 SYSTEM_CONSTANT "MO_HEV_BP" "0"
 SYSTEM_CONSTANT "MO_MAXVALINDCR_SC" "1"
 SYSTEM_CONSTANT "MO_PHEV_BP" "1"
 SYSTEM_CONSTANT "MO_PRCMAX_SY" "256"
 SYSTEM_CONSTANT "MO_REQRAMCHKEXT_MSK" "32"
 SYSTEM_CONSTANT "MO_REQROMCHKEXT_MSK" "16"
 SYSTEM_CONSTANT "MO_ROM_SY" "1"
 SYSTEM_CONSTANT "MRLY_DIAG_MECH_SY" "0"
 SYSTEM_CONSTANT "MSEBSW_SC" "1"
 SYSTEM_CONSTANT "MSI_SC" "0"
 SYSTEM_CONSTANT "MSI_SY" "0"
 SYSTEM_CONSTANT "MSI_TMPR_SY" "0"
 SYSTEM_CONSTANT "MSPERVOL_RES" "0.001"
 SYSTEM_CONSTANT "MSPERVOL_RES_REV" "1000"
 SYSTEM_CONSTANT "MS_O2_RES" "0.001"
 SYSTEM_CONSTANT "MS_O2_RES_REV" "1000"
 SYSTEM_CONSTANT "MS_SOXLDTOT_RES" "0.5"
 SYSTEM_CONSTANT "MS_SOXLDTOT_RES_FL" "0.5"
 SYSTEM_CONSTANT "MS_SOXLDTOT_RES_REV" "2"
 SYSTEM_CONSTANT "MS_SOXNOX_RES" "1e-005"
 SYSTEM_CONSTANT "MS_SOXNOX_RES_REV" "100000"
 SYSTEM_CONSTANT "MS_SOX_RES" "0.000305"
 SYSTEM_CONSTANT "M_NOXLD_LORES_RES" "0.004"
 SYSTEM_CONSTANT "M_NOXLD_LORES_RES_REV" "250"
 SYSTEM_CONSTANT "M_SOOT_RES1_REV" "250"
 SYSTEM_CONSTANT "NGINJRLYPRSNT_SC" "0"
 SYSTEM_CONSTANT "NOREINI_SC" "1"
 SYSTEM_CONSTANT "NORM_AIRMASS_INJCRV_FACT1" "1280"
 SYSTEM_CONSTANT "NORM_DVOL_X_DT" "360000"
 SYSTEM_CONSTANT "NORM_HCMPTQ0P00000042HCMPT" "4"
 SYSTEM_CONSTANT "NORM_HCMPTQ0P82HCMPT" "8"
 SYSTEM_CONSTANT "NORM_MNOXLOAD2LR" "400"
 SYSTEM_CONSTANT "NORM_Q_BY_RHO" "1000"
 SYSTEM_CONSTANT "NORM_SEC_US" "1000000"
 SYSTEM_CONSTANT "NORM_TIME2LR" "100"
 SYSTEM_CONSTANT "NOXFLWEG_RES" "0.025"
 SYSTEM_CONSTANT "NOXFLW_RES" "0.001"
 SYSTEM_CONSTANT "NOXMASSFLW_RES" "0.001"
 SYSTEM_CONSTANT "NOXMASSFLW_RES_REV" "1000"
 SYSTEM_CONSTANT "NOX_FLD" "10"
 SYSTEM_CONSTANT "NOX_RES" "1"
 SYSTEM_CONSTANT "NRDRVMOD_SC" "1"
 SYSTEM_CONSTANT "NRM_DVOL_X_DT" "360000"
 SYSTEM_CONSTANT "NRM_DVOL_X_DT_HIGH" "18000"
 SYSTEM_CONSTANT "NRM_EXPO_AG_CRS_HI_RESO" "7"
 SYSTEM_CONSTANT "NRM_EXPO_T_INC_PER_DUR_HI_RESO" "8"
 SYSTEM_CONSTANT "NRM_EXP_RES_TRIGO_FUNC" "12"
 SYSTEM_CONSTANT "NRM_Q_BY_RHO" "1000"
 SYSTEM_CONSTANT "NRM_VOL_L_TO_UL" "20"
 SYSTEM_CONSTANT "NSCDS_CT_SENSORS" "1"
 SYSTEM_CONSTANT "NSCMON_UBINLAM_MAX" "2000"
 SYSTEM_CONSTANT "NSCRGN_TIME_100_RES" "0.01"
 SYSTEM_CONSTANT "NSC_ACTV_BP" "1"
 SYSTEM_CONSTANT "NSC_AMPTNOXLDUNLD_MAX" "0"
 SYSTEM_CONSTANT "NSC_AMPTNOXLDUNLD_MIN" "-10"
 SYSTEM_CONSTANT "NSC_AMPTNOXRGN_MAX" "0"
 SYSTEM_CONSTANT "NSC_AMPTNOX_MIN" "0"
 SYSTEM_CONSTANT "NSC_MSO2_MIN" "0"
 SYSTEM_CONSTANT "NSC_MSPERVOL_MIN" "0"
 SYSTEM_CONSTANT "NSC_MSSOXNOX_MAX" "0.1"
 SYSTEM_CONSTANT "NSC_MSSOXNOX_MIN" "0"
 SYSTEM_CONSTANT "NSC_NOXMASSFLW_MIN" "0"
 SYSTEM_CONSTANT "NSC_NOX_ZERO" "0"
 SYSTEM_CONSTANT "NSC_SWTACTV_BP" "0"
 SYSTEM_CONSTANT "NSC_TIMEMAX_SY" "327.5"
 SYSTEM_CONSTANT "NUMCASMAX" "0"
 SYSTEM_CONSTANT "NUMCYLACT_SY" "1"
 SYSTEM_CONSTANT "NUMCYLCAL_SY" "0"
 SYSTEM_CONSTANT "NUMCYLMAX_SY" "1"
 SYSTEM_CONSTANT "O2MPT_RES_REV" "100"
 SYSTEM_CONSTANT "O2_RES" "1e-005"
 SYSTEM_CONSTANT "OBD_PHYSMEDM_SY" "0"
 SYSTEM_CONSTANT "OBS_SY" "0"
 SYSTEM_CONSTANT "OILLVL_MMQ0P004_RES" "0.004"
 SYSTEM_CONSTANT "OILLVL_MMQ0P004_RESREV" "250"
 SYSTEM_CONSTANT "OILMFL_MGPS_Q0P1_RES" "0.1"
 SYSTEM_CONSTANT "OILMFL_MGPS_Q0P1_RES_REV" "10"
 SYSTEM_CONSTANT "OILMSPRCQ0P01_100" "100"
 SYSTEM_CONSTANT "OILMSPRC_Q0P01_RES" "0.01"
 SYSTEM_CONSTANT "OILMSPRC_Q0P01_RES_REV" "100"
 SYSTEM_CONSTANT "OILMS_MG_RES" "1"
 SYSTEM_CONSTANT "OILMS_MG_RES_REV" "1"
 SYSTEM_CONSTANT "OILMS_Q0P1_RES" "0.1"
 SYSTEM_CONSTANT "OILMS_Q0P1_RES_REV" "10"
 SYSTEM_CONSTANT "OILMS_Q10_RES" "10"
 SYSTEM_CONSTANT "OILPPSSWT_PWRSTG_SC" "1"
 SYSTEM_CONSTANT "OILPPSSWT_SC" "1"
 SYSTEM_CONSTANT "PAIRFLTDSPRS_SY" "0"
 SYSTEM_CONSTANT "PEDLMODSELN_SC" "0"
 SYSTEM_CONSTANT "PENVSNSRTYP_SC" "0"
 SYSTEM_CONSTANT "PERMSPLYSYS_SY" "0"
 SYSTEM_CONSTANT "PFLTLD_RO2STOICH" "0.2315"
 SYSTEM_CONSTANT "PFLTLD_RO2STOICHONE" "1"
 SYSTEM_CONSTANT "PFLTPOPPRC_RES" "0.1"
 SYSTEM_CONSTANT "PFLT_ACTV_BP" "0"
 SYSTEM_CONSTANT "PFLT_ACTV_SC" "0"
 SYSTEM_CONSTANT "PHI_POI0_EARLY" "-40"
 SYSTEM_CONSTANT "PHI_POI0_LATE" "-100"
 SYSTEM_CONSTANT "PHI_POI1_ZERO" "0"
 SYSTEM_CONSTANT "PHI_ZERO" "0"
 SYSTEM_CONSTANT "PHYCYLCNTR_SC" "0"
 SYSTEM_CONSTANT "PI" "3.14159265359"
 SYSTEM_CONSTANT "PII321_MI1_POI321" "0"
 SYSTEM_CONSTANT "PII321_UNDEFD_MI1_POI21" "1"
 SYSTEM_CONSTANT "PIICLB_ANGLE32FAC2ANGLE_CNV" "6553600"
 SYSTEM_CONSTANT "PIICLB_FACTS32_RES" "65536"
 SYSTEM_CONSTANT "PIICLB_INJMASSS32_RES" "6553600"
 SYSTEM_CONSTANT "PIICLB_INJMASSS32_ZERO" "0"
 SYSTEM_CONSTANT "PIICLB_RCNFDMAX" "32766"
 SYSTEM_CONSTANT "PIICLB_STATE_CALC" "2"
 SYSTEM_CONSTANT "PIICLB_STATE_CLB" "1"
 SYSTEM_CONSTANT "PIICLB_STATE_INIT" "255"
 SYSTEM_CONSTANT "PIICLB_STATE_START" "0"
 SYSTEM_CONSTANT "PIICLB_STRLS_DISABLED" "1"
 SYSTEM_CONSTANT "PIICLB_STRLS_RELEASED" "0"
 SYSTEM_CONSTANT "PIICLB_TRQBYETA2QNT32_CNV" "83886080"
 SYSTEM_CONSTANT "PIICLB_TRQDT1KDMUL" "65536000"
 SYSTEM_CONSTANT "PIICLB_TRQPERSEC_RES" "1000"
 SYSTEM_CONSTANT "PIICLB_UPDT_COL" "1"
 SYSTEM_CONSTANT "PIICLB_UPDT_SEQ" "0"
 SYSTEM_CONSTANT "PIICLB_VARIANT_NONE" "0"
 SYSTEM_CONSTANT "PIICLB_VARIANT_PIC" "1"
 SYSTEM_CONSTANT "PIICLB_VARIANT_PICALL" "2"
 SYSTEM_CONSTANT "PMAXCTL_FACKPNRM8" "8"
 SYSTEM_CONSTANT "PMP_QNT_MAX" "1500"
 SYSTEM_CONSTANT "PMP_QNT_RES" "0.1"
 SYSTEM_CONSTANT "PMP_QNT_ZERO" "0"
 SYSTEM_CONSTANT "PNRM" "1013"
 SYSTEM_CONSTANT "POSMCCTL_FACKDNRM4" "4"
 SYSTEM_CONSTANT "POSMCCTL_FACKINRM2" "2"
 SYSTEM_CONSTANT "POSMCCTL_FACKPNRM32" "32"
 SYSTEM_CONSTANT "POSTDRV_SOFTRST_SY" "0"
 SYSTEM_CONSTANT "POSTDRV_T15RST_SY" "1"
 SYSTEM_CONSTANT "PRCFACT100_FULLNEG" "-100"
 SYSTEM_CONSTANT "PRCFACT100_FULLPOS" "100"
 SYSTEM_CONSTANT "PRCFACT100_ZERO" "0"
 SYSTEM_CONSTANT "PRC_M_100" "-100"
 SYSTEM_CONSTANT "PREDRV_T15RST_SY" "1"
 SYSTEM_CONSTANT "PREFSCALE_RES" "1000"
 SYSTEM_CONSTANT "PRES_AIR_MAX" "3500"
 SYSTEM_CONSTANT "PRES_AIR_MIN" "0"
 SYSTEM_CONSTANT "PRES_BAR_RES" "1"
 SYSTEM_CONSTANT "PRES_HPA_2000" "2000"
 SYSTEM_CONSTANT "PRES_RAIL_GRADHI_TO_VAL" "60"
 SYSTEM_CONSTANT "PRES_RAIL_GRAD_TO_VAL" "4"
 SYSTEM_CONSTANT "PRES_RAIL_RES" "100"
 SYSTEM_CONSTANT "PRES_RAIL_RES_REV" "100"
 SYSTEM_CONSTANT "PRES_TIME_RES" "400"
 SYSTEM_CONSTANT "PRES_TIME_RES_REV" "400"
 SYSTEM_CONSTANT "PSSC0MSEPF_SC" "1"
 SYSTEM_CONSTANT "PSSC684VRNTSELN_SY" "0"
 SYSTEM_CONSTANT "PTO_SY" "0"
 SYSTEM_CONSTANT "PWRSQ_TEMPSQQ0P01_RES" "0.01"
 SYSTEM_CONSTANT "PWR_HIGH_RES_REV" "10"
 SYSTEM_CONSTANT "PWR_KW_RES" "0.01"
 SYSTEM_CONSTANT "PWR_Q1_RES" "1"
 SYSTEM_CONSTANT "PWR_Q50_RES" "50"
 SYSTEM_CONSTANT "PWR_TEMPQ0P001_RES" "0.01"
 SYSTEM_CONSTANT "PWR_TEMPQ0P1_RES" "0.1"
 SYSTEM_CONSTANT "PWR_ZERO" "0"
 SYSTEM_CONSTANT "QNTR_EXP" "10"
 SYSTEM_CONSTANT "QNTR_MAX" "24"
 SYSTEM_CONSTANT "QNTR_MIN" "0.0009765625"
 SYSTEM_CONSTANT "QNTR_RES" "0.0009765625"
 SYSTEM_CONSTANT "QNTR_RES_REV" "1024"
 SYSTEM_CONSTANT "QNTSEL_SY" "0"
 SYSTEM_CONSTANT "Qp_RES" "10"
 SYSTEM_CONSTANT "QUICKSHIFT_SC" "0"
 SYSTEM_CONSTANT "RAIL_MEUN" "1"
 SYSTEM_CONSTANT "RAIL_PCV" "0"
 SYSTEM_CONSTANT "RAIL_PRES_ZERO" "0"
 SYSTEM_CONSTANT "RATAM_RES" "0.01"
 SYSTEM_CONSTANT "RATAM_RES_HIGH" "0.001"
 SYSTEM_CONSTANT "RATAM_RES_REV" "100"
 SYSTEM_CONSTANT "RATAM_RES_REV_HIGH" "1000"
 SYSTEM_CONSTANT "RATCM_RES" "1e-006"
 SYSTEM_CONSTANT "RATO2DRYAIR" "0.2315"
 SYSTEM_CONSTANT "RATPCRITAIR" "0.52828199"
 SYSTEM_CONSTANT "RAT_AIR_PRES_RES" "0.001"
 SYSTEM_CONSTANT "RAT_HIGH_RES" "0.001"
 SYSTEM_CONSTANT "RAT_HIGH_RES_REV" "1000"
 SYSTEM_CONSTANT "RAT_HIRES_CPP" "0.0001"
 SYSTEM_CONSTANT "RAT_HIRES_CPP_REV" "10000"
 SYSTEM_CONSTANT "RBA_SWTRACEENA_SC" "0"
 SYSTEM_CONSTANT "RBPTCEL_A_ZR" "0"
 SYSTEM_CONSTANT "RBPTCEL_CLUCLSD" "0"
 SYSTEM_CONSTANT "RBPTCEL_CLUGEARDISENGMT" "5"
 SYSTEM_CONSTANT "RBPTCEL_CLUGEARSHIFT" "7"
 SYSTEM_CONSTANT "RBPTCEL_CLULNCH" "3"
 SYSTEM_CONSTANT "RBPTCEL_CLUOPEN" "1"
 SYSTEM_CONSTANT "RBPTCEL_CLUSHIFTSUPRT" "6"
 SYSTEM_CONSTANT "RBPTCEL_CLUTQTRCK" "4"
 SYSTEM_CONSTANT "RBPTCEL_CLUTRAN" "2"
 SYSTEM_CONSTANT "RBPTCEL_CNVN_F_ZR" "0"
 SYSTEM_CONSTANT "RBPTCEL_CNVN_P_ZR" "0"
 SYSTEM_CONSTANT "RBPTCEL_DST_ZR" "0"
 SYSTEM_CONSTANT "RBPTCEL_FRQ_ZR" "0"
 SYSTEM_CONSTANT "RBPTCEL_F_ZR" "0"
 SYSTEM_CONSTANT "RBPTCEL_GRDTN_ZR" "0"
 SYSTEM_CONSTANT "RBPTCEL_GRDTRAT_ZR" "0"
 SYSTEM_CONSTANT "RBPTCEL_I_ZR" "0"
 SYSTEM_CONSTANT "RBPTCEL_P_ZR" "0"
 SYSTEM_CONSTANT "RBPTCEL_RAT" "0"
 SYSTEM_CONSTANT "RBPTCEL_RAT_1" "100"
 SYSTEM_CONSTANT "RBPTCEL_RAT_ZR" "0"
 SYSTEM_CONSTANT "RBPTCEL_RMDETNUS_BITPOSN_0" "0"
 SYSTEM_CONSTANT "RBPTCEL_SPD_ZR" "0"
 SYSTEM_CONSTANT "RBPTCEL_SSWTSECVC_DISAD" "0"
 SYSTEM_CONSTANT "RBPTCEL_SSWTSECVC_ENAD" "1"
 SYSTEM_CONSTANT "RBPTCEL_TI_ZR" "0"
 SYSTEM_CONSTANT "RBPTCEL_TQ_ZR" "0"
 SYSTEM_CONSTANT "RBPTCEL_T_ZR" "0"
 SYSTEM_CONSTANT "RBPTCEL_U_ZR" "0"
 SYSTEM_CONSTANT "RBPTCEL_VF_ZR" "0"
 SYSTEM_CONSTANT "RBPTCEL_V_ZR" "0"
 SYSTEM_CONSTANT "RCPTSRC_BRKPEDL" "2"
 SYSTEM_CONSTANT "RESIST_RES" "0.1"
 SYSTEM_CONSTANT "RESO_T_INC_PER_DUR_TTH_ADAP" "10"
 SYSTEM_CONSTANT "REVCNT_RES" "16"
 SYSTEM_CONSTANT "REVCNT_RES_EXP" "4"
 SYSTEM_CONSTANT "REVGEAR1" "-1"
 SYSTEM_CONSTANT "RHO_FUEL_RES" "0.1"
 SYSTEM_CONSTANT "RMPSQRVLG_S_1000_REF" "1000"
 SYSTEM_CONSTANT "RMPSQRVLG_S_100_REF" "100"
 SYSTEM_CONSTANT "RMPSQRVLG_S_REF" "1000"
 SYSTEM_CONSTANT "RMPSQRVLG_S_RES" "65536"
 SYSTEM_CONSTANT "RNOX_ZERO" "0"
 SYSTEM_CONSTANT "R_COIL_MAX" "5000"
 SYSTEM_CONSTANT "R_COIL_MIN" "0"
 SYSTEM_CONSTANT "R_RES" "1"
 SYSTEM_CONSTANT "SCALEFACDIV_RES" "200"
 SYSTEM_CONSTANT "SCR_AMPERE_RES_REV" "5"
 SYSTEM_CONSTANT "SCR_DTTEMP_RES_REV" "10"
 SYSTEM_CONSTANT "SCR_FLVOL_RES_REV" "20"
 SYSTEM_CONSTANT "SCR_ONEMIOPPMNOX_SY" "1000000"
 SYSTEM_CONSTANT "SCR_UC_VOLT_RES_REV" "10"
 SYSTEM_CONSTANT "SCR_VOLTQ0P0001227_RES" "0.0001220703125"
 SYSTEM_CONSTANT "SCR_VOLT_Q0P002_RES_REV" "500"
 SYSTEM_CONSTANT "SD_SC" "0"
 SYSTEM_CONSTANT "SECULIBS_VAR_SY" "999"
 SYSTEM_CONSTANT "SEC_RES" "1"
 SYSTEM_CONSTANT "SENT_SC" "0"
 SYSTEM_CONSTANT "SIA_OEM" "1"
 SYSTEM_CONSTANT "SIA_RB" "0"
 SYSTEM_CONSTANT "SIDSTSWT_MON_SC" "1"
 SYSTEM_CONSTANT "SIGNALS_AUTOPIDTABLE_SUPPORTED" "0"
 SYSTEM_CONSTANT "SIGNALS_BIT_DATATYPE_SUPPORTED" "0"
 SYSTEM_CONSTANT "SIGNALS_EXT2INT_2DARRAY_SUPPORTED" "0"
 SYSTEM_CONSTANT "SIGNALS_FLOAT_SUPPORTED" "0"
 SYSTEM_CONSTANT "SIGNALS_FORCE_PAVAST_IMPORT_STANDARD_SUPPORTED" "0"
 SYSTEM_CONSTANT "SIGNALS_INT2EXT_2DARRAY_SUPPORTED" "0"
 SYSTEM_CONSTANT "Signals_Mode1PidSize_SY" "27"
 SYSTEM_CONSTANT "Signals_NumberPID_SY" "26"
 SYSTEM_CONSTANT "Signals_NumberSigNumExt_SY" "5"
 SYSTEM_CONSTANT "Signals_NumberSigNumIntStd_SY" "88"
 SYSTEM_CONSTANT "Signals_NumberSigNumInt_SY" "91"
 SYSTEM_CONSTANT "Signals_SupportArray_Length_SY" "0"
 SYSTEM_CONSTANT "SIGNALS_VIRTUAL_B_ATMTPA_S" "89"
 SYSTEM_CONSTANT "SIGNALS_VIRTUAL_B_BM_S" "90"
 SYSTEM_CONSTANT "SIGNALS_VIRTUAL_DCMDSPUDS_DID_0110_ENGINE_STATUS_S" "91"
 SYSTEM_CONSTANT "Sig_I15031_LeanAppl_SY" "1"
 SYSTEM_CONSTANT "SIMPLE_SEG_SHIFT" "0"
 SYSTEM_CONSTANT "SOTMASSPERSEC_RES" "0.1"
 SYSTEM_CONSTANT "SOTMASSPERSEC_RES_REV" "10"
 SYSTEM_CONSTANT "SPAVEL_RES" "10"
 SYSTEM_CONSTANT "SPDCTL_DETPTST_SC" "1"
 SYSTEM_CONSTANT "SPECHEATFINE_RES_REV" "5"
 SYSTEM_CONSTANT "SPECHEAT_RES" "2"
 SYSTEM_CONSTANT "SPECIFICHEAT_RES" "0.0001"
 SYSTEM_CONSTANT "SPECIFICHEAT_RES_REV" "10000"
 SYSTEM_CONSTANT "SPRKSEATTMDL_SC" "1"
 SYSTEM_CONSTANT "STAACTVDET_SY" "0"
 SYSTEM_CONSTANT "STM_SY" "0"
 SYSTEM_CONSTANT "STNETH_SY" "0"
 SYSTEM_CONSTANT "STRTCTL_SC" "4"
 SYSTEM_CONSTANT "STRTTRQ_OFF" "0"
 SYSTEM_CONSTANT "STRTTRQ_ON" "1"
 SYSTEM_CONSTANT "STSP_SY" "0"
 SYSTEM_CONSTANT "SVS_SY" "0"
 SYSTEM_CONSTANT "SWT_DISABLED" "0"
 SYSTEM_CONSTANT "SWT_ENABLED" "1"
 SYSTEM_CONSTANT "SYC_AFTRUNDIAG_SC" "0"
 SYSTEM_CONSTANT "SYC_CAL_PERMSPLYSYS_SY" "0"
 SYSTEM_CONSTANT "SYC_CNTPOSTDRV_SC" "0"
 SYSTEM_CONSTANT "SYC_COORD_SC" "0"
 SYSTEM_CONSTANT "SYC_DRIVE" "4"
 SYSTEM_CONSTANT "SYC_ENALCYPROLG_SC" "1"
 SYSTEM_CONSTANT "SYC_INI" "0"
 SYSTEM_CONSTANT "SYC_INIEND" "2"
 SYSTEM_CONSTANT "SYC_INISYN" "1"
 SYSTEM_CONSTANT "SYC_POSTDRIVE" "5"
 SYSTEM_CONSTANT "SYC_POST_OS_EXIT" "6"
 SYSTEM_CONSTANT "SYC_PREDRIVE" "3"
 SYSTEM_CONSTANT "SYC_PROLGPREDRV_SC" "0"
 SYSTEM_CONSTANT "SY_2PGRD1E" "0"
 SYSTEM_CONSTANT "SY_2PGRD4E" "0"
 SYSTEM_CONSTANT "SY_2SG" "0"
 SYSTEM_CONSTANT "SY_ACPAC" "0"
 SYSTEM_CONSTANT "SY_AFIMVAR" "0"
 SYSTEM_CONSTANT "SY_AGR" "0"
 SYSTEM_CONSTANT "SY_AGR2" "0"
 SYSTEM_CONSTANT "SY_AIRBAG" "0"
 SYSTEM_CONSTANT "SY_ALE" "0"
 SYSTEM_CONSTANT "SY_APP" "1"
 SYSTEM_CONSTANT "SY_ASR" "0"
 SYSTEM_CONSTANT "SY_ASVAR" "1"
 SYSTEM_CONSTANT "SY_AUFLAD" "0"
 SYSTEM_CONSTANT "SY_BDE" "0"
 SYSTEM_CONSTANT "SY_BKVSRV" "0"
 SYSTEM_CONSTANT "SY_BPEZEK" "0"
 SYSTEM_CONSTANT "SY_CANVFZ" "0"
 SYSTEM_CONSTANT "SY_CASLIMP" "0"
 SYSTEM_CONSTANT "SY_CMPTSTIGN" "1"
 SYSTEM_CONSTANT "SY_CNG" "0"
 SYSTEM_CONSTANT "SY_CVT" "0"
 SYSTEM_CONSTANT "SY_DAPRID" "0"
 SYSTEM_CONSTANT "SY_DCPV" "0"
 SYSTEM_CONSTANT "SY_DG23I" "0"
 SYSTEM_CONSTANT "SY_DIGBT" "6"
 SYSTEM_CONSTANT "SY_DKATZP" "1"
 SYSTEM_CONSTANT "SY_DKNOTVVT" "0"
 SYSTEM_CONSTANT "SY_DKZEROP" "0"
 SYSTEM_CONSTANT "SY_DLDP" "0"
 SYSTEM_CONSTANT "SY_DMDBTGT" "0"
 SYSTEM_CONSTANT "SY_DMDCYLID" "0"
 SYSTEM_CONSTANT "SY_DMDFCER" "0"
 SYSTEM_CONSTANT "SY_DMDPAT" "0"
 SYSTEM_CONSTANT "SY_DMDSTQ" "50"
 SYSTEM_CONSTANT "SY_DMDTAL" "0"
 SYSTEM_CONSTANT "SY_DMDVAR" "0"
 SYSTEM_CONSTANT "SY_DMDZAG" "2"
 SYSTEM_CONSTANT "SY_DMDZMS" "0"
 SYSTEM_CONSTANT "SY_DMTL" "0"
 SYSTEM_CONSTANT "SY_DOPZW" "1"
 SYSTEM_CONSTANT "SY_DSPACE" "1"
 SYSTEM_CONSTANT "SY_DSS" "1"
 SYSTEM_CONSTANT "SY_DSS2" "0"
 SYSTEM_CONSTANT "SY_DSU" "0"
 SYSTEM_CONSTANT "SY_DSVDK" "0"
 SYSTEM_CONSTANT "SY_DTCWCS" "0"
 SYSTEM_CONSTANT "SY_DTHM" "0"
 SYSTEM_CONSTANT "SY_DVEAIF" "0"
 SYSTEM_CONSTANT "SY_DVEKOOR" "0"
 SYSTEM_CONSTANT "SY_DWVNWKW" "0"
 SYSTEM_CONSTANT "SY_DYNSYN" "0"
 SYSTEM_CONSTANT "SY_EEPWRMON" "0"
 SYSTEM_CONSTANT "SY_EGAS" "0"
 SYSTEM_CONSTANT "SY_EKPABP" "0"
 SYSTEM_CONSTANT "SY_EKPRMK" "0"
 SYSTEM_CONSTANT "SY_EKPSTA" "1"
 SYSTEM_CONSTANT "SY_EPMPHDT" "0"
 SYSTEM_CONSTANT "SY_FABE" "0"
 SYSTEM_CONSTANT "SY_FAEVZUE" "0"
 SYSTEM_CONSTANT "SY_FANT" "0"
 SYSTEM_CONSTANT "SY_FELMR" "0"
 SYSTEM_CONSTANT "SY_FFV" "0"
 SYSTEM_CONSTANT "SY_FFZ" "0"
 SYSTEM_CONSTANT "SY_FGR" "0"
 SYSTEM_CONSTANT "SY_FLUQ" "45"
 SYSTEM_CONSTANT "SY_FPCSSP" "0"
 SYSTEM_CONSTANT "SY_GAP" "2"
 SYSTEM_CONSTANT "SY_GAP2SYN" "0"
 SYSTEM_CONSTANT "SY_GDIPFI" "0"
 SYSTEM_CONSTANT "SY_HALVEZYLZA" "0"
 SYSTEM_CONSTANT "SY_HEV" "0"
 SYSTEM_CONSTANT "SY_HFM" "0"
 SYSTEM_CONSTANT "SY_HFMKOMP" "0"
 SYSTEM_CONSTANT "SY_HIENGSPD" "1"
 SYSTEM_CONSTANT "SY_HKS" "0"
 SYSTEM_CONSTANT "SY_HLSHFET" "0"
 SYSTEM_CONSTANT "SY_HLSVFET" "0"
 SYSTEM_CONSTANT "SY_HMB" "0"
 SYSTEM_CONSTANT "SY_HMBMBA" "0"
 SYSTEM_CONSTANT "SY_HMM" "0"
 SYSTEM_CONSTANT "SY_HOS" "0"
 SYSTEM_CONSTANT "SY_HSP" "0"
 SYSTEM_CONSTANT "SY_IGNABP" "0"
 SYSTEM_CONSTANT "SY_INJASYN" "0"
 SYSTEM_CONSTANT "SY_IPRCRSH" "0"
 SYSTEM_CONSTANT "SY_ISG" "0"
 SYSTEM_CONSTANT "SY_IUMPR" "1"
 SYSTEM_CONSTANT "SY_KAC" "0"
 SYSTEM_CONSTANT "SY_KCLD" "0"
 SYSTEM_CONSTANT "SY_KDS" "0"
 SYSTEM_CONSTANT "SY_KL50" "0"
 SYSTEM_CONSTANT "SY_KLAF" "0"
 SYSTEM_CONSTANT "SY_KORRZ" "1"
 SYSTEM_CONSTANT "SY_KSE" "0"
 SYSTEM_CONSTANT "SY_KSZA" "0"
 SYSTEM_CONSTANT "SY_KT" "0"
 SYSTEM_CONSTANT "SY_KTIGNBI" "0"
 SYSTEM_CONSTANT "SY_LAMKOP" "0"
 SYSTEM_CONSTANT "SY_LBK" "0"
 SYSTEM_CONSTANT "SY_LLSGSTA" "1"
 SYSTEM_CONSTANT "SY_LLSKOMP" "1"
 SYSTEM_CONSTANT "SY_LRHK" "0"
 SYSTEM_CONSTANT "SY_LRSTA" "1"
 SYSTEM_CONSTANT "SY_LS" "0"
 SYSTEM_CONSTANT "SY_LSFIKR" "0"
 SYSTEM_CONSTANT "SY_LSFIKR2" "0"
 SYSTEM_CONSTANT "SY_LSFNHK" "1"
 SYSTEM_CONSTANT "SY_LSFNHK2" "0"
 SYSTEM_CONSTANT "SY_LSFNTL" "0"
 SYSTEM_CONSTANT "SY_LSFNTL2" "0"
 SYSTEM_CONSTANT "SY_LSFNVK" "0"
 SYSTEM_CONSTANT "SY_LSFNVK2" "0"
 SYSTEM_CONSTANT "SY_LSFVHK" "1"
 SYSTEM_CONSTANT "SY_LSFVHK2" "0"
 SYSTEM_CONSTANT "SY_LSFVVK" "0"
 SYSTEM_CONSTANT "SY_LSFVVK2" "0"
 SYSTEM_CONSTANT "SY_LSUIKR" "0"
 SYSTEM_CONSTANT "SY_LSUIKR2" "0"
 SYSTEM_CONSTANT "SY_LSUNHK" "0"
 SYSTEM_CONSTANT "SY_LSUNHK2" "0"
 SYSTEM_CONSTANT "SY_LSUNTL" "0"
 SYSTEM_CONSTANT "SY_LSUNTL2" "0"
 SYSTEM_CONSTANT "SY_LSUNVK" "0"
 SYSTEM_CONSTANT "SY_LSUNVK2" "0"
 SYSTEM_CONSTANT "SY_LSUVHK" "0"
 SYSTEM_CONSTANT "SY_LSUVHK2" "0"
 SYSTEM_CONSTANT "SY_LSUVVK" "0"
 SYSTEM_CONSTANT "SY_LSUVVK2" "0"
 SYSTEM_CONSTANT "SY_LSZYVER" "0"
 SYSTEM_CONSTANT "SY_LUART" "1"
 SYSTEM_CONSTANT "SY_LUESTA" "1"
 SYSTEM_CONSTANT "SY_LUFAK" "8.796093022"
 SYSTEM_CONSTANT "SY_LUSRKR" "0"
 SYSTEM_CONSTANT "SY_MDBGV" "0"
 SYSTEM_CONSTANT "SY_MDMXEXC" "0"
 SYSTEM_CONSTANT "SY_MODE5" "1"
 SYSTEM_CONSTANT "SY_MOROM" "0"
 SYSTEM_CONSTANT "SY_MSGRED" "0"
 SYSTEM_CONSTANT "SY_MSR" "0"
 SYSTEM_CONSTANT "SY_NG" "0"
 SYSTEM_CONSTANT "SY_NGFADIO" "0"
 SYSTEM_CONSTANT "SY_NIGNCL" "2"
 SYSTEM_CONSTANT "SY_NLDG" "0"
 SYSTEM_CONSTANT "SY_NLZOFF" "1"
 SYSTEM_CONSTANT "SY_NMAXAIR" "0"
 SYSTEM_CONSTANT "SY_NOHK" "0"
 SYSTEM_CONSTANT "SY_NOHK2" "0"
 SYSTEM_CONSTANT "SY_NSYNC" "1"
 SYSTEM_CONSTANT "SY_NUMGAP" "1"
 SYSTEM_CONSTANT "SY_NVLD" "0"
 SYSTEM_CONSTANT "SY_NWGA" "0"
 SYSTEM_CONSTANT "SY_NWGA2" "0"
 SYSTEM_CONSTANT "SY_NWGE" "0"
 SYSTEM_CONSTANT "SY_NWGE2" "0"
 SYSTEM_CONSTANT "SY_NWS" "0"
 SYSTEM_CONSTANT "SY_NWSA" "0"
 SYSTEM_CONSTANT "SY_OVHP" "1"
 SYSTEM_CONSTANT "SY_PGRAD" "0"
 SYSTEM_CONSTANT "SY_PGRAD2" "0"
 SYSTEM_CONSTANT "SY_PGRD01E" "0"
 SYSTEM_CONSTANT "SY_PGRD04E" "0"
 SYSTEM_CONSTANT "SY_PHAS2NEG" "0"
 SYSTEM_CONSTANT "SY_PHASNEG" "1"
 SYSTEM_CONSTANT "SY_PHDET" "6"
 SYSTEM_CONSTANT "SY_PHDETCALCLUTS" "0"
 SYSTEM_CONSTANT "SY_PHDETMF" "0"
 SYSTEM_CONSTANT "SY_PHDETSPDGRD" "0"
 SYSTEM_CONSTANT "SY_PHDETZW" "0"
 SYSTEM_CONSTANT "SY_PHDTMAP" "2"
 SYSTEM_CONSTANT "SY_PHFEPOS" "0"
 SYSTEM_CONSTANT "SY_PSTDRST" "0"
 SYSTEM_CONSTANT "SY_PTO" "0"
 SYSTEM_CONSTANT "SY_QSYN" "0"
 SYSTEM_CONSTANT "SY_ROLLE" "0"
 SYSTEM_CONSTANT "SY_ROVS" "1"
 SYSTEM_CONSTANT "SY_SCH" "0"
 SYSTEM_CONSTANT "SY_SDST" "1"
 SYSTEM_CONSTANT "SY_SGANDVE" "1"
 SYSTEM_CONSTANT "SY_SGANZ" "1"
 SYSTEM_CONSTANT "SY_SKH" "0"
 SYSTEM_CONSTANT "SY_SLS" "0"
 SYSTEM_CONSTANT "SY_SLVANZ" "0"
 SYSTEM_CONSTANT "SY_SSPDKP" "0"
 SYSTEM_CONSTANT "SY_STASTO" "0"
 SYSTEM_CONSTANT "SY_STERVK" "0"
 SYSTEM_CONSTANT "SY_STETLR" "0"
 SYSTEM_CONSTANT "SY_SU" "0"
 SYSTEM_CONSTANT "SY_SVBB" "0"
 SYSTEM_CONSTANT "SY_TEETH" "36"
 SYSTEM_CONSTANT "SY_TEVANZ" "1"
 SYSTEM_CONSTANT "SY_TEVKOMP" "1"
 SYSTEM_CONSTANT "SY_TEVPR" "0"
 SYSTEM_CONSTANT "SY_TEVSTA" "1"
 SYSTEM_CONSTANT "SY_TFAM" "0"
 SYSTEM_CONSTANT "SY_TLRARES" "0"
 SYSTEM_CONSTANT "SY_TNSIG" "0"
 SYSTEM_CONSTANT "SY_TTFCRSFIL" "0"
 SYSTEM_CONSTANT "SY_TUMG" "2"
 SYSTEM_CONSTANT "SY_TURBO" "0"
 SYSTEM_CONSTANT "SY_TZW" "0"
 SYSTEM_CONSTANT "SY_UBDEDIQ" "70"
 SYSTEM_CONSTANT "SY_UBDEENQ" "80"
 SYSTEM_CONSTANT "SY_UBR" "0"
 SYSTEM_CONSTANT "SY_VANGLE" "0"
 SYSTEM_CONSTANT "SY_VAR" "10"
 SYSTEM_CONSTANT "SY_VIRTSYN" "1"
 SYSTEM_CONSTANT "SY_VVT" "0"
 SYSTEM_CONSTANT "SY_WFS" "0"
 SYSTEM_CONSTANT "SY_WMAX" "72"
 SYSTEM_CONSTANT "SY_WMIN" "-36"
 SYSTEM_CONSTANT "SY_WNWADM" "0"
 SYSTEM_CONSTANT "SY_ZAGPATTERNMX" "3"
 SYSTEM_CONSTANT "SY_ZGST" "0"
 SYSTEM_CONSTANT "SY_ZNDAUS" "3"
 SYSTEM_CONSTANT "SY_ZUESTA" "0"
 SYSTEM_CONSTANT "SY_ZYLOFFH" "0"
 SYSTEM_CONSTANT "SY_ZYLZA" "1"
 SYSTEM_CONSTANT "SY_ZYLZG" "1"
 SYSTEM_CONSTANT "SY_ZZBANK" "0"
 SYSTEM_CONSTANT "SY_ZZSG" "0"
 SYSTEM_CONSTANT "T15RAWDSQENA_SC" "1"
 SYSTEM_CONSTANT "T15_ATS_SY" "0"
 SYSTEM_CONSTANT "T15_DBGMD_VD_SY" "1"
 SYSTEM_CONSTANT "T15_ON_VLDT_COM_SY" "0"
 SYSTEM_CONSTANT "T15_WKDETN_SC" "1"
 SYSTEM_CONSTANT "T50_ATS_SY" "0"
 SYSTEM_CONSTANT "T50_SY" "0"
 SYSTEM_CONSTANT "TDC_ADAP_SY" "0"
 SYSTEM_CONSTANT "TDC_UNEQLGEOM_SY" "0"
 SYSTEM_CONSTANT "TEGMOD_HEATFLOWKW_RES" "100000"
 SYSTEM_CONSTANT "TEGMOD_HEATFLOW_INTER_RES" "360"
 SYSTEM_CONSTANT "TEGMOD_HEATKJ_RES" "100"
 SYSTEM_CONSTANT "TEGMOD_INTER_RES" "1"
 SYSTEM_CONSTANT "TEMP_20_CELS" "20"
 SYSTEM_CONSTANT "TEMP_CELS_1200" "1200"
 SYSTEM_CONSTANT "TEMP_CELS_150" "150"
 SYSTEM_CONSTANT "TEMP_CELS_1500" "1500"
 SYSTEM_CONSTANT "TEMP_CELS_MAX" "3003.56"
 SYSTEM_CONSTANT "TEMP_CELS_MIN" "-3549.94"
 SYSTEM_CONSTANT "TEMP_CELS_M_100" "-100"
 SYSTEM_CONSTANT "TEMP_CELS_M_200" "-200"
 SYSTEM_CONSTANT "TEMP_KELV_1000" "1000"
 SYSTEM_CONSTANT "TEMP_KELV_1200" "1200"
 SYSTEM_CONSTANT "TEMP_KELV_M_1000" "-1000"
 SYSTEM_CONSTANT "TEMP_KELV_M_200" "-200"
 SYSTEM_CONSTANT "THDFACOPMODEMAXSIZE" "10"
 SYSTEM_CONSTANT "THRVLVPROD_SY" "0"
 SYSTEM_CONSTANT "THRVLV_LIMLRNGTSTRTRIG_SC" "1"
 SYSTEM_CONSTANT "THRVLV_POKAYOKE_SC" "1"
 SYSTEM_CONSTANT "THRVLV_TWNCHRGCTRL_SC" "0"
 SYSTEM_CONSTANT "TIMEDELAY_S_2_MIN" "0.001"
 SYSTEM_CONSTANT "TIMEDELAY_S_2_NRM" "8"
 SYSTEM_CONSTANT "TIME_5S_NRM_SY" "5"
 SYSTEM_CONSTANT "TIME_DEB_10MS" "10000"
 SYSTEM_CONSTANT "TIME_DT_1000MS" "1000000"
 SYSTEM_CONSTANT "TIME_DT_100MS" "100000"
 SYSTEM_CONSTANT "TIME_DT_10MS" "10000"
 SYSTEM_CONSTANT "TIME_DT_1S" "1000000"
 SYSTEM_CONSTANT "TIME_DT_200MS" "200000"
 SYSTEM_CONSTANT "TIME_S_12000" "12000"
 SYSTEM_CONSTANT "TIME_S_LORES_ONE" "1"
 SYSTEM_CONSTANT "Time_s_LORES_RES" "1"
 SYSTEM_CONSTANT "Time_s_LORES_RES_REV" "1"
 SYSTEM_CONSTANT "TIME_S_LORES_ZERO" "0"
 SYSTEM_CONSTANT "TIME_TICK_SEC_INV" "100"
 SYSTEM_CONSTANT "TI_PII_EARL_REL" "13000"
 SYSTEM_CONSTANT "TI_POI2_LATE_REL" "-13000"
 SYSTEM_CONSTANT "TLE7244_SC" "0"
 SYSTEM_CONSTANT "TNRM" "0"
 SYSTEM_CONSTANT "TQSTRUCT2W_SC" "1"
 SYSTEM_CONSTANT "TRA_AST" "2"
 SYSTEM_CONSTANT "TRA_AT" "1"
 SYSTEM_CONSTANT "TRA_AT_SY" "0"
 SYSTEM_CONSTANT "TRA_CVT" "3"
 SYSTEM_CONSTANT "TRA_DCT" "4"
 SYSTEM_CONSTANT "TRA_MT" "0"
 SYSTEM_CONSTANT "TRQSEL_SY" "1"
 SYSTEM_CONSTANT "TRQ_MONLIM_DIAG_SY" "0"
 SYSTEM_CONSTANT "TRQ_ZERO" "0"
 SYSTEM_CONSTANT "TWCOR_HIRES_SC" "1"
 SYSTEM_CONSTANT "TWNCHRGSYS_SC" "0"
 SYSTEM_CONSTANT "TWOWHLCUST_SC" "3"
 SYSTEM_CONSTANT "TWO_POW_NRM_EXP_RES_TRIGO_FUNC" "4096"
 SYSTEM_CONSTANT "TWSTSTRT_AVL_SC" "0"
 SYSTEM_CONSTANT "UART_SY" "0"
 SYSTEM_CONSTANT "UDPNM_SC" "0"
 SYSTEM_CONSTANT "UEGO_ICS1B1_SY" "0"
 SYSTEM_CONSTANT "UEGO_ICS1B2_SY" "0"
 SYSTEM_CONSTANT "VEHTYP_SC" "1"
 SYSTEM_CONSTANT "VEHVCANSRC_SC" "0"
 SYSTEM_CONSTANT "VEHVSRC_SY" "2"
 SYSTEM_CONSTANT "VEHV_SGLWHLDIAG_SY" "0"
 SYSTEM_CONSTANT "VEL_KMH_0" "0"
 SYSTEM_CONSTANT "VEL_KMH_300" "300"
 SYSTEM_CONSTANT "VEL_KMH_M_300" "-300"
 SYSTEM_CONSTANT "VERSSTOPMISFGDETNBYINJ_SY" "0"
 SYSTEM_CONSTANT "VFG_SC" "0"
 SYSTEM_CONSTANT "VNQ6040_SC" "0"
 SYSTEM_CONSTANT "VOL_FILGLVL_RES" "1"
 SYSTEM_CONSTANT "VOL_FILGLVL_RES_REV" "1"
 SYSTEM_CONSTANT "VOL_NSC_RES" "0.0001"
 SYSTEM_CONSTANT "VOL_NSC_RES_FL" "0.0001"
 SYSTEM_CONSTANT "VOL_NSC_RES_REV" "10000"
 SYSTEM_CONSTANT "VOL_RES_REV" "100"
 SYSTEM_CONSTANT "V_CAM_RES_REV" "256"
 SYSTEM_CONSTANT "WDGS_CFGADPR_SC" "1"
 SYSTEM_CONSTANT "WHLSPDINPTYP_SC" "0"
 SYSTEM_CONSTANT "WHLSPDSENS_SC" "1"
 SYSTEM_CONSTANT "XCPVERS_SC" "3"
 SYSTEM_CONSTANT "XCP_SY" "1"
 SYSTEM_CONSTANT "XDI_SC" "0"
 SYSTEM_CONSTANT "ZERO" "0"
 SYSTEM_CONSTANT "ZFC_SY" "0" /end MOD_PAR
/begin MOD_COMMON "" BYTE_ORDER MSB_FIRST ALIGNMENT_BYTE 1 ALIGNMENT_WORD 2 ALIGNMENT_LONG 4 ALIGNMENT_INT64 4 ALIGNMENT_FLOAT32_IEEE 4 ALIGNMENT_FLOAT64_IEEE 4 /end MOD_COMMON
/begin IF_DATA ASAP1B_Bypass
 /begin TP_BLOB 0x102 /* Bypass version */ 0x102 /* Blob version */ /end TP_BLOB
/end IF_DATA
/begin IF_DATA XCPplus 0x0102
 /begin PAG /* MAX_SEGMENTS */ 3 /end PAG
 /*************** start of PROTOCOL_LAYER *******************/
 /begin PROTOCOL_LAYER /* At MODULE */ 0x0102 /* XCP protocol layer version */ 250 /* T1 [ms] */ 250 /* T2 [ms] */ 0 /* T3 [ms] */ 0 /* T4 [ms] */ 0 /* T5 [ms] */ 0 /* T6 [ms] */ 0 /* T7 [ms] */ 8 /* MAX_CTO */ 8 /* MAX_DTO default for DAQ and STIM */ BYTE_ORDER_MSB_FIRST /* BYTE_ORDER: MOTOROLA */ ADDRESS_GRANULARITY_BYTE /* ADDRESS_GRANULARITY */ OPTIONAL_CMD GET_ID OPTIONAL_CMD SET_MTA OPTIONAL_CMD UPLOAD OPTIONAL_CMD SHORT_UPLOAD OPTIONAL_CMD BUILD_CHECKSUM OPTIONAL_CMD DOWNLOAD OPTIONAL_CMD DOWNLOAD_NEXT OPTIONAL_CMD DOWNLOAD_MAX OPTIONAL_CMD SET_CAL_PAGE OPTIONAL_CMD GET_CAL_PAGE OPTIONAL_CMD COPY_CAL_PAGE OPTIONAL_CMD CLEAR_DAQ_LIST OPTIONAL_CMD SET_DAQ_PTR OPTIONAL_CMD WRITE_DAQ OPTIONAL_CMD SET_DAQ_LIST_MODE OPTIONAL_CMD START_STOP_DAQ_LIST OPTIONAL_CMD START_STOP_SYNCH OPTIONAL_CMD FREE_DAQ OPTIONAL_CMD ALLOC_DAQ OPTIONAL_CMD ALLOC_ODT OPTIONAL_CMD ALLOC_ODT_ENTRY COMMUNICATION_MODE_SUPPORTED /* optional modes supported */ BLOCK SLAVE /* Slave Block Mode supported */ MASTER /* Master Block Mode supported */ 255 /* MAX_BS */ 0 /* MIN_ST */ /end PROTOCOL_LAYER
 /***************** end of PROTOCOL_LAYER *******************/ /********************* start of DAQ ************************/
 /begin DAQ /* DAQ supported, at MODULE*/ DYNAMIC /* DAQ_CONFIG_TYPE */ 65535 /* MAX_DAQ */ 4 /* MAX_EVENT_CHANNEL */ 0 /* MIN_DAQ */ OPTIMISATION_TYPE_DEFAULT /* OPTIMISATION_TYPE */ ADDRESS_EXTENSION_FREE /* ADDRESS_EXTENSION */ IDENTIFICATION_FIELD_TYPE_ABSOLUTE /* IDENTIFICATION_FIELD */ GRANULARITY_ODT_ENTRY_SIZE_DAQ_BYTE /* GRANULARITY_ODT_ENTRY_SIZE_DAQ */ 255 /* MAX_ODT_ENTRY_SIZE_DAQ */ OVERLOAD_INDICATION_EVENT /* OVERLOAD_INDICATION */ PRESCALER_SUPPORTED
  /begin STIM /* STIM supported */ GRANULARITY_ODT_ENTRY_SIZE_STIM_BYTE /* GRANULARITY_ODT_ENTRY_SIZE_STIM */ 255 /* MAX_ODT_ENTRY_SIZE_STIM */ /end STIM
  /begin DAQ_MEMORY_CONSUMPTION 3995 /* DAQ_MEMORY_LIMIT: in Elements[AG] */ 60 /* DAQ_SIZE: number of elements[AG] per DAQ list */ 6 /* ODT_SIZE: number of elements[AG] per ODT */ 5 /* ODT_ENTRY_SIZE: number of elements[AG] per ODT_entry */ 2 /* ODT_DAQ_BUFFER_ELEMENT_SIZE: number of */ /* payload elements[AG]*factor = sizeof(send buffer)[AG] */ 3 /* ODT_STIM_BUFFER_ELEMENT_SIZE: number of */ /* payload elements[AG]*factor = sizeof(receive buffer)[AG] */ /end DAQ_MEMORY_CONSUMPTION
  /******************* start of EVENT ************************/ /begin EVENT "segment synchronous" "seg_sync" 0 DAQ 1 0 6 7 /end EVENT /begin EVENT "10ms time synchronous" "10_ms" 1 DAQ 1 10 6 6 /end EVENT /begin EVENT "100ms time synchronous" "100_ms" 2 DAQ 1 100 6 5 /end EVENT
  /begin EVENT "1000ms time synchronous" "1000_ms" 3 DAQ 1 100 7 /* EVENT_CHANNEL_TIME_UNIT: UNIT_10MS */ 4 /end EVENT
  /********************* end of EVENT ************************/ /end DAQ
 /********************* end of DAQ **************************/
 /begin XCP_ON_CAN /************************ start of CAN *********************/ 0x0102 /* XCP on CAN version */ CAN_ID_MASTER 0x7F0 /* CMD/STIM CAN-ID */ /* master -> slave */ CAN_ID_SLAVE 0x7F1 /* RES/ERR/EV/SERV/DAQ CAN-ID */ /* slave -> master */ /* Bit31= 1: extended identifier */ BAUDRATE 500000 /* BAUDRATE [Hz] */ SAMPLE_POINT 75 /* sample point */ /* [% complete bit time] */ SAMPLE_RATE SINGLE /* 1 sample per bit */ BTL_CYCLES 8 /* BTL_CYCLES */ /* [slots per bit time] */ SJW 1 /* length synchr. segment */ /* [BTL_CYCLES] */ SYNC_EDGE SINGLE /* on falling edge only */ /************************* end of CAN **********************/ /*************** start of PROTOCOL_LAYER *******************/
  /begin PROTOCOL_LAYER /* At MODULE */ 0x0102 /* XCP protocol layer version */ 250 /* T1 [ms] */ 250 /* T2 [ms] */ 0 /* T3 [ms] */ 0 /* T4 [ms] */ 0 /* T5 [ms] */ 0 /* T6 [ms] */ 0 /* T7 [ms] */ 8 /* MAX_CTO */ 8 /* MAX_DTO default for DAQ and STIM */ BYTE_ORDER_MSB_FIRST /* BYTE_ORDER: MOTOROLA */ ADDRESS_GRANULARITY_BYTE /* ADDRESS_GRANULARITY */ OPTIONAL_CMD GET_ID OPTIONAL_CMD SET_MTA OPTIONAL_CMD UPLOAD OPTIONAL_CMD SHORT_UPLOAD OPTIONAL_CMD BUILD_CHECKSUM OPTIONAL_CMD DOWNLOAD OPTIONAL_CMD DOWNLOAD_NEXT OPTIONAL_CMD DOWNLOAD_MAX OPTIONAL_CMD SET_CAL_PAGE OPTIONAL_CMD GET_CAL_PAGE OPTIONAL_CMD COPY_CAL_PAGE OPTIONAL_CMD CLEAR_DAQ_LIST OPTIONAL_CMD SET_DAQ_PTR OPTIONAL_CMD WRITE_DAQ OPTIONAL_CMD SET_DAQ_LIST_MODE OPTIONAL_CMD START_STOP_DAQ_LIST OPTIONAL_CMD START_STOP_SYNCH OPTIONAL_CMD FREE_DAQ OPTIONAL_CMD ALLOC_DAQ OPTIONAL_CMD ALLOC_ODT OPTIONAL_CMD ALLOC_ODT_ENTRY COMMUNICATION_MODE_SUPPORTED /* optional modes supported */ BLOCK SLAVE /* Slave Block Mode supported */ MASTER /* Master Block Mode supported */ 255 /* MAX_BS */ 0 /* MIN_ST */ /end PROTOCOL_LAYER
  /***************** end of PROTOCOL_LAYER *******************/ /********************* start of DAQ ************************/
  /begin DAQ /* DAQ supported, at MODULE*/ DYNAMIC /* DAQ_CONFIG_TYPE */ 65535 /* MAX_DAQ */ 4 /* MAX_EVENT_CHANNEL */ 0 /* MIN_DAQ */ OPTIMISATION_TYPE_DEFAULT /* OPTIMISATION_TYPE */ ADDRESS_EXTENSION_FREE /* ADDRESS_EXTENSION */ IDENTIFICATION_FIELD_TYPE_ABSOLUTE /* IDENTIFICATION_FIELD */ GRANULARITY_ODT_ENTRY_SIZE_DAQ_BYTE /* GRANULARITY_ODT_ENTRY_SIZE_DAQ */ 255 /* MAX_ODT_ENTRY_SIZE_DAQ */ OVERLOAD_INDICATION_EVENT /* OVERLOAD_INDICATION */ PRESCALER_SUPPORTED
   /begin STIM /* STIM supported */ GRANULARITY_ODT_ENTRY_SIZE_STIM_BYTE /* GRANULARITY_ODT_ENTRY_SIZE_STIM */ 255 /* MAX_ODT_ENTRY_SIZE_STIM */ /end STIM
   /begin DAQ_MEMORY_CONSUMPTION 3995 /* DAQ_MEMORY_LIMIT: in Elements[AG] */ 60 /* DAQ_SIZE: number of elements[AG] per DAQ list */ 6 /* ODT_SIZE: number of elements[AG] per ODT */ 5 /* ODT_ENTRY_SIZE: number of elements[AG] per ODT_entry */ 2 /* ODT_DAQ_BUFFER_ELEMENT_SIZE: number of */ /* payload elements[AG]*factor = sizeof(send buffer)[AG] */ 3 /* ODT_STIM_BUFFER_ELEMENT_SIZE: number of */ /* payload elements[AG]*factor = sizeof(receive buffer)[AG] */ /end DAQ_MEMORY_CONSUMPTION
   /******************* start of EVENT ************************/ /begin EVENT "segment synchronous" "seg_sync" 0 DAQ 1 0 6 7 /end EVENT /begin EVENT "10ms time synchronous" "10_ms" 1 DAQ 1 10 6 6 /end EVENT /begin EVENT "100ms time synchronous" "100_ms" 2 DAQ 1 100 6 5 /end EVENT
   /begin EVENT "1000ms time synchronous" "1000_ms" 3 DAQ 1 100 7 /* EVENT_CHANNEL_TIME_UNIT: UNIT_10MS */ 4 /end EVENT
   /********************* end of EVENT ************************/ /end DAQ
  /********************* end of DAQ **************************/ TRANSPORT_LAYER_INSTANCE "CAN_0_PL0" /end XCP_ON_CAN
/end IF_DATA
/begin CHARACTERISTIC DDRC_DebArCounter.DFC_CANIF_E_CTRL_NOT_SLEEP_ERROR_VALUE.isJmpUpActv_C "Parameters of ArCounter debouncing / DFC_CANIF_E_CTRL_NOT_SLEEP_ERROR_VALUE / Jump at change from ""Passed"" to ""Failed"" debouncing" VALUE 0x9081374 RB_Val_Wu8 1.000 OneToOne 0.00 1.000 FORMAT "%5.3" EXTENDED_LIMITS 0.00 255.0 /end CHARACTERISTIC
/begin CHARACTERISTIC DDRC_DebArCounter.DFC_CANIF_E_CTRL_NOT_SLEEP_ERROR_VALUE.isJmpDwnActv_C "Parameters of ArCounter debouncing / DFC_CANIF_E_CTRL_NOT_SLEEP_ERROR_VALUE / Jump at change from ""Failed"" to ""Passed"" debouncing" VALUE 0x9081375 RB_Val_Wu8 1.000 OneToOne 0.00 1.000 FORMAT "%5.3" EXTENDED_LIMITS 0.00 255.0 /end CHARACTERISTIC
/begin CHARACTERISTIC DDRC_DebArCounter.DFC_CANIF_E_CTRL_NOT_SLEEP_ERROR_VALUE.limPassd_C "Parameters of ArCounter debouncing / DFC_CANIF_E_CTRL_NOT_SLEEP_ERROR_VALUE / ""Passed"" limit" VALUE 0x9081376 RB_Val_Ws16 32767.00 OneToOne -32768.00 -1.000000 FORMAT "%8.2" EXTENDED_LIMITS -32768.00 32767.00 /end CHARACTERISTIC
/begin CHARACTERISTIC DDRC_DebArCounter.DFC_CANIF_E_CTRL_NOT_SLEEP_ERROR_VALUE.limFaild_C "Parameters of ArCounter debouncing / DFC_CANIF_E_CTRL_NOT_SLEEP_ERROR_VALUE / ""Failed"" limit" VALUE 0x9081378 RB_Val_Ws16 32766.00 OneToOne 1.000000 32767.00 FORMAT "%8.2" EXTENDED_LIMITS -32768.00 32767.00 /end CHARACTERISTIC
/begin CHARACTERISTIC DDRC_DebArCounter.DFC_CANIF_E_CTRL_NOT_SLEEP_ERROR_VALUE.stepUp_C "Parameters of ArCounter debouncing / DFC_CANIF_E_CTRL_NOT_SLEEP_ERROR_VALUE / Stepsize of ""Failed"" direction" VALUE 0x908137A RB_Val_Ws16 32766.00 OneToOne 1.000000 32767.00 FORMAT "%8.2" EXTENDED_LIMITS -32768.00 32767.00 /end CHARACTERISTIC
/begin CHARACTERISTIC DDRC_DebArCounter.DFC_CANIF_E_CTRL_NOT_SLEEP_ERROR_VALUE.stepDwn_C "Parameters of ArCounter debouncing / DFC_CANIF_E_CTRL_NOT_SLEEP_ERROR_VALUE / Stepsize of ""Passed"" direction" VALUE 0x908137C RB_Val_Ws16 32767.00 OneToOne -32768.00 -1.000000 FORMAT "%8.2" EXTENDED_LIMITS -32768.00 32767.00 /end CHARACTERISTIC
/begin CHARACTERISTIC DDRC_DebArCounter.DFC_CANIF_E_CTRL_NOT_SLEEP_ERROR_VALUE.jmpUpVal_C "Parameters of ArCounter debouncing / DFC_CANIF_E_CTRL_NOT_SLEEP_ERROR_VALUE / Jumppoint direction ""Failed""" VALUE 0x908137E RB_Val_Ws16 65535.00 OneToOne -32768.00 32767.00 FORMAT "%8.2" /end CHARACTERISTIC
/begin CHARACTERISTIC DDRC_DebArCounter.DFC_CANIF_E_CTRL_NOT_SLEEP_ERROR_VALUE.jmpDwnVal_C "Parameters of ArCounter debouncing / DFC_CANIF_E_CTRL_NOT_SLEEP_ERROR_VALUE / Jumppoint direction ""Passed""" VALUE 0x9081380 RB_Val_Ws16 65535.00 OneToOne -32768.00 32767.00 FORMAT "%8.2" /end CHARACTERISTIC
/begin CHARACTERISTIC DDRC_DebArCounter.DFC_rba_MultiStackTrace_Threshold.isJmpUpActv_C "Parameters of ArCounter debouncing / DFC_rba_MultiStackTrace_Threshold / Jump at change from ""Passed"" to ""Failed"" debouncing" VALUE 0x9081494 RB_Val_Wu8 1.000 OneToOne 0.00 1.000 FORMAT "%5.3" EXTENDED_LIMITS 0.00 255.0 /end CHARACTERISTIC
/begin CHARACTERISTIC DDRC_DebArCounter.DFC_rba_MultiStackTrace_Threshold.isJmpDwnActv_C "Parameters of ArCounter debouncing / DFC_rba_MultiStackTrace_Threshold / Jump at change from ""Failed"" to ""Passed"" debouncing" VALUE 0x9081495 RB_Val_Wu8 1.000 OneToOne 0.00 1.000 FORMAT "%5.3" EXTENDED_LIMITS 0.00 255.0 /end CHARACTERISTIC
/begin CHARACTERISTIC DDRC_DebArCounter.DFC_rba_MultiStackTrace_Threshold.limPassd_C "Parameters of ArCounter debouncing / DFC_rba_MultiStackTrace_Threshold / ""Passed"" limit" VALUE 0x9081496 RB_Val_Ws16 32767.00 OneToOne -32768.00 -1.000000 FORMAT "%8.2" EXTENDED_LIMITS -32768.00 32767.00 /end CHARACTERISTIC
/begin CHARACTERISTIC DDRC_DebArCounter.DFC_rba_MultiStackTrace_Threshold.limFaild_C "Parameters of ArCounter debouncing / DFC_rba_MultiStackTrace_Threshold / ""Failed"" limit" VALUE 0x9081498 RB_Val_Ws16 32766.00 OneToOne 1.000000 32767.00 FORMAT "%8.2" EXTENDED_LIMITS -32768.00 32767.00 /end CHARACTERISTIC
/begin CHARACTERISTIC DDRC_DebArCounter.DFC_rba_MultiStackTrace_Threshold.stepUp_C "Parameters of ArCounter debouncing / DFC_rba_MultiStackTrace_Threshold / Stepsize of ""Failed"" direction" VALUE 0x908149A RB_Val_Ws16 32766.00 OneToOne 1.000000 32767.00 FORMAT "%8.2" EXTENDED_LIMITS -32768.00 32767.00 /end CHARACTERISTIC
/begin CHARACTERISTIC DDRC_DebArCounter.DFC_rba_MultiStackTrace_Threshold.stepDwn_C "Parameters of ArCounter debouncing / DFC_rba_MultiStackTrace_Threshold / Stepsize of ""Passed"" direction" VALUE 0x908149C RB_Val_Ws16 32767.00 OneToOne -32768.00 -1.000000 FORMAT "%8.2" EXTENDED_LIMITS -32768.00 32767.00 /end CHARACTERISTIC
/begin CHARACTERISTIC DDRC_DebArCounter.DFC_rba_MultiStackTrace_Threshold.jmpUpVal_C "Parameters of ArCounter debouncing / DFC_rba_MultiStackTrace_Threshold / Jumppoint direction ""Failed""" VALUE 0x908149E RB_Val_Ws16 65535.00 OneToOne -32768.00 32767.00 FORMAT "%8.2" /end CHARACTERISTIC
/begin CHARACTERISTIC DDRC_DebArCounter.DFC_rba_MultiStackTrace_Threshold.jmpDwnVal_C "Parameters of ArCounter debouncing / DFC_rba_MultiStackTrace_Threshold / Jumppoint direction ""Passed""" VALUE 0x90814A0 RB_Val_Ws16 65535.00 OneToOne -32768.00 32767.00 FORMAT "%8.2" /end CHARACTERISTIC
/begin CHARACTERISTIC DFC_CtlMsk2.DFC_CANIF_E_CTRL_NOT_SLEEP_ERROR_VALUE_C "Behaviour control mask / Behaviour control masks of check DFC_CANIF_E_CTRL_NOT_SLEEP_ERROR_VALUE" VALUE 0x90803B9 Val_Wu8 255.0 DFES_OneToOne 0.00 255.0 FORMAT "%5.1" /end CHARACTERISTIC
/begin CHARACTERISTIC DFC_CtlMsk2.DFC_rba_MultiStackTrace_Threshold_C "Behaviour control mask / Behaviour control masks of check DFC_rba_MultiStackTrace_Threshold" VALUE 0x90803CB Val_Wu8 255.0 DFES_OneToOne 0.00 255.0 FORMAT "%5.1" /end CHARACTERISTIC
/begin CHARACTERISTIC DFC_CtlMsk2.DFC_rba_MRly_Diag_Stk_Event_C "Behaviour control mask / Behaviour control masks of check DFC_rba_MRly_Diag_Stk_Event" VALUE 0x90803CC Val_Wu8 255.0 DFES_OneToOne 0.00 255.0 FORMAT "%5.1" /end CHARACTERISTIC
/begin CHARACTERISTIC DFC_DisblMsk2.DFC_CANIF_E_CTRL_NOT_SLEEP_ERROR_VALUE_C "disable mask / Disable masks of check DFC_CANIF_E_CTRL_NOT_SLEEP_ERROR_VALUE" VALUE 0x9080D89 Val_Wu8 255.0 DFES_OneToOne 0.00 255.0 FORMAT "%5.1" /end CHARACTERISTIC
/begin CHARACTERISTIC DFC_DisblMsk2.DFC_rba_MultiStackTrace_Threshold_C "disable mask / Disable masks of check DFC_rba_MultiStackTrace_Threshold" VALUE 0x9080D9B Val_Wu8 255.0 DFES_OneToOne 0.00 255.0 FORMAT "%5.1" /end CHARACTERISTIC
/begin CHARACTERISTIC DFC_DisblMsk2.DFC_rba_MRly_Diag_Stk_Event_C "disable mask / Disable masks of check DFC_rba_MRly_Diag_Stk_Event" VALUE 0x9080D9C Val_Wu8 255.0 DFES_OneToOne 0.00 255.0 FORMAT "%5.1" /end CHARACTERISTIC
/*********** Start of merged MEASUREMENT blocks ***********/
/begin MEASUREMENT Can_DriverState_MP "Flag to check if CAN driver is Initialized(CAN_READY(TRUE)) or Not Initialized (CAN_UNINIT(FALSE))" UBYTE RB_RBA_Common_CentralElements_CompuMethods_Identical 1 100 0.0 255. FORMAT "%5.0" ECU_ADDRESS 0x40002AD8 /end MEASUREMENT
/begin MEASUREMENT CanIf_ControllerState_0[0].DeviceMode "Can Interface controller State[0]/" UBYTE AUTOSAR_CanIf_CompuMethods_CanIf_ControllerModeType_Enum_comp 1 100 0.0 255. FORMAT "%5.0" ECU_ADDRESS 0x40003F38 /end MEASUREMENT
/begin MEASUREMENT CanIf_ControllerState_0[1].DeviceMode "Can Interface controller State[1]/" UBYTE AUTOSAR_CanIf_CompuMethods_CanIf_ControllerModeType_Enum_comp 1 100 0.0 255. FORMAT "%5.0" ECU_ADDRESS 0x40003F40 /end MEASUREMENT
/begin MEASUREMENT CanIf_ControllerState_0[0].ChannelMode "Can Interface controller State[0]/" UBYTE AUTOSAR_CanIf_CompuMethods_CanIf_PduGetModeType_Enum_comp 1 100 0.0 255. FORMAT "%5.0" ECU_ADDRESS 0x40003F3C /end MEASUREMENT
/begin MEASUREMENT CanIf_ControllerState_0[1].ChannelMode "Can Interface controller State[1]/" UBYTE AUTOSAR_CanIf_CompuMethods_CanIf_PduGetModeType_Enum_comp 1 100 0.0 255. FORMAT "%5.0" ECU_ADDRESS 0x40003F44 /end MEASUREMENT
/begin MEASUREMENT CanIf_Init_Flag "Flag to check if CANIF is Initialized(TRUE) or Not Initialized (FALSE)" UBYTE RB_RBA_Common_CentralElements_CompuMethods_Identical 1 100 0.0 255. FORMAT "%5.0" ECU_ADDRESS 0x40002D09 /end MEASUREMENT
/begin MEASUREMENT CanSM_TimerConfig_a[0].cntTick_u16 "CanSM timer configuration[0]/" UWORD RB_RBA_Common_CentralElements_CompuMethods_Identical 1 100 0.0 65535. FORMAT "%5.0" ECU_ADDRESS 0x40003F68 /end MEASUREMENT
/begin MEASUREMENT CanSM_TimerConfig_a[1].cntTick_u16 "CanSM timer configuration[1]/" UWORD RB_RBA_Common_CentralElements_CompuMethods_Identical 1 100 0.0 65535. FORMAT "%5.0" ECU_ADDRESS 0x40003F70 /end MEASUREMENT
/begin MEASUREMENT CanSM_TimerConfig_a[0].stTimer "CanSM timer configuration[0]/" UBYTE AUTOSAR_CanSM_CompuMethods_CanSM_TimerStateType_Enum_comp 1 100 0.0 255. FORMAT "%5.0" ECU_ADDRESS 0x40003F6C /end MEASUREMENT
/begin MEASUREMENT CanSM_TimerConfig_a[1].stTimer "CanSM timer configuration[1]/" UBYTE AUTOSAR_CanSM_CompuMethods_CanSM_TimerStateType_Enum_comp 1 100 0.0 255. FORMAT "%5.0" ECU_ADDRESS 0x40003F74 /end MEASUREMENT
/begin MEASUREMENT ComM_ChannelStruct[0].ChannelState_e "ComM Channel structure[0]/" ULONG RB_RBA_Common_CentralElements_CompuMethods_Identical 1 100 0.0 4.E9 FORMAT "%5.0" ECU_ADDRESS 0x400045A0 /end MEASUREMENT
/begin MEASUREMENT ComM_ChannelStruct[1].ChannelState_e "ComM Channel structure[1]/" ULONG RB_RBA_Common_CentralElements_CompuMethods_Identical 1 100 0.0 4.E9 FORMAT "%5.0" ECU_ADDRESS 0x400045B8 /end MEASUREMENT
/begin MEASUREMENT ComM_ChannelStruct[0].ChannelMode_u8 "ComM Channel structure[0]/" UBYTE RB_RBA_Common_CentralElements_CompuMethods_Identical 1 100 0.0 255. FORMAT "%5.0" ECU_ADDRESS 0x400045AA /end MEASUREMENT
/begin MEASUREMENT ComM_ChannelStruct[1].ChannelMode_u8 "ComM Channel structure[1]/" UBYTE RB_RBA_Common_CentralElements_CompuMethods_Identical 1 100 0.0 255. FORMAT "%5.0" ECU_ADDRESS 0x400045C2 /end MEASUREMENT
/begin MEASUREMENT ComM_ChannelStruct[0].BusSmMode_u8 "ComM Channel structure[0]/" UBYTE RB_RBA_Common_CentralElements_CompuMethods_Identical 1 100 0.0 255. FORMAT "%5.0" ECU_ADDRESS 0x400045AB /end MEASUREMENT
/begin MEASUREMENT ComM_ChannelStruct[1].BusSmMode_u8 "ComM Channel structure[1]/" UBYTE RB_RBA_Common_CentralElements_CompuMethods_Identical 1 100 0.0 255. FORMAT "%5.0" ECU_ADDRESS 0x400045C3 /end MEASUREMENT
/begin MEASUREMENT ComM_ChannelStruct[0].LightTimeoutCtr_u32 "ComM Channel structure[0]/" ULONG RB_RBA_Common_CentralElements_CompuMethods_Identical 1 100 0.0 4.E9 FORMAT "%5.0" ECU_ADDRESS 0x400045A4 /end MEASUREMENT
/begin MEASUREMENT ComM_ChannelStruct[1].LightTimeoutCtr_u32 "ComM Channel structure[1]/" ULONG RB_RBA_Common_CentralElements_CompuMethods_Identical 1 100 0.0 4.E9 FORMAT "%5.0" ECU_ADDRESS 0x400045BC /end MEASUREMENT
/begin MEASUREMENT ComM_ChannelStruct[0].MinFullComTimeoutCtr_u16 "ComM Channel structure[0]/" UWORD RB_RBA_Common_CentralElements_CompuMethods_Identical 1 100 0.0 65535. FORMAT "%5.0" ECU_ADDRESS 0x400045A8 /end MEASUREMENT
/begin MEASUREMENT ComM_ChannelStruct[1].MinFullComTimeoutCtr_u16 "ComM Channel structure[1]/" UWORD RB_RBA_Common_CentralElements_CompuMethods_Identical 1 100 0.0 65535. FORMAT "%5.0" ECU_ADDRESS 0x400045C0 /end MEASUREMENT
/begin MEASUREMENT ComM_ChannelStruct[0].UserRequestCtr_u8 "ComM Channel structure[0]/" UBYTE RB_RBA_Common_CentralElements_CompuMethods_Identical 1 100 0.0 255. FORMAT "%5.0" ECU_ADDRESS 0x400045AC /end MEASUREMENT
/begin MEASUREMENT ComM_ChannelStruct[1].UserRequestCtr_u8 "ComM Channel structure[1]/" UBYTE RB_RBA_Common_CentralElements_CompuMethods_Identical 1 100 0.0 255. FORMAT "%5.0" ECU_ADDRESS 0x400045C4 /end MEASUREMENT
/begin MEASUREMENT ComM_ChannelStruct[0].PassiveRequestState_u8 "ComM Channel structure[0]/" UBYTE RB_RBA_Common_CentralElements_CompuMethods_Identical 1 100 0.0 255. FORMAT "%5.0" ECU_ADDRESS 0x400045AD /end MEASUREMENT
/begin MEASUREMENT ComM_ChannelStruct[1].PassiveRequestState_u8 "ComM Channel structure[1]/" UBYTE RB_RBA_Common_CentralElements_CompuMethods_Identical 1 100 0.0 255. FORMAT "%5.0" ECU_ADDRESS 0x400045C5 /end MEASUREMENT
/begin MEASUREMENT ComM_ChannelStruct[0].PncRequestCtr_u8 "ComM Channel structure[0]/" UBYTE RB_RBA_Common_CentralElements_CompuMethods_Identical 1 100 0.0 255. FORMAT "%5.0" ECU_ADDRESS 0x400045AE /end MEASUREMENT
/begin MEASUREMENT ComM_ChannelStruct[1].PncRequestCtr_u8 "ComM Channel structure[1]/" UBYTE RB_RBA_Common_CentralElements_CompuMethods_Identical 1 100 0.0 255. FORMAT "%5.0" ECU_ADDRESS 0x400045C6 /end MEASUREMENT
/begin MEASUREMENT ComM_ChannelStruct[0].InhibitionReqStatus_u8 "ComM Channel structure[0]/" UBYTE RB_RBA_Common_CentralElements_CompuMethods_Identical 1 100 0.0 255. FORMAT "%5.0" ECU_ADDRESS 0x400045AF /end MEASUREMENT
/begin MEASUREMENT ComM_ChannelStruct[1].InhibitionReqStatus_u8 "ComM Channel structure[1]/" UBYTE RB_RBA_Common_CentralElements_CompuMethods_Identical 1 100 0.0 255. FORMAT "%5.0" ECU_ADDRESS 0x400045C7 /end MEASUREMENT
/begin MEASUREMENT ComM_ChannelStruct[0].NmNetworkRequestStatus_b "ComM Channel structure[0]/" UBYTE RB_RBA_Common_CentralElements_CompuMethods_Identical 1 100 0.0 255. FORMAT "%5.0" ECU_ADDRESS 0x400045B0 /end MEASUREMENT
/begin MEASUREMENT ComM_ChannelStruct[1].NmNetworkRequestStatus_b "ComM Channel structure[1]/" UBYTE RB_RBA_Common_CentralElements_CompuMethods_Identical 1 100 0.0 255. FORMAT "%5.0" ECU_ADDRESS 0x400045C8 /end MEASUREMENT
/begin MEASUREMENT ComM_ChannelStruct[0].DiagnosticRequestState_b "ComM Channel structure[0]/" UBYTE RB_RBA_Common_CentralElements_CompuMethods_Identical 1 100 0.0 255. FORMAT "%5.0" ECU_ADDRESS 0x400045B1 /end MEASUREMENT
/begin MEASUREMENT ComM_ChannelStruct[1].DiagnosticRequestState_b "ComM Channel structure[1]/" UBYTE RB_RBA_Common_CentralElements_CompuMethods_Identical 1 100 0.0 255. FORMAT "%5.0" ECU_ADDRESS 0x400045C9 /end MEASUREMENT
/begin MEASUREMENT ComM_ChannelStruct[0].CommunicationAllowed_b "ComM Channel structure[0]/" UBYTE RB_RBA_Common_CentralElements_CompuMethods_Identical 1 100 0.0 255. FORMAT "%5.0" ECU_ADDRESS 0x400045B2 /end MEASUREMENT
/begin MEASUREMENT ComM_ChannelStruct[1].CommunicationAllowed_b "ComM Channel structure[1]/" UBYTE RB_RBA_Common_CentralElements_CompuMethods_Identical 1 100 0.0 255. FORMAT "%5.0" ECU_ADDRESS 0x400045CA /end MEASUREMENT
/begin MEASUREMENT ComM_ChannelStruct[0].NmBusSleepIndicationStatus_b "ComM Channel structure[0]/" UBYTE RB_RBA_Common_CentralElements_CompuMethods_Identical 1 100 0.0 255. FORMAT "%5.0" ECU_ADDRESS 0x400045B3 /end MEASUREMENT
/begin MEASUREMENT ComM_ChannelStruct[1].NmBusSleepIndicationStatus_b "ComM Channel structure[1]/" UBYTE RB_RBA_Common_CentralElements_CompuMethods_Identical 1 100 0.0 255. FORMAT "%5.0" ECU_ADDRESS 0x400045CB /end MEASUREMENT
/begin MEASUREMENT ComM_ChannelStruct[0].NmPrepareBusSleepIndicationStatus_b "ComM Channel structure[0]/" UBYTE RB_RBA_Common_CentralElements_CompuMethods_Identical 1 100 0.0 255. FORMAT "%5.0" ECU_ADDRESS 0x400045B4 /end MEASUREMENT
/begin MEASUREMENT ComM_ChannelStruct[1].NmPrepareBusSleepIndicationStatus_b "ComM Channel structure[1]/" UBYTE RB_RBA_Common_CentralElements_CompuMethods_Identical 1 100 0.0 255. FORMAT "%5.0" ECU_ADDRESS 0x400045CC /end MEASUREMENT
/begin MEASUREMENT ComM_ChannelStruct[0].NmNetworkModeStatus_b "ComM Channel structure[0]/" UBYTE RB_RBA_Common_CentralElements_CompuMethods_Identical 1 100 0.0 255. FORMAT "%5.0" ECU_ADDRESS 0x400045B5 /end MEASUREMENT
/begin MEASUREMENT ComM_ChannelStruct[1].NmNetworkModeStatus_b "ComM Channel structure[1]/" UBYTE RB_RBA_Common_CentralElements_CompuMethods_Identical 1 100 0.0 255. FORMAT "%5.0" ECU_ADDRESS 0x400045CD /end MEASUREMENT
/begin MEASUREMENT ComM_UserStruct[0].WakeUpInhibitionCtr_u16 "ComM user structure[0]/" UWORD RB_RBA_Common_CentralElements_CompuMethods_Identical 1 100 0.0 65535. FORMAT "%5.0" ECU_ADDRESS 0x400045D0 /end MEASUREMENT
/begin MEASUREMENT ComM_UserStruct[1].WakeUpInhibitionCtr_u16 "ComM user structure[1]/" UWORD RB_RBA_Common_CentralElements_CompuMethods_Identical 1 100 0.0 65535. FORMAT "%5.0" ECU_ADDRESS 0x400045DA /end MEASUREMENT
/begin MEASUREMENT ComM_UserStruct[0].LimitToNoComCtr_u16 "ComM user structure[0]/" UWORD RB_RBA_Common_CentralElements_CompuMethods_Identical 1 100 0.0 65535. FORMAT "%5.0" ECU_ADDRESS 0x400045D2 /end MEASUREMENT
/begin MEASUREMENT ComM_UserStruct[1].LimitToNoComCtr_u16 "ComM user structure[1]/" UWORD RB_RBA_Common_CentralElements_CompuMethods_Identical 1 100 0.0 65535. FORMAT "%5.0" ECU_ADDRESS 0x400045DC /end MEASUREMENT
/begin MEASUREMENT ComM_UserStruct[0].RequestedUserMode_t "ComM user structure[0]/" UBYTE RB_RBA_Common_CentralElements_CompuMethods_Identical 1 100 0.0 255. FORMAT "%5.0" ECU_ADDRESS 0x400045D4 /end MEASUREMENT
/begin MEASUREMENT ComM_UserStruct[1].RequestedUserMode_t "ComM user structure[1]/" UBYTE RB_RBA_Common_CentralElements_CompuMethods_Identical 1 100 0.0 255. FORMAT "%5.0" ECU_ADDRESS 0x400045DE /end MEASUREMENT
/begin MEASUREMENT ComM_UserStruct[0].numChannelsInFullCom_u8 "ComM user structure[0]/" UBYTE RB_RBA_Common_CentralElements_CompuMethods_Identical 1 100 0.0 255. FORMAT "%5.0" ECU_ADDRESS 0x400045D6 /end MEASUREMENT
/begin MEASUREMENT ComM_UserStruct[1].numChannelsInFullCom_u8 "ComM user structure[1]/" UBYTE RB_RBA_Common_CentralElements_CompuMethods_Identical 1 100 0.0 255. FORMAT "%5.0" ECU_ADDRESS 0x400045E0 /end MEASUREMENT
/begin MEASUREMENT ComM_UserStruct[0].numChannelsInSilentCom_u8 "ComM user structure[0]/" UBYTE RB_RBA_Common_CentralElements_CompuMethods_Identical 1 100 0.0 255. FORMAT "%5.0" ECU_ADDRESS 0x400045D7 /end MEASUREMENT
/begin MEASUREMENT ComM_UserStruct[1].numChannelsInSilentCom_u8 "ComM user structure[1]/" UBYTE RB_RBA_Common_CentralElements_CompuMethods_Identical 1 100 0.0 255. FORMAT "%5.0" ECU_ADDRESS 0x400045E1 /end MEASUREMENT
/begin MEASUREMENT ComM_UserStruct[0].numChannelsInNoCom_u8 "ComM user structure[0]/" UBYTE RB_RBA_Common_CentralElements_CompuMethods_Identical 1 100 0.0 255. FORMAT "%5.0" ECU_ADDRESS 0x400045D8 /end MEASUREMENT
/begin MEASUREMENT ComM_UserStruct[1].numChannelsInNoCom_u8 "ComM user structure[1]/" UBYTE RB_RBA_Common_CentralElements_CompuMethods_Identical 1 100 0.0 255. FORMAT "%5.0" ECU_ADDRESS 0x400045E2 /end MEASUREMENT
/begin MEASUREMENT ComM_UserStruct[0].IndicatedUserMode_t "ComM user structure[0]/" UBYTE RB_RBA_Common_CentralElements_CompuMethods_Identical 1 100 0.0 255. FORMAT "%5.0" ECU_ADDRESS 0x400045D5 /end MEASUREMENT
/begin MEASUREMENT ComM_UserStruct[1].IndicatedUserMode_t "ComM user structure[1]/" UBYTE RB_RBA_Common_CentralElements_CompuMethods_Identical 1 100 0.0 255. FORMAT "%5.0" ECU_ADDRESS 0x400045DF /end MEASUREMENT
/begin MEASUREMENT rba_MRly_Ctrl_State_MP "Current control state of Main Relay" UBYTE RB_RBA_rba_MRly_BswModuleDescriptions_rba_MRly_Ctrl_States_CompuMethod 1 100 0.0 1.000 FORMAT "%8.3" ECU_ADDRESS 0x40009EA8
 /begin ANNOTATION ANNOTATION_LABEL "Description (coming from AUTOSAR DESC field)" /begin ANNOTATION_TEXT "Current control state of Main Relay\r\n" /end ANNOTATION_TEXT /end ANNOTATION
/end MEASUREMENT
/begin MEASUREMENT rba_MultiStackTrace_CurrentCycleMaxUsage_User0 "Current Cycle Max Usage stack User0" UWORD RB_RBA_rba_OsShell_CompuMethods_rba_OsShell_ResourceConversion 1 100 0.0 65535. FORMAT "%5.0" ECU_ADDRESS 0x400061A4 /end MEASUREMENT
/begin MEASUREMENT rba_MultiStackTrace_LifeTimeMaxUsage_User0 "Life Time Max Usage stack User0" UWORD RB_RBA_rba_OsShell_CompuMethods_rba_OsShell_ResourceConversion 1 100 0.0 65535. FORMAT "%5.0" ECU_ADDRESS 0x4000B446 /end MEASUREMENT
/begin MEASUREMENT rba_OsShell_Cntr1000msTask "OS task counter for the OS_1000ms_Task" UWORD RB_RBA_Common_CentralElements_CompuMethods_Identical 1 100 0.0 65535. FORMAT "%5.0" ECU_ADDRESS 0x4000618E /end MEASUREMENT
/begin MEASUREMENT rba_OsShell_Cntr100msTask "OS task counter for the OS_100ms_Task" UWORD RB_RBA_Common_CentralElements_CompuMethods_Identical 1 100 0.0 65535. FORMAT "%5.0" ECU_ADDRESS 0x40006184 /end MEASUREMENT
/begin MEASUREMENT rba_OsShell_Cntr10msTask "OS task counter for the OS_10ms_Task" UWORD RB_RBA_Common_CentralElements_CompuMethods_Identical 1 100 0.0 65535. FORMAT "%5.0" ECU_ADDRESS 0x4000617A /end MEASUREMENT
/begin MEASUREMENT rba_OsShell_Cntr1msTask "OS task counter for the OS_1ms_Task" UWORD RB_RBA_Common_CentralElements_CompuMethods_Identical 1 100 0.0 65535. FORMAT "%5.0" ECU_ADDRESS 0x40006154 /end MEASUREMENT
/begin MEASUREMENT rba_OsShell_Cntr200msTask "OS task counter for the OS_200ms_Task" UWORD RB_RBA_Common_CentralElements_CompuMethods_Identical 1 100 0.0 65535. FORMAT "%5.0" ECU_ADDRESS 0x40006186 /end MEASUREMENT
/begin MEASUREMENT rba_OsShell_Cntr20msTask "OS task counter for the OS_20ms_Task" UWORD RB_RBA_Common_CentralElements_CompuMethods_Identical 1 100 0.0 65535. FORMAT "%5.0" ECU_ADDRESS 0x4000617E /end MEASUREMENT
/begin MEASUREMENT rba_OsShell_Cntr2msTask "OS task counter for the OS_2ms_Task" UWORD RB_RBA_Common_CentralElements_CompuMethods_Identical 1 100 0.0 65535. FORMAT "%5.0" ECU_ADDRESS 0x40006172 /end MEASUREMENT
/begin MEASUREMENT rba_OsShell_Cntr50msTask "OS task counter for the OS_50ms_Task" UWORD RB_RBA_Common_CentralElements_CompuMethods_Identical 1 100 0.0 65535. FORMAT "%5.0" ECU_ADDRESS 0x40006180 /end MEASUREMENT
/begin MEASUREMENT rba_OsShell_Cntr5msTask "OS task counter for the OS_5ms_Task" UWORD RB_RBA_Common_CentralElements_CompuMethods_Identical 1 100 0.0 65535. FORMAT "%5.0" ECU_ADDRESS 0x40006174 /end MEASUREMENT
/begin MEASUREMENT rba_OsShell_CntrBswAppDsmTask "OS task counter for the OS_BswApp_Dsm_Task" UWORD RB_RBA_Common_CentralElements_CompuMethods_Identical 1 100 0.0 65535. FORMAT "%5.0" ECU_ADDRESS 0x400061A0 /end MEASUREMENT
/begin MEASUREMENT rba_OsShell_CntrBswBgTask "OS task counter for the OS_BswBg_Task" UWORD RB_RBA_Common_CentralElements_CompuMethods_Identical 1 100 0.0 65535. FORMAT "%5.0" ECU_ADDRESS 0x4000619E /end MEASUREMENT
/begin MEASUREMENT rba_OsShell_CntrCalWup100msTask "OS task counter for the OS_CalWup_100ms_Task" UWORD RB_RBA_Common_CentralElements_CompuMethods_Identical 1 100 0.0 65535. FORMAT "%5.0" ECU_ADDRESS 0x40006182 /end MEASUREMENT
/begin MEASUREMENT rba_OsShell_CntrCalWup10msTask "OS task counter for the OS_CalWup_10ms_Task" UWORD RB_RBA_Common_CentralElements_CompuMethods_Identical 1 100 0.0 65535. FORMAT "%5.0" ECU_ADDRESS 0x40006178 /end MEASUREMENT
/begin MEASUREMENT rba_OsShell_CntrCalWup20msTask "OS task counter for the OS_CalWup_20ms_Task" UWORD RB_RBA_Common_CentralElements_CompuMethods_Identical 1 100 0.0 65535. FORMAT "%5.0" ECU_ADDRESS 0x4000617C /end MEASUREMENT
/begin MEASUREMENT rba_OsShell_CntrCalWup2msTask "OS task counter for the OS_CalWup_2ms_Task" UWORD RB_RBA_Common_CentralElements_CompuMethods_Identical 1 100 0.0 65535. FORMAT "%5.0" ECU_ADDRESS 0x40006170 /end MEASUREMENT
/begin MEASUREMENT rba_OsShell_CntrCalWupBgTask "OS task counter for the OS_CalWup_Bg_Task" UWORD RB_RBA_Common_CentralElements_CompuMethods_Identical 1 100 0.0 65535. FORMAT "%5.0" ECU_ADDRESS 0x4000619C /end MEASUREMENT
/begin MEASUREMENT rba_OsShell_CntrCalWupIniEndTask "OS task counter for the OS_CalWup_IniEnd_Task" UWORD RB_RBA_Common_CentralElements_CompuMethods_Identical 1 100 0.0 65535. FORMAT "%5.0" ECU_ADDRESS 0x4000619A /end MEASUREMENT
/begin MEASUREMENT rba_OsShell_CntrCalWupIniTask "OS task counter for the OS_CalWup_Ini_Task" UWORD RB_RBA_Common_CentralElements_CompuMethods_Identical 1 100 0.0 65535. FORMAT "%5.0" ECU_ADDRESS 0x40006198 /end MEASUREMENT
/begin MEASUREMENT rba_OsShell_CntrDSMClearTask "OS task counter for the OS_DSM_Clear_Task" UWORD RB_RBA_Common_CentralElements_CompuMethods_Identical 1 100 0.0 65535. FORMAT "%5.0" ECU_ADDRESS 0x4000618C /end MEASUREMENT
/begin MEASUREMENT rba_OsShell_CntrEngReStrtModeMTask "OS task counter for the OS_EngReStrtModeM_Task" UWORD RB_RBA_Common_CentralElements_CompuMethods_Identical 1 100 0.0 65535. FORMAT "%5.0" ECU_ADDRESS 0x40006196 /end MEASUREMENT
/begin MEASUREMENT rba_OsShell_CntrEngReStrtTask "OS task counter for the OS_EngReStrt_Task" UWORD RB_RBA_Common_CentralElements_CompuMethods_Identical 1 100 0.0 65535. FORMAT "%5.0" ECU_ADDRESS 0x4000616E /end MEASUREMENT
/begin MEASUREMENT rba_OsShell_CntrEpmNoSyncTask "OS task counter for the OS_EpmNoSync_Task" UWORD RB_RBA_Common_CentralElements_CompuMethods_Identical 1 100 0.0 65535. FORMAT "%5.0" ECU_ADDRESS 0x4000616C /end MEASUREMENT
/begin MEASUREMENT rba_OsShell_CntrInfraBswApp10msTask "OS task counter for the OS_InfraBswApp_10ms_Task" UWORD RB_RBA_Common_CentralElements_CompuMethods_Identical 1 100 0.0 65535. FORMAT "%5.0" ECU_ADDRESS 0x40006176 /end MEASUREMENT
/begin MEASUREMENT rba_OsShell_CntrIniDrvTask "OS task counter for the OS_IniDrv_Task" UWORD RB_RBA_Common_CentralElements_CompuMethods_Identical 1 100 0.0 65535. FORMAT "%5.0" ECU_ADDRESS 0x4000618A /end MEASUREMENT
/begin MEASUREMENT rba_OsShell_CntrIniEndTask "OS task counter for the OS_IniEnd_Task" UWORD RB_RBA_Common_CentralElements_CompuMethods_Identical 1 100 0.0 65535. FORMAT "%5.0" ECU_ADDRESS 0x40006194 /end MEASUREMENT
/begin MEASUREMENT rba_OsShell_CntrIniTask "OS task counter for the OS_Ini_Task" UWORD RB_RBA_Common_CentralElements_CompuMethods_Identical 1 100 0.0 65535. FORMAT "%5.0" ECU_ADDRESS 0x40006192 /end MEASUREMENT
/begin MEASUREMENT rba_OsShell_CntrMoSyncFirstTask "OS task counter for the OS_Mo_SyncFirst_Task" UWORD RB_RBA_Common_CentralElements_CompuMethods_Identical 1 100 0.0 65535. FORMAT "%5.0" ECU_ADDRESS 0x4000616A /end MEASUREMENT
/begin MEASUREMENT rba_OsShell_CntrMoSyncIniTask "OS task counter for the OS_Mo_SyncIni_Task" UWORD RB_RBA_Common_CentralElements_CompuMethods_Identical 1 100 0.0 65535. FORMAT "%5.0" ECU_ADDRESS 0x40006168 /end MEASUREMENT
/begin MEASUREMENT rba_OsShell_CntrMoSyncS0Task "OS task counter for the OS_Mo_SyncS0_Task" UWORD RB_RBA_Common_CentralElements_CompuMethods_Identical 1 100 0.0 65535. FORMAT "%5.0" ECU_ADDRESS 0x40006166 /end MEASUREMENT
/begin MEASUREMENT rba_OsShell_CntrMoTask "OS task counter for the OS_Mo_Task" UWORD RB_RBA_Common_CentralElements_CompuMethods_Identical 1 100 0.0 65535. FORMAT "%5.0" ECU_ADDRESS 0x40006156 /end MEASUREMENT
/begin MEASUREMENT rba_OsShell_CntrReIniModeMTask "OS task counter for the OS_ReIniModeM_Task" UWORD RB_RBA_Common_CentralElements_CompuMethods_Identical 1 100 0.0 65535. FORMAT "%5.0" ECU_ADDRESS 0x40006190 /end MEASUREMENT
/begin MEASUREMENT rba_OsShell_CntrReIniTask "OS task counter for the OS_ReIni_Task" UWORD RB_RBA_Common_CentralElements_CompuMethods_Identical 1 100 0.0 65535. FORMAT "%5.0" ECU_ADDRESS 0x40006188 /end MEASUREMENT
/begin MEASUREMENT rba_OsShell_CntrShutdown10msTask "OS task counter for the OS_Shutdown_10ms_Task" UWORD RB_RBA_Common_CentralElements_CompuMethods_Identical 1 100 0.0 65535. FORMAT "%5.0" ECU_ADDRESS 0x4000614E /end MEASUREMENT
/begin MEASUREMENT rba_OsShell_CntrShutdownBswTask "OS task counter for the OS_Shutdown_Bsw_Task" UWORD RB_RBA_Common_CentralElements_CompuMethods_Identical 1 100 0.0 65535. FORMAT "%5.0" ECU_ADDRESS 0x40006152 /end MEASUREMENT
/begin MEASUREMENT rba_OsShell_CntrShutdownSeqTask "OS task counter for the OS_Shutdown_Seq_Task" UWORD RB_RBA_Common_CentralElements_CompuMethods_Identical 1 100 0.0 65535. FORMAT "%5.0" ECU_ADDRESS 0x40006150 /end MEASUREMENT
/begin MEASUREMENT rba_OsShell_CntrSyncFirstTask "OS task counter for the OS_SyncFirst_Task" UWORD RB_RBA_Common_CentralElements_CompuMethods_Identical 1 100 0.0 65535. FORMAT "%5.0" ECU_ADDRESS 0x40006164 /end MEASUREMENT
/begin MEASUREMENT rba_OsShell_CntrSyncIniTask "OS task counter for the OS_SyncIni_Task" UWORD RB_RBA_Common_CentralElements_CompuMethods_Identical 1 100 0.0 65535. FORMAT "%5.0" ECU_ADDRESS 0x40006162 /end MEASUREMENT
/begin MEASUREMENT rba_OsShell_CntrSyncPreTask "OS task counter for the OS_SyncPre_Task" UWORD RB_RBA_Common_CentralElements_CompuMethods_Identical 1 100 0.0 65535. FORMAT "%5.0" ECU_ADDRESS 0x40006160 /end MEASUREMENT
/begin MEASUREMENT rba_OsShell_CntrSyncS0Task "OS task counter for the OS_SyncS0_Task" UWORD RB_RBA_Common_CentralElements_CompuMethods_Identical 1 100 0.0 65535. FORMAT "%5.0" ECU_ADDRESS 0x4000615E /end MEASUREMENT
/begin MEASUREMENT rba_OsShell_CntrSyncS1Task "OS task counter for the OS_SyncS1_Task" UWORD RB_RBA_Common_CentralElements_CompuMethods_Identical 1 100 0.0 65535. FORMAT "%5.0" ECU_ADDRESS 0x4000615C /end MEASUREMENT
/begin MEASUREMENT rba_OsShell_CntrSyncVirtualFirstTask "OS task counter for the OS_SyncVirtualFirst_Task" UWORD RB_RBA_Common_CentralElements_CompuMethods_Identical 1 100 0.0 65535. FORMAT "%5.0" ECU_ADDRESS 0x4000615A /end MEASUREMENT
/begin MEASUREMENT rba_OsShell_CntrSyncVirtualTask "OS task counter for the OS_SyncVirtual_Task" UWORD RB_RBA_Common_CentralElements_CompuMethods_Identical 1 100 0.0 65535. FORMAT "%5.0" ECU_ADDRESS 0x40006158 /end MEASUREMENT
/begin MEASUREMENT rba_OsShell_TaskRespTime_OS_1000ms_Task.current "Task response time monitoring for OS_1000ms_Task/" ULONG RB_RBA_rba_OsShell_CompuMethods_rba_OsShell_TaskRespTime_CompMethod 1 100 0.0 4.E9 FORMAT "%5.0" ECU_ADDRESS 0x40007380 /end MEASUREMENT
/begin MEASUREMENT rba_OsShell_TaskRespTime_OS_1000ms_Task.max "Task response time monitoring for OS_1000ms_Task/" ULONG RB_RBA_rba_OsShell_CompuMethods_rba_OsShell_TaskRespTime_CompMethod 1 100 0.0 4.E9 FORMAT "%5.0" ECU_ADDRESS 0x40007384 /end MEASUREMENT
/begin MEASUREMENT rba_OsShell_TaskRespTime_OS_1000ms_Task.lifetimeMax "Task response time monitoring for OS_1000ms_Task/" ULONG RB_RBA_rba_OsShell_CompuMethods_rba_OsShell_TaskRespTime_CompMethod 1 100 0.0 4.E9 FORMAT "%5.0" ECU_ADDRESS 0x40007388 /end MEASUREMENT
/begin MEASUREMENT rba_OsShell_TaskRespTime_OS_100ms_Task.current "Task response time monitoring for OS_100ms_Task/" ULONG RB_RBA_rba_OsShell_CompuMethods_rba_OsShell_TaskRespTime_CompMethod 1 100 0.0 4.E9 FORMAT "%5.0" ECU_ADDRESS 0x40007374 /end MEASUREMENT
/begin MEASUREMENT rba_OsShell_TaskRespTime_OS_100ms_Task.max "Task response time monitoring for OS_100ms_Task/" ULONG RB_RBA_rba_OsShell_CompuMethods_rba_OsShell_TaskRespTime_CompMethod 1 100 0.0 4.E9 FORMAT "%5.0" ECU_ADDRESS 0x40007378 /end MEASUREMENT
/begin MEASUREMENT rba_OsShell_TaskRespTime_OS_100ms_Task.lifetimeMax "Task response time monitoring for OS_100ms_Task/" ULONG RB_RBA_rba_OsShell_CompuMethods_rba_OsShell_TaskRespTime_CompMethod 1 100 0.0 4.E9 FORMAT "%5.0" ECU_ADDRESS 0x4000737C /end MEASUREMENT
/begin MEASUREMENT rba_OsShell_TaskRespTime_OS_10ms_Task.current "Task response time monitoring for OS_10ms_Task/" ULONG RB_RBA_rba_OsShell_CompuMethods_rba_OsShell_TaskRespTime_CompMethod 1 100 0.0 4.E9 FORMAT "%5.0" ECU_ADDRESS 0x40007368 /end MEASUREMENT
/begin MEASUREMENT rba_OsShell_TaskRespTime_OS_10ms_Task.max "Task response time monitoring for OS_10ms_Task/" ULONG RB_RBA_rba_OsShell_CompuMethods_rba_OsShell_TaskRespTime_CompMethod 1 100 0.0 4.E9 FORMAT "%5.0" ECU_ADDRESS 0x4000736C /end MEASUREMENT
/begin MEASUREMENT rba_OsShell_TaskRespTime_OS_10ms_Task.lifetimeMax "Task response time monitoring for OS_10ms_Task/" ULONG RB_RBA_rba_OsShell_CompuMethods_rba_OsShell_TaskRespTime_CompMethod 1 100 0.0 4.E9 FORMAT "%5.0" ECU_ADDRESS 0x40007370 /end MEASUREMENT
/begin MEASUREMENT rba_OsShell_TaskRespTime_OS_1ms_Task.current "Task response time monitoring for OS_1ms_Task/" ULONG RB_RBA_rba_OsShell_CompuMethods_rba_OsShell_TaskRespTime_CompMethod 1 100 0.0 4.E9 FORMAT "%5.0" ECU_ADDRESS 0x4000735C /end MEASUREMENT
/begin MEASUREMENT rba_OsShell_TaskRespTime_OS_1ms_Task.max "Task response time monitoring for OS_1ms_Task/" ULONG RB_RBA_rba_OsShell_CompuMethods_rba_OsShell_TaskRespTime_CompMethod 1 100 0.0 4.E9 FORMAT "%5.0" ECU_ADDRESS 0x40007360 /end MEASUREMENT
/begin MEASUREMENT rba_OsShell_TaskRespTime_OS_1ms_Task.lifetimeMax "Task response time monitoring for OS_1ms_Task/" ULONG RB_RBA_rba_OsShell_CompuMethods_rba_OsShell_TaskRespTime_CompMethod 1 100 0.0 4.E9 FORMAT "%5.0" ECU_ADDRESS 0x40007364 /end MEASUREMENT
/begin MEASUREMENT rba_OsShell_TaskRespTime_OS_200ms_Task.current "Task response time monitoring for OS_200ms_Task/" ULONG RB_RBA_rba_OsShell_CompuMethods_rba_OsShell_TaskRespTime_CompMethod 1 100 0.0 4.E9 FORMAT "%5.0" ECU_ADDRESS 0x40007350 /end MEASUREMENT
/begin MEASUREMENT rba_OsShell_TaskRespTime_OS_200ms_Task.max "Task response time monitoring for OS_200ms_Task/" ULONG RB_RBA_rba_OsShell_CompuMethods_rba_OsShell_TaskRespTime_CompMethod 1 100 0.0 4.E9 FORMAT "%5.0" ECU_ADDRESS 0x40007354 /end MEASUREMENT
/begin MEASUREMENT rba_OsShell_TaskRespTime_OS_200ms_Task.lifetimeMax "Task response time monitoring for OS_200ms_Task/" ULONG RB_RBA_rba_OsShell_CompuMethods_rba_OsShell_TaskRespTime_CompMethod 1 100 0.0 4.E9 FORMAT "%5.0" ECU_ADDRESS 0x40007358 /end MEASUREMENT
/begin MEASUREMENT rba_OsShell_TaskRespTime_OS_20ms_Task.current "Task response time monitoring for OS_20ms_Task/" ULONG RB_RBA_rba_OsShell_CompuMethods_rba_OsShell_TaskRespTime_CompMethod 1 100 0.0 4.E9 FORMAT "%5.0" ECU_ADDRESS 0x40007344 /end MEASUREMENT
/begin MEASUREMENT rba_OsShell_TaskRespTime_OS_20ms_Task.max "Task response time monitoring for OS_20ms_Task/" ULONG RB_RBA_rba_OsShell_CompuMethods_rba_OsShell_TaskRespTime_CompMethod 1 100 0.0 4.E9 FORMAT "%5.0" ECU_ADDRESS 0x40007348 /end MEASUREMENT
/begin MEASUREMENT rba_OsShell_TaskRespTime_OS_20ms_Task.lifetimeMax "Task response time monitoring for OS_20ms_Task/" ULONG RB_RBA_rba_OsShell_CompuMethods_rba_OsShell_TaskRespTime_CompMethod 1 100 0.0 4.E9 FORMAT "%5.0" ECU_ADDRESS 0x4000734C /end MEASUREMENT
/begin MEASUREMENT rba_OsShell_TaskRespTime_OS_2ms_Task.current "Task response time monitoring for OS_2ms_Task/" ULONG RB_RBA_rba_OsShell_CompuMethods_rba_OsShell_TaskRespTime_CompMethod 1 100 0.0 4.E9 FORMAT "%5.0" ECU_ADDRESS 0x40007338 /end MEASUREMENT
/begin MEASUREMENT rba_OsShell_TaskRespTime_OS_2ms_Task.max "Task response time monitoring for OS_2ms_Task/" ULONG RB_RBA_rba_OsShell_CompuMethods_rba_OsShell_TaskRespTime_CompMethod 1 100 0.0 4.E9 FORMAT "%5.0" ECU_ADDRESS 0x4000733C /end MEASUREMENT
/begin MEASUREMENT rba_OsShell_TaskRespTime_OS_2ms_Task.lifetimeMax "Task response time monitoring for OS_2ms_Task/" ULONG RB_RBA_rba_OsShell_CompuMethods_rba_OsShell_TaskRespTime_CompMethod 1 100 0.0 4.E9 FORMAT "%5.0" ECU_ADDRESS 0x40007340 /end MEASUREMENT
/begin MEASUREMENT rba_OsShell_TaskRespTime_OS_50ms_Task.current "Task response time monitoring for OS_50ms_Task/" ULONG RB_RBA_rba_OsShell_CompuMethods_rba_OsShell_TaskRespTime_CompMethod 1 100 0.0 4.E9 FORMAT "%5.0" ECU_ADDRESS 0x4000732C /end MEASUREMENT
/begin MEASUREMENT rba_OsShell_TaskRespTime_OS_50ms_Task.max "Task response time monitoring for OS_50ms_Task/" ULONG RB_RBA_rba_OsShell_CompuMethods_rba_OsShell_TaskRespTime_CompMethod 1 100 0.0 4.E9 FORMAT "%5.0" ECU_ADDRESS 0x40007330 /end MEASUREMENT
/begin MEASUREMENT rba_OsShell_TaskRespTime_OS_50ms_Task.lifetimeMax "Task response time monitoring for OS_50ms_Task/" ULONG RB_RBA_rba_OsShell_CompuMethods_rba_OsShell_TaskRespTime_CompMethod 1 100 0.0 4.E9 FORMAT "%5.0" ECU_ADDRESS 0x40007334 /end MEASUREMENT
/begin MEASUREMENT rba_OsShell_TaskRespTime_OS_5ms_Task.current "Task response time monitoring for OS_5ms_Task/" ULONG RB_RBA_rba_OsShell_CompuMethods_rba_OsShell_TaskRespTime_CompMethod 1 100 0.0 4.E9 FORMAT "%5.0" ECU_ADDRESS 0x40007320 /end MEASUREMENT
/begin MEASUREMENT rba_OsShell_TaskRespTime_OS_5ms_Task.max "Task response time monitoring for OS_5ms_Task/" ULONG RB_RBA_rba_OsShell_CompuMethods_rba_OsShell_TaskRespTime_CompMethod 1 100 0.0 4.E9 FORMAT "%5.0" ECU_ADDRESS 0x40007324 /end MEASUREMENT
/begin MEASUREMENT rba_OsShell_TaskRespTime_OS_5ms_Task.lifetimeMax "Task response time monitoring for OS_5ms_Task/" ULONG RB_RBA_rba_OsShell_CompuMethods_rba_OsShell_TaskRespTime_CompMethod 1 100 0.0 4.E9 FORMAT "%5.0" ECU_ADDRESS 0x40007328 /end MEASUREMENT
/begin MEASUREMENT rba_OsShell_TaskRespTime_OS_InfraBswApp_10ms_Task.current "Task response time monitoring for OS_InfraBswApp_10ms_Task/" ULONG RB_RBA_rba_OsShell_CompuMethods_rba_OsShell_TaskRespTime_CompMethod 1 100 0.0 4.E9 FORMAT "%5.0" ECU_ADDRESS 0x40007314 /end MEASUREMENT
/begin MEASUREMENT rba_OsShell_TaskRespTime_OS_InfraBswApp_10ms_Task.max "Task response time monitoring for OS_InfraBswApp_10ms_Task/" ULONG RB_RBA_rba_OsShell_CompuMethods_rba_OsShell_TaskRespTime_CompMethod 1 100 0.0 4.E9 FORMAT "%5.0" ECU_ADDRESS 0x40007318 /end MEASUREMENT
/begin MEASUREMENT rba_OsShell_TaskRespTime_OS_InfraBswApp_10ms_Task.lifetimeMax "Task response time monitoring for OS_InfraBswApp_10ms_Task/" ULONG RB_RBA_rba_OsShell_CompuMethods_rba_OsShell_TaskRespTime_CompMethod 1 100 0.0 4.E9 FORMAT "%5.0" ECU_ADDRESS 0x4000731C /end MEASUREMENT
/begin MEASUREMENT rba_OsShell_cntrErrAccess "OS E_OS_ACCESS error counter" UBYTE RB_RBA_Common_CentralElements_CompuMethods_Identical 1 100 0.0 255. FORMAT "%5.0" ECU_ADDRESS 0x400065C2 /end MEASUREMENT
/begin MEASUREMENT rba_OsShell_cntrErrCallevel "OS E_OS_CALLEVEL error counter" UBYTE RB_RBA_Common_CentralElements_CompuMethods_Identical 1 100 0.0 255. FORMAT "%5.0" ECU_ADDRESS 0x400065C1 /end MEASUREMENT
/begin MEASUREMENT rba_OsShell_cntrErrId "OS E_OS_ID error counter" UBYTE RB_RBA_Common_CentralElements_CompuMethods_Identical 1 100 0.0 255. FORMAT "%5.0" ECU_ADDRESS 0x400065C0 /end MEASUREMENT
/begin MEASUREMENT rba_OsShell_cntrErrLimitSum "OS E_OS_LIMIT error counter" UBYTE RB_RBA_Common_CentralElements_CompuMethods_Identical 1 100 0.0 255. FORMAT "%5.0" ECU_ADDRESS 0x400065BF /end MEASUREMENT
/begin MEASUREMENT rba_OsShell_cntrErrNoFunc "OS E_OS_NOFUNC error counter" UBYTE RB_RBA_Common_CentralElements_CompuMethods_Identical 1 100 0.0 255. FORMAT "%5.0" ECU_ADDRESS 0x400065BE /end MEASUREMENT
/begin MEASUREMENT rba_OsShell_cntrErrResource "OS E_OS_RESOURCE error counter" UBYTE RB_RBA_Common_CentralElements_CompuMethods_Identical 1 100 0.0 255. FORMAT "%5.0" ECU_ADDRESS 0x400065BD /end MEASUREMENT
/begin MEASUREMENT rba_OsShell_cntrErrState "OS E_OS_STATE error counter" UBYTE RB_RBA_Common_CentralElements_CompuMethods_Identical 1 100 0.0 255. FORMAT "%5.0" ECU_ADDRESS 0x400065BC /end MEASUREMENT
/begin MEASUREMENT rba_OsShell_cntrErrSum "OS overall error counter" UBYTE RB_RBA_Common_CentralElements_CompuMethods_Identical 1 100 0.0 255. FORMAT "%5.0" ECU_ADDRESS 0x400065A7 /end MEASUREMENT
/begin MEASUREMENT rba_OsShell_cntrErrValue "OS E_OS_VALUE error counter" UBYTE RB_RBA_Common_CentralElements_CompuMethods_Identical 1 100 0.0 255. FORMAT "%5.0" ECU_ADDRESS 0x400065BB /end MEASUREMENT
/begin MEASUREMENT rba_OsShell_tiPowerOnFrst10ms "Time from last Power on Reset to first 10ms-Raster" UWORD RB_RBA_Common_CentralElements_CompuMethods_Identical 1 100 0.0 65535. FORMAT "%5.0" ECU_ADDRESS 0x400061AC /end MEASUREMENT
/begin MEASUREMENT rba_OsShell_tiResetFrst10ms "Time from last Reset to first 10ms-Raster" UWORD RB_RBA_Common_CentralElements_CompuMethods_Identical 1 100 0.0 65535. FORMAT "%5.0" ECU_ADDRESS 0x400061AE /end MEASUREMENT
/begin MEASUREMENT rba_Runtime_CurrentCycleMax_Core0 "Current Cycle Max Runtime of Core0" UWORD RB_RBA_rba_OsShell_CompuMethods_rba_OsShell_ResourceConversion 1 100 0.0 65535. FORMAT "%5.0" ECU_ADDRESS 0x400061A2 /end MEASUREMENT
/begin MEASUREMENT rba_Runtime_LifeTimeMax_Core0 "Life Cycle Max Runtime of Core0" UWORD RB_RBA_rba_OsShell_CompuMethods_rba_OsShell_ResourceConversion 1 100 0.0 65535. FORMAT "%5.0" ECU_ADDRESS 0x4000B444 /end MEASUREMENT
/begin MEASUREMENT rba_Reset_ApplEnv_st.Loc_u32 "reset application environment/" ULONG RB_RBA_Common_CentralElements_CompuMethods_Identical 1 100 0.0 4.E9 FORMAT "%5.0" ECU_ADDRESS 0x40004728 /end MEASUREMENT
/begin MEASUREMENT rba_Reset_ApplEnv_st.UserValue_u32 "reset application environment/" ULONG RB_RBA_Common_CentralElements_CompuMethods_Identical 1 100 0.0 4.E9 FORMAT "%5.0" ECU_ADDRESS 0x4000472C /end MEASUREMENT
/begin MEASUREMENT rba_Reset_ApplEnv_st.Id_en "reset application environment/" ULONG RB_RBA_rba_Reset_CompuMethods_rba_Reset_Id_ten 1 100 0.0 4.E9 FORMAT "%5.0" ECU_ADDRESS 0x40004730 /end MEASUREMENT
/begin MEASUREMENT rba_Reset_ApplEnv_st.Grp_en "reset application environment/" ULONG RB_RBA_Common_CentralElements_CompuMethods_Identical 1 100 0.0 4.E9 FORMAT "%5.0" ECU_ADDRESS 0x40004734 /end MEASUREMENT
/begin MEASUREMENT rba_Reset_ApplEnv_st.CntrRst_u8 "reset application environment/" UBYTE RB_RBA_Common_CentralElements_CompuMethods_Identical 1 100 0.0 255. FORMAT "%5.0" ECU_ADDRESS 0x40004738 /end MEASUREMENT
/begin MEASUREMENT rba_Reset_ExtHistBuf_ast[0].ResetId_en "extended Reset history buffer[0]/" ULONG RB_RBA_rba_Reset_CompuMethods_rba_Reset_Id_ten 1 100 0.0 4.E9 FORMAT "%5.0" ECU_ADDRESS 0x4000F8D4 /end MEASUREMENT
/begin MEASUREMENT rba_Reset_ExtHistBuf_ast[1].ResetId_en "extended Reset history buffer[1]/" ULONG RB_RBA_rba_Reset_CompuMethods_rba_Reset_Id_ten 1 100 0.0 4.E9 FORMAT "%5.0" ECU_ADDRESS 0x4000F8E0 /end MEASUREMENT
/begin MEASUREMENT rba_Reset_ExtHistBuf_ast[2].ResetId_en "extended Reset history buffer[2]/" ULONG RB_RBA_rba_Reset_CompuMethods_rba_Reset_Id_ten 1 100 0.0 4.E9 FORMAT "%5.0" ECU_ADDRESS 0x4000F8EC /end MEASUREMENT
/begin MEASUREMENT rba_Reset_ExtHistBuf_ast[3].ResetId_en "extended Reset history buffer[3]/" ULONG RB_RBA_rba_Reset_CompuMethods_rba_Reset_Id_ten 1 100 0.0 4.E9 FORMAT "%5.0" ECU_ADDRESS 0x4000F8F8 /end MEASUREMENT
/begin MEASUREMENT rba_Reset_ExtHistBuf_ast[4].ResetId_en "extended Reset history buffer[4]/" ULONG RB_RBA_rba_Reset_CompuMethods_rba_Reset_Id_ten 1 100 0.0 4.E9 FORMAT "%5.0" ECU_ADDRESS 0x4000F904 /end MEASUREMENT
/begin MEASUREMENT rba_Reset_ExtHistBuf_ast[5].ResetId_en "extended Reset history buffer[5]/" ULONG RB_RBA_rba_Reset_CompuMethods_rba_Reset_Id_ten 1 100 0.0 4.E9 FORMAT "%5.0" ECU_ADDRESS 0x4000F910 /end MEASUREMENT
/begin MEASUREMENT rba_Reset_ExtHistBuf_ast[6].ResetId_en "extended Reset history buffer[6]/" ULONG RB_RBA_rba_Reset_CompuMethods_rba_Reset_Id_ten 1 100 0.0 4.E9 FORMAT "%5.0" ECU_ADDRESS 0x4000F91C /end MEASUREMENT
/begin MEASUREMENT rba_Reset_ExtHistBuf_ast[7].ResetId_en "extended Reset history buffer[7]/" ULONG RB_RBA_rba_Reset_CompuMethods_rba_Reset_Id_ten 1 100 0.0 4.E9 FORMAT "%5.0" ECU_ADDRESS 0x4000F928 /end MEASUREMENT
/begin MEASUREMENT rba_Reset_ExtHistBuf_ast[8].ResetId_en "extended Reset history buffer[8]/" ULONG RB_RBA_rba_Reset_CompuMethods_rba_Reset_Id_ten 1 100 0.0 4.E9 FORMAT "%5.0" ECU_ADDRESS 0x4000F934 /end MEASUREMENT
/begin MEASUREMENT rba_Reset_ExtHistBuf_ast[9].ResetId_en "extended Reset history buffer[9]/" ULONG RB_RBA_rba_Reset_CompuMethods_rba_Reset_Id_ten 1 100 0.0 4.E9 FORMAT "%5.0" ECU_ADDRESS 0x4000F940 /end MEASUREMENT
/begin MEASUREMENT rba_Reset_ExtHistBuf_ast[0].Cntr_u16 "extended Reset history buffer[0]/" UWORD RB_RBA_Common_CentralElements_CompuMethods_Identical 1 100 0.0 65535. FORMAT "%5.0" ECU_ADDRESS 0x4000F8D8 /end MEASUREMENT
/begin MEASUREMENT rba_Reset_ExtHistBuf_ast[1].Cntr_u16 "extended Reset history buffer[1]/" UWORD RB_RBA_Common_CentralElements_CompuMethods_Identical 1 100 0.0 65535. FORMAT "%5.0" ECU_ADDRESS 0x4000F8E4 /end MEASUREMENT
/begin MEASUREMENT rba_Reset_ExtHistBuf_ast[2].Cntr_u16 "extended Reset history buffer[2]/" UWORD RB_RBA_Common_CentralElements_CompuMethods_Identical 1 100 0.0 65535. FORMAT "%5.0" ECU_ADDRESS 0x4000F8F0 /end MEASUREMENT
/begin MEASUREMENT rba_Reset_ExtHistBuf_ast[3].Cntr_u16 "extended Reset history buffer[3]/" UWORD RB_RBA_Common_CentralElements_CompuMethods_Identical 1 100 0.0 65535. FORMAT "%5.0" ECU_ADDRESS 0x4000F8FC /end MEASUREMENT
/begin MEASUREMENT rba_Reset_ExtHistBuf_ast[4].Cntr_u16 "extended Reset history buffer[4]/" UWORD RB_RBA_Common_CentralElements_CompuMethods_Identical 1 100 0.0 65535. FORMAT "%5.0" ECU_ADDRESS 0x4000F908 /end MEASUREMENT
/begin MEASUREMENT rba_Reset_ExtHistBuf_ast[5].Cntr_u16 "extended Reset history buffer[5]/" UWORD RB_RBA_Common_CentralElements_CompuMethods_Identical 1 100 0.0 65535. FORMAT "%5.0" ECU_ADDRESS 0x4000F914 /end MEASUREMENT
/begin MEASUREMENT rba_Reset_ExtHistBuf_ast[6].Cntr_u16 "extended Reset history buffer[6]/" UWORD RB_RBA_Common_CentralElements_CompuMethods_Identical 1 100 0.0 65535. FORMAT "%5.0" ECU_ADDRESS 0x4000F920 /end MEASUREMENT
/begin MEASUREMENT rba_Reset_ExtHistBuf_ast[7].Cntr_u16 "extended Reset history buffer[7]/" UWORD RB_RBA_Common_CentralElements_CompuMethods_Identical 1 100 0.0 65535. FORMAT "%5.0" ECU_ADDRESS 0x4000F92C /end MEASUREMENT
/begin MEASUREMENT rba_Reset_ExtHistBuf_ast[8].Cntr_u16 "extended Reset history buffer[8]/" UWORD RB_RBA_Common_CentralElements_CompuMethods_Identical 1 100 0.0 65535. FORMAT "%5.0" ECU_ADDRESS 0x4000F938 /end MEASUREMENT
/begin MEASUREMENT rba_Reset_ExtHistBuf_ast[9].Cntr_u16 "extended Reset history buffer[9]/" UWORD RB_RBA_Common_CentralElements_CompuMethods_Identical 1 100 0.0 65535. FORMAT "%5.0" ECU_ADDRESS 0x4000F944 /end MEASUREMENT
/begin MEASUREMENT rba_Reset_ExtHistBuf_ast[0].Addr_u32 "extended Reset history buffer[0]/" ULONG RB_RBA_Common_CentralElements_CompuMethods_Identical 1 100 0.0 4.E9 FORMAT "%5.0" ECU_ADDRESS 0x4000F8DC /end MEASUREMENT
/begin MEASUREMENT rba_Reset_ExtHistBuf_ast[1].Addr_u32 "extended Reset history buffer[1]/" ULONG RB_RBA_Common_CentralElements_CompuMethods_Identical 1 100 0.0 4.E9 FORMAT "%5.0" ECU_ADDRESS 0x4000F8E8 /end MEASUREMENT
/begin MEASUREMENT rba_Reset_ExtHistBuf_ast[2].Addr_u32 "extended Reset history buffer[2]/" ULONG RB_RBA_Common_CentralElements_CompuMethods_Identical 1 100 0.0 4.E9 FORMAT "%5.0" ECU_ADDRESS 0x4000F8F4 /end MEASUREMENT
/begin MEASUREMENT rba_Reset_ExtHistBuf_ast[3].Addr_u32 "extended Reset history buffer[3]/" ULONG RB_RBA_Common_CentralElements_CompuMethods_Identical 1 100 0.0 4.E9 FORMAT "%5.0" ECU_ADDRESS 0x4000F900 /end MEASUREMENT
/begin MEASUREMENT rba_Reset_ExtHistBuf_ast[4].Addr_u32 "extended Reset history buffer[4]/" ULONG RB_RBA_Common_CentralElements_CompuMethods_Identical 1 100 0.0 4.E9 FORMAT "%5.0" ECU_ADDRESS 0x4000F90C /end MEASUREMENT
/begin MEASUREMENT rba_Reset_ExtHistBuf_ast[5].Addr_u32 "extended Reset history buffer[5]/" ULONG RB_RBA_Common_CentralElements_CompuMethods_Identical 1 100 0.0 4.E9 FORMAT "%5.0" ECU_ADDRESS 0x4000F918 /end MEASUREMENT
/begin MEASUREMENT rba_Reset_ExtHistBuf_ast[6].Addr_u32 "extended Reset history buffer[6]/" ULONG RB_RBA_Common_CentralElements_CompuMethods_Identical 1 100 0.0 4.E9 FORMAT "%5.0" ECU_ADDRESS 0x4000F924 /end MEASUREMENT
/begin MEASUREMENT rba_Reset_ExtHistBuf_ast[7].Addr_u32 "extended Reset history buffer[7]/" ULONG RB_RBA_Common_CentralElements_CompuMethods_Identical 1 100 0.0 4.E9 FORMAT "%5.0" ECU_ADDRESS 0x4000F930 /end MEASUREMENT
/begin MEASUREMENT rba_Reset_ExtHistBuf_ast[8].Addr_u32 "extended Reset history buffer[8]/" ULONG RB_RBA_Common_CentralElements_CompuMethods_Identical 1 100 0.0 4.E9 FORMAT "%5.0" ECU_ADDRESS 0x4000F93C /end MEASUREMENT
/begin MEASUREMENT rba_Reset_ExtHistBuf_ast[9].Addr_u32 "extended Reset history buffer[9]/" ULONG RB_RBA_Common_CentralElements_CompuMethods_Identical 1 100 0.0 4.E9 FORMAT "%5.0" ECU_ADDRESS 0x4000F948 /end MEASUREMENT
/*********** Start of merged FUNCTION blocks ***********/
/begin FUNCTION Can "McFunction Can Created by MCFunctionUpdater" /begin LOC_MEASUREMENT Can_DriverState_MP /end LOC_MEASUREMENT FUNCTION_VERSION "33.20.1" /end FUNCTION
/begin FUNCTION CanIf "2.17.3    CAN Interface"
 /begin DEF_CHARACTERISTIC DDRC_DebArCounter.DFC_CANIF_E_CTRL_NOT_SLEEP_ERROR_VALUE.isJmpDwnActv_C DDRC_DebArCounter.DFC_CANIF_E_CTRL_NOT_SLEEP_ERROR_VALUE.isJmpUpActv_C DDRC_DebArCounter.DFC_CANIF_E_CTRL_NOT_SLEEP_ERROR_VALUE.jmpDwnVal_C DDRC_DebArCounter.DFC_CANIF_E_CTRL_NOT_SLEEP_ERROR_VALUE.jmpUpVal_C DDRC_DebArCounter.DFC_CANIF_E_CTRL_NOT_SLEEP_ERROR_VALUE.limFaild_C DDRC_DebArCounter.DFC_CANIF_E_CTRL_NOT_SLEEP_ERROR_VALUE.limPassd_C DDRC_DebArCounter.DFC_CANIF_E_CTRL_NOT_SLEEP_ERROR_VALUE.stepDwn_C DDRC_DebArCounter.DFC_CANIF_E_CTRL_NOT_SLEEP_ERROR_VALUE.stepUp_C DFC_CtlMsk2.DFC_CANIF_E_CTRL_NOT_SLEEP_ERROR_VALUE_C DFC_DisblMsk2.DFC_CANIF_E_CTRL_NOT_SLEEP_ERROR_VALUE_C /end DEF_CHARACTERISTIC
 /begin LOC_MEASUREMENT CanIf_ControllerState_0[0].ChannelMode CanIf_ControllerState_0[0].DeviceMode CanIf_ControllerState_0[1].ChannelMode CanIf_ControllerState_0[1].DeviceMode CanIf_Init_Flag /end LOC_MEASUREMENT
 FUNCTION_VERSION "2.17.3" /end FUNCTION
/begin FUNCTION CanSM "McFunction CanSM Created by MCFunctionUpdater"
 /begin LOC_MEASUREMENT CanSM_TimerConfig_a[0].cntTick_u16 CanSM_TimerConfig_a[0].stTimer CanSM_TimerConfig_a[1].cntTick_u16 CanSM_TimerConfig_a[1].stTimer /end LOC_MEASUREMENT
 FUNCTION_VERSION "2.19.1" /end FUNCTION
/begin FUNCTION ComM "McFunction ComM Created by MCFunctionUpdater"
 /begin LOC_MEASUREMENT ComM_ChannelStruct[0].BusSmMode_u8 ComM_ChannelStruct[0].ChannelMode_u8 ComM_ChannelStruct[0].ChannelState_e ComM_ChannelStruct[0].CommunicationAllowed_b ComM_ChannelStruct[0].DiagnosticRequestState_b ComM_ChannelStruct[0].InhibitionReqStatus_u8 ComM_ChannelStruct[0].LightTimeoutCtr_u32 ComM_ChannelStruct[0].MinFullComTimeoutCtr_u16 ComM_ChannelStruct[0].NmBusSleepIndicationStatus_b ComM_ChannelStruct[0].NmNetworkModeStatus_b ComM_ChannelStruct[0].NmNetworkRequestStatus_b ComM_ChannelStruct[0].NmPrepareBusSleepIndicationStatus_b ComM_ChannelStruct[0].PassiveRequestState_u8 ComM_ChannelStruct[0].PncRequestCtr_u8 ComM_ChannelStruct[0].UserRequestCtr_u8 ComM_ChannelStruct[1].BusSmMode_u8 ComM_ChannelStruct[1].ChannelMode_u8 ComM_ChannelStruct[1].ChannelState_e ComM_ChannelStruct[1].CommunicationAllowed_b ComM_ChannelStruct[1].DiagnosticRequestState_b ComM_ChannelStruct[1].InhibitionReqStatus_u8 ComM_ChannelStruct[1].LightTimeoutCtr_u32 ComM_ChannelStruct[1].MinFullComTimeoutCtr_u16 ComM_ChannelStruct[1].NmBusSleepIndicationStatus_b ComM_ChannelStruct[1].NmNetworkModeStatus_b ComM_ChannelStruct[1].NmNetworkRequestStatus_b ComM_ChannelStruct[1].NmPrepareBusSleepIndicationStatus_b ComM_ChannelStruct[1].PassiveRequestState_u8 ComM_ChannelStruct[1].PncRequestCtr_u8 ComM_ChannelStruct[1].UserRequestCtr_u8 ComM_UserStruct[0].IndicatedUserMode_t ComM_UserStruct[0].LimitToNoComCtr_u16 ComM_UserStruct[0].RequestedUserMode_t ComM_UserStruct[0].WakeUpInhibitionCtr_u16 ComM_UserStruct[0].numChannelsInFullCom_u8 ComM_UserStruct[0].numChannelsInNoCom_u8 ComM_UserStruct[0].numChannelsInSilentCom_u8 ComM_UserStruct[1].IndicatedUserMode_t ComM_UserStruct[1].LimitToNoComCtr_u16 ComM_UserStruct[1].RequestedUserMode_t ComM_UserStruct[1].WakeUpInhibitionCtr_u16 ComM_UserStruct[1].numChannelsInFullCom_u8 ComM_UserStruct[1].numChannelsInNoCom_u8 ComM_UserStruct[1].numChannelsInSilentCom_u8 /end LOC_MEASUREMENT
 FUNCTION_VERSION "3.18.2" /end FUNCTION
/begin FUNCTION rba_MRly "1.18.0    Main Relay"
 /begin DEF_CHARACTERISTIC DFC_CtlMsk2.DFC_rba_MRly_Diag_Stk_Event_C DFC_DisblMsk2.DFC_rba_MRly_Diag_Stk_Event_C /end DEF_CHARACTERISTIC
 /begin LOC_MEASUREMENT rba_MRly_Ctrl_State_MP /end LOC_MEASUREMENT
 FUNCTION_VERSION "1.18.0" /end FUNCTION
/begin FUNCTION rba_OsShell "1.24.1    Operating System Shell"
 /begin DEF_CHARACTERISTIC DDRC_DebArCounter.DFC_rba_MultiStackTrace_Threshold.isJmpDwnActv_C DDRC_DebArCounter.DFC_rba_MultiStackTrace_Threshold.isJmpUpActv_C DDRC_DebArCounter.DFC_rba_MultiStackTrace_Threshold.jmpDwnVal_C DDRC_DebArCounter.DFC_rba_MultiStackTrace_Threshold.jmpUpVal_C DDRC_DebArCounter.DFC_rba_MultiStackTrace_Threshold.limFaild_C DDRC_DebArCounter.DFC_rba_MultiStackTrace_Threshold.limPassd_C DDRC_DebArCounter.DFC_rba_MultiStackTrace_Threshold.stepDwn_C DDRC_DebArCounter.DFC_rba_MultiStackTrace_Threshold.stepUp_C DFC_CtlMsk2.DFC_rba_MultiStackTrace_Threshold_C DFC_DisblMsk2.DFC_rba_MultiStackTrace_Threshold_C /end DEF_CHARACTERISTIC
 /begin LOC_MEASUREMENT rba_MultiStackTrace_CurrentCycleMaxUsage_User0 rba_MultiStackTrace_LifeTimeMaxUsage_User0 rba_OsShell_Cntr1000msTask rba_OsShell_Cntr100msTask rba_OsShell_Cntr10msTask rba_OsShell_Cntr1msTask rba_OsShell_Cntr200msTask rba_OsShell_Cntr20msTask rba_OsShell_Cntr2msTask rba_OsShell_Cntr50msTask rba_OsShell_Cntr5msTask rba_OsShell_CntrBswAppDsmTask rba_OsShell_CntrBswBgTask rba_OsShell_CntrCalWup100msTask rba_OsShell_CntrCalWup10msTask rba_OsShell_CntrCalWup20msTask rba_OsShell_CntrCalWup2msTask rba_OsShell_CntrCalWupBgTask rba_OsShell_CntrCalWupIniEndTask rba_OsShell_CntrCalWupIniTask rba_OsShell_CntrDSMClearTask rba_OsShell_CntrEngReStrtModeMTask rba_OsShell_CntrEngReStrtTask rba_OsShell_CntrEpmNoSyncTask rba_OsShell_CntrInfraBswApp10msTask rba_OsShell_CntrIniDrvTask rba_OsShell_CntrIniEndTask rba_OsShell_CntrIniTask rba_OsShell_CntrMoSyncFirstTask rba_OsShell_CntrMoSyncIniTask rba_OsShell_CntrMoSyncS0Task rba_OsShell_CntrMoTask rba_OsShell_CntrReIniModeMTask rba_OsShell_CntrReIniTask rba_OsShell_CntrShutdown10msTask rba_OsShell_CntrShutdownBswTask rba_OsShell_CntrShutdownSeqTask rba_OsShell_CntrSyncFirstTask rba_OsShell_CntrSyncIniTask rba_OsShell_CntrSyncPreTask rba_OsShell_CntrSyncS0Task rba_OsShell_CntrSyncS1Task rba_OsShell_CntrSyncVirtualFirstTask rba_OsShell_CntrSyncVirtualTask rba_OsShell_TaskRespTime_OS_1000ms_Task.current rba_OsShell_TaskRespTime_OS_1000ms_Task.lifetimeMax rba_OsShell_TaskRespTime_OS_1000ms_Task.max rba_OsShell_TaskRespTime_OS_100ms_Task.current rba_OsShell_TaskRespTime_OS_100ms_Task.lifetimeMax rba_OsShell_TaskRespTime_OS_100ms_Task.max rba_OsShell_TaskRespTime_OS_10ms_Task.current rba_OsShell_TaskRespTime_OS_10ms_Task.lifetimeMax rba_OsShell_TaskRespTime_OS_10ms_Task.max rba_OsShell_TaskRespTime_OS_1ms_Task.current rba_OsShell_TaskRespTime_OS_1ms_Task.lifetimeMax rba_OsShell_TaskRespTime_OS_1ms_Task.max rba_OsShell_TaskRespTime_OS_200ms_Task.current rba_OsShell_TaskRespTime_OS_200ms_Task.lifetimeMax rba_OsShell_TaskRespTime_OS_200ms_Task.max rba_OsShell_TaskRespTime_OS_20ms_Task.current rba_OsShell_TaskRespTime_OS_20ms_Task.lifetimeMax rba_OsShell_TaskRespTime_OS_20ms_Task.max rba_OsShell_TaskRespTime_OS_2ms_Task.current rba_OsShell_TaskRespTime_OS_2ms_Task.lifetimeMax rba_OsShell_TaskRespTime_OS_2ms_Task.max rba_OsShell_TaskRespTime_OS_50ms_Task.current rba_OsShell_TaskRespTime_OS_50ms_Task.lifetimeMax rba_OsShell_TaskRespTime_OS_50ms_Task.max rba_OsShell_TaskRespTime_OS_5ms_Task.current rba_OsShell_TaskRespTime_OS_5ms_Task.lifetimeMax rba_OsShell_TaskRespTime_OS_5ms_Task.max rba_OsShell_TaskRespTime_OS_InfraBswApp_10ms_Task.current rba_OsShell_TaskRespTime_OS_InfraBswApp_10ms_Task.lifetimeMax rba_OsShell_TaskRespTime_OS_InfraBswApp_10ms_Task.max rba_OsShell_cntrErrAccess rba_OsShell_cntrErrCallevel rba_OsShell_cntrErrId rba_OsShell_cntrErrLimitSum rba_OsShell_cntrErrNoFunc rba_OsShell_cntrErrResource rba_OsShell_cntrErrState rba_OsShell_cntrErrSum rba_OsShell_cntrErrValue rba_OsShell_tiPowerOnFrst10ms rba_OsShell_tiResetFrst10ms rba_Runtime_CurrentCycleMax_Core0 rba_Runtime_LifeTimeMax_Core0 /end LOC_MEASUREMENT
 FUNCTION_VERSION "1.24.1" /end FUNCTION
/begin FUNCTION rba_Reset "McFunction rba_Reset Created by MCFunctionUpdater"
 /begin LOC_MEASUREMENT rba_Reset_ApplEnv_st.CntrRst_u8 rba_Reset_ApplEnv_st.Grp_en rba_Reset_ApplEnv_st.Id_en rba_Reset_ApplEnv_st.Loc_u32 rba_Reset_ApplEnv_st.UserValue_u32 rba_Reset_ExtHistBuf_ast[0].Addr_u32 rba_Reset_ExtHistBuf_ast[0].Cntr_u16 rba_Reset_ExtHistBuf_ast[0].ResetId_en rba_Reset_ExtHistBuf_ast[1].Addr_u32 rba_Reset_ExtHistBuf_ast[1].Cntr_u16 rba_Reset_ExtHistBuf_ast[1].ResetId_en rba_Reset_ExtHistBuf_ast[2].Addr_u32 rba_Reset_ExtHistBuf_ast[2].Cntr_u16 rba_Reset_ExtHistBuf_ast[2].ResetId_en rba_Reset_ExtHistBuf_ast[3].Addr_u32 rba_Reset_ExtHistBuf_ast[3].Cntr_u16 rba_Reset_ExtHistBuf_ast[3].ResetId_en rba_Reset_ExtHistBuf_ast[4].Addr_u32 rba_Reset_ExtHistBuf_ast[4].Cntr_u16 rba_Reset_ExtHistBuf_ast[4].ResetId_en rba_Reset_ExtHistBuf_ast[5].Addr_u32 rba_Reset_ExtHistBuf_ast[5].Cntr_u16 rba_Reset_ExtHistBuf_ast[5].ResetId_en rba_Reset_ExtHistBuf_ast[6].Addr_u32 rba_Reset_ExtHistBuf_ast[6].Cntr_u16 rba_Reset_ExtHistBuf_ast[6].ResetId_en rba_Reset_ExtHistBuf_ast[7].Addr_u32 rba_Reset_ExtHistBuf_ast[7].Cntr_u16 rba_Reset_ExtHistBuf_ast[7].ResetId_en rba_Reset_ExtHistBuf_ast[8].Addr_u32 rba_Reset_ExtHistBuf_ast[8].Cntr_u16 rba_Reset_ExtHistBuf_ast[8].ResetId_en rba_Reset_ExtHistBuf_ast[9].Addr_u32 rba_Reset_ExtHistBuf_ast[9].Cntr_u16 rba_Reset_ExtHistBuf_ast[9].ResetId_en /end LOC_MEASUREMENT
 FUNCTION_VERSION "1.24.1" /end FUNCTION
/*********** Start of merged COMPU_METHOD blocks ***********/
/begin COMPU_METHOD RB_RBA_Common_CentralElements_CompuMethods_Identical "The internal value and the physical one are identical. No physical unit available" RAT_FUNC "%10.5" "" COEFFS 0.0 1.0 0.0 0.0 0.0 1.0 /end COMPU_METHOD
/begin COMPU_METHOD AUTOSAR_CanIf_CompuMethods_CanIf_ControllerModeType_Enum_comp "Computation method for enum type CanIf_ControllerModeType" TAB_VERB "%10.5" "" COMPU_TAB_REF AUTOSAR_CanIf_CompuMethods_CanIf_ControllerModeType_Enum_comp /end COMPU_METHOD
/begin COMPU_METHOD AUTOSAR_CanIf_CompuMethods_CanIf_PduGetModeType_Enum_comp "Computation method for enum type CanIf_PduGetModeType" TAB_VERB "%10.5" "" COMPU_TAB_REF AUTOSAR_CanIf_CompuMethods_CanIf_PduGetModeType_Enum_comp /end COMPU_METHOD
/begin COMPU_METHOD AUTOSAR_CanSM_CompuMethods_CanSM_TimerStateType_Enum_comp "Computation method for the enum CanSM_TimerStateType" TAB_VERB "%10.5" "" COMPU_TAB_REF AUTOSAR_CanSM_CompuMethods_CanSM_TimerStateType_Enum_comp /end COMPU_METHOD
/begin COMPU_METHOD RB_RBA_rba_MRly_BswModuleDescriptions_rba_MRly_Ctrl_States_CompuMethod "" TAB_VERB "%10.5" "" COMPU_TAB_REF RB_RBA_rba_MRly_BswModuleDescriptions_rba_MRly_Ctrl_States_CompuMethod /end COMPU_METHOD
/begin COMPU_METHOD RB_RBA_rba_OsShell_CompuMethods_rba_OsShell_ResourceConversion "rba_OsShell resource conversion factor" RAT_FUNC "%10.5" "%" COEFFS 0.0 -1.0 0.0 0.0 0.0 -0.01 REF_UNIT RB_RBA_rba_OsShell_Units_Perc /end COMPU_METHOD
/begin COMPU_METHOD RB_RBA_rba_OsShell_CompuMethods_rba_OsShell_TaskRespTime_CompMethod "Task response time computation method" RAT_FUNC "%10.5" "us" COEFFS 0.0 -1.0 0.0 0.0 0.0 -0.025 REF_UNIT RB_RBA_rba_OsShell_Units_MicroSec /end COMPU_METHOD
/begin COMPU_METHOD RB_RBA_rba_Reset_CompuMethods_rba_Reset_Id_ten "CompuMethod for the Reset Ids" TAB_VERB "%10.5" "" COMPU_TAB_REF RB_RBA_rba_Reset_CompuMethods_rba_Reset_Id_ten /end COMPU_METHOD
/begin COMPU_METHOD AccGrv "" RAT_FUNC "%6.4" "g" COEFFS 0 100 0 0 0 1 /end COMPU_METHOD
/begin COMPU_METHOD ActAngle "" RAT_FUNC "%6.4" "deg" COEFFS 0 20 0 0 0 1 /end COMPU_METHOD
/begin COMPU_METHOD ADDLEONV_SC_Compu "" TAB_VERB "%6.3" "" COMPU_TAB_REF ADDLEONV_SC_Compu /end COMPU_METHOD
/*********** Start of merged COMPU_VTAB blocks ***********/
/begin COMPU_VTAB AUTOSAR_CanIf_CompuMethods_CanIf_ControllerModeType_Enum_comp "Computation method for enum type CanIf_ControllerModeType" TAB_VERB 5 0 "CANIF_CS_UNINIT" 1 "CANIF_CS_STOPPED" 2 "CANIF_CS_STARTED" 3 "CANIF_CS_SLEEP" 4 "CANIF_CS_MAXMODE" /end COMPU_VTAB
/begin COMPU_VTAB AUTOSAR_CanIf_CompuMethods_CanIf_PduGetModeType_Enum_comp "Computation method for enum type CanIf_PduGetModeType" TAB_VERB 6 0 "CANIF_GET_OFFLINE" 1 "CANIF_GET_RX_ONLINE" 2 "CANIF_GET_TX_ONLINE" 3 "CANIF_GET_ONLINE" 4 "CANIF_GET_OFFLINE_ACTIVE" 5 "CANIF_GET_OFFLINE_ACTIVE_RX_ONLINE" /end COMPU_VTAB
/begin COMPU_VTAB AUTOSAR_CanSM_CompuMethods_CanSM_TimerStateType_Enum_comp "Computation method for the enum CanSM_TimerStateType" TAB_VERB 4 1 "CANSM_TIMER_INIT" 2 "CANSM_TIMER_RUNNING" 3 "CANSM_TIMER_ELAPSED" 4 "CANSM_TIMER_CANCELLED" /end COMPU_VTAB
/begin COMPU_VTAB RB_RBA_rba_MRly_BswModuleDescriptions_rba_MRly_Ctrl_States_CompuMethod "" TAB_VERB 2 0 "rba_MRly_Ctrl_Open_e" 1 "rba_MRly_Ctrl_Close_e" /end COMPU_VTAB
/begin COMPU_VTAB RB_RBA_rba_Reset_CompuMethods_rba_Reset_Id_ten "CompuMethod for the Reset Ids" TAB_VERB 244 0 "RBA_RESET_POWERON_E" 1 "RBA_RESET_POWERON_WARM_E" 2 "RBA_RESET_POWERON_WDT_E" 3 "RBA_RESET_POWERON_KL15_E" 4 "RBA_RESET_ESR0_E" 5 "RBA_RESET_ESR1_E" 6 "RBA_RESET_WDT_E" 7 "RBA_RESET_OCDS" 8 "RBA_RESET_CB0_E" 9 "RBA_RESET_CB1_E" 10 "RBA_RESET_CB3_E" 11 "RBA_RESET_TP_E" 12 "RBA_RESET_CANWAK_E" 13 "RBA_RESET_PIN1WAK_E" 14 "RBA_RESET_PIN2WAK_E" 15 "RBA_RESET_PIN3WAK_E" 16 "RBA_RESET_STCWAK_E" 17 "RBA_RESET_HW_E" 18 "RBA_RESET_SOFTDEST_E" 19 "RBA_RESET_JTAGDEST_E" 20 "RBA_RESET_HSMDEST_E" 21 "RBA_RESET_TSRDEST_E" 22 "RBA_RESET_FCCUHARD_E" 23 "RBA_RESET_FCCUSOFT_E" 24 "RBA_RESET_JTAGFUNC_E" 25 "RBA_RESET_HSMFUNC_E" 26 "RBA_RESET_TSRFUNC_E" 27 "RBA_RESET_VORFUNC_E" 28 "RBA_RESET_NOTDEFINED_E" 29 "RBA_RESET_FFRRDEST_E" 30 "RBA_RESET_SSCMDEST_E" 31 "RBA_RESET_FLASH_E" 32 "RBA_RESET_PLL0_E" 33 "RBA_RESET_CMU_FHL0_E" 34 "RBA_RESET_CMU_OLR_E" 35 "RBA_RESET_CORE_E" 36 "RBA_RESET_CWD_E" 37 "RBA_RESET_SWT_E" 4096 "RBA_RESET_POWERON_SIMU_E" 4097 "RBA_RESET_HWRESET_SIMU_E" 4098 "RBA_RESET_RB_PROG_E" 4099 "RBA_RESET_CBPROG_E" 4100 "RBA_RESET_CBCPU_E" 4101 "RBA_RESET_RB_PROG_ILLEGAL_PATH_E" 4102 "RBA_RESET_TSW_EXIT_E" 4103 "RBA_RESET_TSW_MAGICPATTERN_E" 4104 "RBA_RESET_TRAP_IN_SB_E" 4105 "RBA_RESET_SWDESTRST_RAMVALID_E" 4106 "RBA_RESET_SWDESTRST_RAMINVALID_E" 4107 "RBA_RESET_SWDESTRST_REQ_RAMVALID_E" 4108 "RBA_RESET_OBD_SVC11_RESET_E" 4109 "RBA_RESET_PLL_LOSS_OF_LOCK_E" 4110 "RBA_RESET_DUMMY03_E" 4111 "RBA_RESET_DUMMY04_E" 4112 "RBA_RESET_DUMMY05_E" 4113 "RBA_RESET_DUMMY06_E" 4114 "RBA_RESET_DUMMY07_E" 4115 "RBA_RESET_DUMMY08_E" 4116 "RBA_RESET_DUMMY09_E" 4117 "RBA_RESET_DUMMY10_E" 12288 "ECUM_E_RESET_CONFIGURATION_DATA_INCONSISTENT" 12289 "ECUM_E_RESET_GENERAL" 12290 "ECUM_E_RESET_INVALID_PTR_RETURNED" 12291 "ECUM_E_RESET_NULL_PTR_RETURNED" 12292 "ECUM_E_RESET_RAM_CHECK_FAILED" 12293 "ECUM_E_RESET_START_CORE_FAILED" 12294 "ECUM_RESET" 12295 "MCU_RB_RESET_DTS_ERROR" 12296 "MCU_RESET_ILLEGAL_CALL_OF_MCU_PERFORM_RESET" 12297 "MCU_RESET_UNDEFINED" 12298 "RBA_EMM_EVR13OVCFG_ERROR_RESET" 12299 "RBA_EMM_EVR13UVCFG_ERROR_RESET" 12300 "RBA_EMM_EVR33OVCFG_ERROR_RESET" 12301 "RBA_EMM_EVR33UVCFG_ERROR_RESET" 12302 "RBA_EMM_EVR50OVCFG_ERROR_RESET" 12303 "RBA_EMM_EVR50UVCFG_ERROR_RESET" 12304 "RBA_EMM_INT_TEMP_MON_RESET" 12305 "RBA_EMM_INVALID_STAT_RESET" 12306 "RBA_EMM_UNEXPECTED_LOCK_RESET" 12307 "RBA_EMM_VDDMOVCFG_ERROR_RESET" 12308 "RBA_EMM_VDDMUVCFG_ERROR_RESET" 12309 "RBA_EMM_VDDPDOVCFG_ERROR_RESET" 12310 "RBA_EMM_VDDPDUVCFG_ERROR_RESET" 12311 "RBA_EMM_VEVRSBOVCFG_ERROR_RESET" 12312 "RBA_EMM_VEVRSBUVCFG_ERROR_RESET" 12313 "RBA_MPU_INVALID_ADDRESS_ALIGNMENT_RESET" 12314 "RBA_MPU_INVALID_NUMBER_REGIONS_RESET" 12315 "RBA_MPU_INVALID_REGION_ADDRESS_RESET" 12316 "RBA_MPU_REGION_START_END_ADDRESS_RESET" 12317 "RBA_MULTISTACKTRACE_UNDEROVERFLOW" 12318 "RBA_RESET_BSW_DEFAULT_E" 12319 "RBA_RESET_FIRST_SWRESET" 12320 "RBA_RESET_INFOBLK_FAULT" 12321 "RBA_RESET_MOCEMM_ECC_FAILED" 12322 "RBA_RESET_MOCEMM_INITORDER" 12323 "RBA_RESET_MOCEMM_RAMCHK_FAILED" 12324 "RBA_RESET_MOCEMM_ROMCHK_FAILED" 12325 "RBA_RESET_MOCEMM_WTCHK_FAILED" 12326 "RBA_RESET_MOCSOP_BUS_ERROR" 12327 "RBA_RESET_MOCSOP_OS_TIMEOUT_ERROR" 12328 "RBA_RESET_MOCSOP_TIRESPTIME_ERROR" 12329 "RBA_RESET_MOCSOP_WRTEST_FAILED" 12330 "RBA_RESET_RBA_BSWSRV_ADDRESS_RANGE_VIOLATION_E" 12331 "RBA_RESET_RBA_BSWSRV_INTSUSP_CORRUPTION" 12332 "RBA_RESET_RBA_BSWSRV_INTSUSP_CTR_VIOLATION_E" 12333 "RBA_RESET_RBA_BSWSRV_LOCK_CTR_VIOLATION_E" 12334 "RBA_RESET_RBA_BSWSRV_LOCK_NESTING_VIOLATION_E" 12335 "RBA_RESET_RBA_BYP_FINISH_E" 12336 "RBA_RESET_RBA_CALWUPFINISH_E" 12337 "RBA_RESET_RBA_MEMLAY_CB_SIZE_E" 12338 "RBA_RESET_SOPTEST_FAILED" 12339 "RBA_RESET_SWRST_EEPACTFIRSTINIT_E" 12340 "RBA_RESET_SWRST_EEPDELENVRAM_E" 12341 "RBA_SYC_POWERUNDERVOLTAGE_RSTID_RECOVERY_FAILED" 12342 "RBA_SYC_RESET_T15" 12343 "RESET_SWRESET_CPLCHK_FAILED" 12344 "RESET_SWRESET_ILLEGAL_SW_PATH" 12345 "RESET_SWRESET_MOCCOM_BUS_ERROR" 12346 "RESET_SWRESET_MOCCOM_CPLCHK_FAILED" 12347 "RESET_SWRESET_MOCCOM_CTSOPTST" 12348 "RESET_SWRESET_MOCCOM_OS_TIMEOUT_ERROR" 12349 "RESET_SWRESET_MOCCOM_PWR_ERROR" 12350 "RESET_SWRESET_MOCCOM_SOPTST" 12351 "RESET_SWRESET_MOCCOM_WRTEST_FAILED" 12352 "RESET_SWRESET_MOCGTM_CHKROM_FAILED" 12353 "RESET_SWRESET_MOCGTM_FAILED" 12354 "RESET_SWRESET_MOCGTM_INI_COMPLEMENT_FAILED" 12355 "RESET_SWRESET_MOCGTM_INI_FAILED" 12356 "RESET_SWRESET_MOCMEM_CHKRAM_FAILED" 12357 "RESET_SWRESET_MOCMEM_CHKROM_FAILED" 12358 "RESET_SWRESET_MOCMEM_CPLCHK_FAILED" 12359 "RESET_SWRESET_MOCMEM_NUMBLKERR_FAILED" 12360 "RESET_SWRESET_MOCMEM_WTRAM_FAILED" 12361 "RESET_SWRESET_MOCMEM_WTROM_FAILED" 12362 "RESET_SWRESET_OCWDA_WDA_MONITOR" 12363 "SWRESET_MOCADCNTP_PREICO" 12364 "SWRESET_MOCADCTST_PREICO" 12365 "SWRESET_UNEXPSYCSTSUB_E" 16384 "RBA_SYC_POWERUNDERVOLTAGE_RSTID_DIO_READ_FAILED" 16385 "RBA_SYC_POWERUNDERVOLTAGE_RSTID_UV_DETECTED" 16386 "RBA_SYC_RESET_RESTART" 16387 "RBA_SYC_RESET_WAKEUP" 20480 "RBA_RESET_CPU0_EXC_SYSRST_E" 20481 "RBA_RESET_CPU0_EXC_CRITINP_E" 20482 "RBA_RESET_CPU0_EXC_MCHK_UNKNOWN_E" 20483 "RBA_RESET_CPU0_EXC_MCHK_MCP_E" 20484 "RBA_RESET_CPU0_EXC_MCHK_IC_DPERR_E" 20485 "RBA_RESET_CPU0_EXC_MCHK_RES2_E" 20486 "RBA_RESET_CPU0_EXC_MCHK_DC_DPERR_E" 20487 "RBA_RESET_CPU0_EXC_MCHK_EXCP_ERR_E" 20488 "RBA_RESET_CPU0_EXC_MCHK_IC_TPERR_E" 20489 "RBA_RESET_CPU0_EXC_MCHK_DC_TPERR_E" 20490 "RBA_RESET_CPU0_EXC_MCHK_IC_LKERR_E" 20491 "RBA_RESET_CPU0_EXC_MCHK_DC_LKERR_E" 20492 "RBA_RESET_CPU0_EXC_MCHK_RES9_E" 20493 "RBA_RESET_CPU0_EXC_MCHK_RES10_E" 20494 "RBA_RESET_CPU0_EXC_MCHK_NMI_E" 20495 "RBA_RESET_CPU0_EXC_MCHK_MAV_E" 20496 "RBA_RESET_CPU0_EXC_MCHK_MEA_E" 20497 "RBA_RESET_CPU0_EXC_MCHK_U_E" 20498 "RBA_RESET_CPU0_EXC_MCHK_IF_E" 20499 "RBA_RESET_CPU0_EXC_MCHK_LD_E" 20500 "RBA_RESET_CPU0_EXC_MCHK_ST_E" 20501 "RBA_RESET_CPU0_EXC_MCHK_G_E" 20502 "RBA_RESET_CPU0_EXC_MCHK_RES19_E" 20503 "RBA_RESET_CPU0_EXC_MCHK_RES20_E" 20504 "RBA_RESET_CPU0_EXC_MCHK_STACK_ERR_E" 20505 "RBA_RESET_CPU0_EXC_MCHK_IMEM_PERR_E" 20506 "RBA_RESET_CPU0_EXC_MCHK_DMEM_RDPERR_E" 20507 "RBA_RESET_CPU0_EXC_MCHK_DMEM_WRPERR_E" 20508 "RBA_RESET_CPU0_EXC_MCHK_RES25_E" 20509 "RBA_RESET_CPU0_EXC_MCHK_RES26_E" 20510 "RBA_RESET_CPU0_EXC_MCHK_BUS_IRERR_E" 20511 "RBA_RESET_CPU0_EXC_MCHK_BUS_DRERR_E" 20512 "RBA_RESET_CPU0_EXC_MCHK_BUS_WRERR_E" 20513 "RBA_RESET_CPU0_EXC_MCHK_BUS_WRDSI_E" 20514 "RBA_RESET_CPU0_EXC_MCHK_RES31_E" 20515 "RBA_RESET_CPU0_EXC_DATAST_E" 20516 "RBA_RESET_CPU0_EXC_DATAST_PIL_E" 20517 "RBA_RESET_CPU0_EXC_DATAST_PPR_E" 20518 "RBA_RESET_CPU0_EXC_DATAST_PTR_E" 20519 "RBA_RESET_CPU0_EXC_DATAST_FP_E" 20520 "RBA_RESET_CPU0_EXC_DATAST_ST_E" 20521 "RBA_RESET_CPU0_EXC_DATAST_BO_E" 20522 "RBA_RESET_CPU0_EXC_DATAST_SPV_E" 20523 "RBA_RESET_CPU0_EXC_DATAST_VLEMI_E" 20524 "RBA_RESET_CPU0_EXC_INSTRST_E" 20525 "RBA_RESET_CPU0_EXC_INSTRST_PIL_E" 20526 "RBA_RESET_CPU0_EXC_INSTRST_PPR_E" 20527 "RBA_RESET_CPU0_EXC_INSTRST_PTR_E" 20528 "RBA_RESET_CPU0_EXC_INSTRST_FP_E" 20529 "RBA_RESET_CPU0_EXC_INSTRST_ST_E" 20530 "RBA_RESET_CPU0_EXC_INSTRST_BO_E" 20531 "RBA_RESET_CPU0_EXC_INSTRST_SPV_E" 20532 "RBA_RESET_CPU0_EXC_INSTRST_VLEMI_E" 20533 "RBA_RESET_CPU0_EXC_EXTINT_E" 20534 "RBA_RESET_CPU0_EXC_ALIGN_E" 20535 "RBA_RESET_CPU0_EXC_ALIGN_PIL_E" 20536 "RBA_RESET_CPU0_EXC_ALIGN_PPR_E" 20537 "RBA_RESET_CPU0_EXC_ALIGN_PTR_E" 20538 "RBA_RESET_CPU0_EXC_ALIGN_FP_E" 20539 "RBA_RESET_CPU0_EXC_ALIGN_ST_E" 20540 "RBA_RESET_CPU0_EXC_ALIGN_BO_E" 20541 "RBA_RESET_CPU0_EXC_ALIGN_SPV_E" 20542 "RBA_RESET_CPU0_EXC_ALIGN_VLEMI_E" 20543 "RBA_RESET_CPU0_EXC_PROGRAM_E" 20544 "RBA_RESET_CPU0_EXC_PROGRAM_PIL_E" 20545 "RBA_RESET_CPU0_EXC_PROGRAM_PPR_E" 20546 "RBA_RESET_CPU0_EXC_PROGRAM_PTR_E" 20547 "RBA_RESET_CPU0_EXC_PROGRAM_FP_E" 20548 "RBA_RESET_CPU0_EXC_PROGRAM_ST_E" 20549 "RBA_RESET_CPU0_EXC_PROGRAM_BO_E" 20550 "RBA_RESET_CPU0_EXC_PROGRAM_SPV_E" 20551 "RBA_RESET_CPU0_EXC_PROGRAM_VLEMI_E" 20552 "RBA_RESET_CPU0_EXC_PERFMON_E" 20553 "RBA_RESET_CPU0_EXC_SYSCALL_E" 20554 "RBA_RESET_CPU0_EXC_SYSCALL_PIL_E" 20555 "RBA_RESET_CPU0_EXC_SYSCALL_PPR_E" 20556 "RBA_RESET_CPU0_EXC_SYSCALL_PTR_E" 20557 "RBA_RESET_CPU0_EXC_SYSCALL_FP_E" 20558 "RBA_RESET_CPU0_EXC_SYSCALL_ST_E" 20559 "RBA_RESET_CPU0_EXC_SYSCALL_BO_E" 20560 "RBA_RESET_CPU0_EXC_SYSCALL_SPV_E" 20561 "RBA_RESET_CPU0_EXC_SYSCALL_VLEMI_E" 20562 "RBA_RESET_CPU0_EXC_DEBUG_E" 20563 "RBA_RESET_CPU0_EXC_EFPUDATAEXC_E" 20564 "RBA_RESET_CPU0_EXC_EFPUDATAEXC_PIL_E" 20565 "RBA_RESET_CPU0_EXC_EFPUDATAEXC_PPR_E" 20566 "RBA_RESET_CPU0_EXC_EFPUDATAEXC_PTR_E" 20567 "RBA_RESET_CPU0_EXC_EFPUDATAEXC_FP_E" 20568 "RBA_RESET_CPU0_EXC_EFPUDATAEXC_ST_E" 20569 "RBA_RESET_CPU0_EXC_EFPUDATAEXC_BO_E" 20570 "RBA_RESET_CPU0_EXC_EFPUDATAEXC_SPV_E" 20571 "RBA_RESET_CPU0_EXC_EFPUDATAEXC_VLEMI_E" 20572 "RBA_RESET_CPU0_EXC_EFPUROUNDEXC_E" 20573 "RBA_RESET_CPU0_EXC_EFPUROUNDEXC_PIL_E" 20574 "RBA_RESET_CPU0_EXC_EFPUROUNDEXC_PPR_E" 20575 "RBA_RESET_CPU0_EXC_EFPUROUNDEXC_PTR_E" 20576 "RBA_RESET_CPU0_EXC_EFPUROUNDEXC_FP_E" 20577 "RBA_RESET_CPU0_EXC_EFPUROUNDEXC_ST_E" 20578 "RBA_RESET_CPU0_EXC_EFPUROUNDEXC_BO_E" 20579 "RBA_RESET_CPU0_EXC_EFPUROUNDEXC_SPV_E" 20580 "RBA_RESET_CPU0_EXC_EFPUROUNDEXC_VLEMI_E" 20581 "RBA_RESET_CPU0_EXC_TBD_E" /end COMPU_VTAB
/*********** End of merged COMPU_VTAB blocks ***********/
/begin COMPU_VTAB ADDLEONV_SC_Compu "" TAB_VERB 2 0 "False" 1 "True" /end COMPU_VTAB
/begin COMPU_METHOD AFS_Rmp "" RAT_FUNC "%6.3" "1/s" COEFFS 0 6.5536 0 0 0 1 /end COMPU_METHOD
/begin COMPU_METHOD AGCTRL_CRKAGWINMAP_SC_Compu "" TAB_VERB "%6.3" "" COMPU_TAB_REF AGCTRL_CRKAGWINMAP_SC_Compu /end COMPU_METHOD
/begin COMPU_VTAB AGCTRL_CRKAGWINMAP_SC_Compu "" TAB_VERB 2 0 "False" 1 "True" /end COMPU_VTAB
/begin COMPU_METHOD AGCTRL_SYNCNCPV_SC_Compu "" TAB_VERB "%6.3" "" COMPU_TAB_REF AGCTRL_SYNCNCPV_SC_Compu /end COMPU_METHOD
/begin COMPU_VTAB AGCTRL_SYNCNCPV_SC_Compu "" TAB_VERB 2 0 "False" 1 "True" /end COMPU_VTAB
/begin COMPU_METHOD AgPrTime_COMPU "" RAT_FUNC "%6.4" "deg CrS/s" COEFFS 0 100 0 0 0 1 /end COMPU_METHOD
/begin COMPU_METHOD AIRCHRGMDL_SC_Compu "" TAB_VERB "%6.3" "" COMPU_TAB_REF AIRCHRGMDL_SC_Compu /end COMPU_METHOD
/begin COMPU_VTAB AIRCHRGMDL_SC_Compu "" TAB_VERB 2 1 "Single" 2 "Atleast_two" /end COMPU_VTAB
/begin COMPU_METHOD AirFlRat "" RAT_FUNC "%6.4" "-" COEFFS 0 200 0 0 0 1 /end COMPU_METHOD
/begin COMPU_METHOD AirMass "" RAT_FUNC "%6.4" "g" COEFFS 0 100 0 0 0 1 /end COMPU_METHOD
/begin COMPU_METHOD AirMassPerCyl "" RAT_FUNC "%6.3" "mg/Hub" COEFFS 0 10 0 0 0 1 /end COMPU_METHOD
/begin COMPU_METHOD AirMassPerTime "" RAT_FUNC "%6.3" "Kg/h" COEFFS 0 10 0 0 0 1 /end COMPU_METHOD
/begin COMPU_METHOD AirMassPerTimeMgScnd "" RAT_FUNC "%6.3" "mg/s" COEFFS 0 10 0 0 0 1 /end COMPU_METHOD
/begin COMPU_METHOD AirMassPerTime_2 "" RAT_FUNC "%7.6" "g/s" COEFFS 0 31250 0 0 0 1 /end COMPU_METHOD
/begin COMPU_METHOD AirMass_2 "" RAT_FUNC "%6.3" "g" COEFFS 0 10 0 0 0 1 /end COMPU_METHOD
/begin COMPU_METHOD AirMsPrTime_q0p0003_COMPU "" RAT_FUNC "%6.5" "g/s" COEFFS 0 3333.33333333333 0 0 0 1 /end COMPU_METHOD
/begin COMPU_METHOD AirMs_q0p1_COMPU "" RAT_FUNC "%6.3" "g" COEFFS 0 10 0 0 0 1 /end COMPU_METHOD
/begin COMPU_METHOD AirSysDdT_ms "" RAT_FUNC "%13.3" "ms" COEFFS 0 0 1 0 9.31322574615479e-006 0 /end COMPU_METHOD
/begin COMPU_METHOD AirSysSwt "" RAT_FUNC "%10.9" "-" COEFFS 0 16384000 0 0 0 1 /end COMPU_METHOD
/begin COMPU_METHOD AirSysSwt_S16 "" RAT_FUNC "%7.6" "-" COEFFS 0 16384 0 0 0 1 /end COMPU_METHOD
/begin COMPU_METHOD AIRSYS_AIRCHRGMIN_SC_Compu "" TAB_VERB "%6.3" "" COMPU_TAB_REF AIRSYS_AIRCHRGMIN_SC_Compu /end COMPU_METHOD
/begin COMPU_VTAB AIRSYS_AIRCHRGMIN_SC_Compu "" TAB_VERB 2 0 "False" 1 "True" /end COMPU_VTAB
/begin COMPU_METHOD AirVolPerTime "" RAT_FUNC "%6.3" "m^3/h" COEFFS 0 10 0 0 0 1 /end COMPU_METHOD
/begin COMPU_METHOD DFES_OneToOne "" RAT_FUNC "%6.2" "-" COEFFS 0 1 0 0 0 1 /end COMPU_METHOD
/begin COMPU_METHOD OneToOne "" RAT_FUNC "%6.2" "-" COEFFS 0 1 0 0 0 1 /end COMPU_METHOD
/begin RECORD_LAYOUT RB_Val_Ws16 FNC_VALUES 1 SWORD COLUMN_DIR DIRECT /end RECORD_LAYOUT
/begin RECORD_LAYOUT RB_Val_Wu8 FNC_VALUES 1 UBYTE COLUMN_DIR DIRECT /end RECORD_LAYOUT
/begin RECORD_LAYOUT Val_Wu8 FNC_VALUES 1 UBYTE COLUMN_DIR DIRECT /end RECORD_LAYOUT
/begin UNIT RB_RBA_rba_OsShell_Units_Perc "Percent" "%" EXTENDED_SI /end UNIT
/begin UNIT RB_RBA_rba_OsShell_Units_MicroSec "Micro Second" "us" EXTENDED_SI /end UNIT
/*********** End of merged UNIT blocks ***********/
/end MODULE
/end PROJECT
