ASAP2_VERSION 1 60
/begin PROJECT MSE2_BJ10_0038_00 "MDG1"
/begin HEADER "" VERSION "MSE2_BJ10_0038_00" PROJECT_NO MSE2_BJ10_0038_00 /end HEADER
/begin MODULE DIM ""
/begin MOD_COMMON "" BYTE_ORDER MSB_FIRST ALIGNMENT_BYTE 1 ALIGNMENT_WORD 2 ALIGNMENT_LONG 4 ALIGNMENT_INT64 4 ALIGNMENT_FLOAT32_IEEE 4 ALIGNMENT_FLOAT64_IEEE 4 /end MOD_COMMON
/begin CHARACTERISTIC DINH_FId.DFC_BusDiagOpenLoad_Can0_CA "inhibitable FIds / FIds to be inhibited by inhibit source DFC_BusDiagOpenLoad_Can0" VAL_BLK 0x908068C ValA_Wu16 86. DINH_FIdVerb 0.00 86. FORMAT "%2.0" READ_ONLY NUMBER 3 /end CHARACTERISTIC
/begin CHARACTERISTIC DINH_FId.DFC_Com_ABSInfo_DLC_CA "inhibitable FIds / FIds to be inhibited by inhibit source DFC_Com_ABSInfo_DLC" VAL_BLK 0x9080692 ValA_Wu16 86. DINH_FIdVerb 0.00 86. FORMAT "%2.0" READ_ONLY NUMBER 2 /end CHARACTERISTIC
/begin CHARACTERISTIC DINH_FId.DFC_Com_ABSInfo_TO_CA "inhibitable FIds / FIds to be inhibited by inhibit source DFC_Com_ABSInfo_TO" VAL_BLK 0x9080696 ValA_Wu16 86. DINH_FIdVerb 0.00 86. FORMAT "%2.0" READ_ONLY NUMBER 2 /end CHARACTERISTIC
/begin CHARACTERISTIC DINH_FId.DFC_BusDiagBusOff_Can0_CA "inhibitable FIds / FIds to be inhibited by inhibit source DFC_BusDiagBusOff_Can0" VAL_BLK 0x908069A ValA_Wu16 86. DINH_FIdVerb 0.00 86. FORMAT "%2.0" READ_ONLY NUMBER 3 /end CHARACTERISTIC
/begin CHARACTERISTIC DINH_FId.DFC_DevLibBattUHi_CA "inhibitable FIds / FIds to be inhibited by inhibit source DFC_DevLibBattUHi" VAL_BLK 0x90806A0 ValA_Wu16 86. DINH_FIdVerb 0.00 86. FORMAT "%2.0" READ_ONLY NUMBER 2 /end CHARACTERISTIC
/begin CHARACTERISTIC DINH_FId.DFC_DevLibBattULo_CA "inhibitable FIds / FIds to be inhibited by inhibit source DFC_DevLibBattULo" VAL_BLK 0x90806A4 ValA_Wu16 86. DINH_FIdVerb 0.00 86. FORMAT "%2.0" READ_ONLY NUMBER 2 /end CHARACTERISTIC
/begin CHARACTERISTIC DINH_FId.DFC_StrtOL_CA "inhibitable FIds / FIds to be inhibited by inhibit source DFC_StrtOL" VAL_BLK 0x90806A8 ValA_Wu16 86. DINH_FIdVerb 0.00 86. FORMAT "%2.0" READ_ONLY NUMBER 3 /end CHARACTERISTIC
/begin CHARACTERISTIC DINH_FId.DFC_StrtOvrTemp_CA "inhibitable FIds / FIds to be inhibited by inhibit source DFC_StrtOvrTemp" VAL_BLK 0x90806AE ValA_Wu16 86. DINH_FIdVerb 0.00 86. FORMAT "%2.0" READ_ONLY NUMBER 2 /end CHARACTERISTIC
/begin CHARACTERISTIC DINH_FId.DFC_StrtSCB_CA "inhibitable FIds / FIds to be inhibited by inhibit source DFC_StrtSCB" VAL_BLK 0x90806B2 ValA_Wu16 86. DINH_FIdVerb 0.00 86. FORMAT "%2.0" READ_ONLY NUMBER 3 /end CHARACTERISTIC
/begin CHARACTERISTIC DINH_FId.DFC_StrtSCG_CA "inhibitable FIds / FIds to be inhibited by inhibit source DFC_StrtSCG" VAL_BLK 0x90806B8 ValA_Wu16 86. DINH_FIdVerb 0.00 86. FORMAT "%2.0" READ_ONLY NUMBER 3 /end CHARACTERISTIC
/begin CHARACTERISTIC DINH_FId.DFC_MILLmpOL_CA "inhibitable FIds / FIds to be inhibited by inhibit source DFC_MILLmpOL" VAL_BLK 0x90806BE ValA_Wu16 86. DINH_FIdVerb 0.00 86. FORMAT "%2.0" READ_ONLY NUMBER 2 /end CHARACTERISTIC
/begin CHARACTERISTIC DINH_FId.DFC_MILLmpOT_CA "inhibitable FIds / FIds to be inhibited by inhibit source DFC_MILLmpOT" VAL_BLK 0x90806C2 ValA_Wu16 86. DINH_FIdVerb 0.00 86. FORMAT "%2.0" READ_ONLY NUMBER 2 /end CHARACTERISTIC
/begin CHARACTERISTIC DINH_FId.DFC_MILLmpSCB_CA "inhibitable FIds / FIds to be inhibited by inhibit source DFC_MILLmpSCB" VAL_BLK 0x90806C6 ValA_Wu16 86. DINH_FIdVerb 0.00 86. FORMAT "%2.0" READ_ONLY NUMBER 2 /end CHARACTERISTIC
/begin CHARACTERISTIC DINH_FId.DFC_MILLmpSCG_CA "inhibitable FIds / FIds to be inhibited by inhibit source DFC_MILLmpSCG" VAL_BLK 0x90806CA ValA_Wu16 86. DINH_FIdVerb 0.00 86. FORMAT "%2.0" READ_ONLY NUMBER 2 /end CHARACTERISTIC
/begin CHARACTERISTIC DINH_FId.DFC_EV1max_CA "inhibitable FIds / FIds to be inhibited by inhibit source DFC_EV1max" VAL_BLK 0x90806CE ValA_Wu16 86. DINH_FIdVerb 0.00 86. FORMAT "%2.0" READ_ONLY NUMBER 4 /end CHARACTERISTIC
/begin CHARACTERISTIC DINH_FId.DFC_EV1min_CA "inhibitable FIds / FIds to be inhibited by inhibit source DFC_EV1min" VAL_BLK 0x90806D6 ValA_Wu16 86. DINH_FIdVerb 0.00 86. FORMAT "%2.0" READ_ONLY NUMBER 6 /end CHARACTERISTIC
/begin CHARACTERISTIC DINH_FId.DFC_EV1sig_CA "inhibitable FIds / FIds to be inhibited by inhibit source DFC_EV1sig" VAL_BLK 0x90806E2 ValA_Wu16 86. DINH_FIdVerb 0.00 86. FORMAT "%2.0" READ_ONLY NUMBER 4 /end CHARACTERISTIC
/begin CHARACTERISTIC DINH_FId.DFC_CEngDsTPlausSTC_CA "inhibitable FIds / FIds to be inhibited by inhibit source DFC_CEngDsTPlausSTC" VAL_BLK 0x90806EA ValA_Wu16 86. DINH_FIdVerb 0.00 86. FORMAT "%2.0" READ_ONLY NUMBER 13 /end CHARACTERISTIC
/begin CHARACTERISTIC DINH_FId.DFC_ClthStkOpn_CA "inhibitable FIds / FIds to be inhibited by inhibit source DFC_ClthStkOpn" VAL_BLK 0x9080704 ValA_Wu16 86. DINH_FIdVerb 0.00 86. FORMAT "%2.0" READ_ONLY NUMBER 5 /end CHARACTERISTIC
/begin CHARACTERISTIC DINH_FId.DFC_EVX_CA "inhibitable FIds / FIds to be inhibited by inhibit source DFC_EVX" VAL_BLK 0x908070E ValA_Wu16 86. DINH_FIdVerb 0.00 86. FORMAT "%2.0" READ_ONLY NUMBER 2 /end CHARACTERISTIC
/begin CHARACTERISTIC DINH_FId.DFC_IntkAirTAirFltDsSTC_CA "inhibitable FIds / FIds to be inhibited by inhibit source DFC_IntkAirTAirFltDsSTC" VAL_BLK 0x9080712 ValA_Wu16 86. DINH_FIdVerb 0.00 86. FORMAT "%2.0" READ_ONLY NUMBER 8 /end CHARACTERISTIC
/begin CHARACTERISTIC DINH_FId.DFC_RoughRoad_CA "inhibitable FIds / FIds to be inhibited by inhibit source DFC_RoughRoad" VAL_BLK 0x9080722 ValA_Wu16 86. DINH_FIdVerb 0.00 86. FORMAT "%2.0" READ_ONLY NUMBER 2 /end CHARACTERISTIC
/begin CHARACTERISTIC DINH_FId.DFC_SSpMon1_CA "inhibitable FIds / FIds to be inhibited by inhibit source DFC_SSpMon1" VAL_BLK 0x9080726 ValA_Wu16 86. DINH_FIdVerb 0.00 86. FORMAT "%2.0" READ_ONLY NUMBER 6 /end CHARACTERISTIC
/begin CHARACTERISTIC DINH_FId.DFC_SSpMon1OT_CA "inhibitable FIds / FIds to be inhibited by inhibit source DFC_SSpMon1OT" VAL_BLK 0x9080732 ValA_Wu16 86. DINH_FIdVerb 0.00 86. FORMAT "%2.0" READ_ONLY NUMBER 2 /end CHARACTERISTIC
/begin CHARACTERISTIC DINH_FId.DFC_SSpMon1OV_CA "inhibitable FIds / FIds to be inhibited by inhibit source DFC_SSpMon1OV" VAL_BLK 0x9080736 ValA_Wu16 86. DINH_FIdVerb 0.00 86. FORMAT "%2.0" READ_ONLY NUMBER 3 /end CHARACTERISTIC
/begin CHARACTERISTIC DINH_FId.DFC_SSpMon1SCG_CA "inhibitable FIds / FIds to be inhibited by inhibit source DFC_SSpMon1SCG" VAL_BLK 0x908073C ValA_Wu16 86. DINH_FIdVerb 0.00 86. FORMAT "%2.0" READ_ONLY NUMBER 3 /end CHARACTERISTIC
/begin CHARACTERISTIC DINH_FId.DFC_SSpMon1UV_CA "inhibitable FIds / FIds to be inhibited by inhibit source DFC_SSpMon1UV" VAL_BLK 0x9080742 ValA_Wu16 86. DINH_FIdVerb 0.00 86. FORMAT "%2.0" READ_ONLY NUMBER 2 /end CHARACTERISTIC
/begin CHARACTERISTIC DINH_FId.DFC_SSpMon2_CA "inhibitable FIds / FIds to be inhibited by inhibit source DFC_SSpMon2" VAL_BLK 0x9080746 ValA_Wu16 86. DINH_FIdVerb 0.00 86. FORMAT "%2.0" READ_ONLY NUMBER 3 /end CHARACTERISTIC
/begin CHARACTERISTIC DINH_FId.DFC_SSpMon2OT_CA "inhibitable FIds / FIds to be inhibited by inhibit source DFC_SSpMon2OT" VAL_BLK 0x908074C ValA_Wu16 86. DINH_FIdVerb 0.00 86. FORMAT "%2.0" READ_ONLY NUMBER 2 /end CHARACTERISTIC
/begin CHARACTERISTIC DINH_FId.DFC_SSpMon2OV_CA "inhibitable FIds / FIds to be inhibited by inhibit source DFC_SSpMon2OV" VAL_BLK 0x9080750 ValA_Wu16 86. DINH_FIdVerb 0.00 86. FORMAT "%2.0" READ_ONLY NUMBER 3 /end CHARACTERISTIC
/begin CHARACTERISTIC DINH_FId.DFC_SSpMon2SCG_CA "inhibitable FIds / FIds to be inhibited by inhibit source DFC_SSpMon2SCG" VAL_BLK 0x9080756 ValA_Wu16 86. DINH_FIdVerb 0.00 86. FORMAT "%2.0" READ_ONLY NUMBER 3 /end CHARACTERISTIC
/begin CHARACTERISTIC DINH_FId.DFC_SSpMon2UV_CA "inhibitable FIds / FIds to be inhibited by inhibit source DFC_SSpMon2UV" VAL_BLK 0x908075C ValA_Wu16 86. DINH_FIdVerb 0.00 86. FORMAT "%2.0" READ_ONLY NUMBER 2 /end CHARACTERISTIC
/begin CHARACTERISTIC DINH_FId.DFC_CANIF_E_CTRL_NOT_SLEEP_ERROR_VALUE_CA "inhibitable FIds / FIds to be inhibited by inhibit source DFC_CANIF_E_CTRL_NOT_SLEEP_ERROR_VALUE" VAL_BLK 0x9080760 ValA_Wu16 86. DINH_FIdVerb 0.00 86. FORMAT "%2.0" READ_ONLY NUMBER 2 /end CHARACTERISTIC
/begin CHARACTERISTIC DINH_FId.DFC_CANIF_E_CTRL_STOPPED_ERROR_VALUE_CA "inhibitable FIds / FIds to be inhibited by inhibit source DFC_CANIF_E_CTRL_STOPPED_ERROR_VALUE" VAL_BLK 0x9080764 ValA_Wu16 86. DINH_FIdVerb 0.00 86. FORMAT "%2.0" READ_ONLY NUMBER 2 /end CHARACTERISTIC
/begin CHARACTERISTIC DINH_FId.DFC_CANIF_E_INVALID_DLC_ERROR_CA "inhibitable FIds / FIds to be inhibited by inhibit source DFC_CANIF_E_INVALID_DLC_ERROR" VAL_BLK 0x9080768 ValA_Wu16 86. DINH_FIdVerb 0.00 86. FORMAT "%2.0" READ_ONLY NUMBER 2 /end CHARACTERISTIC
/begin CHARACTERISTIC DINH_FId.DFC_CANNM_E_CANIF_TRANSMIT_ERROR_CA "inhibitable FIds / FIds to be inhibited by inhibit source DFC_CANNM_E_CANIF_TRANSMIT_ERROR" VAL_BLK 0x908076C ValA_Wu16 86. DINH_FIdVerb 0.00 86. FORMAT "%2.0" READ_ONLY NUMBER 2 /end CHARACTERISTIC
/begin CHARACTERISTIC DINH_FId.DFC_CANNM_E_INIT_FAILED_CA "inhibitable FIds / FIds to be inhibited by inhibit source DFC_CANNM_E_INIT_FAILED" VAL_BLK 0x9080770 ValA_Wu16 86. DINH_FIdVerb 0.00 86. FORMAT "%2.0" READ_ONLY NUMBER 2 /end CHARACTERISTIC
/begin CHARACTERISTIC DINH_FId.DFC_CANNM_E_NETWORK_TIMEOUT_CA "inhibitable FIds / FIds to be inhibited by inhibit source DFC_CANNM_E_NETWORK_TIMEOUT" VAL_BLK 0x9080774 ValA_Wu16 86. DINH_FIdVerb 0.00 86. FORMAT "%2.0" READ_ONLY NUMBER 2 /end CHARACTERISTIC
/begin CHARACTERISTIC DINH_FId.DFC_CAN_E_TIMEOUT_CA "inhibitable FIds / FIds to be inhibited by inhibit source DFC_CAN_E_TIMEOUT" VAL_BLK 0x9080778 ValA_Wu16 86. DINH_FIdVerb 0.00 86. FORMAT "%2.0" READ_ONLY NUMBER 2 /end CHARACTERISTIC
/begin CHARACTERISTIC DINH_FId.DFC_COMM_E_NET_START_IND_CHANNEL_0_CA "inhibitable FIds / FIds to be inhibited by inhibit source DFC_COMM_E_NET_START_IND_CHANNEL_0" VAL_BLK 0x908077C ValA_Wu16 86. DINH_FIdVerb 0.00 86. FORMAT "%2.0" READ_ONLY NUMBER 2 /end CHARACTERISTIC
/begin CHARACTERISTIC DINH_FId.DFC_COMM_E_NET_START_IND_CHANNEL_1_CA "inhibitable FIds / FIds to be inhibited by inhibit source DFC_COMM_E_NET_START_IND_CHANNEL_1" VAL_BLK 0x9080780 ValA_Wu16 86. DINH_FIdVerb 0.00 86. FORMAT "%2.0" READ_ONLY NUMBER 2 /end CHARACTERISTIC
/begin CHARACTERISTIC DINH_FId.DFC_COMM_E_NET_START_IND_CHANNEL_2_CA "inhibitable FIds / FIds to be inhibited by inhibit source DFC_COMM_E_NET_START_IND_CHANNEL_2" VAL_BLK 0x9080784 ValA_Wu16 86. DINH_FIdVerb 0.00 86. FORMAT "%2.0" READ_ONLY NUMBER 2 /end CHARACTERISTIC
/begin CHARACTERISTIC DINH_FId.DFC_COMM_E_NET_START_IND_CHANNEL_3_CA "inhibitable FIds / FIds to be inhibited by inhibit source DFC_COMM_E_NET_START_IND_CHANNEL_3" VAL_BLK 0x9080788 ValA_Wu16 86. DINH_FIdVerb 0.00 86. FORMAT "%2.0" READ_ONLY NUMBER 2 /end CHARACTERISTIC
/begin CHARACTERISTIC DINH_FId.DFC_COMM_E_NET_START_IND_CHANNEL_4_CA "inhibitable FIds / FIds to be inhibited by inhibit source DFC_COMM_E_NET_START_IND_CHANNEL_4" VAL_BLK 0x908078C ValA_Wu16 86. DINH_FIdVerb 0.00 86. FORMAT "%2.0" READ_ONLY NUMBER 2 /end CHARACTERISTIC
/begin CHARACTERISTIC DINH_FId.DFC_COMM_E_NET_START_IND_CHANNEL_5_CA "inhibitable FIds / FIds to be inhibited by inhibit source DFC_COMM_E_NET_START_IND_CHANNEL_5" VAL_BLK 0x9080790 ValA_Wu16 86. DINH_FIdVerb 0.00 86. FORMAT "%2.0" READ_ONLY NUMBER 2 /end CHARACTERISTIC
/begin CHARACTERISTIC DINH_FId.DFC_PDUR_E_INIT_FAILED_CA "inhibitable FIds / FIds to be inhibited by inhibit source DFC_PDUR_E_INIT_FAILED" VAL_BLK 0x9080794 ValA_Wu16 86. DINH_FIdVerb 0.00 86. FORMAT "%2.0" READ_ONLY NUMBER 2 /end CHARACTERISTIC
/begin CHARACTERISTIC DINH_FId.DFC_PDUR_E_PDU_INSTANCE_LOST_CA "inhibitable FIds / FIds to be inhibited by inhibit source DFC_PDUR_E_PDU_INSTANCE_LOST" VAL_BLK 0x9080798 ValA_Wu16 86. DINH_FIdVerb 0.00 86. FORMAT "%2.0" READ_ONLY NUMBER 2 /end CHARACTERISTIC
/begin CHARACTERISTIC DINH_FId.DFC_RBA_IOEXTLIB_KEEPALIVE_DRV_CA "inhibitable FIds / FIds to be inhibited by inhibit source DFC_RBA_IOEXTLIB_KEEPALIVE_DRV" VAL_BLK 0x908079C ValA_Wu16 86. DINH_FIdVerb 0.00 86. FORMAT "%2.0" READ_ONLY NUMBER 2 /end CHARACTERISTIC
/begin CHARACTERISTIC DINH_FId.DFC_RBA_IOEXTLIB_KEEPALIVE_INI_CA "inhibitable FIds / FIds to be inhibited by inhibit source DFC_RBA_IOEXTLIB_KEEPALIVE_INI" VAL_BLK 0x90807A0 ValA_Wu16 86. DINH_FIdVerb 0.00 86. FORMAT "%2.0" READ_ONLY NUMBER 2 /end CHARACTERISTIC
/begin CHARACTERISTIC DINH_FId.DFC_rba_IoSigRtc_StopCounter_CA "inhibitable FIds / FIds to be inhibited by inhibit source DFC_rba_IoSigRtc_StopCounter" VAL_BLK 0x90807A4 ValA_Wu16 86. DINH_FIdVerb 0.00 86. FORMAT "%2.0" READ_ONLY NUMBER 2 /end CHARACTERISTIC
/begin CHARACTERISTIC DINH_FId.DFC_rba_MultiStackTrace_Threshold_CA "inhibitable FIds / FIds to be inhibited by inhibit source DFC_rba_MultiStackTrace_Threshold" VAL_BLK 0x90807A8 ValA_Wu16 86. DINH_FIdVerb 0.00 86. FORMAT "%2.0" READ_ONLY NUMBER 2 /end CHARACTERISTIC
/begin CHARACTERISTIC DINH_FId.DFC_rba_MRly_Diag_Stk_Event_CA "inhibitable FIds / FIds to be inhibited by inhibit source DFC_rba_MRly_Diag_Stk_Event" VAL_BLK 0x90807AC ValA_Wu16 86. DINH_FIdVerb 0.00 86. FORMAT "%2.0" READ_ONLY NUMBER 2 /end CHARACTERISTIC
/begin CHARACTERISTIC DINH_FId.DFC_rba_SyC_IrrSwOffTrigEngRun_Event_CA "inhibitable FIds / FIds to be inhibited by inhibit source DFC_rba_SyC_IrrSwOffTrigEngRun_Event" VAL_BLK 0x90807B0 ValA_Wu16 86. DINH_FIdVerb 0.00 86. FORMAT "%2.0" READ_ONLY NUMBER 2 /end CHARACTERISTIC
/begin CHARACTERISTIC DINH_FId.DFC_rba_T15_Diag_ComInVld_Event_CA "inhibitable FIds / FIds to be inhibited by inhibit source DFC_rba_T15_Diag_ComInVld_Event" VAL_BLK 0x90807B4 ValA_Wu16 86. DINH_FIdVerb 0.00 86. FORMAT "%2.0" READ_ONLY NUMBER 2 /end CHARACTERISTIC
/begin CHARACTERISTIC DINH_FId.DFC_rba_T15_Diag_ComOff_HwOn_Event_CA "inhibitable FIds / FIds to be inhibited by inhibit source DFC_rba_T15_Diag_ComOff_HwOn_Event" VAL_BLK 0x90807B8 ValA_Wu16 86. DINH_FIdVerb 0.00 86. FORMAT "%2.0" READ_ONLY NUMBER 2 /end CHARACTERISTIC
/begin CHARACTERISTIC DINH_FId.DFC_rba_T15_Diag_ComOn_HwOff_Event_CA "inhibitable FIds / FIds to be inhibited by inhibit source DFC_rba_T15_Diag_ComOn_HwOff_Event" VAL_BLK 0x90807BC ValA_Wu16 86. DINH_FIdVerb 0.00 86. FORMAT "%2.0" READ_ONLY NUMBER 2 /end CHARACTERISTIC
/begin CHARACTERISTIC DINH_FId.DFC_BypAirActrOcCoil1_CA "inhibitable FIds / FIds to be inhibited by inhibit source DFC_BypAirActrOcCoil1" VAL_BLK 0x90807C0 ValA_Wu16 86. DINH_FIdVerb 0.00 86. FORMAT "%2.0" READ_ONLY NUMBER 7 /end CHARACTERISTIC
/begin CHARACTERISTIC DINH_FId.DFC_BypAirActrOcCoil2_CA "inhibitable FIds / FIds to be inhibited by inhibit source DFC_BypAirActrOcCoil2" VAL_BLK 0x90807CE ValA_Wu16 86. DINH_FIdVerb 0.00 86. FORMAT "%2.0" READ_ONLY NUMBER 7 /end CHARACTERISTIC
/begin CHARACTERISTIC DINH_FId.DFC_BypAirActrOlCoil1_CA "inhibitable FIds / FIds to be inhibited by inhibit source DFC_BypAirActrOlCoil1" VAL_BLK 0x90807DC ValA_Wu16 86. DINH_FIdVerb 0.00 86. FORMAT "%2.0" READ_ONLY NUMBER 7 /end CHARACTERISTIC
/begin CHARACTERISTIC DINH_FId.DFC_BypAirActrOlCoil2_CA "inhibitable FIds / FIds to be inhibited by inhibit source DFC_BypAirActrOlCoil2" VAL_BLK 0x90807EA ValA_Wu16 86. DINH_FIdVerb 0.00 86. FORMAT "%2.0" READ_ONLY NUMBER 7 /end CHARACTERISTIC
/begin CHARACTERISTIC DINH_FId.DFC_BypAirActrOt_CA "inhibitable FIds / FIds to be inhibited by inhibit source DFC_BypAirActrOt" VAL_BLK 0x90807F8 ValA_Wu16 86. DINH_FIdVerb 0.00 86. FORMAT "%2.0" READ_ONLY NUMBER 7 /end CHARACTERISTIC
/begin CHARACTERISTIC DINH_FId.DFC_BypAirActrScbCoil1_CA "inhibitable FIds / FIds to be inhibited by inhibit source DFC_BypAirActrScbCoil1" VAL_BLK 0x9080806 ValA_Wu16 86. DINH_FIdVerb 0.00 86. FORMAT "%2.0" READ_ONLY NUMBER 8 /end CHARACTERISTIC
/begin CHARACTERISTIC DINH_FId.DFC_BypAirActrScbCoil2_CA "inhibitable FIds / FIds to be inhibited by inhibit source DFC_BypAirActrScbCoil2" VAL_BLK 0x9080816 ValA_Wu16 86. DINH_FIdVerb 0.00 86. FORMAT "%2.0" READ_ONLY NUMBER 8 /end CHARACTERISTIC
/begin CHARACTERISTIC DINH_FId.DFC_BypAirActrScgCoil1_CA "inhibitable FIds / FIds to be inhibited by inhibit source DFC_BypAirActrScgCoil1" VAL_BLK 0x9080826 ValA_Wu16 86. DINH_FIdVerb 0.00 86. FORMAT "%2.0" READ_ONLY NUMBER 8 /end CHARACTERISTIC
/begin CHARACTERISTIC DINH_FId.DFC_BypAirActrScgCoil2_CA "inhibitable FIds / FIds to be inhibited by inhibit source DFC_BypAirActrScgCoil2" VAL_BLK 0x9080836 ValA_Wu16 86. DINH_FIdVerb 0.00 86. FORMAT "%2.0" READ_ONLY NUMBER 7 /end CHARACTERISTIC
/begin CHARACTERISTIC DINH_FId.DFC_CEngDsTPhysRngHi_CA "inhibitable FIds / FIds to be inhibited by inhibit source DFC_CEngDsTPhysRngHi" VAL_BLK 0x9080844 ValA_Wu16 86. DINH_FIdVerb 0.00 86. FORMAT "%2.0" READ_ONLY NUMBER 14 /end CHARACTERISTIC
/begin CHARACTERISTIC DINH_FId.DFC_CEngDsTPhysRngLo_CA "inhibitable FIds / FIds to be inhibited by inhibit source DFC_CEngDsTPhysRngLo" VAL_BLK 0x9080860 ValA_Wu16 86. DINH_FIdVerb 0.00 86. FORMAT "%2.0" READ_ONLY NUMBER 14 /end CHARACTERISTIC
/begin CHARACTERISTIC DINH_FId.DFC_CEngDsTSRCMax_CA "inhibitable FIds / FIds to be inhibited by inhibit source DFC_CEngDsTSRCMax" VAL_BLK 0x908087C ValA_Wu16 86. DINH_FIdVerb 0.00 86. FORMAT "%2.0" READ_ONLY NUMBER 16 /end CHARACTERISTIC
/begin CHARACTERISTIC DINH_FId.DFC_CEngDsTSRCMin_CA "inhibitable FIds / FIds to be inhibited by inhibit source DFC_CEngDsTSRCMin" VAL_BLK 0x908089C ValA_Wu16 86. DINH_FIdVerb 0.00 86. FORMAT "%2.0" READ_ONLY NUMBER 16 /end CHARACTERISTIC
/begin CHARACTERISTIC DINH_FId.DFC_DKmax_CA "inhibitable FIds / FIds to be inhibited by inhibit source DFC_DKmax" VAL_BLK 0x90808BC ValA_Wu16 86. DINH_FIdVerb 0.00 86. FORMAT "%2.0" READ_ONLY NUMBER 6 /end CHARACTERISTIC
/begin CHARACTERISTIC DINH_FId.DFC_DKmin_CA "inhibitable FIds / FIds to be inhibited by inhibit source DFC_DKmin" VAL_BLK 0x90808C8 ValA_Wu16 86. DINH_FIdVerb 0.00 86. FORMAT "%2.0" READ_ONLY NUMBER 6 /end CHARACTERISTIC
/begin CHARACTERISTIC DINH_FId.DFC_DLLRmax_CA "inhibitable FIds / FIds to be inhibited by inhibit source DFC_DLLRmax" VAL_BLK 0x90808D4 ValA_Wu16 86. DINH_FIdVerb 0.00 86. FORMAT "%2.0" READ_ONLY NUMBER 3 /end CHARACTERISTIC
/begin CHARACTERISTIC DINH_FId.DFC_DLLRmin_CA "inhibitable FIds / FIds to be inhibited by inhibit source DFC_DLLRmin" VAL_BLK 0x90808DA ValA_Wu16 86. DINH_FIdVerb 0.00 86. FORMAT "%2.0" READ_ONLY NUMBER 3 /end CHARACTERISTIC
/begin CHARACTERISTIC DINH_FId.DFC_DLLRnpl_CA "inhibitable FIds / FIds to be inhibited by inhibit source DFC_DLLRnpl" VAL_BLK 0x90808E0 ValA_Wu16 86. DINH_FIdVerb 0.00 86. FORMAT "%2.0" READ_ONLY NUMBER 3 /end CHARACTERISTIC
/begin CHARACTERISTIC DINH_FId.DFC_DSSRngMax_CA "inhibitable FIds / FIds to be inhibited by inhibit source DFC_DSSRngMax" VAL_BLK 0x90808E6 ValA_Wu16 86. DINH_FIdVerb 0.00 86. FORMAT "%2.0" READ_ONLY NUMBER 4 /end CHARACTERISTIC
/begin CHARACTERISTIC DINH_FId.DFC_DSSRngMin_CA "inhibitable FIds / FIds to be inhibited by inhibit source DFC_DSSRngMin" VAL_BLK 0x90808EE ValA_Wu16 86. DINH_FIdVerb 0.00 86. FORMAT "%2.0" READ_ONLY NUMBER 4 /end CHARACTERISTIC
/begin CHARACTERISTIC DINH_FId.DFC_DSSmax_CA "inhibitable FIds / FIds to be inhibited by inhibit source DFC_DSSmax" VAL_BLK 0x90808F6 ValA_Wu16 86. DINH_FIdVerb 0.00 86. FORMAT "%2.0" READ_ONLY NUMBER 14 /end CHARACTERISTIC
/begin CHARACTERISTIC DINH_FId.DFC_DSSmin_CA "inhibitable FIds / FIds to be inhibited by inhibit source DFC_DSSmin" VAL_BLK 0x9080912 ValA_Wu16 86. DINH_FIdVerb 0.00 86. FORMAT "%2.0" READ_ONLY NUMBER 13 /end CHARACTERISTIC
/begin CHARACTERISTIC DINH_FId.DFC_DSSnpl_CA "inhibitable FIds / FIds to be inhibited by inhibit source DFC_DSSnpl" VAL_BLK 0x908092C ValA_Wu16 86. DINH_FIdVerb 0.00 86. FORMAT "%2.0" READ_ONLY NUMBER 6 /end CHARACTERISTIC
/begin CHARACTERISTIC DINH_FId.DFC_DSSnplMax_CA "inhibitable FIds / FIds to be inhibited by inhibit source DFC_DSSnplMax" VAL_BLK 0x9080938 ValA_Wu16 86. DINH_FIdVerb 0.00 86. FORMAT "%2.0" READ_ONLY NUMBER 9 /end CHARACTERISTIC
/begin CHARACTERISTIC DINH_FId.DFC_DSSnplMin_CA "inhibitable FIds / FIds to be inhibited by inhibit source DFC_DSSnplMin" VAL_BLK 0x908094A ValA_Wu16 86. DINH_FIdVerb 0.00 86. FORMAT "%2.0" READ_ONLY NUMBER 9 /end CHARACTERISTIC
/begin CHARACTERISTIC DINH_FId.DFC_DSSsig_CA "inhibitable FIds / FIds to be inhibited by inhibit source DFC_DSSsig" VAL_BLK 0x908095C ValA_Wu16 86. DINH_FIdVerb 0.00 86. FORMAT "%2.0" READ_ONLY NUMBER 4 /end CHARACTERISTIC
/begin CHARACTERISTIC DINH_FId.DFC_EpmCrSErrSig_CA "inhibitable FIds / FIds to be inhibited by inhibit source DFC_EpmCrSErrSig" VAL_BLK 0x9080964 ValA_Wu16 86. DINH_FIdVerb 0.00 86. FORMAT "%2.0" READ_ONLY NUMBER 6 /end CHARACTERISTIC
/begin CHARACTERISTIC DINH_FId.DFC_EpmCrSNoSig_CA "inhibitable FIds / FIds to be inhibited by inhibit source DFC_EpmCrSNoSig" VAL_BLK 0x9080970 ValA_Wu16 86. DINH_FIdVerb 0.00 86. FORMAT "%2.0" READ_ONLY NUMBER 8 /end CHARACTERISTIC
/begin CHARACTERISTIC DINH_FId.DFC_HEGOS1B1ElecNpl_CA "inhibitable FIds / FIds to be inhibited by inhibit source DFC_HEGOS1B1ElecNpl" VAL_BLK 0x9080980 ValA_Wu16 86. DINH_FIdVerb 0.00 86. FORMAT "%2.0" READ_ONLY NUMBER 2 /end CHARACTERISTIC
/begin CHARACTERISTIC DINH_FId.DFC_HSH_CA "inhibitable FIds / FIds to be inhibited by inhibit source DFC_HSH" VAL_BLK 0x9080984 ValA_Wu16 86. DINH_FIdVerb 0.00 86. FORMAT "%2.0" READ_ONLY NUMBER 7 /end CHARACTERISTIC
/begin CHARACTERISTIC DINH_FId.DFC_HSHEmax_CA "inhibitable FIds / FIds to be inhibited by inhibit source DFC_HSHEmax" VAL_BLK 0x9080992 ValA_Wu16 86. DINH_FIdVerb 0.00 86. FORMAT "%2.0" READ_ONLY NUMBER 10 /end CHARACTERISTIC
/begin CHARACTERISTIC DINH_FId.DFC_HSHEmin_CA "inhibitable FIds / FIds to be inhibited by inhibit source DFC_HSHEmin" VAL_BLK 0x90809A6 ValA_Wu16 86. DINH_FIdVerb 0.00 86. FORMAT "%2.0" READ_ONLY NUMBER 10 /end CHARACTERISTIC
/begin CHARACTERISTIC DINH_FId.DFC_HSHEsig_CA "inhibitable FIds / FIds to be inhibited by inhibit source DFC_HSHEsig" VAL_BLK 0x90809BA ValA_Wu16 86. DINH_FIdVerb 0.00 86. FORMAT "%2.0" READ_ONLY NUMBER 10 /end CHARACTERISTIC
/begin CHARACTERISTIC DINH_FId.DFC_HSV_CA "inhibitable FIds / FIds to be inhibited by inhibit source DFC_HSV" VAL_BLK 0x90809CE ValA_Wu16 86. DINH_FIdVerb 0.00 86. FORMAT "%2.0" READ_ONLY NUMBER 9 /end CHARACTERISTIC
/begin CHARACTERISTIC DINH_FId.DFC_HSVEmax_CA "inhibitable FIds / FIds to be inhibited by inhibit source DFC_HSVEmax" VAL_BLK 0x90809E0 ValA_Wu16 86. DINH_FIdVerb 0.00 86. FORMAT "%2.0" READ_ONLY NUMBER 10 /end CHARACTERISTIC
/begin CHARACTERISTIC DINH_FId.DFC_HSVEmin_CA "inhibitable FIds / FIds to be inhibited by inhibit source DFC_HSVEmin" VAL_BLK 0x90809F4 ValA_Wu16 86. DINH_FIdVerb 0.00 86. FORMAT "%2.0" READ_ONLY NUMBER 10 /end CHARACTERISTIC
/begin CHARACTERISTIC DINH_FId.DFC_HSVEsig_CA "inhibitable FIds / FIds to be inhibited by inhibit source DFC_HSVEsig" VAL_BLK 0x9080A08 ValA_Wu16 86. DINH_FIdVerb 0.00 86. FORMAT "%2.0" READ_ONLY NUMBER 10 /end CHARACTERISTIC
/begin CHARACTERISTIC DINH_FId.DFC_HdLampMax_CA "inhibitable FIds / FIds to be inhibited by inhibit source DFC_HdLampMax" VAL_BLK 0x9080A1C ValA_Wu16 86. DINH_FIdVerb 0.00 86. FORMAT "%2.0" READ_ONLY NUMBER 2 /end CHARACTERISTIC
/begin CHARACTERISTIC DINH_FId.DFC_HdLampMin_CA "inhibitable FIds / FIds to be inhibited by inhibit source DFC_HdLampMin" VAL_BLK 0x9080A20 ValA_Wu16 86. DINH_FIdVerb 0.00 86. FORMAT "%2.0" READ_ONLY NUMBER 2 /end CHARACTERISTIC
/begin CHARACTERISTIC DINH_FId.DFC_HdLampSig_CA "inhibitable FIds / FIds to be inhibited by inhibit source DFC_HdLampSig" VAL_BLK 0x9080A24 ValA_Wu16 86. DINH_FIdVerb 0.00 86. FORMAT "%2.0" READ_ONLY NUMBER 2 /end CHARACTERISTIC
/begin CHARACTERISTIC DINH_FId.DFC_IgnCoil1Err_CA "inhibitable FIds / FIds to be inhibited by inhibit source DFC_IgnCoil1Err" VAL_BLK 0x9080A28 ValA_Wu16 86. DINH_FIdVerb 0.00 86. FORMAT "%2.0" READ_ONLY NUMBER 2 /end CHARACTERISTIC
/begin CHARACTERISTIC DINH_FId.DFC_IgnCoil2Err_CA "inhibitable FIds / FIds to be inhibited by inhibit source DFC_IgnCoil2Err" VAL_BLK 0x9080A2C ValA_Wu16 86. DINH_FIdVerb 0.00 86. FORMAT "%2.0" READ_ONLY NUMBER 2 /end CHARACTERISTIC
/begin CHARACTERISTIC DINH_FId.DFC_IgnIgbtDiagSCG_0_CA "inhibitable FIds / FIds to be inhibited by inhibit source DFC_IgnIgbtDiagSCG_0" VAL_BLK 0x9080A30 ValA_Wu16 86. DINH_FIdVerb 0.00 86. FORMAT "%2.0" READ_ONLY NUMBER 3 /end CHARACTERISTIC
/begin CHARACTERISTIC DINH_FId.DFC_IgnIgbtDiagSCG_1_CA "inhibitable FIds / FIds to be inhibited by inhibit source DFC_IgnIgbtDiagSCG_1" VAL_BLK 0x9080A36 ValA_Wu16 86. DINH_FIdVerb 0.00 86. FORMAT "%2.0" READ_ONLY NUMBER 3 /end CHARACTERISTIC
/begin CHARACTERISTIC DINH_FId.DFC_IntkAirTAirFltDsPRCMax_CA "inhibitable FIds / FIds to be inhibited by inhibit source DFC_IntkAirTAirFltDsPRCMax" VAL_BLK 0x9080A3C ValA_Wu16 86. DINH_FIdVerb 0.00 86. FORMAT "%2.0" READ_ONLY NUMBER 8 /end CHARACTERISTIC
/begin CHARACTERISTIC DINH_FId.DFC_IntkAirTAirFltDsPRCMin_CA "inhibitable FIds / FIds to be inhibited by inhibit source DFC_IntkAirTAirFltDsPRCMin" VAL_BLK 0x9080A4C ValA_Wu16 86. DINH_FIdVerb 0.00 86. FORMAT "%2.0" READ_ONLY NUMBER 8 /end CHARACTERISTIC
/begin CHARACTERISTIC DINH_FId.DFC_IntkAirTAirFltDsSRCMax_CA "inhibitable FIds / FIds to be inhibited by inhibit source DFC_IntkAirTAirFltDsSRCMax" VAL_BLK 0x9080A5C ValA_Wu16 86. DINH_FIdVerb 0.00 86. FORMAT "%2.0" READ_ONLY NUMBER 10 /end CHARACTERISTIC
/begin CHARACTERISTIC DINH_FId.DFC_IntkAirTAirFltDsSRCMin_CA "inhibitable FIds / FIds to be inhibited by inhibit source DFC_IntkAirTAirFltDsSRCMin" VAL_BLK 0x9080A70 ValA_Wu16 86. DINH_FIdVerb 0.00 86. FORMAT "%2.0" READ_ONLY NUMBER 10 /end CHARACTERISTIC
/begin CHARACTERISTIC DINH_FId.DFC_IntkMnfldPNoSyn_CA "inhibitable FIds / FIds to be inhibited by inhibit source DFC_IntkMnfldPNoSyn" VAL_BLK 0x9080A84 ValA_Wu16 86. DINH_FIdVerb 0.00 86. FORMAT "%2.0" READ_ONLY NUMBER 2 /end CHARACTERISTIC
/begin CHARACTERISTIC DINH_FId.DFC_KAT_CA "inhibitable FIds / FIds to be inhibited by inhibit source DFC_KAT" VAL_BLK 0x9080A88 ValA_Wu16 86. DINH_FIdVerb 0.00 86. FORMAT "%2.0" READ_ONLY NUMBER 2 /end CHARACTERISTIC
/begin CHARACTERISTIC DINH_FId.DFC_KPEmax_CA "inhibitable FIds / FIds to be inhibited by inhibit source DFC_KPEmax" VAL_BLK 0x9080A8C ValA_Wu16 86. DINH_FIdVerb 0.00 86. FORMAT "%2.0" READ_ONLY NUMBER 2 /end CHARACTERISTIC
/begin CHARACTERISTIC DINH_FId.DFC_KPEmin_CA "inhibitable FIds / FIds to be inhibited by inhibit source DFC_KPEmin" VAL_BLK 0x9080A90 ValA_Wu16 86. DINH_FIdVerb 0.00 86. FORMAT "%2.0" READ_ONLY NUMBER 2 /end CHARACTERISTIC
/begin CHARACTERISTIC DINH_FId.DFC_KPEsig_CA "inhibitable FIds / FIds to be inhibited by inhibit source DFC_KPEsig" VAL_BLK 0x9080A94 ValA_Wu16 86. DINH_FIdVerb 0.00 86. FORMAT "%2.0" READ_ONLY NUMBER 2 /end CHARACTERISTIC
/begin CHARACTERISTIC DINH_FId.DFC_KVSFmax_CA "inhibitable FIds / FIds to be inhibited by inhibit source DFC_KVSFmax" VAL_BLK 0x9080A98 ValA_Wu16 86. DINH_FIdVerb 0.00 86. FORMAT "%2.0" READ_ONLY NUMBER 6 /end CHARACTERISTIC
/begin CHARACTERISTIC DINH_FId.DFC_KVSFmin_CA "inhibitable FIds / FIds to be inhibited by inhibit source DFC_KVSFmin" VAL_BLK 0x9080AA4 ValA_Wu16 86. DINH_FIdVerb 0.00 86. FORMAT "%2.0" READ_ONLY NUMBER 6 /end CHARACTERISTIC
/begin CHARACTERISTIC DINH_FId.DFC_KVSOmax_CA "inhibitable FIds / FIds to be inhibited by inhibit source DFC_KVSOmax" VAL_BLK 0x9080AB0 ValA_Wu16 86. DINH_FIdVerb 0.00 86. FORMAT "%2.0" READ_ONLY NUMBER 6 /end CHARACTERISTIC
/begin CHARACTERISTIC DINH_FId.DFC_KVSOmin_CA "inhibitable FIds / FIds to be inhibited by inhibit source DFC_KVSOmin" VAL_BLK 0x9080ABC ValA_Wu16 86. DINH_FIdVerb 0.00 86. FORMAT "%2.0" READ_ONLY NUMBER 6 /end CHARACTERISTIC
/begin CHARACTERISTIC DINH_FId.DFC_LASHmn_CA "inhibitable FIds / FIds to be inhibited by inhibit source DFC_LASHmn" VAL_BLK 0x9080AC8 ValA_Wu16 86. DINH_FIdVerb 0.00 86. FORMAT "%2.0" READ_ONLY NUMBER 8 /end CHARACTERISTIC
/begin CHARACTERISTIC DINH_FId.DFC_LASHmx_CA "inhibitable FIds / FIds to be inhibited by inhibit source DFC_LASHmx" VAL_BLK 0x9080AD8 ValA_Wu16 86. DINH_FIdVerb 0.00 86. FORMAT "%2.0" READ_ONLY NUMBER 7 /end CHARACTERISTIC
/begin CHARACTERISTIC DINH_FId.DFC_LATP_CA "inhibitable FIds / FIds to be inhibited by inhibit source DFC_LATP" VAL_BLK 0x9080AE6 ValA_Wu16 86. DINH_FIdVerb 0.00 86. FORMAT "%2.0" READ_ONLY NUMBER 5 /end CHARACTERISTIC
/begin CHARACTERISTIC DINH_FId.DFC_LDLAHI_CA "inhibitable FIds / FIds to be inhibited by inhibit source DFC_LDLAHI" VAL_BLK 0x9080AF0 ValA_Wu16 86. DINH_FIdVerb 0.00 86. FORMAT "%2.0" READ_ONLY NUMBER 5 /end CHARACTERISTIC
/begin CHARACTERISTIC DINH_FId.DFC_LFS1Max_CA "inhibitable FIds / FIds to be inhibited by inhibit source DFC_LFS1Max" VAL_BLK 0x9080AFA ValA_Wu16 86. DINH_FIdVerb 0.00 86. FORMAT "%2.0" READ_ONLY NUMBER 2 /end CHARACTERISTIC
/begin CHARACTERISTIC DINH_FId.DFC_LFS1Min_CA "inhibitable FIds / FIds to be inhibited by inhibit source DFC_LFS1Min" VAL_BLK 0x9080AFE ValA_Wu16 86. DINH_FIdVerb 0.00 86. FORMAT "%2.0" READ_ONLY NUMBER 2 /end CHARACTERISTIC
/begin CHARACTERISTIC DINH_FId.DFC_LFS1Sig_CA "inhibitable FIds / FIds to be inhibited by inhibit source DFC_LFS1Sig" VAL_BLK 0x9080B02 ValA_Wu16 86. DINH_FIdVerb 0.00 86. FORMAT "%2.0" READ_ONLY NUMBER 2 /end CHARACTERISTIC
/begin CHARACTERISTIC DINH_FId.DFC_LSHmax_CA "inhibitable FIds / FIds to be inhibited by inhibit source DFC_LSHmax" VAL_BLK 0x9080B06 ValA_Wu16 86. DINH_FIdVerb 0.00 86. FORMAT "%2.0" READ_ONLY NUMBER 8 /end CHARACTERISTIC
/begin CHARACTERISTIC DINH_FId.DFC_LSHmin_CA "inhibitable FIds / FIds to be inhibited by inhibit source DFC_LSHmin" VAL_BLK 0x9080B16 ValA_Wu16 86. DINH_FIdVerb 0.00 86. FORMAT "%2.0" READ_ONLY NUMBER 8 /end CHARACTERISTIC
/begin CHARACTERISTIC DINH_FId.DFC_LSHnpl_CA "inhibitable FIds / FIds to be inhibited by inhibit source DFC_LSHnpl" VAL_BLK 0x9080B26 ValA_Wu16 86. DINH_FIdVerb 0.00 86. FORMAT "%2.0" READ_ONLY NUMBER 7 /end CHARACTERISTIC
/begin CHARACTERISTIC DINH_FId.DFC_LSHsig_CA "inhibitable FIds / FIds to be inhibited by inhibit source DFC_LSHsig" VAL_BLK 0x9080B34 ValA_Wu16 86. DINH_FIdVerb 0.00 86. FORMAT "%2.0" READ_ONLY NUMBER 8 /end CHARACTERISTIC
/begin CHARACTERISTIC DINH_FId.DFC_LSVmax_CA "inhibitable FIds / FIds to be inhibited by inhibit source DFC_LSVmax" VAL_BLK 0x9080B44 ValA_Wu16 86. DINH_FIdVerb 0.00 86. FORMAT "%2.0" READ_ONLY NUMBER 8 /end CHARACTERISTIC
/begin CHARACTERISTIC DINH_FId.DFC_LSVmin_CA "inhibitable FIds / FIds to be inhibited by inhibit source DFC_LSVmin" VAL_BLK 0x9080B54 ValA_Wu16 86. DINH_FIdVerb 0.00 86. FORMAT "%2.0" READ_ONLY NUMBER 8 /end CHARACTERISTIC
/begin CHARACTERISTIC DINH_FId.DFC_LSVnpl_CA "inhibitable FIds / FIds to be inhibited by inhibit source DFC_LSVnpl" VAL_BLK 0x9080B64 ValA_Wu16 86. DINH_FIdVerb 0.00 86. FORMAT "%2.0" READ_ONLY NUMBER 7 /end CHARACTERISTIC
/begin CHARACTERISTIC DINH_FId.DFC_LSVsig_CA "inhibitable FIds / FIds to be inhibited by inhibit source DFC_LSVsig" VAL_BLK 0x9080B72 ValA_Wu16 86. DINH_FIdVerb 0.00 86. FORMAT "%2.0" READ_ONLY NUMBER 8 /end CHARACTERISTIC
/begin CHARACTERISTIC DINH_FId.DFC_MDCat_CA "inhibitable FIds / FIds to be inhibited by inhibit source DFC_MDCat" VAL_BLK 0x9080B82 ValA_Wu16 86. DINH_FIdVerb 0.00 86. FORMAT "%2.0" READ_ONLY NUMBER 2 /end CHARACTERISTIC
/begin CHARACTERISTIC DINH_FId.DFC_MDCatCurr_CA "inhibitable FIds / FIds to be inhibited by inhibit source DFC_MDCatCurr" VAL_BLK 0x9080B86 ValA_Wu16 86. DINH_FIdVerb 0.00 86. FORMAT "%2.0" READ_ONLY NUMBER 2 /end CHARACTERISTIC
/begin CHARACTERISTIC DINH_FId.DFC_MDCyl_CA "inhibitable FIds / FIds to be inhibited by inhibit source DFC_MDCyl" VAL_BLK 0x9080B8A ValA_Wu16 86. DINH_FIdVerb 0.00 86. FORMAT "%2.0" READ_ONLY NUMBER 6 /end CHARACTERISTIC
/begin CHARACTERISTIC DINH_FId.DFC_MDEmi_CA "inhibitable FIds / FIds to be inhibited by inhibit source DFC_MDEmi" VAL_BLK 0x9080B96 ValA_Wu16 86. DINH_FIdVerb 0.00 86. FORMAT "%2.0" READ_ONLY NUMBER 2 /end CHARACTERISTIC
/begin CHARACTERISTIC DINH_FId.DFC_MDEmiStrt_CA "inhibitable FIds / FIds to be inhibited by inhibit source DFC_MDEmiStrt" VAL_BLK 0x9080B9A ValA_Wu16 86. DINH_FIdVerb 0.00 86. FORMAT "%2.0" READ_ONLY NUMBER 2 /end CHARACTERISTIC
/begin CHARACTERISTIC DINH_FId.DFC_MDMpl_CA "inhibitable FIds / FIds to be inhibited by inhibit source DFC_MDMpl" VAL_BLK 0x9080B9E ValA_Wu16 86. DINH_FIdVerb 0.00 86. FORMAT "%2.0" READ_ONLY NUMBER 6 /end CHARACTERISTIC
/begin CHARACTERISTIC DINH_FId.DFC_MoCADCNTP_CA "inhibitable FIds / FIds to be inhibited by inhibit source DFC_MoCADCNTP" VAL_BLK 0x9080BAA ValA_Wu16 86. DINH_FIdVerb 0.00 86. FORMAT "%2.0" READ_ONLY NUMBER 2 /end CHARACTERISTIC
/begin CHARACTERISTIC DINH_FId.DFC_MoCADCTst_CA "inhibitable FIds / FIds to be inhibited by inhibit source DFC_MoCADCTst" VAL_BLK 0x9080BAE ValA_Wu16 86. DINH_FIdVerb 0.00 86. FORMAT "%2.0" READ_ONLY NUMBER 2 /end CHARACTERISTIC
/begin CHARACTERISTIC DINH_FId.DFC_MoFSidst_CA "inhibitable FIds / FIds to be inhibited by inhibit source DFC_MoFSidst" VAL_BLK 0x9080BB2 ValA_Wu16 86. DINH_FIdVerb 0.00 86. FORMAT "%2.0" READ_ONLY NUMBER 2 /end CHARACTERISTIC
/begin CHARACTERISTIC DINH_FId.DFC_OCWDACom_CA "inhibitable FIds / FIds to be inhibited by inhibit source DFC_OCWDACom" VAL_BLK 0x9080BB6 ValA_Wu16 86. DINH_FIdVerb 0.00 86. FORMAT "%2.0" READ_ONLY NUMBER 2 /end CHARACTERISTIC
/begin CHARACTERISTIC DINH_FId.DFC_OilPPSSwtMax_CA "inhibitable FIds / FIds to be inhibited by inhibit source DFC_OilPPSSwtMax" VAL_BLK 0x9080BBA ValA_Wu16 86. DINH_FIdVerb 0.00 86. FORMAT "%2.0" READ_ONLY NUMBER 2 /end CHARACTERISTIC
/begin CHARACTERISTIC DINH_FId.DFC_OilPPSSwtMin_CA "inhibitable FIds / FIds to be inhibited by inhibit source DFC_OilPPSSwtMin" VAL_BLK 0x9080BBE ValA_Wu16 86. DINH_FIdVerb 0.00 86. FORMAT "%2.0" READ_ONLY NUMBER 2 /end CHARACTERISTIC
/begin CHARACTERISTIC DINH_FId.DFC_OilPPSSwtSig_CA "inhibitable FIds / FIds to be inhibited by inhibit source DFC_OilPPSSwtSig" VAL_BLK 0x9080BC2 ValA_Wu16 86. DINH_FIdVerb 0.00 86. FORMAT "%2.0" READ_ONLY NUMBER 2 /end CHARACTERISTIC
/begin CHARACTERISTIC DINH_FId.DFC_OvHEngSpdLimr_CA "inhibitable FIds / FIds to be inhibited by inhibit source DFC_OvHEngSpdLimr" VAL_BLK 0x9080BC6 ValA_Wu16 86. DINH_FIdVerb 0.00 86. FORMAT "%2.0" READ_ONLY NUMBER 3 /end CHARACTERISTIC
/begin CHARACTERISTIC DINH_FId.DFC_RoVComVld_CA "inhibitable FIds / FIds to be inhibited by inhibit source DFC_RoVComVld" VAL_BLK 0x9080BCC ValA_Wu16 86. DINH_FIdVerb 0.00 86. FORMAT "%2.0" READ_ONLY NUMBER 2 /end CHARACTERISTIC
/begin CHARACTERISTIC DINH_FId.DFC_RoVSNpl_CA "inhibitable FIds / FIds to be inhibited by inhibit source DFC_RoVSNpl" VAL_BLK 0x9080BD0 ValA_Wu16 86. DINH_FIdVerb 0.00 86. FORMAT "%2.0" READ_ONLY NUMBER 4 /end CHARACTERISTIC
/begin CHARACTERISTIC DINH_FId.DFC_RoVSOL_CA "inhibitable FIds / FIds to be inhibited by inhibit source DFC_RoVSOL" VAL_BLK 0x9080BD8 ValA_Wu16 86. DINH_FIdVerb 0.00 86. FORMAT "%2.0" READ_ONLY NUMBER 4 /end CHARACTERISTIC
/begin CHARACTERISTIC DINH_FId.DFC_RoVSSCB_CA "inhibitable FIds / FIds to be inhibited by inhibit source DFC_RoVSSCB" VAL_BLK 0x9080BE0 ValA_Wu16 86. DINH_FIdVerb 0.00 86. FORMAT "%2.0" READ_ONLY NUMBER 4 /end CHARACTERISTIC
/begin CHARACTERISTIC DINH_FId.DFC_RoVSSCG_CA "inhibitable FIds / FIds to be inhibited by inhibit source DFC_RoVSSCG" VAL_BLK 0x9080BE8 ValA_Wu16 86. DINH_FIdVerb 0.00 86. FORMAT "%2.0" READ_ONLY NUMBER 4 /end CHARACTERISTIC
/begin CHARACTERISTIC DINH_FId.DFC_SdSTNpl_CA "inhibitable FIds / FIds to be inhibited by inhibit source DFC_SdSTNpl" VAL_BLK 0x9080BF0 ValA_Wu16 86. DINH_FIdVerb 0.00 86. FORMAT "%2.0" READ_ONLY NUMBER 3 /end CHARACTERISTIC
/begin CHARACTERISTIC DINH_FId.DFC_SdSTSCB_CA "inhibitable FIds / FIds to be inhibited by inhibit source DFC_SdSTSCB" VAL_BLK 0x9080BF6 ValA_Wu16 86. DINH_FIdVerb 0.00 86. FORMAT "%2.0" READ_ONLY NUMBER 3 /end CHARACTERISTIC
/begin CHARACTERISTIC DINH_FId.DFC_SdSTSCG_CA "inhibitable FIds / FIds to be inhibited by inhibit source DFC_SdSTSCG" VAL_BLK 0x9080BFC ValA_Wu16 86. DINH_FIdVerb 0.00 86. FORMAT "%2.0" READ_ONLY NUMBER 3 /end CHARACTERISTIC
/begin CHARACTERISTIC DINH_FId.DFC_SdSTSOL_CA "inhibitable FIds / FIds to be inhibited by inhibit source DFC_SdSTSOL" VAL_BLK 0x9080C02 ValA_Wu16 86. DINH_FIdVerb 0.00 86. FORMAT "%2.0" READ_ONLY NUMBER 3 /end CHARACTERISTIC
/begin CHARACTERISTIC DINH_FId.DFC_TEVEmax_CA "inhibitable FIds / FIds to be inhibited by inhibit source DFC_TEVEmax" VAL_BLK 0x9080C08 ValA_Wu16 86. DINH_FIdVerb 0.00 86. FORMAT "%2.0" READ_ONLY NUMBER 8 /end CHARACTERISTIC
/begin CHARACTERISTIC DINH_FId.DFC_TEVEmin_CA "inhibitable FIds / FIds to be inhibited by inhibit source DFC_TEVEmin" VAL_BLK 0x9080C18 ValA_Wu16 86. DINH_FIdVerb 0.00 86. FORMAT "%2.0" READ_ONLY NUMBER 8 /end CHARACTERISTIC
/begin CHARACTERISTIC DINH_FId.DFC_TEVEsig_CA "inhibitable FIds / FIds to be inhibited by inhibit source DFC_TEVEsig" VAL_BLK 0x9080C28 ValA_Wu16 86. DINH_FIdVerb 0.00 86. FORMAT "%2.0" READ_ONLY NUMBER 8 /end CHARACTERISTIC
/begin CHARACTERISTIC DINH_FId.DFC_TMnpl_CA "inhibitable FIds / FIds to be inhibited by inhibit source DFC_TMnpl" VAL_BLK 0x9080C38 ValA_Wu16 86. DINH_FIdVerb 0.00 86. FORMAT "%2.0" READ_ONLY NUMBER 13 /end CHARACTERISTIC
/begin CHARACTERISTIC DINH_FId.DFC_UBmax_CA "inhibitable FIds / FIds to be inhibited by inhibit source DFC_UBmax" VAL_BLK 0x9080C52 ValA_Wu16 86. DINH_FIdVerb 0.00 86. FORMAT "%2.0" READ_ONLY NUMBER 7 /end CHARACTERISTIC
/begin CHARACTERISTIC DINH_FId.DFC_UBmin_CA "inhibitable FIds / FIds to be inhibited by inhibit source DFC_UBmin" VAL_BLK 0x9080C60 ValA_Wu16 86. DINH_FIdVerb 0.00 86. FORMAT "%2.0" READ_ONLY NUMBER 7 /end CHARACTERISTIC
/begin CHARACTERISTIC DINH_FId.DFC_UBnpl_CA "inhibitable FIds / FIds to be inhibited by inhibit source DFC_UBnpl" VAL_BLK 0x9080C6E ValA_Wu16 86. DINH_FIdVerb 0.00 86. FORMAT "%2.0" READ_ONLY NUMBER 7 /end CHARACTERISTIC
/begin CHARACTERISTIC DINH_FId.DFC_VFZsig_CA "inhibitable FIds / FIds to be inhibited by inhibit source DFC_VFZsig" VAL_BLK 0x9080C7C ValA_Wu16 86. DINH_FIdVerb 0.00 86. FORMAT "%2.0" READ_ONLY NUMBER 9 /end CHARACTERISTIC
/begin CHARACTERISTIC DINH_FId.DFC_VFZsig2_CA "inhibitable FIds / FIds to be inhibited by inhibit source DFC_VFZsig2" VAL_BLK 0x9080C8E ValA_Wu16 86. DINH_FIdVerb 0.00 86. FORMAT "%2.0" READ_ONLY NUMBER 3 /end CHARACTERISTIC
/begin CHARACTERISTIC DINH_FId.DSQ_DSMInhibitAlways_CA "inhibitable FIds / FIds to be inhibited by inhibit source DSQ_DSMInhibitAlways" VAL_BLK 0x9080C94 ValA_Wu16 86. DINH_FIdVerb 0.00 86. FORMAT "%2.0" READ_ONLY NUMBER 3 /end CHARACTERISTIC
/begin CHARACTERISTIC DINH_FId.DSQ_EpmReverseRun_CA "inhibitable FIds / FIds to be inhibited by inhibit source DSQ_EpmReverseRun" VAL_BLK 0x9080C9A ValA_Wu16 86. DINH_FIdVerb 0.00 86. FORMAT "%2.0" READ_ONLY NUMBER 3 /end CHARACTERISTIC
/begin CHARACTERISTIC DINH_FId.DSQ_MRly_CA "inhibitable FIds / FIds to be inhibited by inhibit source DSQ_MRly" VAL_BLK 0x9080CA0 ValA_Wu16 86. DINH_FIdVerb 0.00 86. FORMAT "%2.0" READ_ONLY NUMBER 2 /end CHARACTERISTIC
/begin CHARACTERISTIC DINH_FId.DSQ_RvsRotPred_CA "inhibitable FIds / FIds to be inhibited by inhibit source DSQ_RvsRotPred" VAL_BLK 0x9080CA4 ValA_Wu16 86. DINH_FIdVerb 0.00 86. FORMAT "%2.0" READ_ONLY NUMBER 2 /end CHARACTERISTIC
/begin CHARACTERISTIC DINH_FId.DSQ_StrtActr_CA "inhibitable FIds / FIds to be inhibited by inhibit source DSQ_StrtActr" VAL_BLK 0x9080CA8 ValA_Wu16 86. DINH_FIdVerb 0.00 86. FORMAT "%2.0" READ_ONLY NUMBER 2 /end CHARACTERISTIC
/begin CHARACTERISTIC DINH_FId.DSQ_T15TurnOfDly_CA "inhibitable FIds / FIds to be inhibited by inhibit source DSQ_T15TurnOfDly" VAL_BLK 0x9080CAC ValA_Wu16 86. DINH_FIdVerb 0.00 86. FORMAT "%2.0" READ_ONLY NUMBER 2 /end CHARACTERISTIC
/begin CHARACTERISTIC DINH_Lim.DFC_BusDiagOpenLoad_Can0_CA "inhibit conditions / inhibit limit conditions for inhibit source DFC_BusDiagOpenLoad_Can0" VAL_BLK 0x9080E09 ValA_Wu8 17.0000000000 DINH_LimDFCVerb 0.00 17.0000000000 FORMAT "%13.10" READ_ONLY NUMBER 3 /end CHARACTERISTIC
/begin CHARACTERISTIC DINH_Lim.DFC_Com_ABSInfo_DLC_CA "inhibit conditions / inhibit limit conditions for inhibit source DFC_Com_ABSInfo_DLC" VAL_BLK 0x9080E0C ValA_Wu8 17.0000000000 DINH_LimDFCVerb 0.00 17.0000000000 FORMAT "%13.10" READ_ONLY NUMBER 2 /end CHARACTERISTIC
/begin CHARACTERISTIC DINH_Lim.DFC_Com_ABSInfo_TO_CA "inhibit conditions / inhibit limit conditions for inhibit source DFC_Com_ABSInfo_TO" VAL_BLK 0x9080E0E ValA_Wu8 17.0000000000 DINH_LimDFCVerb 0.00 17.0000000000 FORMAT "%13.10" READ_ONLY NUMBER 2 /end CHARACTERISTIC
/begin CHARACTERISTIC DINH_Lim.DFC_BusDiagBusOff_Can0_CA "inhibit conditions / inhibit limit conditions for inhibit source DFC_BusDiagBusOff_Can0" VAL_BLK 0x9080E10 ValA_Wu8 17.0000000000 DINH_LimDFCVerb 0.00 17.0000000000 FORMAT "%13.10" READ_ONLY NUMBER 3 /end CHARACTERISTIC
/begin CHARACTERISTIC DINH_Lim.DFC_DevLibBattUHi_CA "inhibit conditions / inhibit limit conditions for inhibit source DFC_DevLibBattUHi" VAL_BLK 0x9080E13 ValA_Wu8 17.0000000000 DINH_LimDFCVerb 0.00 17.0000000000 FORMAT "%13.10" READ_ONLY NUMBER 2 /end CHARACTERISTIC
/begin CHARACTERISTIC DINH_Lim.DFC_DevLibBattULo_CA "inhibit conditions / inhibit limit conditions for inhibit source DFC_DevLibBattULo" VAL_BLK 0x9080E15 ValA_Wu8 17.0000000000 DINH_LimDFCVerb 0.00 17.0000000000 FORMAT "%13.10" READ_ONLY NUMBER 2 /end CHARACTERISTIC
/begin CHARACTERISTIC DINH_Lim.DFC_StrtOL_CA "inhibit conditions / inhibit limit conditions for inhibit source DFC_StrtOL" VAL_BLK 0x9080E17 ValA_Wu8 17.0000000000 DINH_LimDFCVerb 0.00 17.0000000000 FORMAT "%13.10" READ_ONLY NUMBER 3 /end CHARACTERISTIC
/begin CHARACTERISTIC DINH_Lim.DFC_StrtOvrTemp_CA "inhibit conditions / inhibit limit conditions for inhibit source DFC_StrtOvrTemp" VAL_BLK 0x9080E1A ValA_Wu8 17.0000000000 DINH_LimDFCVerb 0.00 17.0000000000 FORMAT "%13.10" READ_ONLY NUMBER 2 /end CHARACTERISTIC
/begin CHARACTERISTIC DINH_Lim.DFC_StrtSCB_CA "inhibit conditions / inhibit limit conditions for inhibit source DFC_StrtSCB" VAL_BLK 0x9080E1C ValA_Wu8 17.0000000000 DINH_LimDFCVerb 0.00 17.0000000000 FORMAT "%13.10" READ_ONLY NUMBER 3 /end CHARACTERISTIC
/begin CHARACTERISTIC DINH_Lim.DFC_StrtSCG_CA "inhibit conditions / inhibit limit conditions for inhibit source DFC_StrtSCG" VAL_BLK 0x9080E1F ValA_Wu8 17.0000000000 DINH_LimDFCVerb 0.00 17.0000000000 FORMAT "%13.10" READ_ONLY NUMBER 3 /end CHARACTERISTIC
/begin CHARACTERISTIC DINH_Lim.DFC_MILLmpOL_CA "inhibit conditions / inhibit limit conditions for inhibit source DFC_MILLmpOL" VAL_BLK 0x9080E22 ValA_Wu8 17.0000000000 DINH_LimDFCVerb 0.00 17.0000000000 FORMAT "%13.10" READ_ONLY NUMBER 2 /end CHARACTERISTIC
/begin CHARACTERISTIC DINH_Lim.DFC_MILLmpOT_CA "inhibit conditions / inhibit limit conditions for inhibit source DFC_MILLmpOT" VAL_BLK 0x9080E24 ValA_Wu8 17.0000000000 DINH_LimDFCVerb 0.00 17.0000000000 FORMAT "%13.10" READ_ONLY NUMBER 2 /end CHARACTERISTIC
/begin CHARACTERISTIC DINH_Lim.DFC_MILLmpSCB_CA "inhibit conditions / inhibit limit conditions for inhibit source DFC_MILLmpSCB" VAL_BLK 0x9080E26 ValA_Wu8 17.0000000000 DINH_LimDFCVerb 0.00 17.0000000000 FORMAT "%13.10" READ_ONLY NUMBER 2 /end CHARACTERISTIC
/begin CHARACTERISTIC DINH_Lim.DFC_MILLmpSCG_CA "inhibit conditions / inhibit limit conditions for inhibit source DFC_MILLmpSCG" VAL_BLK 0x9080E28 ValA_Wu8 17.0000000000 DINH_LimDFCVerb 0.00 17.0000000000 FORMAT "%13.10" READ_ONLY NUMBER 2 /end CHARACTERISTIC
/begin CHARACTERISTIC DINH_Lim.DFC_EV1max_CA "inhibit conditions / inhibit limit conditions for inhibit source DFC_EV1max" VAL_BLK 0x9080E2A ValA_Wu8 17.0000000000 DINH_LimDFCVerb 0.00 17.0000000000 FORMAT "%13.10" READ_ONLY NUMBER 4 /end CHARACTERISTIC
/begin CHARACTERISTIC DINH_Lim.DFC_EV1min_CA "inhibit conditions / inhibit limit conditions for inhibit source DFC_EV1min" VAL_BLK 0x9080E2E ValA_Wu8 17.0000000000 DINH_LimDFCVerb 0.00 17.0000000000 FORMAT "%13.10" READ_ONLY NUMBER 6 /end CHARACTERISTIC
/begin CHARACTERISTIC DINH_Lim.DFC_EV1sig_CA "inhibit conditions / inhibit limit conditions for inhibit source DFC_EV1sig" VAL_BLK 0x9080E34 ValA_Wu8 17.0000000000 DINH_LimDFCVerb 0.00 17.0000000000 FORMAT "%13.10" READ_ONLY NUMBER 4 /end CHARACTERISTIC
/begin CHARACTERISTIC DINH_Lim.DFC_CEngDsTPlausSTC_CA "inhibit conditions / inhibit limit conditions for inhibit source DFC_CEngDsTPlausSTC" VAL_BLK 0x9080E38 ValA_Wu8 17.0000000000 DINH_LimDFCVerb 0.00 17.0000000000 FORMAT "%13.10" READ_ONLY NUMBER 13 /end CHARACTERISTIC
/begin CHARACTERISTIC DINH_Lim.DFC_ClthStkOpn_CA "inhibit conditions / inhibit limit conditions for inhibit source DFC_ClthStkOpn" VAL_BLK 0x9080E45 ValA_Wu8 17.0000000000 DINH_LimDFCVerb 0.00 17.0000000000 FORMAT "%13.10" READ_ONLY NUMBER 5 /end CHARACTERISTIC
/begin CHARACTERISTIC DINH_Lim.DFC_EVX_CA "inhibit conditions / inhibit limit conditions for inhibit source DFC_EVX" VAL_BLK 0x9080E4A ValA_Wu8 17.0000000000 DINH_LimDFCVerb 0.00 17.0000000000 FORMAT "%13.10" READ_ONLY NUMBER 2 /end CHARACTERISTIC
/begin CHARACTERISTIC DINH_Lim.DFC_IntkAirTAirFltDsSTC_CA "inhibit conditions / inhibit limit conditions for inhibit source DFC_IntkAirTAirFltDsSTC" VAL_BLK 0x9080E4C ValA_Wu8 17.0000000000 DINH_LimDFCVerb 0.00 17.0000000000 FORMAT "%13.10" READ_ONLY NUMBER 8 /end CHARACTERISTIC
/begin CHARACTERISTIC DINH_Lim.DFC_RoughRoad_CA "inhibit conditions / inhibit limit conditions for inhibit source DFC_RoughRoad" VAL_BLK 0x9080E54 ValA_Wu8 17.0000000000 DINH_LimDFCVerb 0.00 17.0000000000 FORMAT "%13.10" READ_ONLY NUMBER 2 /end CHARACTERISTIC
/begin CHARACTERISTIC DINH_Lim.DFC_SSpMon1_CA "inhibit conditions / inhibit limit conditions for inhibit source DFC_SSpMon1" VAL_BLK 0x9080E56 ValA_Wu8 17.0000000000 DINH_LimDFCVerb 0.00 17.0000000000 FORMAT "%13.10" READ_ONLY NUMBER 6 /end CHARACTERISTIC
/begin CHARACTERISTIC DINH_Lim.DFC_SSpMon1OT_CA "inhibit conditions / inhibit limit conditions for inhibit source DFC_SSpMon1OT" VAL_BLK 0x9080E5C ValA_Wu8 17.0000000000 DINH_LimDFCVerb 0.00 17.0000000000 FORMAT "%13.10" READ_ONLY NUMBER 2 /end CHARACTERISTIC
/begin CHARACTERISTIC DINH_Lim.DFC_SSpMon1OV_CA "inhibit conditions / inhibit limit conditions for inhibit source DFC_SSpMon1OV" VAL_BLK 0x9080E5E ValA_Wu8 17.0000000000 DINH_LimDFCVerb 0.00 17.0000000000 FORMAT "%13.10" READ_ONLY NUMBER 3 /end CHARACTERISTIC
/begin CHARACTERISTIC DINH_Lim.DFC_SSpMon1SCG_CA "inhibit conditions / inhibit limit conditions for inhibit source DFC_SSpMon1SCG" VAL_BLK 0x9080E61 ValA_Wu8 17.0000000000 DINH_LimDFCVerb 0.00 17.0000000000 FORMAT "%13.10" READ_ONLY NUMBER 3 /end CHARACTERISTIC
/begin CHARACTERISTIC DINH_Lim.DFC_SSpMon1UV_CA "inhibit conditions / inhibit limit conditions for inhibit source DFC_SSpMon1UV" VAL_BLK 0x9080E64 ValA_Wu8 17.0000000000 DINH_LimDFCVerb 0.00 17.0000000000 FORMAT "%13.10" READ_ONLY NUMBER 2 /end CHARACTERISTIC
/begin CHARACTERISTIC DINH_Lim.DFC_SSpMon2_CA "inhibit conditions / inhibit limit conditions for inhibit source DFC_SSpMon2" VAL_BLK 0x9080E66 ValA_Wu8 17.0000000000 DINH_LimDFCVerb 0.00 17.0000000000 FORMAT "%13.10" READ_ONLY NUMBER 3 /end CHARACTERISTIC
/begin CHARACTERISTIC DINH_Lim.DFC_SSpMon2OT_CA "inhibit conditions / inhibit limit conditions for inhibit source DFC_SSpMon2OT" VAL_BLK 0x9080E69 ValA_Wu8 17.0000000000 DINH_LimDFCVerb 0.00 17.0000000000 FORMAT "%13.10" READ_ONLY NUMBER 2 /end CHARACTERISTIC
/begin CHARACTERISTIC DINH_Lim.DFC_SSpMon2OV_CA "inhibit conditions / inhibit limit conditions for inhibit source DFC_SSpMon2OV" VAL_BLK 0x9080E6B ValA_Wu8 17.0000000000 DINH_LimDFCVerb 0.00 17.0000000000 FORMAT "%13.10" READ_ONLY NUMBER 3 /end CHARACTERISTIC
/begin CHARACTERISTIC DINH_Lim.DFC_SSpMon2SCG_CA "inhibit conditions / inhibit limit conditions for inhibit source DFC_SSpMon2SCG" VAL_BLK 0x9080E6E ValA_Wu8 17.0000000000 DINH_LimDFCVerb 0.00 17.0000000000 FORMAT "%13.10" READ_ONLY NUMBER 3 /end CHARACTERISTIC
/begin CHARACTERISTIC DINH_Lim.DFC_SSpMon2UV_CA "inhibit conditions / inhibit limit conditions for inhibit source DFC_SSpMon2UV" VAL_BLK 0x9080E71 ValA_Wu8 17.0000000000 DINH_LimDFCVerb 0.00 17.0000000000 FORMAT "%13.10" READ_ONLY NUMBER 2 /end CHARACTERISTIC
/begin CHARACTERISTIC DINH_Lim.DFC_CANIF_E_CTRL_NOT_SLEEP_ERROR_VALUE_CA "inhibit conditions / inhibit limit conditions for inhibit source DFC_CANIF_E_CTRL_NOT_SLEEP_ERROR_VALUE" VAL_BLK 0x9080E73 ValA_Wu8 17.0000000000 DINH_LimDFCVerb 0.00 17.0000000000 FORMAT "%13.10" READ_ONLY NUMBER 2 /end CHARACTERISTIC
/begin CHARACTERISTIC DINH_Lim.DFC_CANIF_E_CTRL_STOPPED_ERROR_VALUE_CA "inhibit conditions / inhibit limit conditions for inhibit source DFC_CANIF_E_CTRL_STOPPED_ERROR_VALUE" VAL_BLK 0x9080E75 ValA_Wu8 17.0000000000 DINH_LimDFCVerb 0.00 17.0000000000 FORMAT "%13.10" READ_ONLY NUMBER 2 /end CHARACTERISTIC
/begin CHARACTERISTIC DINH_Lim.DFC_CANIF_E_INVALID_DLC_ERROR_CA "inhibit conditions / inhibit limit conditions for inhibit source DFC_CANIF_E_INVALID_DLC_ERROR" VAL_BLK 0x9080E77 ValA_Wu8 17.0000000000 DINH_LimDFCVerb 0.00 17.0000000000 FORMAT "%13.10" READ_ONLY NUMBER 2 /end CHARACTERISTIC
/begin CHARACTERISTIC DINH_Lim.DFC_CANNM_E_CANIF_TRANSMIT_ERROR_CA "inhibit conditions / inhibit limit conditions for inhibit source DFC_CANNM_E_CANIF_TRANSMIT_ERROR" VAL_BLK 0x9080E79 ValA_Wu8 17.0000000000 DINH_LimDFCVerb 0.00 17.0000000000 FORMAT "%13.10" READ_ONLY NUMBER 2 /end CHARACTERISTIC
/begin CHARACTERISTIC DINH_Lim.DFC_CANNM_E_INIT_FAILED_CA "inhibit conditions / inhibit limit conditions for inhibit source DFC_CANNM_E_INIT_FAILED" VAL_BLK 0x9080E7B ValA_Wu8 17.0000000000 DINH_LimDFCVerb 0.00 17.0000000000 FORMAT "%13.10" READ_ONLY NUMBER 2 /end CHARACTERISTIC
/begin CHARACTERISTIC DINH_Lim.DFC_CANNM_E_NETWORK_TIMEOUT_CA "inhibit conditions / inhibit limit conditions for inhibit source DFC_CANNM_E_NETWORK_TIMEOUT" VAL_BLK 0x9080E7D ValA_Wu8 17.0000000000 DINH_LimDFCVerb 0.00 17.0000000000 FORMAT "%13.10" READ_ONLY NUMBER 2 /end CHARACTERISTIC
/begin CHARACTERISTIC DINH_Lim.DFC_CAN_E_TIMEOUT_CA "inhibit conditions / inhibit limit conditions for inhibit source DFC_CAN_E_TIMEOUT" VAL_BLK 0x9080E7F ValA_Wu8 17.0000000000 DINH_LimDFCVerb 0.00 17.0000000000 FORMAT "%13.10" READ_ONLY NUMBER 2 /end CHARACTERISTIC
/begin CHARACTERISTIC DINH_Lim.DFC_COMM_E_NET_START_IND_CHANNEL_0_CA "inhibit conditions / inhibit limit conditions for inhibit source DFC_COMM_E_NET_START_IND_CHANNEL_0" VAL_BLK 0x9080E81 ValA_Wu8 17.0000000000 DINH_LimDFCVerb 0.00 17.0000000000 FORMAT "%13.10" READ_ONLY NUMBER 2 /end CHARACTERISTIC
/begin CHARACTERISTIC DINH_Lim.DFC_COMM_E_NET_START_IND_CHANNEL_1_CA "inhibit conditions / inhibit limit conditions for inhibit source DFC_COMM_E_NET_START_IND_CHANNEL_1" VAL_BLK 0x9080E83 ValA_Wu8 17.0000000000 DINH_LimDFCVerb 0.00 17.0000000000 FORMAT "%13.10" READ_ONLY NUMBER 2 /end CHARACTERISTIC
/begin CHARACTERISTIC DINH_Lim.DFC_COMM_E_NET_START_IND_CHANNEL_2_CA "inhibit conditions / inhibit limit conditions for inhibit source DFC_COMM_E_NET_START_IND_CHANNEL_2" VAL_BLK 0x9080E85 ValA_Wu8 17.0000000000 DINH_LimDFCVerb 0.00 17.0000000000 FORMAT "%13.10" READ_ONLY NUMBER 2 /end CHARACTERISTIC
/begin CHARACTERISTIC DINH_Lim.DFC_COMM_E_NET_START_IND_CHANNEL_3_CA "inhibit conditions / inhibit limit conditions for inhibit source DFC_COMM_E_NET_START_IND_CHANNEL_3" VAL_BLK 0x9080E87 ValA_Wu8 17.0000000000 DINH_LimDFCVerb 0.00 17.0000000000 FORMAT "%13.10" READ_ONLY NUMBER 2 /end CHARACTERISTIC
/begin CHARACTERISTIC DINH_Lim.DFC_COMM_E_NET_START_IND_CHANNEL_4_CA "inhibit conditions / inhibit limit conditions for inhibit source DFC_COMM_E_NET_START_IND_CHANNEL_4" VAL_BLK 0x9080E89 ValA_Wu8 17.0000000000 DINH_LimDFCVerb 0.00 17.0000000000 FORMAT "%13.10" READ_ONLY NUMBER 2 /end CHARACTERISTIC
/begin CHARACTERISTIC DINH_Lim.DFC_COMM_E_NET_START_IND_CHANNEL_5_CA "inhibit conditions / inhibit limit conditions for inhibit source DFC_COMM_E_NET_START_IND_CHANNEL_5" VAL_BLK 0x9080E8B ValA_Wu8 17.0000000000 DINH_LimDFCVerb 0.00 17.0000000000 FORMAT "%13.10" READ_ONLY NUMBER 2 /end CHARACTERISTIC
/begin CHARACTERISTIC DINH_Lim.DFC_PDUR_E_INIT_FAILED_CA "inhibit conditions / inhibit limit conditions for inhibit source DFC_PDUR_E_INIT_FAILED" VAL_BLK 0x9080E8D ValA_Wu8 17.0000000000 DINH_LimDFCVerb 0.00 17.0000000000 FORMAT "%13.10" READ_ONLY NUMBER 2 /end CHARACTERISTIC
/begin CHARACTERISTIC DINH_Lim.DFC_PDUR_E_PDU_INSTANCE_LOST_CA "inhibit conditions / inhibit limit conditions for inhibit source DFC_PDUR_E_PDU_INSTANCE_LOST" VAL_BLK 0x9080E8F ValA_Wu8 17.0000000000 DINH_LimDFCVerb 0.00 17.0000000000 FORMAT "%13.10" READ_ONLY NUMBER 2 /end CHARACTERISTIC
/begin CHARACTERISTIC DINH_Lim.DFC_RBA_IOEXTLIB_KEEPALIVE_DRV_CA "inhibit conditions / inhibit limit conditions for inhibit source DFC_RBA_IOEXTLIB_KEEPALIVE_DRV" VAL_BLK 0x9080E91 ValA_Wu8 17.0000000000 DINH_LimDFCVerb 0.00 17.0000000000 FORMAT "%13.10" READ_ONLY NUMBER 2 /end CHARACTERISTIC
/begin CHARACTERISTIC DINH_Lim.DFC_RBA_IOEXTLIB_KEEPALIVE_INI_CA "inhibit conditions / inhibit limit conditions for inhibit source DFC_RBA_IOEXTLIB_KEEPALIVE_INI" VAL_BLK 0x9080E93 ValA_Wu8 17.0000000000 DINH_LimDFCVerb 0.00 17.0000000000 FORMAT "%13.10" READ_ONLY NUMBER 2 /end CHARACTERISTIC
/begin CHARACTERISTIC DINH_Lim.DFC_rba_IoSigRtc_StopCounter_CA "inhibit conditions / inhibit limit conditions for inhibit source DFC_rba_IoSigRtc_StopCounter" VAL_BLK 0x9080E95 ValA_Wu8 17.0000000000 DINH_LimDFCVerb 0.00 17.0000000000 FORMAT "%13.10" READ_ONLY NUMBER 2 /end CHARACTERISTIC
/begin CHARACTERISTIC DINH_Lim.DFC_rba_MultiStackTrace_Threshold_CA "inhibit conditions / inhibit limit conditions for inhibit source DFC_rba_MultiStackTrace_Threshold" VAL_BLK 0x9080E97 ValA_Wu8 17.0000000000 DINH_LimDFCVerb 0.00 17.0000000000 FORMAT "%13.10" READ_ONLY NUMBER 2 /end CHARACTERISTIC
/begin CHARACTERISTIC DINH_Lim.DFC_rba_MRly_Diag_Stk_Event_CA "inhibit conditions / inhibit limit conditions for inhibit source DFC_rba_MRly_Diag_Stk_Event" VAL_BLK 0x9080E99 ValA_Wu8 17.0000000000 DINH_LimDFCVerb 0.00 17.0000000000 FORMAT "%13.10" READ_ONLY NUMBER 2 /end CHARACTERISTIC
/begin CHARACTERISTIC DINH_Lim.DFC_rba_SyC_IrrSwOffTrigEngRun_Event_CA "inhibit conditions / inhibit limit conditions for inhibit source DFC_rba_SyC_IrrSwOffTrigEngRun_Event" VAL_BLK 0x9080E9B ValA_Wu8 17.0000000000 DINH_LimDFCVerb 0.00 17.0000000000 FORMAT "%13.10" READ_ONLY NUMBER 2 /end CHARACTERISTIC
/begin CHARACTERISTIC DINH_Lim.DFC_rba_T15_Diag_ComInVld_Event_CA "inhibit conditions / inhibit limit conditions for inhibit source DFC_rba_T15_Diag_ComInVld_Event" VAL_BLK 0x9080E9D ValA_Wu8 17.0000000000 DINH_LimDFCVerb 0.00 17.0000000000 FORMAT "%13.10" READ_ONLY NUMBER 2 /end CHARACTERISTIC
/begin CHARACTERISTIC DINH_Lim.DFC_rba_T15_Diag_ComOff_HwOn_Event_CA "inhibit conditions / inhibit limit conditions for inhibit source DFC_rba_T15_Diag_ComOff_HwOn_Event" VAL_BLK 0x9080E9F ValA_Wu8 17.0000000000 DINH_LimDFCVerb 0.00 17.0000000000 FORMAT "%13.10" READ_ONLY NUMBER 2 /end CHARACTERISTIC
/begin CHARACTERISTIC DINH_Lim.DFC_rba_T15_Diag_ComOn_HwOff_Event_CA "inhibit conditions / inhibit limit conditions for inhibit source DFC_rba_T15_Diag_ComOn_HwOff_Event" VAL_BLK 0x9080EA1 ValA_Wu8 17.0000000000 DINH_LimDFCVerb 0.00 17.0000000000 FORMAT "%13.10" READ_ONLY NUMBER 2 /end CHARACTERISTIC
/begin CHARACTERISTIC DINH_Lim.DFC_BypAirActrOcCoil1_CA "inhibit conditions / inhibit limit conditions for inhibit source DFC_BypAirActrOcCoil1" VAL_BLK 0x9080EA3 ValA_Wu8 17.0000000000 DINH_LimDFCVerb 0.00 17.0000000000 FORMAT "%13.10" READ_ONLY NUMBER 7 /end CHARACTERISTIC
/begin CHARACTERISTIC DINH_Lim.DFC_BypAirActrOcCoil2_CA "inhibit conditions / inhibit limit conditions for inhibit source DFC_BypAirActrOcCoil2" VAL_BLK 0x9080EAA ValA_Wu8 17.0000000000 DINH_LimDFCVerb 0.00 17.0000000000 FORMAT "%13.10" READ_ONLY NUMBER 7 /end CHARACTERISTIC
/begin CHARACTERISTIC DINH_Lim.DFC_BypAirActrOlCoil1_CA "inhibit conditions / inhibit limit conditions for inhibit source DFC_BypAirActrOlCoil1" VAL_BLK 0x9080EB1 ValA_Wu8 17.0000000000 DINH_LimDFCVerb 0.00 17.0000000000 FORMAT "%13.10" READ_ONLY NUMBER 7 /end CHARACTERISTIC
/begin CHARACTERISTIC DINH_Lim.DFC_BypAirActrOlCoil2_CA "inhibit conditions / inhibit limit conditions for inhibit source DFC_BypAirActrOlCoil2" VAL_BLK 0x9080EB8 ValA_Wu8 17.0000000000 DINH_LimDFCVerb 0.00 17.0000000000 FORMAT "%13.10" READ_ONLY NUMBER 7 /end CHARACTERISTIC
/begin CHARACTERISTIC DINH_Lim.DFC_BypAirActrOt_CA "inhibit conditions / inhibit limit conditions for inhibit source DFC_BypAirActrOt" VAL_BLK 0x9080EBF ValA_Wu8 17.0000000000 DINH_LimDFCVerb 0.00 17.0000000000 FORMAT "%13.10" READ_ONLY NUMBER 7 /end CHARACTERISTIC
/begin CHARACTERISTIC DINH_Lim.DFC_BypAirActrScbCoil1_CA "inhibit conditions / inhibit limit conditions for inhibit source DFC_BypAirActrScbCoil1" VAL_BLK 0x9080EC6 ValA_Wu8 17.0000000000 DINH_LimDFCVerb 0.00 17.0000000000 FORMAT "%13.10" READ_ONLY NUMBER 8 /end CHARACTERISTIC
/begin CHARACTERISTIC DINH_Lim.DFC_BypAirActrScbCoil2_CA "inhibit conditions / inhibit limit conditions for inhibit source DFC_BypAirActrScbCoil2" VAL_BLK 0x9080ECE ValA_Wu8 17.0000000000 DINH_LimDFCVerb 0.00 17.0000000000 FORMAT "%13.10" READ_ONLY NUMBER 8 /end CHARACTERISTIC
/begin CHARACTERISTIC DINH_Lim.DFC_BypAirActrScgCoil1_CA "inhibit conditions / inhibit limit conditions for inhibit source DFC_BypAirActrScgCoil1" VAL_BLK 0x9080ED6 ValA_Wu8 17.0000000000 DINH_LimDFCVerb 0.00 17.0000000000 FORMAT "%13.10" READ_ONLY NUMBER 8 /end CHARACTERISTIC
/begin CHARACTERISTIC DINH_Lim.DFC_BypAirActrScgCoil2_CA "inhibit conditions / inhibit limit conditions for inhibit source DFC_BypAirActrScgCoil2" VAL_BLK 0x9080EDE ValA_Wu8 17.0000000000 DINH_LimDFCVerb 0.00 17.0000000000 FORMAT "%13.10" READ_ONLY NUMBER 7 /end CHARACTERISTIC
/begin CHARACTERISTIC DINH_Lim.DFC_CEngDsTPhysRngHi_CA "inhibit conditions / inhibit limit conditions for inhibit source DFC_CEngDsTPhysRngHi" VAL_BLK 0x9080EE5 ValA_Wu8 17.0000000000 DINH_LimDFCVerb 0.00 17.0000000000 FORMAT "%13.10" READ_ONLY NUMBER 14 /end CHARACTERISTIC
/begin CHARACTERISTIC DINH_Lim.DFC_CEngDsTPhysRngLo_CA "inhibit conditions / inhibit limit conditions for inhibit source DFC_CEngDsTPhysRngLo" VAL_BLK 0x9080EF3 ValA_Wu8 17.0000000000 DINH_LimDFCVerb 0.00 17.0000000000 FORMAT "%13.10" READ_ONLY NUMBER 14 /end CHARACTERISTIC
/begin CHARACTERISTIC DINH_Lim.DFC_CEngDsTSRCMax_CA "inhibit conditions / inhibit limit conditions for inhibit source DFC_CEngDsTSRCMax" VAL_BLK 0x9080F01 ValA_Wu8 17.0000000000 DINH_LimDFCVerb 0.00 17.0000000000 FORMAT "%13.10" READ_ONLY NUMBER 16 /end CHARACTERISTIC
/begin CHARACTERISTIC DINH_Lim.DFC_CEngDsTSRCMin_CA "inhibit conditions / inhibit limit conditions for inhibit source DFC_CEngDsTSRCMin" VAL_BLK 0x9080F11 ValA_Wu8 17.0000000000 DINH_LimDFCVerb 0.00 17.0000000000 FORMAT "%13.10" READ_ONLY NUMBER 16 /end CHARACTERISTIC
/begin CHARACTERISTIC DINH_Lim.DFC_DKmax_CA "inhibit conditions / inhibit limit conditions for inhibit source DFC_DKmax" VAL_BLK 0x9080F21 ValA_Wu8 17.0000000000 DINH_LimDFCVerb 0.00 17.0000000000 FORMAT "%13.10" READ_ONLY NUMBER 6 /end CHARACTERISTIC
/begin CHARACTERISTIC DINH_Lim.DFC_DKmin_CA "inhibit conditions / inhibit limit conditions for inhibit source DFC_DKmin" VAL_BLK 0x9080F27 ValA_Wu8 17.0000000000 DINH_LimDFCVerb 0.00 17.0000000000 FORMAT "%13.10" READ_ONLY NUMBER 6 /end CHARACTERISTIC
/begin CHARACTERISTIC DINH_Lim.DFC_DLLRmax_CA "inhibit conditions / inhibit limit conditions for inhibit source DFC_DLLRmax" VAL_BLK 0x9080F2D ValA_Wu8 17.0000000000 DINH_LimDFCVerb 0.00 17.0000000000 FORMAT "%13.10" READ_ONLY NUMBER 3 /end CHARACTERISTIC
/begin CHARACTERISTIC DINH_Lim.DFC_DLLRmin_CA "inhibit conditions / inhibit limit conditions for inhibit source DFC_DLLRmin" VAL_BLK 0x9080F30 ValA_Wu8 17.0000000000 DINH_LimDFCVerb 0.00 17.0000000000 FORMAT "%13.10" READ_ONLY NUMBER 3 /end CHARACTERISTIC
/begin CHARACTERISTIC DINH_Lim.DFC_DLLRnpl_CA "inhibit conditions / inhibit limit conditions for inhibit source DFC_DLLRnpl" VAL_BLK 0x9080F33 ValA_Wu8 17.0000000000 DINH_LimDFCVerb 0.00 17.0000000000 FORMAT "%13.10" READ_ONLY NUMBER 3 /end CHARACTERISTIC
/begin CHARACTERISTIC DINH_Lim.DFC_DSSRngMax_CA "inhibit conditions / inhibit limit conditions for inhibit source DFC_DSSRngMax" VAL_BLK 0x9080F36 ValA_Wu8 17.0000000000 DINH_LimDFCVerb 0.00 17.0000000000 FORMAT "%13.10" READ_ONLY NUMBER 4 /end CHARACTERISTIC
/begin CHARACTERISTIC DINH_Lim.DFC_DSSRngMin_CA "inhibit conditions / inhibit limit conditions for inhibit source DFC_DSSRngMin" VAL_BLK 0x9080F3A ValA_Wu8 17.0000000000 DINH_LimDFCVerb 0.00 17.0000000000 FORMAT "%13.10" READ_ONLY NUMBER 4 /end CHARACTERISTIC
/begin CHARACTERISTIC DINH_Lim.DFC_DSSmax_CA "inhibit conditions / inhibit limit conditions for inhibit source DFC_DSSmax" VAL_BLK 0x9080F3E ValA_Wu8 17.0000000000 DINH_LimDFCVerb 0.00 17.0000000000 FORMAT "%13.10" READ_ONLY NUMBER 14 /end CHARACTERISTIC
/begin CHARACTERISTIC DINH_Lim.DFC_DSSmin_CA "inhibit conditions / inhibit limit conditions for inhibit source DFC_DSSmin" VAL_BLK 0x9080F4C ValA_Wu8 17.0000000000 DINH_LimDFCVerb 0.00 17.0000000000 FORMAT "%13.10" READ_ONLY NUMBER 13 /end CHARACTERISTIC
/begin CHARACTERISTIC DINH_Lim.DFC_DSSnpl_CA "inhibit conditions / inhibit limit conditions for inhibit source DFC_DSSnpl" VAL_BLK 0x9080F59 ValA_Wu8 17.0000000000 DINH_LimDFCVerb 0.00 17.0000000000 FORMAT "%13.10" READ_ONLY NUMBER 6 /end CHARACTERISTIC
/begin CHARACTERISTIC DINH_Lim.DFC_DSSnplMax_CA "inhibit conditions / inhibit limit conditions for inhibit source DFC_DSSnplMax" VAL_BLK 0x9080F5F ValA_Wu8 17.0000000000 DINH_LimDFCVerb 0.00 17.0000000000 FORMAT "%13.10" READ_ONLY NUMBER 9 /end CHARACTERISTIC
/begin CHARACTERISTIC DINH_Lim.DFC_DSSnplMin_CA "inhibit conditions / inhibit limit conditions for inhibit source DFC_DSSnplMin" VAL_BLK 0x9080F68 ValA_Wu8 17.0000000000 DINH_LimDFCVerb 0.00 17.0000000000 FORMAT "%13.10" READ_ONLY NUMBER 9 /end CHARACTERISTIC
/begin CHARACTERISTIC DINH_Lim.DFC_DSSsig_CA "inhibit conditions / inhibit limit conditions for inhibit source DFC_DSSsig" VAL_BLK 0x9080F71 ValA_Wu8 17.0000000000 DINH_LimDFCVerb 0.00 17.0000000000 FORMAT "%13.10" READ_ONLY NUMBER 4 /end CHARACTERISTIC
/begin CHARACTERISTIC DINH_Lim.DFC_EpmCrSErrSig_CA "inhibit conditions / inhibit limit conditions for inhibit source DFC_EpmCrSErrSig" VAL_BLK 0x9080F75 ValA_Wu8 17.0000000000 DINH_LimDFCVerb 0.00 17.0000000000 FORMAT "%13.10" READ_ONLY NUMBER 6 /end CHARACTERISTIC
/begin CHARACTERISTIC DINH_Lim.DFC_EpmCrSNoSig_CA "inhibit conditions / inhibit limit conditions for inhibit source DFC_EpmCrSNoSig" VAL_BLK 0x9080F7B ValA_Wu8 17.0000000000 DINH_LimDFCVerb 0.00 17.0000000000 FORMAT "%13.10" READ_ONLY NUMBER 8 /end CHARACTERISTIC
/begin CHARACTERISTIC DINH_Lim.DFC_HEGOS1B1ElecNpl_CA "inhibit conditions / inhibit limit conditions for inhibit source DFC_HEGOS1B1ElecNpl" VAL_BLK 0x9080F83 ValA_Wu8 17.0000000000 DINH_LimDFCVerb 0.00 17.0000000000 FORMAT "%13.10" READ_ONLY NUMBER 2 /end CHARACTERISTIC
/begin CHARACTERISTIC DINH_Lim.DFC_HSH_CA "inhibit conditions / inhibit limit conditions for inhibit source DFC_HSH" VAL_BLK 0x9080F85 ValA_Wu8 17.0000000000 DINH_LimDFCVerb 0.00 17.0000000000 FORMAT "%13.10" READ_ONLY NUMBER 7 /end CHARACTERISTIC
/begin CHARACTERISTIC DINH_Lim.DFC_HSHEmax_CA "inhibit conditions / inhibit limit conditions for inhibit source DFC_HSHEmax" VAL_BLK 0x9080F8C ValA_Wu8 17.0000000000 DINH_LimDFCVerb 0.00 17.0000000000 FORMAT "%13.10" READ_ONLY NUMBER 10 /end CHARACTERISTIC
/begin CHARACTERISTIC DINH_Lim.DFC_HSHEmin_CA "inhibit conditions / inhibit limit conditions for inhibit source DFC_HSHEmin" VAL_BLK 0x9080F96 ValA_Wu8 17.0000000000 DINH_LimDFCVerb 0.00 17.0000000000 FORMAT "%13.10" READ_ONLY NUMBER 10 /end CHARACTERISTIC
/begin CHARACTERISTIC DINH_Lim.DFC_HSHEsig_CA "inhibit conditions / inhibit limit conditions for inhibit source DFC_HSHEsig" VAL_BLK 0x9080FA0 ValA_Wu8 17.0000000000 DINH_LimDFCVerb 0.00 17.0000000000 FORMAT "%13.10" READ_ONLY NUMBER 10 /end CHARACTERISTIC
/begin CHARACTERISTIC DINH_Lim.DFC_HSV_CA "inhibit conditions / inhibit limit conditions for inhibit source DFC_HSV" VAL_BLK 0x9080FAA ValA_Wu8 17.0000000000 DINH_LimDFCVerb 0.00 17.0000000000 FORMAT "%13.10" READ_ONLY NUMBER 9 /end CHARACTERISTIC
/begin CHARACTERISTIC DINH_Lim.DFC_HSVEmax_CA "inhibit conditions / inhibit limit conditions for inhibit source DFC_HSVEmax" VAL_BLK 0x9080FB3 ValA_Wu8 17.0000000000 DINH_LimDFCVerb 0.00 17.0000000000 FORMAT "%13.10" READ_ONLY NUMBER 10 /end CHARACTERISTIC
/begin CHARACTERISTIC DINH_Lim.DFC_HSVEmin_CA "inhibit conditions / inhibit limit conditions for inhibit source DFC_HSVEmin" VAL_BLK 0x9080FBD ValA_Wu8 17.0000000000 DINH_LimDFCVerb 0.00 17.0000000000 FORMAT "%13.10" READ_ONLY NUMBER 10 /end CHARACTERISTIC
/begin CHARACTERISTIC DINH_Lim.DFC_HSVEsig_CA "inhibit conditions / inhibit limit conditions for inhibit source DFC_HSVEsig" VAL_BLK 0x9080FC7 ValA_Wu8 17.0000000000 DINH_LimDFCVerb 0.00 17.0000000000 FORMAT "%13.10" READ_ONLY NUMBER 10 /end CHARACTERISTIC
/begin CHARACTERISTIC DINH_Lim.DFC_HdLampMax_CA "inhibit conditions / inhibit limit conditions for inhibit source DFC_HdLampMax" VAL_BLK 0x9080FD1 ValA_Wu8 17.0000000000 DINH_LimDFCVerb 0.00 17.0000000000 FORMAT "%13.10" READ_ONLY NUMBER 2 /end CHARACTERISTIC
/begin CHARACTERISTIC DINH_Lim.DFC_HdLampMin_CA "inhibit conditions / inhibit limit conditions for inhibit source DFC_HdLampMin" VAL_BLK 0x9080FD3 ValA_Wu8 17.0000000000 DINH_LimDFCVerb 0.00 17.0000000000 FORMAT "%13.10" READ_ONLY NUMBER 2 /end CHARACTERISTIC
/begin CHARACTERISTIC DINH_Lim.DFC_HdLampSig_CA "inhibit conditions / inhibit limit conditions for inhibit source DFC_HdLampSig" VAL_BLK 0x9080FD5 ValA_Wu8 17.0000000000 DINH_LimDFCVerb 0.00 17.0000000000 FORMAT "%13.10" READ_ONLY NUMBER 2 /end CHARACTERISTIC
/begin CHARACTERISTIC DINH_Lim.DFC_IgnCoil1Err_CA "inhibit conditions / inhibit limit conditions for inhibit source DFC_IgnCoil1Err" VAL_BLK 0x9080FD7 ValA_Wu8 17.0000000000 DINH_LimDFCVerb 0.00 17.0000000000 FORMAT "%13.10" READ_ONLY NUMBER 2 /end CHARACTERISTIC
/begin CHARACTERISTIC DINH_Lim.DFC_IgnCoil2Err_CA "inhibit conditions / inhibit limit conditions for inhibit source DFC_IgnCoil2Err" VAL_BLK 0x9080FD9 ValA_Wu8 17.0000000000 DINH_LimDFCVerb 0.00 17.0000000000 FORMAT "%13.10" READ_ONLY NUMBER 2 /end CHARACTERISTIC
/begin CHARACTERISTIC DINH_Lim.DFC_IgnIgbtDiagSCG_0_CA "inhibit conditions / inhibit limit conditions for inhibit source DFC_IgnIgbtDiagSCG_0" VAL_BLK 0x9080FDB ValA_Wu8 17.0000000000 DINH_LimDFCVerb 0.00 17.0000000000 FORMAT "%13.10" READ_ONLY NUMBER 3 /end CHARACTERISTIC
/begin CHARACTERISTIC DINH_Lim.DFC_IgnIgbtDiagSCG_1_CA "inhibit conditions / inhibit limit conditions for inhibit source DFC_IgnIgbtDiagSCG_1" VAL_BLK 0x9080FDE ValA_Wu8 17.0000000000 DINH_LimDFCVerb 0.00 17.0000000000 FORMAT "%13.10" READ_ONLY NUMBER 3 /end CHARACTERISTIC
/begin CHARACTERISTIC DINH_Lim.DFC_IntkAirTAirFltDsPRCMax_CA "inhibit conditions / inhibit limit conditions for inhibit source DFC_IntkAirTAirFltDsPRCMax" VAL_BLK 0x9080FE1 ValA_Wu8 17.0000000000 DINH_LimDFCVerb 0.00 17.0000000000 FORMAT "%13.10" READ_ONLY NUMBER 8 /end CHARACTERISTIC
/begin CHARACTERISTIC DINH_Lim.DFC_IntkAirTAirFltDsPRCMin_CA "inhibit conditions / inhibit limit conditions for inhibit source DFC_IntkAirTAirFltDsPRCMin" VAL_BLK 0x9080FE9 ValA_Wu8 17.0000000000 DINH_LimDFCVerb 0.00 17.0000000000 FORMAT "%13.10" READ_ONLY NUMBER 8 /end CHARACTERISTIC
/begin CHARACTERISTIC DINH_Lim.DFC_IntkAirTAirFltDsSRCMax_CA "inhibit conditions / inhibit limit conditions for inhibit source DFC_IntkAirTAirFltDsSRCMax" VAL_BLK 0x9080FF1 ValA_Wu8 17.0000000000 DINH_LimDFCVerb 0.00 17.0000000000 FORMAT "%13.10" READ_ONLY NUMBER 10 /end CHARACTERISTIC
/begin CHARACTERISTIC DINH_Lim.DFC_IntkAirTAirFltDsSRCMin_CA "inhibit conditions / inhibit limit conditions for inhibit source DFC_IntkAirTAirFltDsSRCMin" VAL_BLK 0x9080FFB ValA_Wu8 17.0000000000 DINH_LimDFCVerb 0.00 17.0000000000 FORMAT "%13.10" READ_ONLY NUMBER 10 /end CHARACTERISTIC
/begin CHARACTERISTIC DINH_Lim.DFC_IntkMnfldPNoSyn_CA "inhibit conditions / inhibit limit conditions for inhibit source DFC_IntkMnfldPNoSyn" VAL_BLK 0x9081005 ValA_Wu8 17.0000000000 DINH_LimDFCVerb 0.00 17.0000000000 FORMAT "%13.10" READ_ONLY NUMBER 2 /end CHARACTERISTIC
/begin CHARACTERISTIC DINH_Lim.DFC_KAT_CA "inhibit conditions / inhibit limit conditions for inhibit source DFC_KAT" VAL_BLK 0x9081007 ValA_Wu8 17.0000000000 DINH_LimDFCVerb 0.00 17.0000000000 FORMAT "%13.10" READ_ONLY NUMBER 2 /end CHARACTERISTIC
/begin CHARACTERISTIC DINH_Lim.DFC_KPEmax_CA "inhibit conditions / inhibit limit conditions for inhibit source DFC_KPEmax" VAL_BLK 0x9081009 ValA_Wu8 17.0000000000 DINH_LimDFCVerb 0.00 17.0000000000 FORMAT "%13.10" READ_ONLY NUMBER 2 /end CHARACTERISTIC
/begin CHARACTERISTIC DINH_Lim.DFC_KPEmin_CA "inhibit conditions / inhibit limit conditions for inhibit source DFC_KPEmin" VAL_BLK 0x908100B ValA_Wu8 17.0000000000 DINH_LimDFCVerb 0.00 17.0000000000 FORMAT "%13.10" READ_ONLY NUMBER 2 /end CHARACTERISTIC
/begin CHARACTERISTIC DINH_Lim.DFC_KPEsig_CA "inhibit conditions / inhibit limit conditions for inhibit source DFC_KPEsig" VAL_BLK 0x908100D ValA_Wu8 17.0000000000 DINH_LimDFCVerb 0.00 17.0000000000 FORMAT "%13.10" READ_ONLY NUMBER 2 /end CHARACTERISTIC
/begin CHARACTERISTIC DINH_Lim.DFC_KVSFmax_CA "inhibit conditions / inhibit limit conditions for inhibit source DFC_KVSFmax" VAL_BLK 0x908100F ValA_Wu8 17.0000000000 DINH_LimDFCVerb 0.00 17.0000000000 FORMAT "%13.10" READ_ONLY NUMBER 6 /end CHARACTERISTIC
/begin CHARACTERISTIC DINH_Lim.DFC_KVSFmin_CA "inhibit conditions / inhibit limit conditions for inhibit source DFC_KVSFmin" VAL_BLK 0x9081015 ValA_Wu8 17.0000000000 DINH_LimDFCVerb 0.00 17.0000000000 FORMAT "%13.10" READ_ONLY NUMBER 6 /end CHARACTERISTIC
/begin CHARACTERISTIC DINH_Lim.DFC_KVSOmax_CA "inhibit conditions / inhibit limit conditions for inhibit source DFC_KVSOmax" VAL_BLK 0x908101B ValA_Wu8 17.0000000000 DINH_LimDFCVerb 0.00 17.0000000000 FORMAT "%13.10" READ_ONLY NUMBER 6 /end CHARACTERISTIC
/begin CHARACTERISTIC DINH_Lim.DFC_KVSOmin_CA "inhibit conditions / inhibit limit conditions for inhibit source DFC_KVSOmin" VAL_BLK 0x9081021 ValA_Wu8 17.0000000000 DINH_LimDFCVerb 0.00 17.0000000000 FORMAT "%13.10" READ_ONLY NUMBER 6 /end CHARACTERISTIC
/begin CHARACTERISTIC DINH_Lim.DFC_LASHmn_CA "inhibit conditions / inhibit limit conditions for inhibit source DFC_LASHmn" VAL_BLK 0x9081027 ValA_Wu8 17.0000000000 DINH_LimDFCVerb 0.00 17.0000000000 FORMAT "%13.10" READ_ONLY NUMBER 8 /end CHARACTERISTIC
/begin CHARACTERISTIC DINH_Lim.DFC_LASHmx_CA "inhibit conditions / inhibit limit conditions for inhibit source DFC_LASHmx" VAL_BLK 0x908102F ValA_Wu8 17.0000000000 DINH_LimDFCVerb 0.00 17.0000000000 FORMAT "%13.10" READ_ONLY NUMBER 7 /end CHARACTERISTIC
/begin CHARACTERISTIC DINH_Lim.DFC_LATP_CA "inhibit conditions / inhibit limit conditions for inhibit source DFC_LATP" VAL_BLK 0x9081036 ValA_Wu8 17.0000000000 DINH_LimDFCVerb 0.00 17.0000000000 FORMAT "%13.10" READ_ONLY NUMBER 5 /end CHARACTERISTIC
/begin CHARACTERISTIC DINH_Lim.DFC_LDLAHI_CA "inhibit conditions / inhibit limit conditions for inhibit source DFC_LDLAHI" VAL_BLK 0x908103B ValA_Wu8 17.0000000000 DINH_LimDFCVerb 0.00 17.0000000000 FORMAT "%13.10" READ_ONLY NUMBER 5 /end CHARACTERISTIC
/begin CHARACTERISTIC DINH_Lim.DFC_LFS1Max_CA "inhibit conditions / inhibit limit conditions for inhibit source DFC_LFS1Max" VAL_BLK 0x9081040 ValA_Wu8 17.0000000000 DINH_LimDFCVerb 0.00 17.0000000000 FORMAT "%13.10" READ_ONLY NUMBER 2 /end CHARACTERISTIC
/begin CHARACTERISTIC DINH_Lim.DFC_LFS1Min_CA "inhibit conditions / inhibit limit conditions for inhibit source DFC_LFS1Min" VAL_BLK 0x9081042 ValA_Wu8 17.0000000000 DINH_LimDFCVerb 0.00 17.0000000000 FORMAT "%13.10" READ_ONLY NUMBER 2 /end CHARACTERISTIC
/begin CHARACTERISTIC DINH_Lim.DFC_LFS1Sig_CA "inhibit conditions / inhibit limit conditions for inhibit source DFC_LFS1Sig" VAL_BLK 0x9081044 ValA_Wu8 17.0000000000 DINH_LimDFCVerb 0.00 17.0000000000 FORMAT "%13.10" READ_ONLY NUMBER 2 /end CHARACTERISTIC
/begin CHARACTERISTIC DINH_Lim.DFC_LSHmax_CA "inhibit conditions / inhibit limit conditions for inhibit source DFC_LSHmax" VAL_BLK 0x9081046 ValA_Wu8 17.0000000000 DINH_LimDFCVerb 0.00 17.0000000000 FORMAT "%13.10" READ_ONLY NUMBER 8 /end CHARACTERISTIC
/begin CHARACTERISTIC DINH_Lim.DFC_LSHmin_CA "inhibit conditions / inhibit limit conditions for inhibit source DFC_LSHmin" VAL_BLK 0x908104E ValA_Wu8 17.0000000000 DINH_LimDFCVerb 0.00 17.0000000000 FORMAT "%13.10" READ_ONLY NUMBER 8 /end CHARACTERISTIC
/begin CHARACTERISTIC DINH_Lim.DFC_LSHnpl_CA "inhibit conditions / inhibit limit conditions for inhibit source DFC_LSHnpl" VAL_BLK 0x9081056 ValA_Wu8 17.0000000000 DINH_LimDFCVerb 0.00 17.0000000000 FORMAT "%13.10" READ_ONLY NUMBER 7 /end CHARACTERISTIC
/begin CHARACTERISTIC DINH_Lim.DFC_LSHsig_CA "inhibit conditions / inhibit limit conditions for inhibit source DFC_LSHsig" VAL_BLK 0x908105D ValA_Wu8 17.0000000000 DINH_LimDFCVerb 0.00 17.0000000000 FORMAT "%13.10" READ_ONLY NUMBER 8 /end CHARACTERISTIC
/begin CHARACTERISTIC DINH_Lim.DFC_LSVmax_CA "inhibit conditions / inhibit limit conditions for inhibit source DFC_LSVmax" VAL_BLK 0x9081065 ValA_Wu8 17.0000000000 DINH_LimDFCVerb 0.00 17.0000000000 FORMAT "%13.10" READ_ONLY NUMBER 8 /end CHARACTERISTIC
/begin CHARACTERISTIC DINH_Lim.DFC_LSVmin_CA "inhibit conditions / inhibit limit conditions for inhibit source DFC_LSVmin" VAL_BLK 0x908106D ValA_Wu8 17.0000000000 DINH_LimDFCVerb 0.00 17.0000000000 FORMAT "%13.10" READ_ONLY NUMBER 8 /end CHARACTERISTIC
/begin CHARACTERISTIC DINH_Lim.DFC_LSVnpl_CA "inhibit conditions / inhibit limit conditions for inhibit source DFC_LSVnpl" VAL_BLK 0x9081075 ValA_Wu8 17.0000000000 DINH_LimDFCVerb 0.00 17.0000000000 FORMAT "%13.10" READ_ONLY NUMBER 7 /end CHARACTERISTIC
/begin CHARACTERISTIC DINH_Lim.DFC_LSVsig_CA "inhibit conditions / inhibit limit conditions for inhibit source DFC_LSVsig" VAL_BLK 0x908107C ValA_Wu8 17.0000000000 DINH_LimDFCVerb 0.00 17.0000000000 FORMAT "%13.10" READ_ONLY NUMBER 8 /end CHARACTERISTIC
/begin CHARACTERISTIC DINH_Lim.DFC_MDCat_CA "inhibit conditions / inhibit limit conditions for inhibit source DFC_MDCat" VAL_BLK 0x9081084 ValA_Wu8 17.0000000000 DINH_LimDFCVerb 0.00 17.0000000000 FORMAT "%13.10" READ_ONLY NUMBER 2 /end CHARACTERISTIC
/begin CHARACTERISTIC DINH_Lim.DFC_MDCatCurr_CA "inhibit conditions / inhibit limit conditions for inhibit source DFC_MDCatCurr" VAL_BLK 0x9081086 ValA_Wu8 17.0000000000 DINH_LimDFCVerb 0.00 17.0000000000 FORMAT "%13.10" READ_ONLY NUMBER 2 /end CHARACTERISTIC
/begin CHARACTERISTIC DINH_Lim.DFC_MDCyl_CA "inhibit conditions / inhibit limit conditions for inhibit source DFC_MDCyl" VAL_BLK 0x9081088 ValA_Wu8 17.0000000000 DINH_LimDFCVerb 0.00 17.0000000000 FORMAT "%13.10" READ_ONLY NUMBER 6 /end CHARACTERISTIC
/begin CHARACTERISTIC DINH_Lim.DFC_MDEmi_CA "inhibit conditions / inhibit limit conditions for inhibit source DFC_MDEmi" VAL_BLK 0x908108E ValA_Wu8 17.0000000000 DINH_LimDFCVerb 0.00 17.0000000000 FORMAT "%13.10" READ_ONLY NUMBER 2 /end CHARACTERISTIC
/begin CHARACTERISTIC DINH_Lim.DFC_MDEmiStrt_CA "inhibit conditions / inhibit limit conditions for inhibit source DFC_MDEmiStrt" VAL_BLK 0x9081090 ValA_Wu8 17.0000000000 DINH_LimDFCVerb 0.00 17.0000000000 FORMAT "%13.10" READ_ONLY NUMBER 2 /end CHARACTERISTIC
/begin CHARACTERISTIC DINH_Lim.DFC_MDMpl_CA "inhibit conditions / inhibit limit conditions for inhibit source DFC_MDMpl" VAL_BLK 0x9081092 ValA_Wu8 17.0000000000 DINH_LimDFCVerb 0.00 17.0000000000 FORMAT "%13.10" READ_ONLY NUMBER 6 /end CHARACTERISTIC
/begin CHARACTERISTIC DINH_Lim.DFC_MoCADCNTP_CA "inhibit conditions / inhibit limit conditions for inhibit source DFC_MoCADCNTP" VAL_BLK 0x9081098 ValA_Wu8 17.0000000000 DINH_LimDFCVerb 0.00 17.0000000000 FORMAT "%13.10" READ_ONLY NUMBER 2 /end CHARACTERISTIC
/begin CHARACTERISTIC DINH_Lim.DFC_MoCADCTst_CA "inhibit conditions / inhibit limit conditions for inhibit source DFC_MoCADCTst" VAL_BLK 0x908109A ValA_Wu8 17.0000000000 DINH_LimDFCVerb 0.00 17.0000000000 FORMAT "%13.10" READ_ONLY NUMBER 2 /end CHARACTERISTIC
/begin CHARACTERISTIC DINH_Lim.DFC_MoFSidst_CA "inhibit conditions / inhibit limit conditions for inhibit source DFC_MoFSidst" VAL_BLK 0x908109C ValA_Wu8 17.0000000000 DINH_LimDFCVerb 0.00 17.0000000000 FORMAT "%13.10" READ_ONLY NUMBER 2 /end CHARACTERISTIC
/begin CHARACTERISTIC DINH_Lim.DFC_OCWDACom_CA "inhibit conditions / inhibit limit conditions for inhibit source DFC_OCWDACom" VAL_BLK 0x908109E ValA_Wu8 17.0000000000 DINH_LimDFCVerb 0.00 17.0000000000 FORMAT "%13.10" READ_ONLY NUMBER 2 /end CHARACTERISTIC
/begin CHARACTERISTIC DINH_Lim.DFC_OilPPSSwtMax_CA "inhibit conditions / inhibit limit conditions for inhibit source DFC_OilPPSSwtMax" VAL_BLK 0x90810A0 ValA_Wu8 17.0000000000 DINH_LimDFCVerb 0.00 17.0000000000 FORMAT "%13.10" READ_ONLY NUMBER 2 /end CHARACTERISTIC
/begin CHARACTERISTIC DINH_Lim.DFC_OilPPSSwtMin_CA "inhibit conditions / inhibit limit conditions for inhibit source DFC_OilPPSSwtMin" VAL_BLK 0x90810A2 ValA_Wu8 17.0000000000 DINH_LimDFCVerb 0.00 17.0000000000 FORMAT "%13.10" READ_ONLY NUMBER 2 /end CHARACTERISTIC
/begin CHARACTERISTIC DINH_Lim.DFC_OilPPSSwtSig_CA "inhibit conditions / inhibit limit conditions for inhibit source DFC_OilPPSSwtSig" VAL_BLK 0x90810A4 ValA_Wu8 17.0000000000 DINH_LimDFCVerb 0.00 17.0000000000 FORMAT "%13.10" READ_ONLY NUMBER 2 /end CHARACTERISTIC
/begin CHARACTERISTIC DINH_Lim.DFC_OvHEngSpdLimr_CA "inhibit conditions / inhibit limit conditions for inhibit source DFC_OvHEngSpdLimr" VAL_BLK 0x90810A6 ValA_Wu8 17.0000000000 DINH_LimDFCVerb 0.00 17.0000000000 FORMAT "%13.10" READ_ONLY NUMBER 3 /end CHARACTERISTIC
/begin CHARACTERISTIC DINH_Lim.DFC_RoVComVld_CA "inhibit conditions / inhibit limit conditions for inhibit source DFC_RoVComVld" VAL_BLK 0x90810A9 ValA_Wu8 17.0000000000 DINH_LimDFCVerb 0.00 17.0000000000 FORMAT "%13.10" READ_ONLY NUMBER 2 /end CHARACTERISTIC
/begin CHARACTERISTIC DINH_Lim.DFC_RoVSNpl_CA "inhibit conditions / inhibit limit conditions for inhibit source DFC_RoVSNpl" VAL_BLK 0x90810AB ValA_Wu8 17.0000000000 DINH_LimDFCVerb 0.00 17.0000000000 FORMAT "%13.10" READ_ONLY NUMBER 4 /end CHARACTERISTIC
/begin CHARACTERISTIC DINH_Lim.DFC_RoVSOL_CA "inhibit conditions / inhibit limit conditions for inhibit source DFC_RoVSOL" VAL_BLK 0x90810AF ValA_Wu8 17.0000000000 DINH_LimDFCVerb 0.00 17.0000000000 FORMAT "%13.10" READ_ONLY NUMBER 4 /end CHARACTERISTIC
/begin CHARACTERISTIC DINH_Lim.DFC_RoVSSCB_CA "inhibit conditions / inhibit limit conditions for inhibit source DFC_RoVSSCB" VAL_BLK 0x90810B3 ValA_Wu8 17.0000000000 DINH_LimDFCVerb 0.00 17.0000000000 FORMAT "%13.10" READ_ONLY NUMBER 4 /end CHARACTERISTIC
/begin CHARACTERISTIC DINH_Lim.DFC_RoVSSCG_CA "inhibit conditions / inhibit limit conditions for inhibit source DFC_RoVSSCG" VAL_BLK 0x90810B7 ValA_Wu8 17.0000000000 DINH_LimDFCVerb 0.00 17.0000000000 FORMAT "%13.10" READ_ONLY NUMBER 4 /end CHARACTERISTIC
/begin CHARACTERISTIC DINH_Lim.DFC_SdSTNpl_CA "inhibit conditions / inhibit limit conditions for inhibit source DFC_SdSTNpl" VAL_BLK 0x90810BB ValA_Wu8 17.0000000000 DINH_LimDFCVerb 0.00 17.0000000000 FORMAT "%13.10" READ_ONLY NUMBER 3 /end CHARACTERISTIC
/begin CHARACTERISTIC DINH_Lim.DFC_SdSTSCB_CA "inhibit conditions / inhibit limit conditions for inhibit source DFC_SdSTSCB" VAL_BLK 0x90810BE ValA_Wu8 17.0000000000 DINH_LimDFCVerb 0.00 17.0000000000 FORMAT "%13.10" READ_ONLY NUMBER 3 /end CHARACTERISTIC
/begin CHARACTERISTIC DINH_Lim.DFC_SdSTSCG_CA "inhibit conditions / inhibit limit conditions for inhibit source DFC_SdSTSCG" VAL_BLK 0x90810C1 ValA_Wu8 17.0000000000 DINH_LimDFCVerb 0.00 17.0000000000 FORMAT "%13.10" READ_ONLY NUMBER 3 /end CHARACTERISTIC
/begin CHARACTERISTIC DINH_Lim.DFC_SdSTSOL_CA "inhibit conditions / inhibit limit conditions for inhibit source DFC_SdSTSOL" VAL_BLK 0x90810C4 ValA_Wu8 17.0000000000 DINH_LimDFCVerb 0.00 17.0000000000 FORMAT "%13.10" READ_ONLY NUMBER 3 /end CHARACTERISTIC
/begin CHARACTERISTIC DINH_Lim.DFC_TEVEmax_CA "inhibit conditions / inhibit limit conditions for inhibit source DFC_TEVEmax" VAL_BLK 0x90810C7 ValA_Wu8 17.0000000000 DINH_LimDFCVerb 0.00 17.0000000000 FORMAT "%13.10" READ_ONLY NUMBER 8 /end CHARACTERISTIC
/begin CHARACTERISTIC DINH_Lim.DFC_TEVEmin_CA "inhibit conditions / inhibit limit conditions for inhibit source DFC_TEVEmin" VAL_BLK 0x90810CF ValA_Wu8 17.0000000000 DINH_LimDFCVerb 0.00 17.0000000000 FORMAT "%13.10" READ_ONLY NUMBER 8 /end CHARACTERISTIC
/begin CHARACTERISTIC DINH_Lim.DFC_TEVEsig_CA "inhibit conditions / inhibit limit conditions for inhibit source DFC_TEVEsig" VAL_BLK 0x90810D7 ValA_Wu8 17.0000000000 DINH_LimDFCVerb 0.00 17.0000000000 FORMAT "%13.10" READ_ONLY NUMBER 8 /end CHARACTERISTIC
/begin CHARACTERISTIC DINH_Lim.DFC_TMnpl_CA "inhibit conditions / inhibit limit conditions for inhibit source DFC_TMnpl" VAL_BLK 0x90810DF ValA_Wu8 17.0000000000 DINH_LimDFCVerb 0.00 17.0000000000 FORMAT "%13.10" READ_ONLY NUMBER 13 /end CHARACTERISTIC
/begin CHARACTERISTIC DINH_Lim.DFC_UBmax_CA "inhibit conditions / inhibit limit conditions for inhibit source DFC_UBmax" VAL_BLK 0x90810EC ValA_Wu8 17.0000000000 DINH_LimDFCVerb 0.00 17.0000000000 FORMAT "%13.10" READ_ONLY NUMBER 7 /end CHARACTERISTIC
/begin CHARACTERISTIC DINH_Lim.DFC_UBmin_CA "inhibit conditions / inhibit limit conditions for inhibit source DFC_UBmin" VAL_BLK 0x90810F3 ValA_Wu8 17.0000000000 DINH_LimDFCVerb 0.00 17.0000000000 FORMAT "%13.10" READ_ONLY NUMBER 7 /end CHARACTERISTIC
/begin CHARACTERISTIC DINH_Lim.DFC_UBnpl_CA "inhibit conditions / inhibit limit conditions for inhibit source DFC_UBnpl" VAL_BLK 0x90810FA ValA_Wu8 17.0000000000 DINH_LimDFCVerb 0.00 17.0000000000 FORMAT "%13.10" READ_ONLY NUMBER 7 /end CHARACTERISTIC
/begin CHARACTERISTIC DINH_Lim.DFC_VFZsig_CA "inhibit conditions / inhibit limit conditions for inhibit source DFC_VFZsig" VAL_BLK 0x9081101 ValA_Wu8 17.0000000000 DINH_LimDFCVerb 0.00 17.0000000000 FORMAT "%13.10" READ_ONLY NUMBER 9 /end CHARACTERISTIC
/begin CHARACTERISTIC DINH_Lim.DFC_VFZsig2_CA "inhibit conditions / inhibit limit conditions for inhibit source DFC_VFZsig2" VAL_BLK 0x908110A ValA_Wu8 17.0000000000 DINH_LimDFCVerb 0.00 17.0000000000 FORMAT "%13.10" READ_ONLY NUMBER 3 /end CHARACTERISTIC
/begin CHARACTERISTIC DINH_Lim.DSQ_DSMInhibitAlways_CA "inhibit conditions / inhibit limit conditions for inhibit source DSQ_DSMInhibitAlways" VAL_BLK 0x908110D ValA_Wu8 16.0000000000 DINH_LimDSQVerb 0.00 16.0000000000 FORMAT "%13.10" READ_ONLY NUMBER 3 /end CHARACTERISTIC
/begin CHARACTERISTIC DINH_Lim.DSQ_EpmReverseRun_CA "inhibit conditions / inhibit limit conditions for inhibit source DSQ_EpmReverseRun" VAL_BLK 0x9081110 ValA_Wu8 16.0000000000 DINH_LimDSQVerb 0.00 16.0000000000 FORMAT "%13.10" READ_ONLY NUMBER 3 /end CHARACTERISTIC
/begin CHARACTERISTIC DINH_Lim.DSQ_MRly_CA "inhibit conditions / inhibit limit conditions for inhibit source DSQ_MRly" VAL_BLK 0x9081113 ValA_Wu8 16.0000000000 DINH_LimDSQVerb 0.00 16.0000000000 FORMAT "%13.10" READ_ONLY NUMBER 2 /end CHARACTERISTIC
/begin CHARACTERISTIC DINH_Lim.DSQ_RvsRotPred_CA "inhibit conditions / inhibit limit conditions for inhibit source DSQ_RvsRotPred" VAL_BLK 0x9081115 ValA_Wu8 16.0000000000 DINH_LimDSQVerb 0.00 16.0000000000 FORMAT "%13.10" READ_ONLY NUMBER 2 /end CHARACTERISTIC
/begin CHARACTERISTIC DINH_Lim.DSQ_StrtActr_CA "inhibit conditions / inhibit limit conditions for inhibit source DSQ_StrtActr" VAL_BLK 0x9081117 ValA_Wu8 16.0000000000 DINH_LimDSQVerb 0.00 16.0000000000 FORMAT "%13.10" READ_ONLY NUMBER 2 /end CHARACTERISTIC
/begin CHARACTERISTIC DINH_Lim.DSQ_T15TurnOfDly_CA "inhibit conditions / inhibit limit conditions for inhibit source DSQ_T15TurnOfDly" VAL_BLK 0x9081119 ValA_Wu8 16.0000000000 DINH_LimDSQVerb 0.00 16.0000000000 FORMAT "%13.10" READ_ONLY NUMBER 2 /end CHARACTERISTIC
/begin CHARACTERISTIC DINH_tiUpdObsv_C "Paging interval time of FId observer" VALUE 0x9081342 Val_Wu16 326.6000 Time_s 1.000000 327.6000 FORMAT "%8.4" EXTENDED_LIMITS 0.00 655.3500 /end CHARACTERISTIC
/begin CHARACTERISTIC DINH_xFIDObsv_C "Function identifier to scan by FId observer" VALUE 0x9081344 Val_Wu16 86. DINH_FIdVerb 0.00 86. FORMAT "%2.0" /end CHARACTERISTIC
/begin CHARACTERISTIC DIUMPR_ctGen.tiIgnMin_C "criterias to count general denominator and ignition cycle counter / minimum detection time for ignition cycle counter after engine start" VALUE 0x9080CB0 Val_Wu8 25.50 DIUMPR_ti100ms 0.00 25.50 FORMAT "%5.2" READ_ONLY /end CHARACTERISTIC
/begin CHARACTERISTIC DIUMPR_ctGen.tiActrMin_C "criterias to count general denominator and ignition cycle counter / minimum activation time of a component to increment denominator" VALUE 0x9080CB1 Val_Wu8 25.50 DIUMPR_ti100ms 0.00 25.50 FORMAT "%5.2" READ_ONLY /end CHARACTERISTIC
/begin CHARACTERISTIC DIUMPR_ctGen.l500MD_C "criterias to count general denominator and ignition cycle counter / minimal driven distance to release special 500 miles denominator" VALUE 0x9080CB2 Val_Wu8 1260. DIUMPR_l10km 0.00 1260. FORMAT "%5.0" EXTENDED_LIMITS 0.00 2550. READ_ONLY /end CHARACTERISTIC
/begin CHARACTERISTIC DIUMPR_ctGen.tiVehSpdMin_C "criterias to count general denominator and ignition cycle counter / minimum operation time about 25 miles per hour" VALUE 0x9080CB4 Val_Wu16 6553.500 DIUMPR_ti100ms 0.00 6553.500 FORMAT "%8.3" READ_ONLY /end CHARACTERISTIC
/begin CHARACTERISTIC DIUMPR_ctGen.pEnvMin_C "criterias to count general denominator and ignition cycle counter / maximum elevation (represented by minimum air pressure)" VALUE 0x9080CB6 Val_Ws16 65535.00 Pres_hPa -32768.00 32767.00 FORMAT "%8.2" READ_ONLY /end CHARACTERISTIC
/begin CHARACTERISTIC DIUMPR_ctGen.vVehMin_C "criterias to count general denominator and ignition cycle counter / minimum vehicle speed" VALUE 0x9080CB8 Val_Ws16 655.3500 Vel -327.6800 327.6700 FORMAT "%8.4" READ_ONLY /end CHARACTERISTIC
/begin CHARACTERISTIC DIUMPR_ctGen.rAPPMax_C "criterias to count general denominator and ignition cycle counter / maximum accelerator pedal position for idle detection" VALUE 0x9080CBA Val_Ws16 799.9878 Prc -400.0000 399.9878 FORMAT "%8.4" READ_ONLY /end CHARACTERISTIC
/begin CHARACTERISTIC DIUMPR_ctGen.vVehIdlMax_C "criterias to count general denominator and ignition cycle counter / maximim vehicle speed for idle detection" VALUE 0x9080CBC Val_Ws16 655.3500 Vel -327.6800 327.6700 FORMAT "%8.4" READ_ONLY /end CHARACTERISTIC
/begin CHARACTERISTIC DIUMPR_ctGen.tEnvMin_C "criterias to count general denominator and ignition cycle counter / mimimum ambient temperatur" VALUE 0x9080CBE Val_Ws16 6553.500 Temp_Cels -3549.940 3003.560 FORMAT "%8.3" READ_ONLY /end CHARACTERISTIC
/begin CHARACTERISTIC DIUMPR_ctGen.tiIdlMin_C "criterias to count general denominator and ignition cycle counter / minimum operation time in idle state" VALUE 0x9080CC0 Val_Wu16 6553.500 DIUMPR_ti100ms 0.00 6553.500 FORMAT "%8.3" READ_ONLY /end CHARACTERISTIC
/begin CHARACTERISTIC DIUMPR_ctGen.tiOpMin_C "criterias to count general denominator and ignition cycle counter / minimum operation time" VALUE 0x9080CC2 Val_Wu16 6553.500 DIUMPR_ti100ms 0.00 6553.500 FORMAT "%8.3" READ_ONLY /end CHARACTERISTIC
/begin CHARACTERISTIC DIUMPR_ctGen.l500MDInc_C "criterias to count general denominator and ignition cycle counter / Number of increments of the internal odometer to reach a interval of 10 km" VALUE 0x9080CC4 Val_Ws16 65535.00 OneToOne -32768.00 32767.00 FORMAT "%8.2" READ_ONLY /end CHARACTERISTIC
/begin CHARACTERISTIC DIUMPR_ctGen.tiSigContActv_C "criterias to count general denominator and ignition cycle counter / minimum energising time twice required for a component to increment the denominator" VALUE 0x9080CC6 Val_Wu8 3.000 DIUMPR_ti100ms 0.00 3.000 FORMAT "%5.3" EXTENDED_LIMITS 0.00 25.50 READ_ONLY /end CHARACTERISTIC
/begin CHARACTERISTIC DIUMPR_ctGen.tiFuEngOpMin_C "criterias to count general denominator and ignition cycle counter / Minimal time for fueled engine firm(operation)" VALUE 0x9080CC8 Val_Wu16 6553.500 DIUMPR_ti100ms 0.00 6553.500 FORMAT "%8.3" READ_ONLY /end CHARACTERISTIC
/begin CHARACTERISTIC DIUMPR_Ctl.FId_CEngDsTSTC_C "IUPR control byte / control byte for in-use performance monitoring of FId_CEngDsTSTC" VALUE 0x9080CCA Val_Wu8 255.0 OneToOne 0.00 255.0 FORMAT "%5.1" READ_ONLY /end CHARACTERISTIC
/begin CHARACTERISTIC DIUMPR_Ctl.FId_IntkAirTAirFltDsSTC_C "IUPR control byte / control byte for in-use performance monitoring of FId_IntkAirTAirFltDsSTC" VALUE 0x9080CCB Val_Wu8 255.0 OneToOne 0.00 255.0 FORMAT "%5.1" READ_ONLY /end CHARACTERISTIC
/begin CHARACTERISTIC DIUMPR_Ctl.FId_OilPPSSwt_C "IUPR control byte / control byte for in-use performance monitoring of FId_OilPPSSwt" VALUE 0x9080CCC Val_Wu8 255.0 OneToOne 0.00 255.0 FORMAT "%5.1" READ_ONLY /end CHARACTERISTIC
/begin CHARACTERISTIC DIUMPR_Ctl.FId_SprkSeatTMdl_C "IUPR control byte / control byte for in-use performance monitoring of FId_SprkSeatTMdl" VALUE 0x9080CCD Val_Wu8 255.0 OneToOne 0.00 255.0 FORMAT "%5.1" READ_ONLY /end CHARACTERISTIC
/begin CHARACTERISTIC DIUMPR_Ctl.FId_StSysStrtCtl_C "IUPR control byte / control byte for in-use performance monitoring of FId_StSysStrtCtl" VALUE 0x9080CCE Val_Wu8 255.0 OneToOne 0.00 255.0 FORMAT "%5.1" READ_ONLY /end CHARACTERISTIC
/begin CHARACTERISTIC DIUMPR_Ctl.FId_TMnplChkIUMPR_C "IUPR control byte / control byte for in-use performance monitoring of FId_TMnplChkIUMPR" VALUE 0x9080CCF Val_Wu8 255.0 OneToOne 0.00 255.0 FORMAT "%5.1" READ_ONLY /end CHARACTERISTIC
/begin CHARACTERISTIC DIUMPR_Ctl.FId_dhlshk_C "IUPR control byte / control byte for in-use performance monitoring of FId_dhlshk" VALUE 0x9080CD0 Val_Wu8 255.0 OneToOne 0.00 255.0 FORMAT "%5.1" READ_ONLY /end CHARACTERISTIC
/begin CHARACTERISTIC DIUMPR_Ctl.FId_dhlsvk_C "IUPR control byte / control byte for in-use performance monitoring of FId_dhlsvk" VALUE 0x9080CD1 Val_Wu8 255.0 OneToOne 0.00 255.0 FORMAT "%5.1" READ_ONLY /end CHARACTERISTIC
/begin CHARACTERISTIC DIUMPR_Ctl.FId_dkat_C "IUPR control byte / control byte for in-use performance monitoring of FId_dkat" VALUE 0x9080CD2 Val_Wu8 255.0 OneToOne 0.00 255.0 FORMAT "%5.1" READ_ONLY /end CHARACTERISTIC
/begin CHARACTERISTIC DIUMPR_Ctl.FId_dlahi_C "IUPR control byte / control byte for in-use performance monitoring of FId_dlahi" VALUE 0x9080CD3 Val_Wu8 255.0 OneToOne 0.00 255.0 FORMAT "%5.1" READ_ONLY /end CHARACTERISTIC
/begin CHARACTERISTIC DIUMPR_Ctl.FId_dlsahk_C "IUPR control byte / control byte for in-use performance monitoring of FId_dlsahk" VALUE 0x9080CD4 Val_Wu8 255.0 OneToOne 0.00 255.0 FORMAT "%5.1" READ_ONLY /end CHARACTERISTIC
/begin CHARACTERISTIC DIUMPR_Ctl.FId_latp_C "IUPR control byte / control byte for in-use performance monitoring of FId_latp" VALUE 0x9080CD5 Val_Wu8 255.0 OneToOne 0.00 255.0 FORMAT "%5.1" READ_ONLY /end CHARACTERISTIC
/begin CHARACTERISTIC DIUMPR_DFC.FId_CEngDsTSTC_C "IUMPR related DFC / assigned fault check for in-use performance monitoring of FId_CEngDsTSTC" VALUE 0x9080CD6 Val_Wu16 160. DFC_Verb 0.00 160. FORMAT "%2.0" /end CHARACTERISTIC
/begin CHARACTERISTIC DIUMPR_DFC.FId_IntkAirTAirFltDsSTC_C "IUMPR related DFC / assigned fault check for in-use performance monitoring of FId_IntkAirTAirFltDsSTC" VALUE 0x9080CD8 Val_Wu16 160. DFC_Verb 0.00 160. FORMAT "%2.0" /end CHARACTERISTIC
/begin CHARACTERISTIC DIUMPR_DFC.FId_OilPPSSwt_C "IUMPR related DFC / assigned fault check for in-use performance monitoring of FId_OilPPSSwt" VALUE 0x9080CDA Val_Wu16 160. DFC_Verb 0.00 160. FORMAT "%2.0" /end CHARACTERISTIC
/begin CHARACTERISTIC DIUMPR_DFC.FId_SprkSeatTMdl_C "IUMPR related DFC / assigned fault check for in-use performance monitoring of FId_SprkSeatTMdl" VALUE 0x9080CDC Val_Wu16 160. DFC_Verb 0.00 160. FORMAT "%2.0" /end CHARACTERISTIC
/begin CHARACTERISTIC DIUMPR_DFC.FId_StSysStrtCtl_C "IUMPR related DFC / assigned fault check for in-use performance monitoring of FId_StSysStrtCtl" VALUE 0x9080CDE Val_Wu16 160. DFC_Verb 0.00 160. FORMAT "%2.0" /end CHARACTERISTIC
/begin CHARACTERISTIC DIUMPR_DFC.FId_TMnplChkIUMPR_C "IUMPR related DFC / assigned fault check for in-use performance monitoring of FId_TMnplChkIUMPR" VALUE 0x9080CE0 Val_Wu16 160. DFC_Verb 0.00 160. FORMAT "%2.0" /end CHARACTERISTIC
/begin CHARACTERISTIC DIUMPR_DFC.FId_dhlshk_C "IUMPR related DFC / assigned fault check for in-use performance monitoring of FId_dhlshk" VALUE 0x9080CE2 Val_Wu16 160. DFC_Verb 0.00 160. FORMAT "%2.0" /end CHARACTERISTIC
/begin CHARACTERISTIC DIUMPR_DFC.FId_dhlsvk_C "IUMPR related DFC / assigned fault check for in-use performance monitoring of FId_dhlsvk" VALUE 0x9080CE4 Val_Wu16 160. DFC_Verb 0.00 160. FORMAT "%2.0" /end CHARACTERISTIC
/begin CHARACTERISTIC DIUMPR_DFC.FId_dkat_C "IUMPR related DFC / assigned fault check for in-use performance monitoring of FId_dkat" VALUE 0x9080CE6 Val_Wu16 160. DFC_Verb 0.00 160. FORMAT "%2.0" /end CHARACTERISTIC
/begin CHARACTERISTIC DIUMPR_DFC.FId_dlahi_C "IUMPR related DFC / assigned fault check for in-use performance monitoring of FId_dlahi" VALUE 0x9080CE8 Val_Wu16 160. DFC_Verb 0.00 160. FORMAT "%2.0" /end CHARACTERISTIC
/begin CHARACTERISTIC DIUMPR_DFC.FId_dlsahk_C "IUMPR related DFC / assigned fault check for in-use performance monitoring of FId_dlsahk" VALUE 0x9080CEA Val_Wu16 160. DFC_Verb 0.00 160. FORMAT "%2.0" /end CHARACTERISTIC
/begin CHARACTERISTIC DIUMPR_DFC.FId_latp_C "IUMPR related DFC / assigned fault check for in-use performance monitoring of FId_latp" VALUE 0x9080CEC Val_Wu16 160. DFC_Verb 0.00 160. FORMAT "%2.0" /end CHARACTERISTIC
/begin CHARACTERISTIC DIUMPR_Grp.FId_CEngDsTSTC_C "IUPR group / component group for in-use performance monitoring of FId_CEngDsTSTC" VALUE 0x9080CEE Val_Wu8 10. DIUMPR_GroupVerb 0.00 10. FORMAT "%2.0" READ_ONLY /end CHARACTERISTIC
/begin CHARACTERISTIC DIUMPR_Grp.FId_IntkAirTAirFltDsSTC_C "IUPR group / component group for in-use performance monitoring of FId_IntkAirTAirFltDsSTC" VALUE 0x9080CEF Val_Wu8 10. DIUMPR_GroupVerb 0.00 10. FORMAT "%2.0" READ_ONLY /end CHARACTERISTIC
/begin CHARACTERISTIC DIUMPR_Grp.FId_OilPPSSwt_C "IUPR group / component group for in-use performance monitoring of FId_OilPPSSwt" VALUE 0x9080CF0 Val_Wu8 10. DIUMPR_GroupVerb 0.00 10. FORMAT "%2.0" READ_ONLY /end CHARACTERISTIC
/begin CHARACTERISTIC DIUMPR_Grp.FId_SprkSeatTMdl_C "IUPR group / component group for in-use performance monitoring of FId_SprkSeatTMdl" VALUE 0x9080CF1 Val_Wu8 10. DIUMPR_GroupVerb 0.00 10. FORMAT "%2.0" READ_ONLY /end CHARACTERISTIC
/begin CHARACTERISTIC DIUMPR_Grp.FId_StSysStrtCtl_C "IUPR group / component group for in-use performance monitoring of FId_StSysStrtCtl" VALUE 0x9080CF2 Val_Wu8 10. DIUMPR_GroupVerb 0.00 10. FORMAT "%2.0" READ_ONLY /end CHARACTERISTIC
/begin CHARACTERISTIC DIUMPR_Grp.FId_TMnplChkIUMPR_C "IUPR group / component group for in-use performance monitoring of FId_TMnplChkIUMPR" VALUE 0x9080CF3 Val_Wu8 10. DIUMPR_GroupVerb 0.00 10. FORMAT "%2.0" READ_ONLY /end CHARACTERISTIC
/begin CHARACTERISTIC DIUMPR_Grp.FId_dhlshk_C "IUPR group / component group for in-use performance monitoring of FId_dhlshk" VALUE 0x9080CF4 Val_Wu8 10. DIUMPR_GroupVerb 0.00 10. FORMAT "%2.0" READ_ONLY /end CHARACTERISTIC
/begin CHARACTERISTIC DIUMPR_Grp.FId_dhlsvk_C "IUPR group / component group for in-use performance monitoring of FId_dhlsvk" VALUE 0x9080CF5 Val_Wu8 10. DIUMPR_GroupVerb 0.00 10. FORMAT "%2.0" READ_ONLY /end CHARACTERISTIC
/begin CHARACTERISTIC DIUMPR_Grp.FId_dkat_C "IUPR group / component group for in-use performance monitoring of FId_dkat" VALUE 0x9080CF6 Val_Wu8 10. DIUMPR_GroupVerb 0.00 10. FORMAT "%2.0" READ_ONLY /end CHARACTERISTIC
/begin CHARACTERISTIC DIUMPR_Grp.FId_dlahi_C "IUPR group / component group for in-use performance monitoring of FId_dlahi" VALUE 0x9080CF7 Val_Wu8 10. DIUMPR_GroupVerb 0.00 10. FORMAT "%2.0" READ_ONLY /end CHARACTERISTIC
/begin CHARACTERISTIC DIUMPR_Grp.FId_dlsahk_C "IUPR group / component group for in-use performance monitoring of FId_dlsahk" VALUE 0x9080CF8 Val_Wu8 10. DIUMPR_GroupVerb 0.00 10. FORMAT "%2.0" READ_ONLY /end CHARACTERISTIC
/begin CHARACTERISTIC DIUMPR_Grp.FId_latp_C "IUPR group / component group for in-use performance monitoring of FId_latp" VALUE 0x9080CF9 Val_Wu8 10. DIUMPR_GroupVerb 0.00 10. FORMAT "%2.0" READ_ONLY /end CHARACTERISTIC
/begin MEASUREMENT DINH_ctMonCorr "Counter of actions done by check routine of inhibit handler" UWORD OneToOne 1 100 0.00 65535.00 FORMAT "%8.2" ECU_ADDRESS 0x40005D10 /end MEASUREMENT
/begin MEASUREMENT DINH_DSQSrv7Vis "Service 0x07 visibility of DSQs" UWORD OneToOne 1 100 0.00 65535.00 FORMAT "%8.2" ARRAY_SIZE 1 ECU_ADDRESS 0x40005F06 /end MEASUREMENT
/begin MEASUREMENT DINH_FIdSrv7Vis "Service 0x07 visibility of FIds" UWORD OneToOne 1 100 0.00 65535.00 FORMAT "%8.2" ARRAY_SIZE 6 ECU_ADDRESS 0x40005F08 /end MEASUREMENT
/begin MEASUREMENT DINH_nrActvInhReas.FId_InhibitAlways "Number of active inhibit reasons for the FIds / Number of active inhibit reasons for FId_InhibitAlways" UWORD DINH_ct_Compu 1 100 -4095.000 4096.000 BIT_MASK 0x1fff FORMAT "%8.3" ECU_ADDRESS 0x40005F22 /end MEASUREMENT
/begin MEASUREMENT DINH_nrActvInhReas.FID_GGVFZG "Number of active inhibit reasons for the FIds / Number of active inhibit reasons for FID_GGVFZG" UWORD DINH_ct_Compu 1 100 -4095.000 4096.000 BIT_MASK 0x1fff FORMAT "%8.3" ECU_ADDRESS 0x40005F24 /end MEASUREMENT
/begin MEASUREMENT DINH_nrActvInhReas.FId_AEKPROVS "Number of active inhibit reasons for the FIds / Number of active inhibit reasons for FId_AEKPROVS" UWORD DINH_ct_Compu 1 100 -4095.000 4096.000 BIT_MASK 0x1fff FORMAT "%8.3" ECU_ADDRESS 0x40005F26 /end MEASUREMENT
/begin MEASUREMENT DINH_nrActvInhReas.FId_BypAirActrPsElecErr "Number of active inhibit reasons for the FIds / Number of active inhibit reasons for FId_BypAirActrPsElecErr" UWORD DINH_ct_Compu 1 100 -4095.000 4096.000 BIT_MASK 0x1fff FORMAT "%8.3" ECU_ADDRESS 0x40005F28 /end MEASUREMENT
/begin MEASUREMENT DINH_nrActvInhReas.FId_BypAirActrPsIf "Number of active inhibit reasons for the FIds / Number of active inhibit reasons for FId_BypAirActrPsIf" UWORD DINH_ct_Compu 1 100 -4095.000 4096.000 BIT_MASK 0x1fff FORMAT "%8.3" ECU_ADDRESS 0x40005F2A /end MEASUREMENT
/begin MEASUREMENT DINH_nrActvInhReas.FId_BypAirActr_SteprMotPosnCtrl "Number of active inhibit reasons for the FIds / Number of active inhibit reasons for FId_BypAirActr_SteprMotPosnCtrl" UWORD DINH_ct_Compu 1 100 -4095.000 4096.000 BIT_MASK 0x1fff FORMAT "%8.3" ECU_ADDRESS 0x40005F2C /end MEASUREMENT
/begin MEASUREMENT DINH_nrActvInhReas.FId_CEngDsTSRCErr "Number of active inhibit reasons for the FIds / Number of active inhibit reasons for FId_CEngDsTSRCErr" UWORD DINH_ct_Compu 1 100 -4095.000 4096.000 BIT_MASK 0x1fff FORMAT "%8.3" ECU_ADDRESS 0x40005F2E /end MEASUREMENT
/begin MEASUREMENT DINH_nrActvInhReas.FId_CEngDsTSTC "Number of active inhibit reasons for the FIds / Number of active inhibit reasons for FId_CEngDsTSTC" UWORD DINH_ct_Compu 1 100 -4095.000 4096.000 BIT_MASK 0x1fff FORMAT "%8.3" ECU_ADDRESS 0x40005F30 /end MEASUREMENT
/begin MEASUREMENT DINH_nrActvInhReas.FId_ClthStkOpn "Number of active inhibit reasons for the FIds / Number of active inhibit reasons for FId_ClthStkOpn" UWORD DINH_ct_Compu 1 100 -4095.000 4096.000 BIT_MASK 0x1fff FORMAT "%8.3" ECU_ADDRESS 0x40005F32 /end MEASUREMENT
/begin MEASUREMENT DINH_nrActvInhReas.FId_ClthSwtSensErr "Number of active inhibit reasons for the FIds / Number of active inhibit reasons for FId_ClthSwtSensErr" UWORD DINH_ct_Compu 1 100 -4095.000 4096.000 BIT_MASK 0x1fff FORMAT "%8.3" ECU_ADDRESS 0x40005F34 /end MEASUREMENT
/begin MEASUREMENT DINH_nrActvInhReas.FId_DIA "Number of active inhibit reasons for the FIds / Number of active inhibit reasons for FId_DIA" UWORD DINH_ct_Compu 1 100 -4095.000 4096.000 BIT_MASK 0x1fff FORMAT "%8.3" ECU_ADDRESS 0x40005F36 /end MEASUREMENT
/begin MEASUREMENT DINH_nrActvInhReas.FId_DIUMPRGenDenom1 "Number of active inhibit reasons for the FIds / Number of active inhibit reasons for FId_DIUMPRGenDenom1" UWORD DINH_ct_Compu 1 100 -4095.000 4096.000 BIT_MASK 0x1fff FORMAT "%8.3" ECU_ADDRESS 0x40005F38 /end MEASUREMENT
/begin MEASUREMENT DINH_nrActvInhReas.FId_DIUMPRGenDenom2 "Number of active inhibit reasons for the FIds / Number of active inhibit reasons for FId_DIUMPRGenDenom2" UWORD DINH_ct_Compu 1 100 -4095.000 4096.000 BIT_MASK 0x1fff FORMAT "%8.3" ECU_ADDRESS 0x40005F3A /end MEASUREMENT
/begin MEASUREMENT DINH_nrActvInhReas.FId_DIUMPRGenDenom3 "Number of active inhibit reasons for the FIds / Number of active inhibit reasons for FId_DIUMPRGenDenom3" UWORD DINH_ct_Compu 1 100 -4095.000 4096.000 BIT_MASK 0x1fff FORMAT "%8.3" ECU_ADDRESS 0x40005F3C /end MEASUREMENT
/begin MEASUREMENT DINH_nrActvInhReas.FId_DIUMPRIgn "Number of active inhibit reasons for the FIds / Number of active inhibit reasons for FId_DIUMPRIgn" UWORD DINH_ct_Compu 1 100 -4095.000 4096.000 BIT_MASK 0x1fff FORMAT "%8.3" ECU_ADDRESS 0x40005F3E /end MEASUREMENT
/begin MEASUREMENT DINH_nrActvInhReas.FId_DK "Number of active inhibit reasons for the FIds / Number of active inhibit reasons for FId_DK" UWORD DINH_ct_Compu 1 100 -4095.000 4096.000 BIT_MASK 0x1fff FORMAT "%8.3" ECU_ADDRESS 0x40005F40 /end MEASUREMENT
/begin MEASUREMENT DINH_nrActvInhReas.FId_DKVS "Number of active inhibit reasons for the FIds / Number of active inhibit reasons for FId_DKVS" UWORD DINH_ct_Compu 1 100 -4095.000 4096.000 BIT_MASK 0x1fff FORMAT "%8.3" ECU_ADDRESS 0x40005F42 /end MEASUREMENT
/begin MEASUREMENT DINH_nrActvInhReas.FId_DLLR "Number of active inhibit reasons for the FIds / Number of active inhibit reasons for FId_DLLR" UWORD DINH_ct_Compu 1 100 -4095.000 4096.000 BIT_MASK 0x1fff FORMAT "%8.3" ECU_ADDRESS 0x40005F44 /end MEASUREMENT
/begin MEASUREMENT DINH_nrActvInhReas.FId_DLLSTP "Number of active inhibit reasons for the FIds / Number of active inhibit reasons for FId_DLLSTP" UWORD DINH_ct_Compu 1 100 -4095.000 4096.000 BIT_MASK 0x1fff FORMAT "%8.3" ECU_ADDRESS 0x40005F46 /end MEASUREMENT
/begin MEASUREMENT DINH_nrActvInhReas.FId_DSMWarmUpCycle "Number of active inhibit reasons for the FIds / Number of active inhibit reasons for FId_DSMWarmUpCycle" UWORD DINH_ct_Compu 1 100 -4095.000 4096.000 BIT_MASK 0x1fff FORMAT "%8.3" ECU_ADDRESS 0x40005F48 /end MEASUREMENT
/begin MEASUREMENT DINH_nrActvInhReas.FId_DSS "Number of active inhibit reasons for the FIds / Number of active inhibit reasons for FId_DSS" UWORD DINH_ct_Compu 1 100 -4095.000 4096.000 BIT_MASK 0x1fff FORMAT "%8.3" ECU_ADDRESS 0x40005F4A /end MEASUREMENT
/begin MEASUREMENT DINH_nrActvInhReas.FId_EDLLR "Number of active inhibit reasons for the FIds / Number of active inhibit reasons for FId_EDLLR" UWORD DINH_ct_Compu 1 100 -4095.000 4096.000 BIT_MASK 0x1fff FORMAT "%8.3" ECU_ADDRESS 0x40005F4C /end MEASUREMENT
/begin MEASUREMENT DINH_nrActvInhReas.FId_EpmCrSDiag "Number of active inhibit reasons for the FIds / Number of active inhibit reasons for FId_EpmCrSDiag" UWORD DINH_ct_Compu 1 100 -4095.000 4096.000 BIT_MASK 0x1fff FORMAT "%8.3" ECU_ADDRESS 0x40005F4E /end MEASUREMENT
/begin MEASUREMENT DINH_nrActvInhReas.FId_EpmCrSDiagBattU "Number of active inhibit reasons for the FIds / Number of active inhibit reasons for FId_EpmCrSDiagBattU" UWORD DINH_ct_Compu 1 100 -4095.000 4096.000 BIT_MASK 0x1fff FORMAT "%8.3" ECU_ADDRESS 0x40005F50 /end MEASUREMENT
/begin MEASUREMENT DINH_nrActvInhReas.FId_EpmCrSDiagVeh "Number of active inhibit reasons for the FIds / Number of active inhibit reasons for FId_EpmCrSDiagVeh" UWORD DINH_ct_Compu 1 100 -4095.000 4096.000 BIT_MASK 0x1fff FORMAT "%8.3" ECU_ADDRESS 0x40005F52 /end MEASUREMENT
/begin MEASUREMENT DINH_nrActvInhReas.FId_EpmCrSErr "Number of active inhibit reasons for the FIds / Number of active inhibit reasons for FId_EpmCrSErr" UWORD DINH_ct_Compu 1 100 -4095.000 4096.000 BIT_MASK 0x1fff FORMAT "%8.3" ECU_ADDRESS 0x40005F54 /end MEASUREMENT
/begin MEASUREMENT DINH_nrActvInhReas.FId_EpmCrSIntkMnfldP "Number of active inhibit reasons for the FIds / Number of active inhibit reasons for FId_EpmCrSIntkMnfldP" UWORD DINH_ct_Compu 1 100 -4095.000 4096.000 BIT_MASK 0x1fff FORMAT "%8.3" ECU_ADDRESS 0x40005F56 /end MEASUREMENT
/begin MEASUREMENT DINH_nrActvInhReas.FId_EpmRRSCrSFaultCheck "Number of active inhibit reasons for the FIds / Number of active inhibit reasons for FId_EpmRRSCrSFaultCheck" UWORD DINH_ct_Compu 1 100 -4095.000 4096.000 BIT_MASK 0x1fff FORMAT "%8.3" ECU_ADDRESS 0x40005F58 /end MEASUREMENT
/begin MEASUREMENT DINH_nrActvInhReas.FId_EpmRRSVehVFaultChck "Number of active inhibit reasons for the FIds / Number of active inhibit reasons for FId_EpmRRSVehVFaultChck" UWORD DINH_ct_Compu 1 100 -4095.000 4096.000 BIT_MASK 0x1fff FORMAT "%8.3" ECU_ADDRESS 0x40005F5A /end MEASUREMENT
/begin MEASUREMENT DINH_nrActvInhReas.FId_EpmSynIntkMnfldP "Number of active inhibit reasons for the FIds / Number of active inhibit reasons for FId_EpmSynIntkMnfldP" UWORD DINH_ct_Compu 1 100 -4095.000 4096.000 BIT_MASK 0x1fff FORMAT "%8.3" ECU_ADDRESS 0x40005F5C /end MEASUREMENT
/begin MEASUREMENT DINH_nrActvInhReas.FId_FKMSDK "Number of active inhibit reasons for the FIds / Number of active inhibit reasons for FId_FKMSDK" UWORD DINH_ct_Compu 1 100 -4095.000 4096.000 BIT_MASK 0x1fff FORMAT "%8.3" ECU_ADDRESS 0x40005F5E /end MEASUREMENT
/begin MEASUREMENT DINH_nrActvInhReas.FId_HEGOS1Htg "Number of active inhibit reasons for the FIds / Number of active inhibit reasons for FId_HEGOS1Htg" UWORD DINH_ct_Compu 1 100 -4095.000 4096.000 BIT_MASK 0x1fff FORMAT "%8.3" ECU_ADDRESS 0x40005F60 /end MEASUREMENT
/begin MEASUREMENT DINH_nrActvInhReas.FId_HEGOS2Htg "Number of active inhibit reasons for the FIds / Number of active inhibit reasons for FId_HEGOS2Htg" UWORD DINH_ct_Compu 1 100 -4095.000 4096.000 BIT_MASK 0x1fff FORMAT "%8.3" ECU_ADDRESS 0x40005F62 /end MEASUREMENT
/begin MEASUREMENT DINH_nrActvInhReas.FId_IgnActvCoilDiag "Number of active inhibit reasons for the FIds / Number of active inhibit reasons for FId_IgnActvCoilDiag" UWORD DINH_ct_Compu 1 100 -4095.000 4096.000 BIT_MASK 0x1fff FORMAT "%8.3" ECU_ADDRESS 0x40005F64 /end MEASUREMENT
/begin MEASUREMENT DINH_nrActvInhReas.FId_InhibitNever "Number of active inhibit reasons for the FIds / Number of active inhibit reasons for FId_InhibitNever" UWORD DINH_ct_Compu 1 100 -4095.000 4096.000 BIT_MASK 0x1fff FORMAT "%8.3" ECU_ADDRESS 0x40005F66 /end MEASUREMENT
/begin MEASUREMENT DINH_nrActvInhReas.FId_InjSysPlausTripRcrd "Number of active inhibit reasons for the FIds / Number of active inhibit reasons for FId_InjSysPlausTripRcrd" UWORD DINH_ct_Compu 1 100 -4095.000 4096.000 BIT_MASK 0x1fff FORMAT "%8.3" ECU_ADDRESS 0x40005F68 /end MEASUREMENT
/begin MEASUREMENT DINH_nrActvInhReas.FId_IntkAirTAirFltDsSRCErr "Number of active inhibit reasons for the FIds / Number of active inhibit reasons for FId_IntkAirTAirFltDsSRCErr" UWORD DINH_ct_Compu 1 100 -4095.000 4096.000 BIT_MASK 0x1fff FORMAT "%8.3" ECU_ADDRESS 0x40005F6A /end MEASUREMENT
/begin MEASUREMENT DINH_nrActvInhReas.FId_IntkAirTAirFltDsSTC "Number of active inhibit reasons for the FIds / Number of active inhibit reasons for FId_IntkAirTAirFltDsSTC" UWORD DINH_ct_Compu 1 100 -4095.000 4096.000 BIT_MASK 0x1fff FORMAT "%8.3" ECU_ADDRESS 0x40005F6C /end MEASUREMENT
/begin MEASUREMENT DINH_nrActvInhReas.FId_KHZ "Number of active inhibit reasons for the FIds / Number of active inhibit reasons for FId_KHZ" UWORD DINH_ct_Compu 1 100 -4095.000 4096.000 BIT_MASK 0x1fff FORMAT "%8.3" ECU_ADDRESS 0x40005F6E /end MEASUREMENT
/begin MEASUREMENT DINH_nrActvInhReas.FId_MisfDetEnvP "Number of active inhibit reasons for the FIds / Number of active inhibit reasons for FId_MisfDetEnvP" UWORD DINH_ct_Compu 1 100 -4095.000 4096.000 BIT_MASK 0x1fff FORMAT "%8.3" ECU_ADDRESS 0x40005F70 /end MEASUREMENT
/begin MEASUREMENT DINH_nrActvInhReas.FId_MisfDetGbx "Number of active inhibit reasons for the FIds / Number of active inhibit reasons for FId_MisfDetGbx" UWORD DINH_ct_Compu 1 100 -4095.000 4096.000 BIT_MASK 0x1fff FORMAT "%8.3" ECU_ADDRESS 0x40005F72 /end MEASUREMENT
/begin MEASUREMENT DINH_nrActvInhReas.FId_MisfDetShtrpAct "Number of active inhibit reasons for the FIds / Number of active inhibit reasons for FId_MisfDetShtrpAct" UWORD DINH_ct_Compu 1 100 -4095.000 4096.000 BIT_MASK 0x1fff FORMAT "%8.3" ECU_ADDRESS 0x40005F74 /end MEASUREMENT
/begin MEASUREMENT DINH_nrActvInhReas.FId_MisfDetStc "Number of active inhibit reasons for the FIds / Number of active inhibit reasons for FId_MisfDetStc" UWORD DINH_ct_Compu 1 100 -4095.000 4096.000 BIT_MASK 0x1fff FORMAT "%8.3" ECU_ADDRESS 0x40005F76 /end MEASUREMENT
/begin MEASUREMENT DINH_nrActvInhReas.FId_MisfDetV "Number of active inhibit reasons for the FIds / Number of active inhibit reasons for FId_MisfDetV" UWORD DINH_ct_Compu 1 100 -4095.000 4096.000 BIT_MASK 0x1fff FORMAT "%8.3" ECU_ADDRESS 0x40005F78 /end MEASUREMENT
/begin MEASUREMENT DINH_nrActvInhReas.FId_MisfDet_InjLockdOpen01 "Number of active inhibit reasons for the FIds / Number of active inhibit reasons for FId_MisfDet_InjLockdOpen01" UWORD DINH_ct_Compu 1 100 -4095.000 4096.000 BIT_MASK 0x1fff FORMAT "%8.3" ECU_ADDRESS 0x40005F7A /end MEASUREMENT
/begin MEASUREMENT DINH_nrActvInhReas.FId_NMAXMDTempErr "Number of active inhibit reasons for the FIds / Number of active inhibit reasons for FId_NMAXMDTempErr" UWORD DINH_ct_Compu 1 100 -4095.000 4096.000 BIT_MASK 0x1fff FORMAT "%8.3" ECU_ADDRESS 0x40005F7C /end MEASUREMENT
/begin MEASUREMENT DINH_nrActvInhReas.FId_NeutSwtSensErr "Number of active inhibit reasons for the FIds / Number of active inhibit reasons for FId_NeutSwtSensErr" UWORD DINH_ct_Compu 1 100 -4095.000 4096.000 BIT_MASK 0x1fff FORMAT "%8.3" ECU_ADDRESS 0x40005F7E /end MEASUREMENT
/begin MEASUREMENT DINH_nrActvInhReas.FId_OilPPSSwt "Number of active inhibit reasons for the FIds / Number of active inhibit reasons for FId_OilPPSSwt" UWORD DINH_ct_Compu 1 100 -4095.000 4096.000 BIT_MASK 0x1fff FORMAT "%8.3" ECU_ADDRESS 0x40005F80 /end MEASUREMENT
/begin MEASUREMENT DINH_nrActvInhReas.FId_PIntkVUsSnsrSply "Number of active inhibit reasons for the FIds / Number of active inhibit reasons for FId_PIntkVUsSnsrSply" UWORD DINH_ct_Compu 1 100 -4095.000 4096.000 BIT_MASK 0x1fff FORMAT "%8.3" ECU_ADDRESS 0x40005F82 /end MEASUREMENT
/begin MEASUREMENT DINH_nrActvInhReas.FId_PSPInjErr "Number of active inhibit reasons for the FIds / Number of active inhibit reasons for FId_PSPInjErr" UWORD DINH_ct_Compu 1 100 -4095.000 4096.000 BIT_MASK 0x1fff FORMAT "%8.3" ECU_ADDRESS 0x40005F84 /end MEASUREMENT
/begin MEASUREMENT DINH_nrActvInhReas.FId_Rollovr_DetnElecErr "Number of active inhibit reasons for the FIds / Number of active inhibit reasons for FId_Rollovr_DetnElecErr" UWORD DINH_ct_Compu 1 100 -4095.000 4096.000 BIT_MASK 0x1fff FORMAT "%8.3" ECU_ADDRESS 0x40005F86 /end MEASUREMENT
/begin MEASUREMENT DINH_nrActvInhReas.FId_Rollovr_DetnSSpErr "Number of active inhibit reasons for the FIds / Number of active inhibit reasons for FId_Rollovr_DetnSSpErr" UWORD DINH_ct_Compu 1 100 -4095.000 4096.000 BIT_MASK 0x1fff FORMAT "%8.3" ECU_ADDRESS 0x40005F88 /end MEASUREMENT
/begin MEASUREMENT DINH_nrActvInhReas.FId_SdSTClth "Number of active inhibit reasons for the FIds / Number of active inhibit reasons for FId_SdSTClth" UWORD DINH_ct_Compu 1 100 -4095.000 4096.000 BIT_MASK 0x1fff FORMAT "%8.3" ECU_ADDRESS 0x40005F8A /end MEASUREMENT
/begin MEASUREMENT DINH_nrActvInhReas.FId_SdSTDiagErr "Number of active inhibit reasons for the FIds / Number of active inhibit reasons for FId_SdSTDiagErr" UWORD DINH_ct_Compu 1 100 -4095.000 4096.000 BIT_MASK 0x1fff FORMAT "%8.3" ECU_ADDRESS 0x40005F8C /end MEASUREMENT
/begin MEASUREMENT DINH_nrActvInhReas.FId_SdSTNGS "Number of active inhibit reasons for the FIds / Number of active inhibit reasons for FId_SdSTNGS" UWORD DINH_ct_Compu 1 100 -4095.000 4096.000 BIT_MASK 0x1fff FORMAT "%8.3" ECU_ADDRESS 0x40005F8E /end MEASUREMENT
/begin MEASUREMENT DINH_nrActvInhReas.FId_SdSTSSpErr "Number of active inhibit reasons for the FIds / Number of active inhibit reasons for FId_SdSTSSpErr" UWORD DINH_ct_Compu 1 100 -4095.000 4096.000 BIT_MASK 0x1fff FORMAT "%8.3" ECU_ADDRESS 0x40005F90 /end MEASUREMENT
/begin MEASUREMENT DINH_nrActvInhReas.FId_SprkSeatTMdl "Number of active inhibit reasons for the FIds / Number of active inhibit reasons for FId_SprkSeatTMdl" UWORD DINH_ct_Compu 1 100 -4095.000 4096.000 BIT_MASK 0x1fff FORMAT "%8.3" ECU_ADDRESS 0x40005F92 /end MEASUREMENT
/begin MEASUREMENT DINH_nrActvInhReas.FId_StSysStrtCtl "Number of active inhibit reasons for the FIds / Number of active inhibit reasons for FId_StSysStrtCtl" UWORD DINH_ct_Compu 1 100 -4095.000 4096.000 BIT_MASK 0x1fff FORMAT "%8.3" ECU_ADDRESS 0x40005F94 /end MEASUREMENT
/begin MEASUREMENT DINH_nrActvInhReas.FId_StrtVDModel "Number of active inhibit reasons for the FIds / Number of active inhibit reasons for FId_StrtVDModel" UWORD DINH_ct_Compu 1 100 -4095.000 4096.000 BIT_MASK 0x1fff FORMAT "%8.3" ECU_ADDRESS 0x40005F96 /end MEASUREMENT
/begin MEASUREMENT DINH_nrActvInhReas.FId_TMLFS "Number of active inhibit reasons for the FIds / Number of active inhibit reasons for FId_TMLFS" UWORD DINH_ct_Compu 1 100 -4095.000 4096.000 BIT_MASK 0x1fff FORMAT "%8.3" ECU_ADDRESS 0x40005F98 /end MEASUREMENT
/begin MEASUREMENT DINH_nrActvInhReas.FId_TMnplChkIUMPR "Number of active inhibit reasons for the FIds / Number of active inhibit reasons for FId_TMnplChkIUMPR" UWORD DINH_ct_Compu 1 100 -4095.000 4096.000 BIT_MASK 0x1fff FORMAT "%8.3" ECU_ADDRESS 0x40005F9A /end MEASUREMENT
/begin MEASUREMENT DINH_nrActvInhReas.FId_ThrVlvSnsrSply "Number of active inhibit reasons for the FIds / Number of active inhibit reasons for FId_ThrVlvSnsrSply" UWORD DINH_ct_Compu 1 100 -4095.000 4096.000 BIT_MASK 0x1fff FORMAT "%8.3" ECU_ADDRESS 0x40005F9C /end MEASUREMENT
/begin MEASUREMENT DINH_nrActvInhReas.FId_UBLFS "Number of active inhibit reasons for the FIds / Number of active inhibit reasons for FId_UBLFS" UWORD DINH_ct_Compu 1 100 -4095.000 4096.000 BIT_MASK 0x1fff FORMAT "%8.3" ECU_ADDRESS 0x40005F9E /end MEASUREMENT
/begin MEASUREMENT DINH_nrActvInhReas.FId_bbte "Number of active inhibit reasons for the FIds / Number of active inhibit reasons for FId_bbte" UWORD DINH_ct_Compu 1 100 -4095.000 4096.000 BIT_MASK 0x1fff FORMAT "%8.3" ECU_ADDRESS 0x40005FA0 /end MEASUREMENT
/begin MEASUREMENT DINH_nrActvInhReas.FId_cfflsh "Number of active inhibit reasons for the FIds / Number of active inhibit reasons for FId_cfflsh" UWORD DINH_ct_Compu 1 100 -4095.000 4096.000 BIT_MASK 0x1fff FORMAT "%8.3" ECU_ADDRESS 0x40005FA2 /end MEASUREMENT
/begin MEASUREMENT DINH_nrActvInhReas.FId_cfflsv "Number of active inhibit reasons for the FIds / Number of active inhibit reasons for FId_cfflsv" UWORD DINH_ct_Compu 1 100 -4095.000 4096.000 BIT_MASK 0x1fff FORMAT "%8.3" ECU_ADDRESS 0x40005FA4 /end MEASUREMENT
/begin MEASUREMENT DINH_nrActvInhReas.FId_dhlshk "Number of active inhibit reasons for the FIds / Number of active inhibit reasons for FId_dhlshk" UWORD DINH_ct_Compu 1 100 -4095.000 4096.000 BIT_MASK 0x1fff FORMAT "%8.3" ECU_ADDRESS 0x40005FA6 /end MEASUREMENT
/begin MEASUREMENT DINH_nrActvInhReas.FId_dhlsvk "Number of active inhibit reasons for the FIds / Number of active inhibit reasons for FId_dhlsvk" UWORD DINH_ct_Compu 1 100 -4095.000 4096.000 BIT_MASK 0x1fff FORMAT "%8.3" ECU_ADDRESS 0x40005FA8 /end MEASUREMENT
/begin MEASUREMENT DINH_nrActvInhReas.FId_dkat "Number of active inhibit reasons for the FIds / Number of active inhibit reasons for FId_dkat" UWORD DINH_ct_Compu 1 100 -4095.000 4096.000 BIT_MASK 0x1fff FORMAT "%8.3" ECU_ADDRESS 0x40005FAA /end MEASUREMENT
/begin MEASUREMENT DINH_nrActvInhReas.FId_dlahi "Number of active inhibit reasons for the FIds / Number of active inhibit reasons for FId_dlahi" UWORD DINH_ct_Compu 1 100 -4095.000 4096.000 BIT_MASK 0x1fff FORMAT "%8.3" ECU_ADDRESS 0x40005FAC /end MEASUREMENT
/begin MEASUREMENT DINH_nrActvInhReas.FId_dlashmn "Number of active inhibit reasons for the FIds / Number of active inhibit reasons for FId_dlashmn" UWORD DINH_ct_Compu 1 100 -4095.000 4096.000 BIT_MASK 0x1fff FORMAT "%8.3" ECU_ADDRESS 0x40005FAE /end MEASUREMENT
/begin MEASUREMENT DINH_nrActvInhReas.FId_dlashmx "Number of active inhibit reasons for the FIds / Number of active inhibit reasons for FId_dlashmx" UWORD DINH_ct_Compu 1 100 -4095.000 4096.000 BIT_MASK 0x1fff FORMAT "%8.3" ECU_ADDRESS 0x40005FB0 /end MEASUREMENT
/begin MEASUREMENT DINH_nrActvInhReas.FId_dlsa "Number of active inhibit reasons for the FIds / Number of active inhibit reasons for FId_dlsa" UWORD DINH_ct_Compu 1 100 -4095.000 4096.000 BIT_MASK 0x1fff FORMAT "%8.3" ECU_ADDRESS 0x40005FB2 /end MEASUREMENT
/begin MEASUREMENT DINH_nrActvInhReas.FId_dlsahk "Number of active inhibit reasons for the FIds / Number of active inhibit reasons for FId_dlsahk" UWORD DINH_ct_Compu 1 100 -4095.000 4096.000 BIT_MASK 0x1fff FORMAT "%8.3" ECU_ADDRESS 0x40005FB4 /end MEASUREMENT
/begin MEASUREMENT DINH_nrActvInhReas.FId_dlsahsv "Number of active inhibit reasons for the FIds / Number of active inhibit reasons for FId_dlsahsv" UWORD DINH_ct_Compu 1 100 -4095.000 4096.000 BIT_MASK 0x1fff FORMAT "%8.3" ECU_ADDRESS 0x40005FB6 /end MEASUREMENT
/begin MEASUREMENT DINH_nrActvInhReas.FId_dlshen "Number of active inhibit reasons for the FIds / Number of active inhibit reasons for FId_dlshen" UWORD DINH_ct_Compu 1 100 -4095.000 4096.000 BIT_MASK 0x1fff FORMAT "%8.3" ECU_ADDRESS 0x40005FB8 /end MEASUREMENT
/begin MEASUREMENT DINH_nrActvInhReas.FId_dlshklt "Number of active inhibit reasons for the FIds / Number of active inhibit reasons for FId_dlshklt" UWORD DINH_ct_Compu 1 100 -4095.000 4096.000 BIT_MASK 0x1fff FORMAT "%8.3" ECU_ADDRESS 0x40005FBA /end MEASUREMENT
/begin MEASUREMENT DINH_nrActvInhReas.FId_dlsven "Number of active inhibit reasons for the FIds / Number of active inhibit reasons for FId_dlsven" UWORD DINH_ct_Compu 1 100 -4095.000 4096.000 BIT_MASK 0x1fff FORMAT "%8.3" ECU_ADDRESS 0x40005FBC /end MEASUREMENT
/begin MEASUREMENT DINH_nrActvInhReas.FId_dlsvhub "Number of active inhibit reasons for the FIds / Number of active inhibit reasons for FId_dlsvhub" UWORD DINH_ct_Compu 1 100 -4095.000 4096.000 BIT_MASK 0x1fff FORMAT "%8.3" ECU_ADDRESS 0x40005FBE /end MEASUREMENT
/begin MEASUREMENT DINH_nrActvInhReas.FId_dlsvklt "Number of active inhibit reasons for the FIds / Number of active inhibit reasons for FId_dlsvklt" UWORD DINH_ct_Compu 1 100 -4095.000 4096.000 BIT_MASK 0x1fff FORMAT "%8.3" ECU_ADDRESS 0x40005FC0 /end MEASUREMENT
/begin MEASUREMENT DINH_nrActvInhReas.FId_dsschub "Number of active inhibit reasons for the FIds / Number of active inhibit reasons for FId_dsschub" UWORD DINH_ct_Compu 1 100 -4095.000 4096.000 BIT_MASK 0x1fff FORMAT "%8.3" ECU_ADDRESS 0x40005FC2 /end MEASUREMENT
/begin MEASUREMENT DINH_nrActvInhReas.FId_latp "Number of active inhibit reasons for the FIds / Number of active inhibit reasons for FId_latp" UWORD DINH_ct_Compu 1 100 -4095.000 4096.000 BIT_MASK 0x1fff FORMAT "%8.3" ECU_ADDRESS 0x40005FC4 /end MEASUREMENT
/begin MEASUREMENT DINH_nrActvInhReas.FId_lra "Number of active inhibit reasons for the FIds / Number of active inhibit reasons for FId_lra" UWORD DINH_ct_Compu 1 100 -4095.000 4096.000 BIT_MASK 0x1fff FORMAT "%8.3" ECU_ADDRESS 0x40005FC6 /end MEASUREMENT
/begin MEASUREMENT DINH_nrActvInhReas.FId_lreb "Number of active inhibit reasons for the FIds / Number of active inhibit reasons for FId_lreb" UWORD DINH_ct_Compu 1 100 -4095.000 4096.000 BIT_MASK 0x1fff FORMAT "%8.3" ECU_ADDRESS 0x40005FC8 /end MEASUREMENT
/begin MEASUREMENT DINH_nrActvInhReas.FId_lrhk "Number of active inhibit reasons for the FIds / Number of active inhibit reasons for FId_lrhk" UWORD DINH_ct_Compu 1 100 -4095.000 4096.000 BIT_MASK 0x1fff FORMAT "%8.3" ECU_ADDRESS 0x40005FCA /end MEASUREMENT
/begin MEASUREMENT DINH_nrActvInhReas.FId_vmaxmd "Number of active inhibit reasons for the FIds / Number of active inhibit reasons for FId_vmaxmd" UWORD DINH_ct_Compu 1 100 -4095.000 4096.000 BIT_MASK 0x1fff FORMAT "%8.3" ECU_ADDRESS 0x40005FCC /end MEASUREMENT
/begin MEASUREMENT DINH_stFId.FId_Unused "Inhibit Status of FIds / " UWORD DFC_OneToOne 1 100 0.00 65535.00 FORMAT "%8.2" ECU_ADDRESS 0x40005F20 /end MEASUREMENT
/begin MEASUREMENT DINH_stFId.FId_InhibitAlways "Inhibit Status of FIds / Status of function identifier FId_InhibitAlways" UWORD DFC_OneToOne 1 100 0.00 65535.00 FORMAT "%8.2" ECU_ADDRESS 0x40005F22 /end MEASUREMENT
/begin MEASUREMENT DINH_stFId.FID_GGVFZG "Inhibit Status of FIds / Status of function identifier FID_GGVFZG" UWORD DFC_OneToOne 1 100 0.00 65535.00 FORMAT "%8.2" ECU_ADDRESS 0x40005F24 /end MEASUREMENT
/begin MEASUREMENT DINH_stFId.FId_AEKPROVS "Inhibit Status of FIds / Status of function identifier FId_AEKPROVS" UWORD DFC_OneToOne 1 100 0.00 65535.00 FORMAT "%8.2" ECU_ADDRESS 0x40005F26 /end MEASUREMENT
/begin MEASUREMENT DINH_stFId.FId_BypAirActrPsElecErr "Inhibit Status of FIds / Status of function identifier FId_BypAirActrPsElecErr" UWORD DFC_OneToOne 1 100 0.00 65535.00 FORMAT "%8.2" ECU_ADDRESS 0x40005F28 /end MEASUREMENT
/begin MEASUREMENT DINH_stFId.FId_BypAirActrPsIf "Inhibit Status of FIds / Status of function identifier FId_BypAirActrPsIf" UWORD DFC_OneToOne 1 100 0.00 65535.00 FORMAT "%8.2" ECU_ADDRESS 0x40005F2A /end MEASUREMENT
/begin MEASUREMENT DINH_stFId.FId_BypAirActr_SteprMotPosnCtrl "Inhibit Status of FIds / Status of function identifier FId_BypAirActr_SteprMotPosnCtrl" UWORD DFC_OneToOne 1 100 0.00 65535.00 FORMAT "%8.2" ECU_ADDRESS 0x40005F2C /end MEASUREMENT
/begin MEASUREMENT DINH_stFId.FId_CEngDsTSRCErr "Inhibit Status of FIds / Status of function identifier FId_CEngDsTSRCErr" UWORD DFC_OneToOne 1 100 0.00 65535.00 FORMAT "%8.2" ECU_ADDRESS 0x40005F2E /end MEASUREMENT
/begin MEASUREMENT DINH_stFId.FId_CEngDsTSTC "Inhibit Status of FIds / Status of function identifier FId_CEngDsTSTC" UWORD DFC_OneToOne 1 100 0.00 65535.00 FORMAT "%8.2" ECU_ADDRESS 0x40005F30 /end MEASUREMENT
/begin MEASUREMENT DINH_stFId.FId_ClthStkOpn "Inhibit Status of FIds / Status of function identifier FId_ClthStkOpn" UWORD DFC_OneToOne 1 100 0.00 65535.00 FORMAT "%8.2" ECU_ADDRESS 0x40005F32 /end MEASUREMENT
/begin MEASUREMENT DINH_stFId.FId_ClthSwtSensErr "Inhibit Status of FIds / Status of function identifier FId_ClthSwtSensErr" UWORD DFC_OneToOne 1 100 0.00 65535.00 FORMAT "%8.2" ECU_ADDRESS 0x40005F34 /end MEASUREMENT
/begin MEASUREMENT DINH_stFId.FId_DIA "Inhibit Status of FIds / Status of function identifier FId_DIA" UWORD DFC_OneToOne 1 100 0.00 65535.00 FORMAT "%8.2" ECU_ADDRESS 0x40005F36 /end MEASUREMENT
/begin MEASUREMENT DINH_stFId.FId_DIUMPRGenDenom1 "Inhibit Status of FIds / Status of function identifier FId_DIUMPRGenDenom1" UWORD DFC_OneToOne 1 100 0.00 65535.00 FORMAT "%8.2" ECU_ADDRESS 0x40005F38 /end MEASUREMENT
/begin MEASUREMENT DINH_stFId.FId_DIUMPRGenDenom2 "Inhibit Status of FIds / Status of function identifier FId_DIUMPRGenDenom2" UWORD DFC_OneToOne 1 100 0.00 65535.00 FORMAT "%8.2" ECU_ADDRESS 0x40005F3A /end MEASUREMENT
/begin MEASUREMENT DINH_stFId.FId_DIUMPRGenDenom3 "Inhibit Status of FIds / Status of function identifier FId_DIUMPRGenDenom3" UWORD DFC_OneToOne 1 100 0.00 65535.00 FORMAT "%8.2" ECU_ADDRESS 0x40005F3C /end MEASUREMENT
/begin MEASUREMENT DINH_stFId.FId_DIUMPRIgn "Inhibit Status of FIds / Status of function identifier FId_DIUMPRIgn" UWORD DFC_OneToOne 1 100 0.00 65535.00 FORMAT "%8.2" ECU_ADDRESS 0x40005F3E /end MEASUREMENT
/begin MEASUREMENT DINH_stFId.FId_DK "Inhibit Status of FIds / Status of function identifier FId_DK" UWORD DFC_OneToOne 1 100 0.00 65535.00 FORMAT "%8.2" ECU_ADDRESS 0x40005F40 /end MEASUREMENT
/begin MEASUREMENT DINH_stFId.FId_DKVS "Inhibit Status of FIds / Status of function identifier FId_DKVS" UWORD DFC_OneToOne 1 100 0.00 65535.00 FORMAT "%8.2" ECU_ADDRESS 0x40005F42 /end MEASUREMENT
/begin MEASUREMENT DINH_stFId.FId_DLLR "Inhibit Status of FIds / Status of function identifier FId_DLLR" UWORD DFC_OneToOne 1 100 0.00 65535.00 FORMAT "%8.2" ECU_ADDRESS 0x40005F44 /end MEASUREMENT
/begin MEASUREMENT DINH_stFId.FId_DLLSTP "Inhibit Status of FIds / Status of function identifier FId_DLLSTP" UWORD DFC_OneToOne 1 100 0.00 65535.00 FORMAT "%8.2" ECU_ADDRESS 0x40005F46 /end MEASUREMENT
/begin MEASUREMENT DINH_stFId.FId_DSMWarmUpCycle "Inhibit Status of FIds / Status of function identifier FId_DSMWarmUpCycle" UWORD DFC_OneToOne 1 100 0.00 65535.00 FORMAT "%8.2" ECU_ADDRESS 0x40005F48 /end MEASUREMENT
/begin MEASUREMENT DINH_stFId.FId_DSS "Inhibit Status of FIds / Status of function identifier FId_DSS" UWORD DFC_OneToOne 1 100 0.00 65535.00 FORMAT "%8.2" ECU_ADDRESS 0x40005F4A /end MEASUREMENT
/begin MEASUREMENT DINH_stFId.FId_EDLLR "Inhibit Status of FIds / Status of function identifier FId_EDLLR" UWORD DFC_OneToOne 1 100 0.00 65535.00 FORMAT "%8.2" ECU_ADDRESS 0x40005F4C /end MEASUREMENT
/begin MEASUREMENT DINH_stFId.FId_EpmCrSDiag "Inhibit Status of FIds / Status of function identifier FId_EpmCrSDiag" UWORD DFC_OneToOne 1 100 0.00 65535.00 FORMAT "%8.2" ECU_ADDRESS 0x40005F4E /end MEASUREMENT
/begin MEASUREMENT DINH_stFId.FId_EpmCrSDiagBattU "Inhibit Status of FIds / Status of function identifier FId_EpmCrSDiagBattU" UWORD DFC_OneToOne 1 100 0.00 65535.00 FORMAT "%8.2" ECU_ADDRESS 0x40005F50 /end MEASUREMENT
/begin MEASUREMENT DINH_stFId.FId_EpmCrSDiagVeh "Inhibit Status of FIds / Status of function identifier FId_EpmCrSDiagVeh" UWORD DFC_OneToOne 1 100 0.00 65535.00 FORMAT "%8.2" ECU_ADDRESS 0x40005F52 /end MEASUREMENT
/begin MEASUREMENT DINH_stFId.FId_EpmCrSErr "Inhibit Status of FIds / Status of function identifier FId_EpmCrSErr" UWORD DFC_OneToOne 1 100 0.00 65535.00 FORMAT "%8.2" ECU_ADDRESS 0x40005F54 /end MEASUREMENT
/begin MEASUREMENT DINH_stFId.FId_EpmCrSIntkMnfldP "Inhibit Status of FIds / Status of function identifier FId_EpmCrSIntkMnfldP" UWORD DFC_OneToOne 1 100 0.00 65535.00 FORMAT "%8.2" ECU_ADDRESS 0x40005F56 /end MEASUREMENT
/begin MEASUREMENT DINH_stFId.FId_EpmRRSCrSFaultCheck "Inhibit Status of FIds / Status of function identifier FId_EpmRRSCrSFaultCheck" UWORD DFC_OneToOne 1 100 0.00 65535.00 FORMAT "%8.2" ECU_ADDRESS 0x40005F58 /end MEASUREMENT
/begin MEASUREMENT DINH_stFId.FId_EpmRRSVehVFaultChck "Inhibit Status of FIds / Status of function identifier FId_EpmRRSVehVFaultChck" UWORD DFC_OneToOne 1 100 0.00 65535.00 FORMAT "%8.2" ECU_ADDRESS 0x40005F5A /end MEASUREMENT
/begin MEASUREMENT DINH_stFId.FId_EpmSynIntkMnfldP "Inhibit Status of FIds / Status of function identifier FId_EpmSynIntkMnfldP" UWORD DFC_OneToOne 1 100 0.00 65535.00 FORMAT "%8.2" ECU_ADDRESS 0x40005F5C /end MEASUREMENT
/begin MEASUREMENT DINH_stFId.FId_FKMSDK "Inhibit Status of FIds / Status of function identifier FId_FKMSDK" UWORD DFC_OneToOne 1 100 0.00 65535.00 FORMAT "%8.2" ECU_ADDRESS 0x40005F5E /end MEASUREMENT
/begin MEASUREMENT DINH_stFId.FId_HEGOS1Htg "Inhibit Status of FIds / Status of function identifier FId_HEGOS1Htg" UWORD DFC_OneToOne 1 100 0.00 65535.00 FORMAT "%8.2" ECU_ADDRESS 0x40005F60 /end MEASUREMENT
/begin MEASUREMENT DINH_stFId.FId_HEGOS2Htg "Inhibit Status of FIds / Status of function identifier FId_HEGOS2Htg" UWORD DFC_OneToOne 1 100 0.00 65535.00 FORMAT "%8.2" ECU_ADDRESS 0x40005F62 /end MEASUREMENT
/begin MEASUREMENT DINH_stFId.FId_IgnActvCoilDiag "Inhibit Status of FIds / Status of function identifier FId_IgnActvCoilDiag" UWORD DFC_OneToOne 1 100 0.00 65535.00 FORMAT "%8.2" ECU_ADDRESS 0x40005F64 /end MEASUREMENT
/begin MEASUREMENT DINH_stFId.FId_InhibitNever "Inhibit Status of FIds / Status of function identifier FId_InhibitNever" UWORD DFC_OneToOne 1 100 0.00 65535.00 FORMAT "%8.2" ECU_ADDRESS 0x40005F66 /end MEASUREMENT
/begin MEASUREMENT DINH_stFId.FId_InjSysPlausTripRcrd "Inhibit Status of FIds / Status of function identifier FId_InjSysPlausTripRcrd" UWORD DFC_OneToOne 1 100 0.00 65535.00 FORMAT "%8.2" ECU_ADDRESS 0x40005F68 /end MEASUREMENT
/begin MEASUREMENT DINH_stFId.FId_IntkAirTAirFltDsSRCErr "Inhibit Status of FIds / Status of function identifier FId_IntkAirTAirFltDsSRCErr" UWORD DFC_OneToOne 1 100 0.00 65535.00 FORMAT "%8.2" ECU_ADDRESS 0x40005F6A /end MEASUREMENT
/begin MEASUREMENT DINH_stFId.FId_IntkAirTAirFltDsSTC "Inhibit Status of FIds / Status of function identifier FId_IntkAirTAirFltDsSTC" UWORD DFC_OneToOne 1 100 0.00 65535.00 FORMAT "%8.2" ECU_ADDRESS 0x40005F6C /end MEASUREMENT
/begin MEASUREMENT DINH_stFId.FId_KHZ "Inhibit Status of FIds / Status of function identifier FId_KHZ" UWORD DFC_OneToOne 1 100 0.00 65535.00 FORMAT "%8.2" ECU_ADDRESS 0x40005F6E /end MEASUREMENT
/begin MEASUREMENT DINH_stFId.FId_MisfDetEnvP "Inhibit Status of FIds / Status of function identifier FId_MisfDetEnvP" UWORD DFC_OneToOne 1 100 0.00 65535.00 FORMAT "%8.2" ECU_ADDRESS 0x40005F70 /end MEASUREMENT
/begin MEASUREMENT DINH_stFId.FId_MisfDetGbx "Inhibit Status of FIds / Status of function identifier FId_MisfDetGbx" UWORD DFC_OneToOne 1 100 0.00 65535.00 FORMAT "%8.2" ECU_ADDRESS 0x40005F72 /end MEASUREMENT
/begin MEASUREMENT DINH_stFId.FId_MisfDetShtrpAct "Inhibit Status of FIds / Status of function identifier FId_MisfDetShtrpAct" UWORD DFC_OneToOne 1 100 0.00 65535.00 FORMAT "%8.2" ECU_ADDRESS 0x40005F74 /end MEASUREMENT
/begin MEASUREMENT DINH_stFId.FId_MisfDetStc "Inhibit Status of FIds / Status of function identifier FId_MisfDetStc" UWORD DFC_OneToOne 1 100 0.00 65535.00 FORMAT "%8.2" ECU_ADDRESS 0x40005F76 /end MEASUREMENT
/begin MEASUREMENT DINH_stFId.FId_MisfDetV "Inhibit Status of FIds / Status of function identifier FId_MisfDetV" UWORD DFC_OneToOne 1 100 0.00 65535.00 FORMAT "%8.2" ECU_ADDRESS 0x40005F78 /end MEASUREMENT
/begin MEASUREMENT DINH_stFId.FId_MisfDet_InjLockdOpen01 "Inhibit Status of FIds / Status of function identifier FId_MisfDet_InjLockdOpen01" UWORD DFC_OneToOne 1 100 0.00 65535.00 FORMAT "%8.2" ECU_ADDRESS 0x40005F7A /end MEASUREMENT
/begin MEASUREMENT DINH_stFId.FId_NMAXMDTempErr "Inhibit Status of FIds / Status of function identifier FId_NMAXMDTempErr" UWORD DFC_OneToOne 1 100 0.00 65535.00 FORMAT "%8.2" ECU_ADDRESS 0x40005F7C /end MEASUREMENT
/begin MEASUREMENT DINH_stFId.FId_NeutSwtSensErr "Inhibit Status of FIds / Status of function identifier FId_NeutSwtSensErr" UWORD DFC_OneToOne 1 100 0.00 65535.00 FORMAT "%8.2" ECU_ADDRESS 0x40005F7E /end MEASUREMENT
/begin MEASUREMENT DINH_stFId.FId_OilPPSSwt "Inhibit Status of FIds / Status of function identifier FId_OilPPSSwt" UWORD DFC_OneToOne 1 100 0.00 65535.00 FORMAT "%8.2" ECU_ADDRESS 0x40005F80 /end MEASUREMENT
/begin MEASUREMENT DINH_stFId.FId_PIntkVUsSnsrSply "Inhibit Status of FIds / Status of function identifier FId_PIntkVUsSnsrSply" UWORD DFC_OneToOne 1 100 0.00 65535.00 FORMAT "%8.2" ECU_ADDRESS 0x40005F82 /end MEASUREMENT
/begin MEASUREMENT DINH_stFId.FId_PSPInjErr "Inhibit Status of FIds / Status of function identifier FId_PSPInjErr" UWORD DFC_OneToOne 1 100 0.00 65535.00 FORMAT "%8.2" ECU_ADDRESS 0x40005F84 /end MEASUREMENT
/begin MEASUREMENT DINH_stFId.FId_Rollovr_DetnElecErr "Inhibit Status of FIds / Status of function identifier FId_Rollovr_DetnElecErr" UWORD DFC_OneToOne 1 100 0.00 65535.00 FORMAT "%8.2" ECU_ADDRESS 0x40005F86 /end MEASUREMENT
/begin MEASUREMENT DINH_stFId.FId_Rollovr_DetnSSpErr "Inhibit Status of FIds / Status of function identifier FId_Rollovr_DetnSSpErr" UWORD DFC_OneToOne 1 100 0.00 65535.00 FORMAT "%8.2" ECU_ADDRESS 0x40005F88 /end MEASUREMENT
/begin MEASUREMENT DINH_stFId.FId_SdSTClth "Inhibit Status of FIds / Status of function identifier FId_SdSTClth" UWORD DFC_OneToOne 1 100 0.00 65535.00 FORMAT "%8.2" ECU_ADDRESS 0x40005F8A /end MEASUREMENT
/begin MEASUREMENT DINH_stFId.FId_SdSTDiagErr "Inhibit Status of FIds / Status of function identifier FId_SdSTDiagErr" UWORD DFC_OneToOne 1 100 0.00 65535.00 FORMAT "%8.2" ECU_ADDRESS 0x40005F8C /end MEASUREMENT
/begin MEASUREMENT DINH_stFId.FId_SdSTNGS "Inhibit Status of FIds / Status of function identifier FId_SdSTNGS" UWORD DFC_OneToOne 1 100 0.00 65535.00 FORMAT "%8.2" ECU_ADDRESS 0x40005F8E /end MEASUREMENT
/begin MEASUREMENT DINH_stFId.FId_SdSTSSpErr "Inhibit Status of FIds / Status of function identifier FId_SdSTSSpErr" UWORD DFC_OneToOne 1 100 0.00 65535.00 FORMAT "%8.2" ECU_ADDRESS 0x40005F90 /end MEASUREMENT
/begin MEASUREMENT DINH_stFId.FId_SprkSeatTMdl "Inhibit Status of FIds / Status of function identifier FId_SprkSeatTMdl" UWORD DFC_OneToOne 1 100 0.00 65535.00 FORMAT "%8.2" ECU_ADDRESS 0x40005F92 /end MEASUREMENT
/begin MEASUREMENT DINH_stFId.FId_StSysStrtCtl "Inhibit Status of FIds / Status of function identifier FId_StSysStrtCtl" UWORD DFC_OneToOne 1 100 0.00 65535.00 FORMAT "%8.2" ECU_ADDRESS 0x40005F94 /end MEASUREMENT
/begin MEASUREMENT DINH_stFId.FId_StrtVDModel "Inhibit Status of FIds / Status of function identifier FId_StrtVDModel" UWORD DFC_OneToOne 1 100 0.00 65535.00 FORMAT "%8.2" ECU_ADDRESS 0x40005F96 /end MEASUREMENT
/begin MEASUREMENT DINH_stFId.FId_TMLFS "Inhibit Status of FIds / Status of function identifier FId_TMLFS" UWORD DFC_OneToOne 1 100 0.00 65535.00 FORMAT "%8.2" ECU_ADDRESS 0x40005F98 /end MEASUREMENT
/begin MEASUREMENT DINH_stFId.FId_TMnplChkIUMPR "Inhibit Status of FIds / Status of function identifier FId_TMnplChkIUMPR" UWORD DFC_OneToOne 1 100 0.00 65535.00 FORMAT "%8.2" ECU_ADDRESS 0x40005F9A /end MEASUREMENT
/begin MEASUREMENT DINH_stFId.FId_ThrVlvSnsrSply "Inhibit Status of FIds / Status of function identifier FId_ThrVlvSnsrSply" UWORD DFC_OneToOne 1 100 0.00 65535.00 FORMAT "%8.2" ECU_ADDRESS 0x40005F9C /end MEASUREMENT
/begin MEASUREMENT DINH_stFId.FId_UBLFS "Inhibit Status of FIds / Status of function identifier FId_UBLFS" UWORD DFC_OneToOne 1 100 0.00 65535.00 FORMAT "%8.2" ECU_ADDRESS 0x40005F9E /end MEASUREMENT
/begin MEASUREMENT DINH_stFId.FId_bbte "Inhibit Status of FIds / Status of function identifier FId_bbte" UWORD DFC_OneToOne 1 100 0.00 65535.00 FORMAT "%8.2" ECU_ADDRESS 0x40005FA0 /end MEASUREMENT
/begin MEASUREMENT DINH_stFId.FId_cfflsh "Inhibit Status of FIds / Status of function identifier FId_cfflsh" UWORD DFC_OneToOne 1 100 0.00 65535.00 FORMAT "%8.2" ECU_ADDRESS 0x40005FA2 /end MEASUREMENT
/begin MEASUREMENT DINH_stFId.FId_cfflsv "Inhibit Status of FIds / Status of function identifier FId_cfflsv" UWORD DFC_OneToOne 1 100 0.00 65535.00 FORMAT "%8.2" ECU_ADDRESS 0x40005FA4 /end MEASUREMENT
/begin MEASUREMENT DINH_stFId.FId_dhlshk "Inhibit Status of FIds / Status of function identifier FId_dhlshk" UWORD DFC_OneToOne 1 100 0.00 65535.00 FORMAT "%8.2" ECU_ADDRESS 0x40005FA6 /end MEASUREMENT
/begin MEASUREMENT DINH_stFId.FId_dhlsvk "Inhibit Status of FIds / Status of function identifier FId_dhlsvk" UWORD DFC_OneToOne 1 100 0.00 65535.00 FORMAT "%8.2" ECU_ADDRESS 0x40005FA8 /end MEASUREMENT
/begin MEASUREMENT DINH_stFId.FId_dkat "Inhibit Status of FIds / Status of function identifier FId_dkat" UWORD DFC_OneToOne 1 100 0.00 65535.00 FORMAT "%8.2" ECU_ADDRESS 0x40005FAA /end MEASUREMENT
/begin MEASUREMENT DINH_stFId.FId_dlahi "Inhibit Status of FIds / Status of function identifier FId_dlahi" UWORD DFC_OneToOne 1 100 0.00 65535.00 FORMAT "%8.2" ECU_ADDRESS 0x40005FAC /end MEASUREMENT
/begin MEASUREMENT DINH_stFId.FId_dlashmn "Inhibit Status of FIds / Status of function identifier FId_dlashmn" UWORD DFC_OneToOne 1 100 0.00 65535.00 FORMAT "%8.2" ECU_ADDRESS 0x40005FAE /end MEASUREMENT
/begin MEASUREMENT DINH_stFId.FId_dlashmx "Inhibit Status of FIds / Status of function identifier FId_dlashmx" UWORD DFC_OneToOne 1 100 0.00 65535.00 FORMAT "%8.2" ECU_ADDRESS 0x40005FB0 /end MEASUREMENT
/begin MEASUREMENT DINH_stFId.FId_dlsa "Inhibit Status of FIds / Status of function identifier FId_dlsa" UWORD DFC_OneToOne 1 100 0.00 65535.00 FORMAT "%8.2" ECU_ADDRESS 0x40005FB2 /end MEASUREMENT
/begin MEASUREMENT DINH_stFId.FId_dlsahk "Inhibit Status of FIds / Status of function identifier FId_dlsahk" UWORD DFC_OneToOne 1 100 0.00 65535.00 FORMAT "%8.2" ECU_ADDRESS 0x40005FB4 /end MEASUREMENT
/begin MEASUREMENT DINH_stFId.FId_dlsahsv "Inhibit Status of FIds / Status of function identifier FId_dlsahsv" UWORD DFC_OneToOne 1 100 0.00 65535.00 FORMAT "%8.2" ECU_ADDRESS 0x40005FB6 /end MEASUREMENT
/begin MEASUREMENT DINH_stFId.FId_dlshen "Inhibit Status of FIds / Status of function identifier FId_dlshen" UWORD DFC_OneToOne 1 100 0.00 65535.00 FORMAT "%8.2" ECU_ADDRESS 0x40005FB8 /end MEASUREMENT
/begin MEASUREMENT DINH_stFId.FId_dlshklt "Inhibit Status of FIds / Status of function identifier FId_dlshklt" UWORD DFC_OneToOne 1 100 0.00 65535.00 FORMAT "%8.2" ECU_ADDRESS 0x40005FBA /end MEASUREMENT
/begin MEASUREMENT DINH_stFId.FId_dlsven "Inhibit Status of FIds / Status of function identifier FId_dlsven" UWORD DFC_OneToOne 1 100 0.00 65535.00 FORMAT "%8.2" ECU_ADDRESS 0x40005FBC /end MEASUREMENT
/begin MEASUREMENT DINH_stFId.FId_dlsvhub "Inhibit Status of FIds / Status of function identifier FId_dlsvhub" UWORD DFC_OneToOne 1 100 0.00 65535.00 FORMAT "%8.2" ECU_ADDRESS 0x40005FBE /end MEASUREMENT
/begin MEASUREMENT DINH_stFId.FId_dlsvklt "Inhibit Status of FIds / Status of function identifier FId_dlsvklt" UWORD DFC_OneToOne 1 100 0.00 65535.00 FORMAT "%8.2" ECU_ADDRESS 0x40005FC0 /end MEASUREMENT
/begin MEASUREMENT DINH_stFId.FId_dsschub "Inhibit Status of FIds / Status of function identifier FId_dsschub" UWORD DFC_OneToOne 1 100 0.00 65535.00 FORMAT "%8.2" ECU_ADDRESS 0x40005FC2 /end MEASUREMENT
/begin MEASUREMENT DINH_stFId.FId_latp "Inhibit Status of FIds / Status of function identifier FId_latp" UWORD DFC_OneToOne 1 100 0.00 65535.00 FORMAT "%8.2" ECU_ADDRESS 0x40005FC4 /end MEASUREMENT
/begin MEASUREMENT DINH_stFId.FId_lra "Inhibit Status of FIds / Status of function identifier FId_lra" UWORD DFC_OneToOne 1 100 0.00 65535.00 FORMAT "%8.2" ECU_ADDRESS 0x40005FC6 /end MEASUREMENT
/begin MEASUREMENT DINH_stFId.FId_lreb "Inhibit Status of FIds / Status of function identifier FId_lreb" UWORD DFC_OneToOne 1 100 0.00 65535.00 FORMAT "%8.2" ECU_ADDRESS 0x40005FC8 /end MEASUREMENT
/begin MEASUREMENT DINH_stFId.FId_lrhk "Inhibit Status of FIds / Status of function identifier FId_lrhk" UWORD DFC_OneToOne 1 100 0.00 65535.00 FORMAT "%8.2" ECU_ADDRESS 0x40005FCA /end MEASUREMENT
/begin MEASUREMENT DINH_stFId.FId_vmaxmd "Inhibit Status of FIds / Status of function identifier FId_vmaxmd" UWORD DFC_OneToOne 1 100 0.00 65535.00 FORMAT "%8.2" ECU_ADDRESS 0x40005FCC /end MEASUREMENT
/begin MEASUREMENT DINH_stMod7VisyCmpl "status of the first completed calculation of mode7 visibility" UBYTE OneToOne 1 100 0.00 255.0 FORMAT "%5.1" ECU_ADDRESS 0x4000648C /end MEASUREMENT
/begin MEASUREMENT DINH_xFIDObsvInh_mp "DFCs and DSQs which inhibit the FId currently" UWORD DFCDSQ_Verb 1 100 0.00 65535. FORMAT "%2.0" ARRAY_SIZE 5 ECU_ADDRESS 0x40009DDC /end MEASUREMENT
/begin MEASUREMENT DINH_xFIDObsvRls_mp "DFCs and DSQs which don't inhibit the FId currently" UWORD DFCDSQ_Verb 1 100 0.00 65535. FORMAT "%2.0" ARRAY_SIZE 5 ECU_ADDRESS 0x40009DD2 /end MEASUREMENT
/begin MEASUREMENT DIUMPR_ctGenDenom "General denominator" UWORD OneToOne 1 100 0.00 65535.00 FORMAT "%8.2" ECU_ADDRESS 0x4000CC74 /end MEASUREMENT
/begin MEASUREMENT DIUMPR_ctIgn "Ignition cycle counter" UWORD OneToOne 1 100 0.00 65535.00 FORMAT "%8.2" ECU_ADDRESS 0x4000CC72 /end MEASUREMENT
/begin MEASUREMENT DIUMPR_Den.FId_CEngDsTSTC "IUMPR denominator (config) / calculated denominator of in-use performance monitoring of FId_CEngDsTSTC" UWORD OneToOne 1 100 0.00 65535.00 FORMAT "%8.2" ECU_ADDRESS 0x4000CC42 /end MEASUREMENT
/begin MEASUREMENT DIUMPR_Den.FId_IntkAirTAirFltDsSTC "IUMPR denominator (config) / calculated denominator of in-use performance monitoring of FId_IntkAirTAirFltDsSTC" UWORD OneToOne 1 100 0.00 65535.00 FORMAT "%8.2" ECU_ADDRESS 0x4000CC44 /end MEASUREMENT
/begin MEASUREMENT DIUMPR_Den.FId_OilPPSSwt "IUMPR denominator (config) / calculated denominator of in-use performance monitoring of FId_OilPPSSwt" UWORD OneToOne 1 100 0.00 65535.00 FORMAT "%8.2" ECU_ADDRESS 0x4000CC46 /end MEASUREMENT
/begin MEASUREMENT DIUMPR_Den.FId_SprkSeatTMdl "IUMPR denominator (config) / calculated denominator of in-use performance monitoring of FId_SprkSeatTMdl" UWORD OneToOne 1 100 0.00 65535.00 FORMAT "%8.2" ECU_ADDRESS 0x4000CC48 /end MEASUREMENT
/begin MEASUREMENT DIUMPR_Den.FId_StSysStrtCtl "IUMPR denominator (config) / calculated denominator of in-use performance monitoring of FId_StSysStrtCtl" UWORD OneToOne 1 100 0.00 65535.00 FORMAT "%8.2" ECU_ADDRESS 0x4000CC4A /end MEASUREMENT
/begin MEASUREMENT DIUMPR_Den.FId_TMnplChkIUMPR "IUMPR denominator (config) / calculated denominator of in-use performance monitoring of FId_TMnplChkIUMPR" UWORD OneToOne 1 100 0.00 65535.00 FORMAT "%8.2" ECU_ADDRESS 0x4000CC4C /end MEASUREMENT
/begin MEASUREMENT DIUMPR_Den.FId_dhlshk "IUMPR denominator (config) / calculated denominator of in-use performance monitoring of FId_dhlshk" UWORD OneToOne 1 100 0.00 65535.00 FORMAT "%8.2" ECU_ADDRESS 0x4000CC4E /end MEASUREMENT
/begin MEASUREMENT DIUMPR_Den.FId_dhlsvk "IUMPR denominator (config) / calculated denominator of in-use performance monitoring of FId_dhlsvk" UWORD OneToOne 1 100 0.00 65535.00 FORMAT "%8.2" ECU_ADDRESS 0x4000CC50 /end MEASUREMENT
/begin MEASUREMENT DIUMPR_Den.FId_dkat "IUMPR denominator (config) / calculated denominator of in-use performance monitoring of FId_dkat" UWORD OneToOne 1 100 0.00 65535.00 FORMAT "%8.2" ECU_ADDRESS 0x4000CC52 /end MEASUREMENT
/begin MEASUREMENT DIUMPR_Den.FId_dlahi "IUMPR denominator (config) / calculated denominator of in-use performance monitoring of FId_dlahi" UWORD OneToOne 1 100 0.00 65535.00 FORMAT "%8.2" ECU_ADDRESS 0x4000CC54 /end MEASUREMENT
/begin MEASUREMENT DIUMPR_Den.FId_dlsahk "IUMPR denominator (config) / calculated denominator of in-use performance monitoring of FId_dlsahk" UWORD OneToOne 1 100 0.00 65535.00 FORMAT "%8.2" ECU_ADDRESS 0x4000CC56 /end MEASUREMENT
/begin MEASUREMENT DIUMPR_Den.FId_latp "IUMPR denominator (config) / calculated denominator of in-use performance monitoring of FId_latp" UWORD OneToOne 1 100 0.00 65535.00 FORMAT "%8.2" ECU_ADDRESS 0x4000CC58 /end MEASUREMENT
/begin MEASUREMENT DIUMPR_Num.FId_CEngDsTSTC "IUMPR numerator (config) / calculated numerator of in-use performance monitoring of FId_CEngDsTSTC" UWORD OneToOne 1 100 0.00 65535.00 FORMAT "%8.2" ECU_ADDRESS 0x4000CC5A /end MEASUREMENT
/begin MEASUREMENT DIUMPR_Num.FId_IntkAirTAirFltDsSTC "IUMPR numerator (config) / calculated numerator of in-use performance monitoring of FId_IntkAirTAirFltDsSTC" UWORD OneToOne 1 100 0.00 65535.00 FORMAT "%8.2" ECU_ADDRESS 0x4000CC5C /end MEASUREMENT
/begin MEASUREMENT DIUMPR_Num.FId_OilPPSSwt "IUMPR numerator (config) / calculated numerator of in-use performance monitoring of FId_OilPPSSwt" UWORD OneToOne 1 100 0.00 65535.00 FORMAT "%8.2" ECU_ADDRESS 0x4000CC5E /end MEASUREMENT
/begin MEASUREMENT DIUMPR_Num.FId_SprkSeatTMdl "IUMPR numerator (config) / calculated numerator of in-use performance monitoring of FId_SprkSeatTMdl" UWORD OneToOne 1 100 0.00 65535.00 FORMAT "%8.2" ECU_ADDRESS 0x4000CC60 /end MEASUREMENT
/begin MEASUREMENT DIUMPR_Num.FId_StSysStrtCtl "IUMPR numerator (config) / calculated numerator of in-use performance monitoring of FId_StSysStrtCtl" UWORD OneToOne 1 100 0.00 65535.00 FORMAT "%8.2" ECU_ADDRESS 0x4000CC62 /end MEASUREMENT
/begin MEASUREMENT DIUMPR_Num.FId_TMnplChkIUMPR "IUMPR numerator (config) / calculated numerator of in-use performance monitoring of FId_TMnplChkIUMPR" UWORD OneToOne 1 100 0.00 65535.00 FORMAT "%8.2" ECU_ADDRESS 0x4000CC64 /end MEASUREMENT
/begin MEASUREMENT DIUMPR_Num.FId_dhlshk "IUMPR numerator (config) / calculated numerator of in-use performance monitoring of FId_dhlshk" UWORD OneToOne 1 100 0.00 65535.00 FORMAT "%8.2" ECU_ADDRESS 0x4000CC66 /end MEASUREMENT
/begin MEASUREMENT DIUMPR_Num.FId_dhlsvk "IUMPR numerator (config) / calculated numerator of in-use performance monitoring of FId_dhlsvk" UWORD OneToOne 1 100 0.00 65535.00 FORMAT "%8.2" ECU_ADDRESS 0x4000CC68 /end MEASUREMENT
/begin MEASUREMENT DIUMPR_Num.FId_dkat "IUMPR numerator (config) / calculated numerator of in-use performance monitoring of FId_dkat" UWORD OneToOne 1 100 0.00 65535.00 FORMAT "%8.2" ECU_ADDRESS 0x4000CC6A /end MEASUREMENT
/begin MEASUREMENT DIUMPR_Num.FId_dlahi "IUMPR numerator (config) / calculated numerator of in-use performance monitoring of FId_dlahi" UWORD OneToOne 1 100 0.00 65535.00 FORMAT "%8.2" ECU_ADDRESS 0x4000CC6C /end MEASUREMENT
/begin MEASUREMENT DIUMPR_Num.FId_dlsahk "IUMPR numerator (config) / calculated numerator of in-use performance monitoring of FId_dlsahk" UWORD OneToOne 1 100 0.00 65535.00 FORMAT "%8.2" ECU_ADDRESS 0x4000CC6E /end MEASUREMENT
/begin MEASUREMENT DIUMPR_Num.FId_latp "IUMPR numerator (config) / calculated numerator of in-use performance monitoring of FId_latp" UWORD OneToOne 1 100 0.00 65535.00 FORMAT "%8.2" ECU_ADDRESS 0x4000CC70 /end MEASUREMENT
/begin MEASUREMENT DIUMPR_numIndGrp "IUMPR record with smallest ratio within the component group" UBYTE CfgRatio_Verb 1 100 0.00 11. FORMAT "%2.0" ARRAY_SIZE 10 ECU_ADDRESS 0x4000509C /end MEASUREMENT
/begin MEASUREMENT DIUMPR_rValRatMin "Smallest ratio within component group" UWORD Fact 1 100 0.00 7.999878 FORMAT "%8.6" ARRAY_SIZE 10 ECU_ADDRESS 0x40005FD4 /end MEASUREMENT
/begin MEASUREMENT DIUMPR_St.FId_CEngDsTSTC "IUMPR status (config) / status of in-use performance monitoring of FId_CEngDsTSTC" UBYTE OneToOne 1 100 0.00 255.0 FORMAT "%5.1" ECU_ADDRESS 0x40005090 /end MEASUREMENT
/begin MEASUREMENT DIUMPR_St.FId_IntkAirTAirFltDsSTC "IUMPR status (config) / status of in-use performance monitoring of FId_IntkAirTAirFltDsSTC" UBYTE OneToOne 1 100 0.00 255.0 FORMAT "%5.1" ECU_ADDRESS 0x40005091 /end MEASUREMENT
/begin MEASUREMENT DIUMPR_St.FId_OilPPSSwt "IUMPR status (config) / status of in-use performance monitoring of FId_OilPPSSwt" UBYTE OneToOne 1 100 0.00 255.0 FORMAT "%5.1" ECU_ADDRESS 0x40005092 /end MEASUREMENT
/begin MEASUREMENT DIUMPR_St.FId_SprkSeatTMdl "IUMPR status (config) / status of in-use performance monitoring of FId_SprkSeatTMdl" UBYTE OneToOne 1 100 0.00 255.0 FORMAT "%5.1" ECU_ADDRESS 0x40005093 /end MEASUREMENT
/begin MEASUREMENT DIUMPR_St.FId_StSysStrtCtl "IUMPR status (config) / status of in-use performance monitoring of FId_StSysStrtCtl" UBYTE OneToOne 1 100 0.00 255.0 FORMAT "%5.1" ECU_ADDRESS 0x40005094 /end MEASUREMENT
/begin MEASUREMENT DIUMPR_St.FId_TMnplChkIUMPR "IUMPR status (config) / status of in-use performance monitoring of FId_TMnplChkIUMPR" UBYTE OneToOne 1 100 0.00 255.0 FORMAT "%5.1" ECU_ADDRESS 0x40005095 /end MEASUREMENT
/begin MEASUREMENT DIUMPR_St.FId_dhlshk "IUMPR status (config) / status of in-use performance monitoring of FId_dhlshk" UBYTE OneToOne 1 100 0.00 255.0 FORMAT "%5.1" ECU_ADDRESS 0x40005096 /end MEASUREMENT
/begin MEASUREMENT DIUMPR_St.FId_dhlsvk "IUMPR status (config) / status of in-use performance monitoring of FId_dhlsvk" UBYTE OneToOne 1 100 0.00 255.0 FORMAT "%5.1" ECU_ADDRESS 0x40005097 /end MEASUREMENT
/begin MEASUREMENT DIUMPR_St.FId_dkat "IUMPR status (config) / status of in-use performance monitoring of FId_dkat" UBYTE OneToOne 1 100 0.00 255.0 FORMAT "%5.1" ECU_ADDRESS 0x40005098 /end MEASUREMENT
/begin MEASUREMENT DIUMPR_St.FId_dlahi "IUMPR status (config) / status of in-use performance monitoring of FId_dlahi" UBYTE OneToOne 1 100 0.00 255.0 FORMAT "%5.1" ECU_ADDRESS 0x40005099 /end MEASUREMENT
/begin MEASUREMENT DIUMPR_St.FId_dlsahk "IUMPR status (config) / status of in-use performance monitoring of FId_dlsahk" UBYTE OneToOne 1 100 0.00 255.0 FORMAT "%5.1" ECU_ADDRESS 0x4000509A /end MEASUREMENT
/begin MEASUREMENT DIUMPR_St.FId_latp "IUMPR status (config) / status of in-use performance monitoring of FId_latp" UBYTE OneToOne 1 100 0.00 255.0 FORMAT "%5.1" ECU_ADDRESS 0x4000509B /end MEASUREMENT
/begin MEASUREMENT DIUMPR_stEnaDenom "enable status for general denominator and ignition cycle counter" ULONG OneToOne 1 100 0.00 4294967295.00 FORMAT "%13.2" ECU_ADDRESS 0x400050A8 /end MEASUREMENT
/begin MEASUREMENT DIUMPR_stFIdGenDenom_mp "collected FId status (mode 7 visibility) of general denominator" UBYTE OneToOne 1 100 0.00 255.0 FORMAT "%5.1" ECU_ADDRESS 0x40009E36 /end MEASUREMENT
/begin MEASUREMENT DIUMPR_stNumCmplCfg "Bit array of status Numerator Completed for configurative variant" UWORD OneToOne 1 100 0.00 65535.00 FORMAT "%8.2" ARRAY_SIZE 1 ECU_ADDRESS 0x4000CC40 /end MEASUREMENT
/begin MEASUREMENT DIUMPR_stPhyActvnCfg "Bitarray of status Physical Activation for configured variant" UWORD OneToOne 1 100 0.00 65535.00 FORMAT "%8.2" ARRAY_SIZE 1 ECU_ADDRESS 0x4000CC3E /end MEASUREMENT
/begin MEASUREMENT DIUMPR_tiEngOpCum "cumulative time since engine start (for general denominator condition)" UWORD DIUMPR_ti100ms 1 100 0.00 6553.500 FORMAT "%8.3" ECU_ADDRESS 0x40005FEA /end MEASUREMENT
/begin MEASUREMENT DIUMPR_tiIdl "continuous vehicle operation at idle (for general denominator condition)" UWORD DIUMPR_ti100ms 1 100 0.00 6553.500 FORMAT "%8.3" ECU_ADDRESS 0x40005FE8 /end MEASUREMENT
/begin MEASUREMENT DIUMPR_tiVehSpdCum "cumulative vehicle operation at or above 25 miles per hour (for general denominator condition)" UWORD DIUMPR_ti100ms 1 100 0.00 6553.500 FORMAT "%8.3" ECU_ADDRESS 0x40005FEC /end MEASUREMENT
/begin FUNCTION DINH "30000.12.0Diagnostic Inhibit Handler"
 /begin DEF_CHARACTERISTIC DINH_FId.DFC_BusDiagOpenLoad_Can0_CA DINH_FId.DFC_Com_ABSInfo_DLC_CA DINH_FId.DFC_Com_ABSInfo_TO_CA DINH_FId.DFC_BusDiagBusOff_Can0_CA DINH_FId.DFC_DevLibBattUHi_CA DINH_FId.DFC_DevLibBattULo_CA DINH_FId.DFC_StrtOL_CA DINH_FId.DFC_StrtOvrTemp_CA DINH_FId.DFC_StrtSCB_CA DINH_FId.DFC_StrtSCG_CA DINH_FId.DFC_MILLmpOL_CA DINH_FId.DFC_MILLmpOT_CA DINH_FId.DFC_MILLmpSCB_CA DINH_FId.DFC_MILLmpSCG_CA DINH_FId.DFC_EV1max_CA DINH_FId.DFC_EV1min_CA DINH_FId.DFC_EV1sig_CA DINH_FId.DFC_CEngDsTPlausSTC_CA DINH_FId.DFC_ClthStkOpn_CA DINH_FId.DFC_EVX_CA DINH_FId.DFC_IntkAirTAirFltDsSTC_CA DINH_FId.DFC_RoughRoad_CA DINH_FId.DFC_SSpMon1_CA DINH_FId.DFC_SSpMon1OT_CA DINH_FId.DFC_SSpMon1OV_CA DINH_FId.DFC_SSpMon1SCG_CA DINH_FId.DFC_SSpMon1UV_CA DINH_FId.DFC_SSpMon2_CA DINH_FId.DFC_SSpMon2OT_CA DINH_FId.DFC_SSpMon2OV_CA DINH_FId.DFC_SSpMon2SCG_CA DINH_FId.DFC_SSpMon2UV_CA DINH_FId.DFC_CANIF_E_CTRL_NOT_SLEEP_ERROR_VALUE_CA DINH_FId.DFC_CANIF_E_CTRL_STOPPED_ERROR_VALUE_CA DINH_FId.DFC_CANIF_E_INVALID_DLC_ERROR_CA DINH_FId.DFC_CANNM_E_CANIF_TRANSMIT_ERROR_CA DINH_FId.DFC_CANNM_E_INIT_FAILED_CA DINH_FId.DFC_CANNM_E_NETWORK_TIMEOUT_CA DINH_FId.DFC_CAN_E_TIMEOUT_CA DINH_FId.DFC_COMM_E_NET_START_IND_CHANNEL_0_CA DINH_FId.DFC_COMM_E_NET_START_IND_CHANNEL_1_CA DINH_FId.DFC_COMM_E_NET_START_IND_CHANNEL_2_CA DINH_FId.DFC_COMM_E_NET_START_IND_CHANNEL_3_CA DINH_FId.DFC_COMM_E_NET_START_IND_CHANNEL_4_CA DINH_FId.DFC_COMM_E_NET_START_IND_CHANNEL_5_CA DINH_FId.DFC_PDUR_E_INIT_FAILED_CA DINH_FId.DFC_PDUR_E_PDU_INSTANCE_LOST_CA DINH_FId.DFC_RBA_IOEXTLIB_KEEPALIVE_DRV_CA DINH_FId.DFC_RBA_IOEXTLIB_KEEPALIVE_INI_CA DINH_FId.DFC_rba_IoSigRtc_StopCounter_CA DINH_FId.DFC_rba_MultiStackTrace_Threshold_CA DINH_FId.DFC_rba_MRly_Diag_Stk_Event_CA DINH_FId.DFC_rba_SyC_IrrSwOffTrigEngRun_Event_CA DINH_FId.DFC_rba_T15_Diag_ComInVld_Event_CA DINH_FId.DFC_rba_T15_Diag_ComOff_HwOn_Event_CA DINH_FId.DFC_rba_T15_Diag_ComOn_HwOff_Event_CA DINH_FId.DFC_BypAirActrOcCoil1_CA DINH_FId.DFC_BypAirActrOcCoil2_CA DINH_FId.DFC_BypAirActrOlCoil1_CA DINH_FId.DFC_BypAirActrOlCoil2_CA DINH_FId.DFC_BypAirActrOt_CA DINH_FId.DFC_BypAirActrScbCoil1_CA DINH_FId.DFC_BypAirActrScbCoil2_CA DINH_FId.DFC_BypAirActrScgCoil1_CA DINH_FId.DFC_BypAirActrScgCoil2_CA DINH_FId.DFC_CEngDsTPhysRngHi_CA DINH_FId.DFC_CEngDsTPhysRngLo_CA DINH_FId.DFC_CEngDsTSRCMax_CA DINH_FId.DFC_CEngDsTSRCMin_CA DINH_FId.DFC_DKmax_CA DINH_FId.DFC_DKmin_CA DINH_FId.DFC_DLLRmax_CA DINH_FId.DFC_DLLRmin_CA DINH_FId.DFC_DLLRnpl_CA DINH_FId.DFC_DSSRngMax_CA DINH_FId.DFC_DSSRngMin_CA DINH_FId.DFC_DSSmax_CA DINH_FId.DFC_DSSmin_CA DINH_FId.DFC_DSSnpl_CA DINH_FId.DFC_DSSnplMax_CA DINH_FId.DFC_DSSnplMin_CA DINH_FId.DFC_DSSsig_CA DINH_FId.DFC_EpmCrSErrSig_CA DINH_FId.DFC_EpmCrSNoSig_CA DINH_FId.DFC_HEGOS1B1ElecNpl_CA DINH_FId.DFC_HSH_CA DINH_FId.DFC_HSHEmax_CA DINH_FId.DFC_HSHEmin_CA DINH_FId.DFC_HSHEsig_CA DINH_FId.DFC_HSV_CA DINH_FId.DFC_HSVEmax_CA DINH_FId.DFC_HSVEmin_CA DINH_FId.DFC_HSVEsig_CA DINH_FId.DFC_HdLampMax_CA DINH_FId.DFC_HdLampMin_CA DINH_FId.DFC_HdLampSig_CA DINH_FId.DFC_IgnCoil1Err_CA DINH_FId.DFC_IgnCoil2Err_CA DINH_FId.DFC_IgnIgbtDiagSCG_0_CA DINH_FId.DFC_IgnIgbtDiagSCG_1_CA DINH_FId.DFC_IntkAirTAirFltDsPRCMax_CA DINH_FId.DFC_IntkAirTAirFltDsPRCMin_CA DINH_FId.DFC_IntkAirTAirFltDsSRCMax_CA DINH_FId.DFC_IntkAirTAirFltDsSRCMin_CA DINH_FId.DFC_IntkMnfldPNoSyn_CA DINH_FId.DFC_KAT_CA DINH_FId.DFC_KPEmax_CA DINH_FId.DFC_KPEmin_CA DINH_FId.DFC_KPEsig_CA DINH_FId.DFC_KVSFmax_CA DINH_FId.DFC_KVSFmin_CA DINH_FId.DFC_KVSOmax_CA DINH_FId.DFC_KVSOmin_CA DINH_FId.DFC_LASHmn_CA DINH_FId.DFC_LASHmx_CA DINH_FId.DFC_LATP_CA DINH_FId.DFC_LDLAHI_CA DINH_FId.DFC_LFS1Max_CA DINH_FId.DFC_LFS1Min_CA DINH_FId.DFC_LFS1Sig_CA DINH_FId.DFC_LSHmax_CA DINH_FId.DFC_LSHmin_CA DINH_FId.DFC_LSHnpl_CA DINH_FId.DFC_LSHsig_CA DINH_FId.DFC_LSVmax_CA DINH_FId.DFC_LSVmin_CA DINH_FId.DFC_LSVnpl_CA DINH_FId.DFC_LSVsig_CA DINH_FId.DFC_MDCat_CA DINH_FId.DFC_MDCatCurr_CA DINH_FId.DFC_MDCyl_CA DINH_FId.DFC_MDEmi_CA DINH_FId.DFC_MDEmiStrt_CA DINH_FId.DFC_MDMpl_CA DINH_FId.DFC_MoCADCNTP_CA DINH_FId.DFC_MoCADCTst_CA DINH_FId.DFC_MoFSidst_CA DINH_FId.DFC_OCWDACom_CA DINH_FId.DFC_OilPPSSwtMax_CA DINH_FId.DFC_OilPPSSwtMin_CA DINH_FId.DFC_OilPPSSwtSig_CA DINH_FId.DFC_OvHEngSpdLimr_CA DINH_FId.DFC_RoVComVld_CA DINH_FId.DFC_RoVSNpl_CA DINH_FId.DFC_RoVSOL_CA DINH_FId.DFC_RoVSSCB_CA DINH_FId.DFC_RoVSSCG_CA DINH_FId.DFC_SdSTNpl_CA DINH_FId.DFC_SdSTSCB_CA DINH_FId.DFC_SdSTSCG_CA DINH_FId.DFC_SdSTSOL_CA DINH_FId.DFC_TEVEmax_CA DINH_FId.DFC_TEVEmin_CA DINH_FId.DFC_TEVEsig_CA DINH_FId.DFC_TMnpl_CA DINH_FId.DFC_UBmax_CA DINH_FId.DFC_UBmin_CA DINH_FId.DFC_UBnpl_CA DINH_FId.DFC_VFZsig_CA DINH_FId.DFC_VFZsig2_CA DINH_FId.DSQ_DSMInhibitAlways_CA DINH_FId.DSQ_EpmReverseRun_CA DINH_FId.DSQ_MRly_CA DINH_FId.DSQ_RvsRotPred_CA DINH_FId.DSQ_StrtActr_CA DINH_FId.DSQ_T15TurnOfDly_CA DINH_Lim.DFC_BusDiagOpenLoad_Can0_CA DINH_Lim.DFC_Com_ABSInfo_DLC_CA DINH_Lim.DFC_Com_ABSInfo_TO_CA DINH_Lim.DFC_BusDiagBusOff_Can0_CA DINH_Lim.DFC_DevLibBattUHi_CA DINH_Lim.DFC_DevLibBattULo_CA DINH_Lim.DFC_StrtOL_CA DINH_Lim.DFC_StrtOvrTemp_CA DINH_Lim.DFC_StrtSCB_CA DINH_Lim.DFC_StrtSCG_CA DINH_Lim.DFC_MILLmpOL_CA DINH_Lim.DFC_MILLmpOT_CA DINH_Lim.DFC_MILLmpSCB_CA DINH_Lim.DFC_MILLmpSCG_CA DINH_Lim.DFC_EV1max_CA DINH_Lim.DFC_EV1min_CA DINH_Lim.DFC_EV1sig_CA DINH_Lim.DFC_CEngDsTPlausSTC_CA DINH_Lim.DFC_ClthStkOpn_CA DINH_Lim.DFC_EVX_CA DINH_Lim.DFC_IntkAirTAirFltDsSTC_CA DINH_Lim.DFC_RoughRoad_CA DINH_Lim.DFC_SSpMon1_CA DINH_Lim.DFC_SSpMon1OT_CA DINH_Lim.DFC_SSpMon1OV_CA DINH_Lim.DFC_SSpMon1SCG_CA DINH_Lim.DFC_SSpMon1UV_CA DINH_Lim.DFC_SSpMon2_CA DINH_Lim.DFC_SSpMon2OT_CA DINH_Lim.DFC_SSpMon2OV_CA DINH_Lim.DFC_SSpMon2SCG_CA DINH_Lim.DFC_SSpMon2UV_CA DINH_Lim.DFC_CANIF_E_CTRL_NOT_SLEEP_ERROR_VALUE_CA DINH_Lim.DFC_CANIF_E_CTRL_STOPPED_ERROR_VALUE_CA DINH_Lim.DFC_CANIF_E_INVALID_DLC_ERROR_CA DINH_Lim.DFC_CANNM_E_CANIF_TRANSMIT_ERROR_CA DINH_Lim.DFC_CANNM_E_INIT_FAILED_CA DINH_Lim.DFC_CANNM_E_NETWORK_TIMEOUT_CA DINH_Lim.DFC_CAN_E_TIMEOUT_CA DINH_Lim.DFC_COMM_E_NET_START_IND_CHANNEL_0_CA DINH_Lim.DFC_COMM_E_NET_START_IND_CHANNEL_1_CA DINH_Lim.DFC_COMM_E_NET_START_IND_CHANNEL_2_CA DINH_Lim.DFC_COMM_E_NET_START_IND_CHANNEL_3_CA DINH_Lim.DFC_COMM_E_NET_START_IND_CHANNEL_4_CA DINH_Lim.DFC_COMM_E_NET_START_IND_CHANNEL_5_CA DINH_Lim.DFC_PDUR_E_INIT_FAILED_CA DINH_Lim.DFC_PDUR_E_PDU_INSTANCE_LOST_CA DINH_Lim.DFC_RBA_IOEXTLIB_KEEPALIVE_DRV_CA DINH_Lim.DFC_RBA_IOEXTLIB_KEEPALIVE_INI_CA DINH_Lim.DFC_rba_IoSigRtc_StopCounter_CA DINH_Lim.DFC_rba_MultiStackTrace_Threshold_CA DINH_Lim.DFC_rba_MRly_Diag_Stk_Event_CA DINH_Lim.DFC_rba_SyC_IrrSwOffTrigEngRun_Event_CA DINH_Lim.DFC_rba_T15_Diag_ComInVld_Event_CA DINH_Lim.DFC_rba_T15_Diag_ComOff_HwOn_Event_CA DINH_Lim.DFC_rba_T15_Diag_ComOn_HwOff_Event_CA DINH_Lim.DFC_BypAirActrOcCoil1_CA DINH_Lim.DFC_BypAirActrOcCoil2_CA DINH_Lim.DFC_BypAirActrOlCoil1_CA DINH_Lim.DFC_BypAirActrOlCoil2_CA DINH_Lim.DFC_BypAirActrOt_CA DINH_Lim.DFC_BypAirActrScbCoil1_CA DINH_Lim.DFC_BypAirActrScbCoil2_CA DINH_Lim.DFC_BypAirActrScgCoil1_CA DINH_Lim.DFC_BypAirActrScgCoil2_CA DINH_Lim.DFC_CEngDsTPhysRngHi_CA DINH_Lim.DFC_CEngDsTPhysRngLo_CA DINH_Lim.DFC_CEngDsTSRCMax_CA DINH_Lim.DFC_CEngDsTSRCMin_CA DINH_Lim.DFC_DKmax_CA DINH_Lim.DFC_DKmin_CA DINH_Lim.DFC_DLLRmax_CA DINH_Lim.DFC_DLLRmin_CA DINH_Lim.DFC_DLLRnpl_CA DINH_Lim.DFC_DSSRngMax_CA DINH_Lim.DFC_DSSRngMin_CA DINH_Lim.DFC_DSSmax_CA DINH_Lim.DFC_DSSmin_CA DINH_Lim.DFC_DSSnpl_CA DINH_Lim.DFC_DSSnplMax_CA DINH_Lim.DFC_DSSnplMin_CA DINH_Lim.DFC_DSSsig_CA DINH_Lim.DFC_EpmCrSErrSig_CA DINH_Lim.DFC_EpmCrSNoSig_CA DINH_Lim.DFC_HEGOS1B1ElecNpl_CA DINH_Lim.DFC_HSH_CA DINH_Lim.DFC_HSHEmax_CA DINH_Lim.DFC_HSHEmin_CA DINH_Lim.DFC_HSHEsig_CA DINH_Lim.DFC_HSV_CA DINH_Lim.DFC_HSVEmax_CA DINH_Lim.DFC_HSVEmin_CA DINH_Lim.DFC_HSVEsig_CA DINH_Lim.DFC_HdLampMax_CA DINH_Lim.DFC_HdLampMin_CA DINH_Lim.DFC_HdLampSig_CA DINH_Lim.DFC_IgnCoil1Err_CA DINH_Lim.DFC_IgnCoil2Err_CA DINH_Lim.DFC_IgnIgbtDiagSCG_0_CA DINH_Lim.DFC_IgnIgbtDiagSCG_1_CA DINH_Lim.DFC_IntkAirTAirFltDsPRCMax_CA DINH_Lim.DFC_IntkAirTAirFltDsPRCMin_CA DINH_Lim.DFC_IntkAirTAirFltDsSRCMax_CA DINH_Lim.DFC_IntkAirTAirFltDsSRCMin_CA DINH_Lim.DFC_IntkMnfldPNoSyn_CA DINH_Lim.DFC_KAT_CA DINH_Lim.DFC_KPEmax_CA DINH_Lim.DFC_KPEmin_CA DINH_Lim.DFC_KPEsig_CA DINH_Lim.DFC_KVSFmax_CA DINH_Lim.DFC_KVSFmin_CA DINH_Lim.DFC_KVSOmax_CA DINH_Lim.DFC_KVSOmin_CA DINH_Lim.DFC_LASHmn_CA DINH_Lim.DFC_LASHmx_CA DINH_Lim.DFC_LATP_CA DINH_Lim.DFC_LDLAHI_CA DINH_Lim.DFC_LFS1Max_CA DINH_Lim.DFC_LFS1Min_CA DINH_Lim.DFC_LFS1Sig_CA DINH_Lim.DFC_LSHmax_CA DINH_Lim.DFC_LSHmin_CA DINH_Lim.DFC_LSHnpl_CA DINH_Lim.DFC_LSHsig_CA DINH_Lim.DFC_LSVmax_CA DINH_Lim.DFC_LSVmin_CA DINH_Lim.DFC_LSVnpl_CA DINH_Lim.DFC_LSVsig_CA DINH_Lim.DFC_MDCat_CA DINH_Lim.DFC_MDCatCurr_CA DINH_Lim.DFC_MDCyl_CA DINH_Lim.DFC_MDEmi_CA DINH_Lim.DFC_MDEmiStrt_CA DINH_Lim.DFC_MDMpl_CA DINH_Lim.DFC_MoCADCNTP_CA DINH_Lim.DFC_MoCADCTst_CA DINH_Lim.DFC_MoFSidst_CA DINH_Lim.DFC_OCWDACom_CA DINH_Lim.DFC_OilPPSSwtMax_CA DINH_Lim.DFC_OilPPSSwtMin_CA DINH_Lim.DFC_OilPPSSwtSig_CA DINH_Lim.DFC_OvHEngSpdLimr_CA DINH_Lim.DFC_RoVComVld_CA DINH_Lim.DFC_RoVSNpl_CA DINH_Lim.DFC_RoVSOL_CA DINH_Lim.DFC_RoVSSCB_CA DINH_Lim.DFC_RoVSSCG_CA DINH_Lim.DFC_SdSTNpl_CA DINH_Lim.DFC_SdSTSCB_CA DINH_Lim.DFC_SdSTSCG_CA DINH_Lim.DFC_SdSTSOL_CA DINH_Lim.DFC_TEVEmax_CA DINH_Lim.DFC_TEVEmin_CA DINH_Lim.DFC_TEVEsig_CA DINH_Lim.DFC_TMnpl_CA DINH_Lim.DFC_UBmax_CA DINH_Lim.DFC_UBmin_CA DINH_Lim.DFC_UBnpl_CA DINH_Lim.DFC_VFZsig_CA DINH_Lim.DFC_VFZsig2_CA DINH_Lim.DSQ_DSMInhibitAlways_CA DINH_Lim.DSQ_EpmReverseRun_CA DINH_Lim.DSQ_MRly_CA DINH_Lim.DSQ_RvsRotPred_CA DINH_Lim.DSQ_StrtActr_CA DINH_Lim.DSQ_T15TurnOfDly_CA DINH_tiUpdObsv_C DINH_xFIDObsv_C /end DEF_CHARACTERISTIC
 /begin LOC_MEASUREMENT DINH_ctMonCorr DINH_DSQSrv7Vis DINH_FIdSrv7Vis DINH_nrActvInhReas.FId_InhibitAlways DINH_nrActvInhReas.FID_GGVFZG DINH_nrActvInhReas.FId_AEKPROVS DINH_nrActvInhReas.FId_BypAirActrPsElecErr DINH_nrActvInhReas.FId_BypAirActrPsIf DINH_nrActvInhReas.FId_BypAirActr_SteprMotPosnCtrl DINH_nrActvInhReas.FId_CEngDsTSRCErr DINH_nrActvInhReas.FId_CEngDsTSTC DINH_nrActvInhReas.FId_ClthStkOpn DINH_nrActvInhReas.FId_ClthSwtSensErr DINH_nrActvInhReas.FId_DIA DINH_nrActvInhReas.FId_DIUMPRGenDenom1 DINH_nrActvInhReas.FId_DIUMPRGenDenom2 DINH_nrActvInhReas.FId_DIUMPRGenDenom3 DINH_nrActvInhReas.FId_DIUMPRIgn DINH_nrActvInhReas.FId_DK DINH_nrActvInhReas.FId_DKVS DINH_nrActvInhReas.FId_DLLR DINH_nrActvInhReas.FId_DLLSTP DINH_nrActvInhReas.FId_DSMWarmUpCycle DINH_nrActvInhReas.FId_DSS DINH_nrActvInhReas.FId_EDLLR DINH_nrActvInhReas.FId_EpmCrSDiag DINH_nrActvInhReas.FId_EpmCrSDiagBattU DINH_nrActvInhReas.FId_EpmCrSDiagVeh DINH_nrActvInhReas.FId_EpmCrSErr DINH_nrActvInhReas.FId_EpmCrSIntkMnfldP DINH_nrActvInhReas.FId_EpmRRSCrSFaultCheck DINH_nrActvInhReas.FId_EpmRRSVehVFaultChck DINH_nrActvInhReas.FId_EpmSynIntkMnfldP DINH_nrActvInhReas.FId_FKMSDK DINH_nrActvInhReas.FId_HEGOS1Htg DINH_nrActvInhReas.FId_HEGOS2Htg DINH_nrActvInhReas.FId_IgnActvCoilDiag DINH_nrActvInhReas.FId_InhibitNever DINH_nrActvInhReas.FId_InjSysPlausTripRcrd DINH_nrActvInhReas.FId_IntkAirTAirFltDsSRCErr DINH_nrActvInhReas.FId_IntkAirTAirFltDsSTC DINH_nrActvInhReas.FId_KHZ DINH_nrActvInhReas.FId_MisfDetEnvP DINH_nrActvInhReas.FId_MisfDetGbx DINH_nrActvInhReas.FId_MisfDetShtrpAct DINH_nrActvInhReas.FId_MisfDetStc DINH_nrActvInhReas.FId_MisfDetV DINH_nrActvInhReas.FId_MisfDet_InjLockdOpen01 DINH_nrActvInhReas.FId_NMAXMDTempErr DINH_nrActvInhReas.FId_NeutSwtSensErr DINH_nrActvInhReas.FId_OilPPSSwt DINH_nrActvInhReas.FId_PIntkVUsSnsrSply DINH_nrActvInhReas.FId_PSPInjErr DINH_nrActvInhReas.FId_Rollovr_DetnElecErr DINH_nrActvInhReas.FId_Rollovr_DetnSSpErr DINH_nrActvInhReas.FId_SdSTClth DINH_nrActvInhReas.FId_SdSTDiagErr DINH_nrActvInhReas.FId_SdSTNGS DINH_nrActvInhReas.FId_SdSTSSpErr DINH_nrActvInhReas.FId_SprkSeatTMdl DINH_nrActvInhReas.FId_StSysStrtCtl DINH_nrActvInhReas.FId_StrtVDModel DINH_nrActvInhReas.FId_TMLFS DINH_nrActvInhReas.FId_TMnplChkIUMPR DINH_nrActvInhReas.FId_ThrVlvSnsrSply DINH_nrActvInhReas.FId_UBLFS DINH_nrActvInhReas.FId_bbte DINH_nrActvInhReas.FId_cfflsh DINH_nrActvInhReas.FId_cfflsv DINH_nrActvInhReas.FId_dhlshk DINH_nrActvInhReas.FId_dhlsvk DINH_nrActvInhReas.FId_dkat DINH_nrActvInhReas.FId_dlahi DINH_nrActvInhReas.FId_dlashmn DINH_nrActvInhReas.FId_dlashmx DINH_nrActvInhReas.FId_dlsa DINH_nrActvInhReas.FId_dlsahk DINH_nrActvInhReas.FId_dlsahsv DINH_nrActvInhReas.FId_dlshen DINH_nrActvInhReas.FId_dlshklt DINH_nrActvInhReas.FId_dlsven DINH_nrActvInhReas.FId_dlsvhub DINH_nrActvInhReas.FId_dlsvklt DINH_nrActvInhReas.FId_dsschub DINH_nrActvInhReas.FId_latp DINH_nrActvInhReas.FId_lra DINH_nrActvInhReas.FId_lreb DINH_nrActvInhReas.FId_lrhk DINH_nrActvInhReas.FId_vmaxmd DINH_stFId.FId_Unused DINH_stFId.FId_InhibitAlways DINH_stFId.FID_GGVFZG DINH_stFId.FId_AEKPROVS DINH_stFId.FId_BypAirActrPsElecErr DINH_stFId.FId_BypAirActrPsIf DINH_stFId.FId_BypAirActr_SteprMotPosnCtrl DINH_stFId.FId_CEngDsTSRCErr DINH_stFId.FId_CEngDsTSTC DINH_stFId.FId_ClthStkOpn DINH_stFId.FId_ClthSwtSensErr DINH_stFId.FId_DIA DINH_stFId.FId_DIUMPRGenDenom1 DINH_stFId.FId_DIUMPRGenDenom2 DINH_stFId.FId_DIUMPRGenDenom3 DINH_stFId.FId_DIUMPRIgn DINH_stFId.FId_DK DINH_stFId.FId_DKVS DINH_stFId.FId_DLLR DINH_stFId.FId_DLLSTP DINH_stFId.FId_DSMWarmUpCycle DINH_stFId.FId_DSS DINH_stFId.FId_EDLLR DINH_stFId.FId_EpmCrSDiag DINH_stFId.FId_EpmCrSDiagBattU DINH_stFId.FId_EpmCrSDiagVeh DINH_stFId.FId_EpmCrSErr DINH_stFId.FId_EpmCrSIntkMnfldP DINH_stFId.FId_EpmRRSCrSFaultCheck DINH_stFId.FId_EpmRRSVehVFaultChck DINH_stFId.FId_EpmSynIntkMnfldP DINH_stFId.FId_FKMSDK DINH_stFId.FId_HEGOS1Htg DINH_stFId.FId_HEGOS2Htg DINH_stFId.FId_IgnActvCoilDiag DINH_stFId.FId_InhibitNever DINH_stFId.FId_InjSysPlausTripRcrd DINH_stFId.FId_IntkAirTAirFltDsSRCErr DINH_stFId.FId_IntkAirTAirFltDsSTC DINH_stFId.FId_KHZ DINH_stFId.FId_MisfDetEnvP DINH_stFId.FId_MisfDetGbx DINH_stFId.FId_MisfDetShtrpAct DINH_stFId.FId_MisfDetStc DINH_stFId.FId_MisfDetV DINH_stFId.FId_MisfDet_InjLockdOpen01 DINH_stFId.FId_NMAXMDTempErr DINH_stFId.FId_NeutSwtSensErr DINH_stFId.FId_OilPPSSwt DINH_stFId.FId_PIntkVUsSnsrSply DINH_stFId.FId_PSPInjErr DINH_stFId.FId_Rollovr_DetnElecErr DINH_stFId.FId_Rollovr_DetnSSpErr DINH_stFId.FId_SdSTClth DINH_stFId.FId_SdSTDiagErr DINH_stFId.FId_SdSTNGS DINH_stFId.FId_SdSTSSpErr DINH_stFId.FId_SprkSeatTMdl DINH_stFId.FId_StSysStrtCtl DINH_stFId.FId_StrtVDModel DINH_stFId.FId_TMLFS DINH_stFId.FId_TMnplChkIUMPR DINH_stFId.FId_ThrVlvSnsrSply DINH_stFId.FId_UBLFS DINH_stFId.FId_bbte DINH_stFId.FId_cfflsh DINH_stFId.FId_cfflsv DINH_stFId.FId_dhlshk DINH_stFId.FId_dhlsvk DINH_stFId.FId_dkat DINH_stFId.FId_dlahi DINH_stFId.FId_dlashmn DINH_stFId.FId_dlashmx DINH_stFId.FId_dlsa DINH_stFId.FId_dlsahk DINH_stFId.FId_dlsahsv DINH_stFId.FId_dlshen DINH_stFId.FId_dlshklt DINH_stFId.FId_dlsven DINH_stFId.FId_dlsvhub DINH_stFId.FId_dlsvklt DINH_stFId.FId_dsschub DINH_stFId.FId_latp DINH_stFId.FId_lra DINH_stFId.FId_lreb DINH_stFId.FId_lrhk DINH_stFId.FId_vmaxmd DINH_stMod7VisyCmpl DINH_xFIDObsvInh_mp DINH_xFIDObsvRls_mp /end LOC_MEASUREMENT
 FUNCTION_VERSION "30000.12.0" /end FUNCTION
/begin FUNCTION DIUMPR "30000.18.1_386.0.0Diagnostic In Use Monitor Performance Ratio"
 /begin DEF_CHARACTERISTIC DIUMPR_ctGen.tiIgnMin_C DIUMPR_ctGen.tiActrMin_C DIUMPR_ctGen.l500MD_C DIUMPR_ctGen.tiVehSpdMin_C DIUMPR_ctGen.pEnvMin_C DIUMPR_ctGen.vVehMin_C DIUMPR_ctGen.rAPPMax_C DIUMPR_ctGen.vVehIdlMax_C DIUMPR_ctGen.tEnvMin_C DIUMPR_ctGen.tiIdlMin_C DIUMPR_ctGen.tiOpMin_C DIUMPR_ctGen.l500MDInc_C DIUMPR_ctGen.tiSigContActv_C DIUMPR_ctGen.tiFuEngOpMin_C DIUMPR_Ctl.FId_CEngDsTSTC_C DIUMPR_Ctl.FId_IntkAirTAirFltDsSTC_C DIUMPR_Ctl.FId_OilPPSSwt_C DIUMPR_Ctl.FId_SprkSeatTMdl_C DIUMPR_Ctl.FId_StSysStrtCtl_C DIUMPR_Ctl.FId_TMnplChkIUMPR_C DIUMPR_Ctl.FId_dhlshk_C DIUMPR_Ctl.FId_dhlsvk_C DIUMPR_Ctl.FId_dkat_C DIUMPR_Ctl.FId_dlahi_C DIUMPR_Ctl.FId_dlsahk_C DIUMPR_Ctl.FId_latp_C DIUMPR_DFC.FId_CEngDsTSTC_C DIUMPR_DFC.FId_IntkAirTAirFltDsSTC_C DIUMPR_DFC.FId_OilPPSSwt_C DIUMPR_DFC.FId_SprkSeatTMdl_C DIUMPR_DFC.FId_StSysStrtCtl_C DIUMPR_DFC.FId_TMnplChkIUMPR_C DIUMPR_DFC.FId_dhlshk_C DIUMPR_DFC.FId_dhlsvk_C DIUMPR_DFC.FId_dkat_C DIUMPR_DFC.FId_dlahi_C DIUMPR_DFC.FId_dlsahk_C DIUMPR_DFC.FId_latp_C DIUMPR_Grp.FId_CEngDsTSTC_C DIUMPR_Grp.FId_IntkAirTAirFltDsSTC_C DIUMPR_Grp.FId_OilPPSSwt_C DIUMPR_Grp.FId_SprkSeatTMdl_C DIUMPR_Grp.FId_StSysStrtCtl_C DIUMPR_Grp.FId_TMnplChkIUMPR_C DIUMPR_Grp.FId_dhlshk_C DIUMPR_Grp.FId_dhlsvk_C DIUMPR_Grp.FId_dkat_C DIUMPR_Grp.FId_dlahi_C DIUMPR_Grp.FId_dlsahk_C DIUMPR_Grp.FId_latp_C /end DEF_CHARACTERISTIC
 /begin LOC_MEASUREMENT DIUMPR_ctGenDenom DIUMPR_ctIgn DIUMPR_Den.FId_CEngDsTSTC DIUMPR_Den.FId_IntkAirTAirFltDsSTC DIUMPR_Den.FId_OilPPSSwt DIUMPR_Den.FId_SprkSeatTMdl DIUMPR_Den.FId_StSysStrtCtl DIUMPR_Den.FId_TMnplChkIUMPR DIUMPR_Den.FId_dhlshk DIUMPR_Den.FId_dhlsvk DIUMPR_Den.FId_dkat DIUMPR_Den.FId_dlahi DIUMPR_Den.FId_dlsahk DIUMPR_Den.FId_latp DIUMPR_Num.FId_CEngDsTSTC DIUMPR_Num.FId_IntkAirTAirFltDsSTC DIUMPR_Num.FId_OilPPSSwt DIUMPR_Num.FId_SprkSeatTMdl DIUMPR_Num.FId_StSysStrtCtl DIUMPR_Num.FId_TMnplChkIUMPR DIUMPR_Num.FId_dhlshk DIUMPR_Num.FId_dhlsvk DIUMPR_Num.FId_dkat DIUMPR_Num.FId_dlahi DIUMPR_Num.FId_dlsahk DIUMPR_Num.FId_latp DIUMPR_numIndGrp DIUMPR_rValRatMin DIUMPR_St.FId_CEngDsTSTC DIUMPR_St.FId_IntkAirTAirFltDsSTC DIUMPR_St.FId_OilPPSSwt DIUMPR_St.FId_SprkSeatTMdl DIUMPR_St.FId_StSysStrtCtl DIUMPR_St.FId_TMnplChkIUMPR DIUMPR_St.FId_dhlshk DIUMPR_St.FId_dhlsvk DIUMPR_St.FId_dkat DIUMPR_St.FId_dlahi DIUMPR_St.FId_dlsahk DIUMPR_St.FId_latp DIUMPR_stEnaDenom DIUMPR_stFIdGenDenom_mp DIUMPR_stNumCmplCfg DIUMPR_stPhyActvnCfg DIUMPR_tiEngOpCum DIUMPR_tiIdl DIUMPR_tiVehSpdCum /end LOC_MEASUREMENT
 FUNCTION_VERSION "30000.18.1_386.0.0" /end FUNCTION
/begin COMPU_METHOD CfgRatio_Verb "" TAB_VERB "%2.1" "-" COMPU_TAB_REF CfgRatio_Verb /end COMPU_METHOD
/begin COMPU_VTAB CfgRatio_Verb "" TAB_VERB 12 0 "FId_CEngDsTSTC" 1 "FId_IntkAirTAirFltDsSTC" 2 "FId_OilPPSSwt" 3 "FId_SprkSeatTMdl" 4 "FId_StSysStrtCtl" 5 "FId_TMnplChkIUMPR" 6 "FId_dhlshk" 7 "FId_dhlsvk" 8 "FId_dkat" 9 "FId_dlahi" 10 "FId_dlsahk" 11 "FId_latp" DEFAULT_VALUE "---" /end COMPU_VTAB
/begin COMPU_METHOD DFCDSQ_Verb "" TAB_VERB "%2.1" "-" COMPU_TAB_REF DFCDSQ_Verb /end COMPU_METHOD
/begin COMPU_VTAB DFCDSQ_Verb "" TAB_VERB 168 0 "NoInhibit" 1 "DFC_BusDiagOpenLoad_Can0" 2 "DFC_Com_ABSInfo_DLC" 3 "DFC_Com_ABSInfo_TO" 4 "DFC_BusDiagBusOff_Can0" 5 "DFC_DevLibBattUHi" 6 "DFC_DevLibBattULo" 7 "DFC_StrtOL" 8 "DFC_StrtOvrTemp" 9 "DFC_StrtSCB" 10 "DFC_StrtSCG" 11 "DFC_MILLmpOL" 12 "DFC_MILLmpOT" 13 "DFC_MILLmpSCB" 14 "DFC_MILLmpSCG" 15 "DFC_EV1max" 16 "DFC_EV1min" 17 "DFC_EV1sig" 18 "DFC_CEngDsTPlausSTC" 19 "DFC_ClthStkOpn" 20 "DFC_EVX" 21 "DFC_IntkAirTAirFltDsSTC" 22 "DFC_RoughRoad" 23 "DFC_SSpMon1" 24 "DFC_SSpMon1OT" 25 "DFC_SSpMon1OV" 26 "DFC_SSpMon1SCG" 27 "DFC_SSpMon1UV" 28 "DFC_SSpMon2" 29 "DFC_SSpMon2OT" 30 "DFC_SSpMon2OV" 31 "DFC_SSpMon2SCG" 32 "DFC_SSpMon2UV" 33 "DFC_CANIF_E_CTRL_NOT_SLEEP_ERROR_VALUE" 34 "DFC_CANIF_E_CTRL_STOPPED_ERROR_VALUE" 35 "DFC_CANIF_E_INVALID_DLC_ERROR" 36 "DFC_CANNM_E_CANIF_TRANSMIT_ERROR" 37 "DFC_CANNM_E_INIT_FAILED" 38 "DFC_CANNM_E_NETWORK_TIMEOUT" 39 "DFC_CAN_E_TIMEOUT" 40 "DFC_COMM_E_NET_START_IND_CHANNEL_0" 41 "DFC_COMM_E_NET_START_IND_CHANNEL_1" 42 "DFC_COMM_E_NET_START_IND_CHANNEL_2" 43 "DFC_COMM_E_NET_START_IND_CHANNEL_3" 44 "DFC_COMM_E_NET_START_IND_CHANNEL_4" 45 "DFC_COMM_E_NET_START_IND_CHANNEL_5" 46 "DFC_PDUR_E_INIT_FAILED" 47 "DFC_PDUR_E_PDU_INSTANCE_LOST" 48 "DFC_RBA_IOEXTLIB_KEEPALIVE_DRV" 49 "DFC_RBA_IOEXTLIB_KEEPALIVE_INI" 50 "DFC_rba_IoSigRtc_StopCounter" 51 "DFC_rba_MultiStackTrace_Threshold" 52 "DFC_rba_MRly_Diag_Stk_Event" 53 "DFC_rba_SyC_IrrSwOffTrigEngRun_Event" 54 "DFC_rba_T15_Diag_ComInVld_Event" 55 "DFC_rba_T15_Diag_ComOff_HwOn_Event" 56 "DFC_rba_T15_Diag_ComOn_HwOff_Event" 57 "DFC_BypAirActrOcCoil1" 58 "DFC_BypAirActrOcCoil2" 59 "DFC_BypAirActrOlCoil1" 60 "DFC_BypAirActrOlCoil2" 61 "DFC_BypAirActrOt" 62 "DFC_BypAirActrScbCoil1" 63 "DFC_BypAirActrScbCoil2" 64 "DFC_BypAirActrScgCoil1" 65 "DFC_BypAirActrScgCoil2" 66 "DFC_CEngDsTPhysRngHi" 67 "DFC_CEngDsTPhysRngLo" 68 "DFC_CEngDsTSRCMax" 69 "DFC_CEngDsTSRCMin" 70 "DFC_DKmax" 71 "DFC_DKmin" 72 "DFC_DLLRmax" 73 "DFC_DLLRmin" 74 "DFC_DLLRnpl" 75 "DFC_DSSRngMax" 76 "DFC_DSSRngMin" 77 "DFC_DSSmax" 78 "DFC_DSSmin" 79 "DFC_DSSnpl" 80 "DFC_DSSnplMax" 81 "DFC_DSSnplMin" 82 "DFC_DSSsig" 83 "DFC_EpmCrSErrSig" 84 "DFC_EpmCrSNoSig" 85 "DFC_HEGOS1B1ElecNpl" 86 "DFC_HSH" 87 "DFC_HSHEmax" 88 "DFC_HSHEmin" 89 "DFC_HSHEsig" 90 "DFC_HSV" 91 "DFC_HSVEmax" 92 "DFC_HSVEmin" 93 "DFC_HSVEsig" 94 "DFC_HdLampMax" 95 "DFC_HdLampMin" 96 "DFC_HdLampSig" 97 "DFC_IgnCoil1Err" 98 "DFC_IgnCoil2Err" 99 "DFC_IgnIgbtDiagSCG_0" 100 "DFC_IgnIgbtDiagSCG_1" 101 "DFC_IntkAirTAirFltDsPRCMax" 102 "DFC_IntkAirTAirFltDsPRCMin" 103 "DFC_IntkAirTAirFltDsSRCMax" 104 "DFC_IntkAirTAirFltDsSRCMin" 105 "DFC_IntkMnfldPNoSyn" 106 "DFC_KAT" 107 "DFC_KPEmax" 108 "DFC_KPEmin" 109 "DFC_KPEsig" 110 "DFC_KVSFmax" 111 "DFC_KVSFmin" 112 "DFC_KVSOmax" 113 "DFC_KVSOmin" 114 "DFC_LASHmn" 115 "DFC_LASHmx" 116 "DFC_LATP" 117 "DFC_LDLAHI" 118 "DFC_LFS1Max" 119 "DFC_LFS1Min" 120 "DFC_LFS1Sig" 121 "DFC_LSHmax" 122 "DFC_LSHmin" 123 "DFC_LSHnpl" 124 "DFC_LSHsig" 125 "DFC_LSVmax" 126 "DFC_LSVmin" 127 "DFC_LSVnpl" 128 "DFC_LSVsig" 129 "DFC_MDCat" 130 "DFC_MDCatCurr" 131 "DFC_MDCyl" 132 "DFC_MDEmi" 133 "DFC_MDEmiStrt" 134 "DFC_MDMpl" 135 "DFC_MoCADCNTP" 136 "DFC_MoCADCTst" 137 "DFC_MoFSidst" 138 "DFC_OCWDACom" 139 "DFC_OilPPSSwtMax" 140 "DFC_OilPPSSwtMin" 141 "DFC_OilPPSSwtSig" 142 "DFC_OvHEngSpdLimr" 143 "DFC_RoVComVld" 144 "DFC_RoVSNpl" 145 "DFC_RoVSOL" 146 "DFC_RoVSSCB" 147 "DFC_RoVSSCG" 148 "DFC_SdSTNpl" 149 "DFC_SdSTSCB" 150 "DFC_SdSTSCG" 151 "DFC_SdSTSOL" 152 "DFC_TEVEmax" 153 "DFC_TEVEmin" 154 "DFC_TEVEsig" 155 "DFC_TMnpl" 156 "DFC_UBmax" 157 "DFC_UBmin" 158 "DFC_UBnpl" 159 "DFC_VFZsig" 160 "DFC_VFZsig2" 161 "DSQ_DSMInhibitAlways" 162 "DSQ_EpmReverseRun" 163 "DSQ_MRly" 164 "DSQ_RvsRotPred" 165 "DSQ_StrtActr" 166 "DSQ_T15TurnOfDly" 65535 "Inhibited_Trip" DEFAULT_VALUE "---" /end COMPU_VTAB
/begin COMPU_METHOD DFC_OneToOne "" RAT_FUNC "%6.2" "-" COEFFS 0 1 0 0 0 1 /end COMPU_METHOD
/begin COMPU_METHOD DFC_Verb "" TAB_VERB "%2.1" "-" COMPU_TAB_REF DFC_Verb /end COMPU_METHOD
/begin COMPU_VTAB DFC_Verb "" TAB_VERB 161 0 "DFC_Unused" 4 "DFC_BusDiagBusOff_Can0" 1 "DFC_BusDiagOpenLoad_Can0" 57 "DFC_BypAirActrOcCoil1" 58 "DFC_BypAirActrOcCoil2" 59 "DFC_BypAirActrOlCoil1" 60 "DFC_BypAirActrOlCoil2" 61 "DFC_BypAirActrOt" 62 "DFC_BypAirActrScbCoil1" 63 "DFC_BypAirActrScbCoil2" 64 "DFC_BypAirActrScgCoil1" 65 "DFC_BypAirActrScgCoil2" 39 "DFC_CAN_E_TIMEOUT" 33 "DFC_CANIF_E_CTRL_NOT_SLEEP_ERROR_VALUE" 34 "DFC_CANIF_E_CTRL_STOPPED_ERROR_VALUE" 35 "DFC_CANIF_E_INVALID_DLC_ERROR" 36 "DFC_CANNM_E_CANIF_TRANSMIT_ERROR" 37 "DFC_CANNM_E_INIT_FAILED" 38 "DFC_CANNM_E_NETWORK_TIMEOUT" 66 "DFC_CEngDsTPhysRngHi" 67 "DFC_CEngDsTPhysRngLo" 18 "DFC_CEngDsTPlausSTC" 68 "DFC_CEngDsTSRCMax" 69 "DFC_CEngDsTSRCMin" 19 "DFC_ClthStkOpn" 2 "DFC_Com_ABSInfo_DLC" 3 "DFC_Com_ABSInfo_TO" 40 "DFC_COMM_E_NET_START_IND_CHANNEL_0" 41 "DFC_COMM_E_NET_START_IND_CHANNEL_1" 42 "DFC_COMM_E_NET_START_IND_CHANNEL_2" 43 "DFC_COMM_E_NET_START_IND_CHANNEL_3" 44 "DFC_COMM_E_NET_START_IND_CHANNEL_4" 45 "DFC_COMM_E_NET_START_IND_CHANNEL_5" 5 "DFC_DevLibBattUHi" 6 "DFC_DevLibBattULo" 70 "DFC_DKmax" 71 "DFC_DKmin" 72 "DFC_DLLRmax" 73 "DFC_DLLRmin" 74 "DFC_DLLRnpl" 77 "DFC_DSSmax" 78 "DFC_DSSmin" 79 "DFC_DSSnpl" 80 "DFC_DSSnplMax" 81 "DFC_DSSnplMin" 75 "DFC_DSSRngMax" 76 "DFC_DSSRngMin" 82 "DFC_DSSsig" 83 "DFC_EpmCrSErrSig" 84 "DFC_EpmCrSNoSig" 15 "DFC_EV1max" 16 "DFC_EV1min" 17 "DFC_EV1sig" 20 "DFC_EVX" 94 "DFC_HdLampMax" 95 "DFC_HdLampMin" 96 "DFC_HdLampSig" 85 "DFC_HEGOS1B1ElecNpl" 86 "DFC_HSH" 87 "DFC_HSHEmax" 88 "DFC_HSHEmin" 89 "DFC_HSHEsig" 90 "DFC_HSV" 91 "DFC_HSVEmax" 92 "DFC_HSVEmin" 93 "DFC_HSVEsig" 97 "DFC_IgnCoil1Err" 98 "DFC_IgnCoil2Err" 99 "DFC_IgnIgbtDiagSCG_0" 100 "DFC_IgnIgbtDiagSCG_1" 101 "DFC_IntkAirTAirFltDsPRCMax" 102 "DFC_IntkAirTAirFltDsPRCMin" 103 "DFC_IntkAirTAirFltDsSRCMax" 104 "DFC_IntkAirTAirFltDsSRCMin" 21 "DFC_IntkAirTAirFltDsSTC" 105 "DFC_IntkMnfldPNoSyn" 106 "DFC_KAT" 107 "DFC_KPEmax" 108 "DFC_KPEmin" 109 "DFC_KPEsig" 110 "DFC_KVSFmax" 111 "DFC_KVSFmin" 112 "DFC_KVSOmax" 113 "DFC_KVSOmin" 114 "DFC_LASHmn" 115 "DFC_LASHmx" 116 "DFC_LATP" 117 "DFC_LDLAHI" 118 "DFC_LFS1Max" 119 "DFC_LFS1Min" 120 "DFC_LFS1Sig" 121 "DFC_LSHmax" 122 "DFC_LSHmin" 123 "DFC_LSHnpl" 124 "DFC_LSHsig" 125 "DFC_LSVmax" 126 "DFC_LSVmin" 127 "DFC_LSVnpl" 128 "DFC_LSVsig" 129 "DFC_MDCat" 130 "DFC_MDCatCurr" 131 "DFC_MDCyl" 132 "DFC_MDEmi" 133 "DFC_MDEmiStrt" 134 "DFC_MDMpl" 11 "DFC_MILLmpOL" 12 "DFC_MILLmpOT" 13 "DFC_MILLmpSCB" 14 "DFC_MILLmpSCG" 135 "DFC_MoCADCNTP" 136 "DFC_MoCADCTst" 137 "DFC_MoFSidst" 138 "DFC_OCWDACom" 139 "DFC_OilPPSSwtMax" 140 "DFC_OilPPSSwtMin" 141 "DFC_OilPPSSwtSig" 142 "DFC_OvHEngSpdLimr" 46 "DFC_PDUR_E_INIT_FAILED" 47 "DFC_PDUR_E_PDU_INSTANCE_LOST" 48 "DFC_RBA_IOEXTLIB_KEEPALIVE_DRV" 49 "DFC_RBA_IOEXTLIB_KEEPALIVE_INI" 50 "DFC_rba_IoSigRtc_StopCounter" 52 "DFC_rba_MRly_Diag_Stk_Event" 51 "DFC_rba_MultiStackTrace_Threshold" 53 "DFC_rba_SyC_IrrSwOffTrigEngRun_Event" 54 "DFC_rba_T15_Diag_ComInVld_Event" 55 "DFC_rba_T15_Diag_ComOff_HwOn_Event" 56 "DFC_rba_T15_Diag_ComOn_HwOff_Event" 22 "DFC_RoughRoad" 143 "DFC_RoVComVld" 144 "DFC_RoVSNpl" 145 "DFC_RoVSOL" 146 "DFC_RoVSSCB" 147 "DFC_RoVSSCG" 148 "DFC_SdSTNpl" 149 "DFC_SdSTSCB" 150 "DFC_SdSTSCG" 151 "DFC_SdSTSOL" 23 "DFC_SSpMon1" 24 "DFC_SSpMon1OT" 25 "DFC_SSpMon1OV" 26 "DFC_SSpMon1SCG" 27 "DFC_SSpMon1UV" 28 "DFC_SSpMon2" 29 "DFC_SSpMon2OT" 30 "DFC_SSpMon2OV" 31 "DFC_SSpMon2SCG" 32 "DFC_SSpMon2UV" 7 "DFC_StrtOL" 8 "DFC_StrtOvrTemp" 9 "DFC_StrtSCB" 10 "DFC_StrtSCG" 152 "DFC_TEVEmax" 153 "DFC_TEVEmin" 154 "DFC_TEVEsig" 155 "DFC_TMnpl" 156 "DFC_UBmax" 157 "DFC_UBmin" 158 "DFC_UBnpl" 159 "DFC_VFZsig" 160 "DFC_VFZsig2" DEFAULT_VALUE "---" /end COMPU_VTAB
/begin COMPU_METHOD DINH_ct_Compu "" RAT_FUNC "%6.0" "" COEFFS 0 -1 4096 0 0 1 /end COMPU_METHOD
/begin COMPU_METHOD DINH_FIdVerb "" TAB_VERB "%2.1" "-" COMPU_TAB_REF DINH_FIdVerb /end COMPU_METHOD
/begin COMPU_VTAB DINH_FIdVerb "" TAB_VERB 87 0 "FId_Unused" 1 "FId_InhibitAlways" 2 "FID_GGVFZG" 3 "FId_AEKPROVS" 4 "FId_BypAirActrPsElecErr" 5 "FId_BypAirActrPsIf" 6 "FId_BypAirActr_SteprMotPosnCtrl" 7 "FId_CEngDsTSRCErr" 8 "FId_CEngDsTSTC" 9 "FId_ClthStkOpn" 10 "FId_ClthSwtSensErr" 11 "FId_DIA" 12 "FId_DIUMPRGenDenom1" 13 "FId_DIUMPRGenDenom2" 14 "FId_DIUMPRGenDenom3" 15 "FId_DIUMPRIgn" 16 "FId_DK" 17 "FId_DKVS" 18 "FId_DLLR" 19 "FId_DLLSTP" 20 "FId_DSMWarmUpCycle" 21 "FId_DSS" 22 "FId_EDLLR" 23 "FId_EpmCrSDiag" 24 "FId_EpmCrSDiagBattU" 25 "FId_EpmCrSDiagVeh" 26 "FId_EpmCrSErr" 27 "FId_EpmCrSIntkMnfldP" 28 "FId_EpmRRSCrSFaultCheck" 29 "FId_EpmRRSVehVFaultChck" 30 "FId_EpmSynIntkMnfldP" 31 "FId_FKMSDK" 32 "FId_HEGOS1Htg" 33 "FId_HEGOS2Htg" 34 "FId_IgnActvCoilDiag" 35 "FId_InhibitNever" 36 "FId_InjSysPlausTripRcrd" 37 "FId_IntkAirTAirFltDsSRCErr" 38 "FId_IntkAirTAirFltDsSTC" 39 "FId_KHZ" 40 "FId_MisfDetEnvP" 41 "FId_MisfDetGbx" 42 "FId_MisfDetShtrpAct" 43 "FId_MisfDetStc" 44 "FId_MisfDetV" 45 "FId_MisfDet_InjLockdOpen01" 46 "FId_NMAXMDTempErr" 47 "FId_NeutSwtSensErr" 48 "FId_OilPPSSwt" 49 "FId_PIntkVUsSnsrSply" 50 "FId_PSPInjErr" 51 "FId_Rollovr_DetnElecErr" 52 "FId_Rollovr_DetnSSpErr" 53 "FId_SdSTClth" 54 "FId_SdSTDiagErr" 55 "FId_SdSTNGS" 56 "FId_SdSTSSpErr" 57 "FId_SprkSeatTMdl" 58 "FId_StSysStrtCtl" 59 "FId_StrtVDModel" 60 "FId_TMLFS" 61 "FId_TMnplChkIUMPR" 62 "FId_ThrVlvSnsrSply" 63 "FId_UBLFS" 64 "FId_bbte" 65 "FId_cfflsh" 66 "FId_cfflsv" 67 "FId_dhlshk" 68 "FId_dhlsvk" 69 "FId_dkat" 70 "FId_dlahi" 71 "FId_dlashmn" 72 "FId_dlashmx" 73 "FId_dlsa" 74 "FId_dlsahk" 75 "FId_dlsahsv" 76 "FId_dlshen" 77 "FId_dlshklt" 78 "FId_dlsven" 79 "FId_dlsvhub" 80 "FId_dlsvklt" 81 "FId_dsschub" 82 "FId_latp" 83 "FId_lra" 84 "FId_lreb" 85 "FId_lrhk" 86 "FId_vmaxmd" DEFAULT_VALUE "---" /end COMPU_VTAB
/begin COMPU_METHOD DINH_LimDFCVerb "" TAB_VERB "%6.3" "-" COMPU_TAB_REF DINH_LimDFCVerb /end COMPU_METHOD
/begin COMPU_VTAB DINH_LimDFCVerb "" TAB_VERB 18 0 "No_Inhibit" 1 "Def50_Deb100" 2 "Def100_Deb100" 3 "Def50_Deb100_Tst" 4 "Def100_Deb100_Tst" 5 "Def50_Deb100_or_NTst" 6 "Def100_Deb100_or_NTst" 7 "Tested" 8 "NotTested" 9 "Def100_Deb0" 10 "Def50_Deb0" 11 "Def25_Deb0" 12 "Def0_Deb0" 13 "Def50_Deb100_Tst_Trip" 14 "Def100_Deb100_Tst_Trip" 15 "Def50_Deb100_MILOn" 16 "Def50_Deb100_Trip" 17 "Def100_Deb100_Trip" /end COMPU_VTAB
/begin COMPU_METHOD DINH_LimDSQVerb "" TAB_VERB "%6.3" "-" COMPU_TAB_REF DINH_LimDSQVerb /end COMPU_METHOD
/begin COMPU_VTAB DINH_LimDSQVerb "" TAB_VERB 17 0 "Qual_AllOk_0" 1 "Qual_1" 2 "Qual_Meas_2" 3 "Qual_PremFrozen_3" 4 "Qual_Model_4" 5 "Qual_5" 6 "Qual_6" 7 "Qual_7" 8 "Qual_Frozen_8" 9 "Qual_9" 10 "Qual_10" 11 "Qual_Tester_11" 12 "Qual_Default_12" 13 "Qual_13" 14 "Qual_14" 15 "Qual_Invalid_15" 16 "No_Inhibit" /end COMPU_VTAB
/begin COMPU_METHOD DIUMPR_GroupVerb "" TAB_VERB "%2.1" "-" COMPU_TAB_REF DIUMPR_GroupVerb /end COMPU_METHOD
/begin COMPU_VTAB DIUMPR_GroupVerb "" TAB_VERB 11 0 "Catalyst_Bank1" 1 "Catalyst_Bank2" 2 "OxygenSensor_Bank1" 3 "OxygenSensor_Bank2" 4 "EGR_VVT" 5 "SecAirSys" 6 "EvpSys" 7 "SecOxySens_Bank1" 8 "SecOxySens_Bank2" 9 "Private" 10 "Unused" DEFAULT_VALUE "---" /end COMPU_VTAB
/begin COMPU_METHOD DIUMPR_l10km "" RAT_FUNC "%6.1" "km" COEFFS 0 1 0 0 0 10 /end COMPU_METHOD
/begin COMPU_METHOD DIUMPR_ti100ms "" RAT_FUNC "%6.3" "s" COEFFS 0 10 0 0 0 1 /end COMPU_METHOD
/begin COMPU_METHOD DSCHED_RATECALC_SY_Compu "" TAB_VERB "%6.3" "" COMPU_TAB_REF DSCHED_RATECALC_SY_Compu /end COMPU_METHOD
/begin COMPU_VTAB DSCHED_RATECALC_SY_Compu "" TAB_VERB 2 0 "DSCHED_RATECALC_DISBL" 1 "DSCHED_RATECALC_ENA" /end COMPU_VTAB
/begin COMPU_METHOD DSCHED_WTT_SY_Compu "" TAB_VERB "%6.3" "" COMPU_TAB_REF DSCHED_WTT_SY_Compu /end COMPU_METHOD
/begin COMPU_VTAB DSCHED_WTT_SY_Compu "" TAB_VERB 2 0 "DSCHED_WTT_DISBL" 1 "DSCHED_WTT_ENA" /end COMPU_VTAB
/begin COMPU_METHOD DSM2AUTOSAR_ASWPF_SC_Compu "" TAB_VERB "%6.3" "" COMPU_TAB_REF DSM2AUTOSAR_ASWPF_SC_Compu /end COMPU_METHOD
/begin COMPU_VTAB DSM2AUTOSAR_ASWPF_SC_Compu "" TAB_VERB 2 0 "No_Support" 1 "Support_BAC" /end COMPU_VTAB
/begin COMPU_METHOD DSM2AUTOSAR_DCMIF_SC_Compu "" TAB_VERB "%6.3" "" COMPU_TAB_REF DSM2AUTOSAR_DCMIF_SC_Compu /end COMPU_METHOD
/begin COMPU_VTAB DSM2AUTOSAR_DCMIF_SC_Compu "" TAB_VERB 7 0 "Platform" 1 "Volvo" 2 "BMW" 3 "VW" 4 "FORD" 5 "DAI" 6 "FPT" /end COMPU_VTAB
/begin COMPU_METHOD DSM2AUTOSAR_SC_Compu "" TAB_VERB "%6.3" "" COMPU_TAB_REF DSM2AUTOSAR_SC_Compu /end COMPU_METHOD
/begin COMPU_VTAB DSM2AUTOSAR_SC_Compu "" TAB_VERB 2 0 "False" 1 "True" /end COMPU_VTAB
/begin COMPU_METHOD DSM2AUTOSAR_SECFCM_SC_Compu "" TAB_VERB "%6.3" "" COMPU_TAB_REF DSM2AUTOSAR_SECFCM_SC_Compu /end COMPU_METHOD
/begin COMPU_VTAB DSM2AUTOSAR_SECFCM_SC_Compu "" TAB_VERB 2 0 "No_Support" 1 "Support_3_Cond" /end COMPU_VTAB
/begin COMPU_METHOD Fact "" RAT_FUNC "%6.5" "-" COEFFS 0 8192 0 0 0 1 /end COMPU_METHOD
/begin COMPU_METHOD OneToOne "" RAT_FUNC "%6.2" "-" COEFFS 0 1 0 0 0 1 /end COMPU_METHOD
/begin COMPU_METHOD Prc "" RAT_FUNC "%6.4" "%" COEFFS 0 81.92 0 0 0 1 /end COMPU_METHOD
/begin COMPU_METHOD Pres_hPa "" RAT_FUNC "%6.2" "hPa" COEFFS 0 1 0 0 0 1 /end COMPU_METHOD
/begin COMPU_METHOD Temp_Cels "" RAT_FUNC "%6.1" "deg C" COEFFS 0 10 2731.4 0 0 1 /end COMPU_METHOD
/begin COMPU_METHOD Time_s "" RAT_FUNC "%6.4" "s" COEFFS 0 100 0 0 0 1 /end COMPU_METHOD
/begin COMPU_METHOD Vel "" RAT_FUNC "%6.4" "km/h" COEFFS 0 100 0 0 0 1 /end COMPU_METHOD
/begin RECORD_LAYOUT ValA_Wu16 FNC_VALUES 1 UWORD COLUMN_DIR DIRECT /end RECORD_LAYOUT
/begin RECORD_LAYOUT ValA_Wu8 FNC_VALUES 1 UBYTE COLUMN_DIR DIRECT /end RECORD_LAYOUT
/begin RECORD_LAYOUT Val_Ws16 FNC_VALUES 1 SWORD COLUMN_DIR DIRECT /end RECORD_LAYOUT
/begin RECORD_LAYOUT Val_Wu16 FNC_VALUES 1 UWORD COLUMN_DIR DIRECT /end RECORD_LAYOUT
/begin RECORD_LAYOUT Val_Wu8 FNC_VALUES 1 UBYTE COLUMN_DIR DIRECT /end RECORD_LAYOUT
/end MODULE
/end PROJECT
