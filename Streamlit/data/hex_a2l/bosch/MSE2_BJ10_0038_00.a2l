ASAP2_VERSION 1 60
/begin PROJECT MSE2_BJ10_0038_00 "MDG1"
/begin HEADER "" VERSION "MSE2_BJ10_0038_00" PROJECT_NO MSE2_BJ10_0038_00 /end HEADER
/begin MODULE DIM ""
/begin MOD_COMMON "" BYTE_ORDER MSB_FIRST ALIGNMENT_BYTE 1 ALIGNMENT_WORD 2 ALIGNMENT_LONG 4 ALIGNMENT_INT64 4 ALIGNMENT_FLOAT32_IEEE 4 ALIGNMENT_FLOAT64_IEEE 4 /end MOD_COMMON
/begin CHARACTERISTIC CWEKP "codeword tvekppwm pwm signal for EKP" VALUE 0x9083868 KwWU8 255.0 dez 0.00 255.0 FORMAT "%5.1" /end CHARACTERISTIC
/begin CHARACTERISTIC DFC_CtlMsk2.DFC_rba_SyC_IrrSwOffTrigEngRun_Event_C "Behaviour control mask / Behaviour control masks of check DFC_rba_SyC_IrrSwOffTrigEngRun_Event" VALUE 0x90803CD Val_Wu8 255.0 DFES_OneToOne 0.00 255.0 FORMAT "%5.1" /end CHARACTERISTIC
/begin CHARACTERISTIC DFC_CtlMsk2.DFC_rba_T15_Diag_ComInVld_Event_C "Behaviour control mask / Behaviour control masks of check DFC_rba_T15_Diag_ComInVld_Event" VALUE 0x90803CE Val_Wu8 255.0 DFES_OneToOne 0.00 255.0 FORMAT "%5.1" /end CHARACTERISTIC
/begin CHARACTERISTIC DFC_CtlMsk2.DFC_rba_T15_Diag_ComOff_HwOn_Event_C "Behaviour control mask / Behaviour control masks of check DFC_rba_T15_Diag_ComOff_HwOn_Event" VALUE 0x90803CF Val_Wu8 255.0 DFES_OneToOne 0.00 255.0 FORMAT "%5.1" /end CHARACTERISTIC
/begin CHARACTERISTIC DFC_CtlMsk2.DFC_rba_T15_Diag_ComOn_HwOff_Event_C "Behaviour control mask / Behaviour control masks of check DFC_rba_T15_Diag_ComOn_HwOff_Event" VALUE 0x90803D0 Val_Wu8 255.0 DFES_OneToOne 0.00 255.0 FORMAT "%5.1" /end CHARACTERISTIC
/begin CHARACTERISTIC DFC_CtlMsk2.DFC_KPEmax_C "Behaviour control mask / Behaviour control masks of check DFC_KPEmax" VALUE 0x9080403 Val_Wu8 255.0 DFES_OneToOne 0.00 255.0 FORMAT "%5.1" /end CHARACTERISTIC
/begin CHARACTERISTIC DFC_CtlMsk2.DFC_KPEmin_C "Behaviour control mask / Behaviour control masks of check DFC_KPEmin" VALUE 0x9080404 Val_Wu8 255.0 DFES_OneToOne 0.00 255.0 FORMAT "%5.1" /end CHARACTERISTIC
/begin CHARACTERISTIC DFC_CtlMsk2.DFC_KPEsig_C "Behaviour control mask / Behaviour control masks of check DFC_KPEsig" VALUE 0x9080405 Val_Wu8 255.0 DFES_OneToOne 0.00 255.0 FORMAT "%5.1" /end CHARACTERISTIC
/begin CHARACTERISTIC DFC_DisblMsk2.DFC_rba_SyC_IrrSwOffTrigEngRun_Event_C "disable mask / Disable masks of check DFC_rba_SyC_IrrSwOffTrigEngRun_Event" VALUE 0x9080D9D Val_Wu8 255.0 DFES_OneToOne 0.00 255.0 FORMAT "%5.1" /end CHARACTERISTIC
/begin CHARACTERISTIC DFC_DisblMsk2.DFC_rba_T15_Diag_ComInVld_Event_C "disable mask / Disable masks of check DFC_rba_T15_Diag_ComInVld_Event" VALUE 0x9080D9E Val_Wu8 255.0 DFES_OneToOne 0.00 255.0 FORMAT "%5.1" /end CHARACTERISTIC
/begin CHARACTERISTIC DFC_DisblMsk2.DFC_rba_T15_Diag_ComOff_HwOn_Event_C "disable mask / Disable masks of check DFC_rba_T15_Diag_ComOff_HwOn_Event" VALUE 0x9080D9F Val_Wu8 255.0 DFES_OneToOne 0.00 255.0 FORMAT "%5.1" /end CHARACTERISTIC
/begin CHARACTERISTIC DFC_DisblMsk2.DFC_rba_T15_Diag_ComOn_HwOff_Event_C "disable mask / Disable masks of check DFC_rba_T15_Diag_ComOn_HwOff_Event" VALUE 0x9080DA0 Val_Wu8 255.0 DFES_OneToOne 0.00 255.0 FORMAT "%5.1" /end CHARACTERISTIC
/begin CHARACTERISTIC DFC_DisblMsk2.DFC_KPEmax_C "disable mask / Disable masks of check DFC_KPEmax" VALUE 0x9080DD3 Val_Wu8 255.0 DFES_OneToOne 0.00 255.0 FORMAT "%5.1" /end CHARACTERISTIC
/begin CHARACTERISTIC DFC_DisblMsk2.DFC_KPEmin_C "disable mask / Disable masks of check DFC_KPEmin" VALUE 0x9080DD4 Val_Wu8 255.0 DFES_OneToOne 0.00 255.0 FORMAT "%5.1" /end CHARACTERISTIC
/begin CHARACTERISTIC DFC_DisblMsk2.DFC_KPEsig_C "disable mask / Disable masks of check DFC_KPEsig" VALUE 0x9080DD5 Val_Wu8 255.0 DFES_OneToOne 0.00 255.0 FORMAT "%5.1" /end CHARACTERISTIC
/begin CHARACTERISTIC EKPPA "Number of test pulse output from diagnosis power stage of fuel pump" VALUE 0x9083869 KwWU8 255.0 dez 0.00 255.0 FORMAT "%5.1" /end CHARACTERISTIC
/begin CHARACTERISTIC TABSTEKP "Threshold time limit for engine shut-off" VALUE 0x908386A KwWU8 255.0 t_q1 0.00 255.0 FORMAT "%5.1" /end CHARACTERISTIC
/begin CHARACTERISTIC TCYCDEKPE "delay time before cycle flag set by %DEKPE" VALUE 0x908386B KwWU8 25.50 t_q0p1 0.00 25.50 FORMAT "%5.2" /end CHARACTERISTIC
/begin CHARACTERISTIC TEKPO "EKP pre run time" VALUE 0x908386C KwWU16 655.3500 t_q0p01 0.00 655.3500 FORMAT "%8.4" /end CHARACTERISTIC
/begin MEASUREMENT rba_Runtime_Input_st.configs_ast[0].idElement_u32 "rba_Runtime Measurement Variable/[0]/" ULONG RB_RBA_Common_CentralElements_CompuMethods_Identical 1 100 0.0 4.E9 FORMAT "%5.0" ECU_ADDRESS 0x400073F8 /end MEASUREMENT
/begin MEASUREMENT rba_Runtime_Input_st.configs_ast[0].idTask_u16 "rba_Runtime Measurement Variable/[0]/" UWORD RB_RBA_Common_CentralElements_CompuMethods_Identical 1 100 0.0 65535. FORMAT "%5.0" ECU_ADDRESS 0x400073FC /end MEASUREMENT
/begin MEASUREMENT rba_Runtime_Input_st.tiSampleTime_u8 "rba_Runtime Measurement Variable/" UBYTE RB_RBA_Common_CentralElements_CompuMethods_Identical 1 100 0.0 255. FORMAT "%5.0" ECU_ADDRESS 0x40007400 /end MEASUREMENT
/begin MEASUREMENT rba_Runtime_Input_st.ctTrigger_u8 "rba_Runtime Measurement Variable/" UBYTE RB_RBA_Common_CentralElements_CompuMethods_Identical 1 100 0.0 255. FORMAT "%5.0" ECU_ADDRESS 0x40007401 /end MEASUREMENT
/begin MEASUREMENT rba_Runtime_MonIsr_ast[0].tiCurRT_u32 "rba_Runtime Measurement Variable[0]/" ULONG RB_RBA_rba_Runtime_CompuMethods_rba_Runtime_Time 1 100 0.0 4.E9 FORMAT "%5.0" ECU_ADDRESS 0x40007570 /end MEASUREMENT
/begin MEASUREMENT rba_Runtime_MonIsr_ast[1].tiCurRT_u32 "rba_Runtime Measurement Variable[1]/" ULONG RB_RBA_rba_Runtime_CompuMethods_rba_Runtime_Time 1 100 0.0 4.E9 FORMAT "%5.0" ECU_ADDRESS 0x40007598 /end MEASUREMENT
/begin MEASUREMENT rba_Runtime_MonIsr_ast[0].tiMinRT_u32 "rba_Runtime Measurement Variable[0]/" ULONG RB_RBA_rba_Runtime_CompuMethods_rba_Runtime_Time 1 100 0.0 4.E9 FORMAT "%5.0" ECU_ADDRESS 0x40007574 /end MEASUREMENT
/begin MEASUREMENT rba_Runtime_MonIsr_ast[1].tiMinRT_u32 "rba_Runtime Measurement Variable[1]/" ULONG RB_RBA_rba_Runtime_CompuMethods_rba_Runtime_Time 1 100 0.0 4.E9 FORMAT "%5.0" ECU_ADDRESS 0x4000759C /end MEASUREMENT
/begin MEASUREMENT rba_Runtime_MonIsr_ast[0].tiMaxRT_u32 "rba_Runtime Measurement Variable[0]/" ULONG RB_RBA_rba_Runtime_CompuMethods_rba_Runtime_Time 1 100 0.0 4.E9 FORMAT "%5.0" ECU_ADDRESS 0x40007578 /end MEASUREMENT
/begin MEASUREMENT rba_Runtime_MonIsr_ast[1].tiMaxRT_u32 "rba_Runtime Measurement Variable[1]/" ULONG RB_RBA_rba_Runtime_CompuMethods_rba_Runtime_Time 1 100 0.0 4.E9 FORMAT "%5.0" ECU_ADDRESS 0x400075A0 /end MEASUREMENT
/begin MEASUREMENT rba_Runtime_MonIsr_ast[0].ctCallsTotal_u32 "rba_Runtime Measurement Variable[0]/" ULONG RB_RBA_Common_CentralElements_CompuMethods_Identical 1 100 0.0 4.E9 FORMAT "%5.0" ECU_ADDRESS 0x4000757C /end MEASUREMENT
/begin MEASUREMENT rba_Runtime_MonIsr_ast[1].ctCallsTotal_u32 "rba_Runtime Measurement Variable[1]/" ULONG RB_RBA_Common_CentralElements_CompuMethods_Identical 1 100 0.0 4.E9 FORMAT "%5.0" ECU_ADDRESS 0x400075A4 /end MEASUREMENT
/begin MEASUREMENT rba_Runtime_MonIsr_ast[0].tiAvrgRT_u32 "rba_Runtime Measurement Variable[0]/" ULONG RB_RBA_rba_Runtime_CompuMethods_rba_Runtime_Time 1 100 0.0 4.E9 FORMAT "%5.0" ECU_ADDRESS 0x40007580 /end MEASUREMENT
/begin MEASUREMENT rba_Runtime_MonIsr_ast[1].tiAvrgRT_u32 "rba_Runtime Measurement Variable[1]/" ULONG RB_RBA_rba_Runtime_CompuMethods_rba_Runtime_Time 1 100 0.0 4.E9 FORMAT "%5.0" ECU_ADDRESS 0x400075A8 /end MEASUREMENT
/begin MEASUREMENT rba_Runtime_MonIsr_ast[0].ctCalls_u32 "rba_Runtime Measurement Variable[0]/" ULONG RB_RBA_Common_CentralElements_CompuMethods_Identical 1 100 0.0 4.E9 FORMAT "%5.0" ECU_ADDRESS 0x40007584 /end MEASUREMENT
/begin MEASUREMENT rba_Runtime_MonIsr_ast[1].ctCalls_u32 "rba_Runtime Measurement Variable[1]/" ULONG RB_RBA_Common_CentralElements_CompuMethods_Identical 1 100 0.0 4.E9 FORMAT "%5.0" ECU_ADDRESS 0x400075AC /end MEASUREMENT
/begin MEASUREMENT rba_Runtime_MonIsr_ast[0].internal_st.tiAccuRT_u32 "rba_Runtime Measurement Variable[0]//" ULONG RB_RBA_rba_Runtime_CompuMethods_rba_Runtime_Time 1 100 0.0 4.E9 FORMAT "%5.0" ECU_ADDRESS 0x40007588 /end MEASUREMENT
/begin MEASUREMENT rba_Runtime_MonIsr_ast[1].internal_st.tiAccuRT_u32 "rba_Runtime Measurement Variable[1]//" ULONG RB_RBA_rba_Runtime_CompuMethods_rba_Runtime_Time 1 100 0.0 4.E9 FORMAT "%5.0" ECU_ADDRESS 0x400075B0 /end MEASUREMENT
/begin MEASUREMENT rba_Runtime_MonIsr_ast[0].internal_st.ctBeginCalls_u32 "rba_Runtime Measurement Variable[0]//" ULONG RB_RBA_Common_CentralElements_CompuMethods_Identical 1 100 0.0 4.E9 FORMAT "%5.0" ECU_ADDRESS 0x4000758C /end MEASUREMENT
/begin MEASUREMENT rba_Runtime_MonIsr_ast[1].internal_st.ctBeginCalls_u32 "rba_Runtime Measurement Variable[1]//" ULONG RB_RBA_Common_CentralElements_CompuMethods_Identical 1 100 0.0 4.E9 FORMAT "%5.0" ECU_ADDRESS 0x400075B4 /end MEASUREMENT
/begin MEASUREMENT rba_Runtime_MonIsr_ast[0].internal_st.tiBeginFree_u32 "rba_Runtime Measurement Variable[0]//" ULONG RB_RBA_rba_Runtime_CompuMethods_rba_Runtime_Time 1 100 0.0 4.E9 FORMAT "%5.0" ECU_ADDRESS 0x40007590 /end MEASUREMENT
/begin MEASUREMENT rba_Runtime_MonIsr_ast[1].internal_st.tiBeginFree_u32 "rba_Runtime Measurement Variable[1]//" ULONG RB_RBA_rba_Runtime_CompuMethods_rba_Runtime_Time 1 100 0.0 4.E9 FORMAT "%5.0" ECU_ADDRESS 0x400075B8 /end MEASUREMENT
/begin MEASUREMENT rba_Runtime_MonIsr_ast[0].loadPer64k_u16 "rba_Runtime Measurement Variable[0]/" UWORD RB_RBA_rba_Runtime_CompuMethods_rba_Runtime_Percentage 1 100 0.0 65535. FORMAT "%5.0" ECU_ADDRESS 0x40007594 /end MEASUREMENT
/begin MEASUREMENT rba_Runtime_MonIsr_ast[1].loadPer64k_u16 "rba_Runtime Measurement Variable[1]/" UWORD RB_RBA_rba_Runtime_CompuMethods_rba_Runtime_Percentage 1 100 0.0 65535. FORMAT "%5.0" ECU_ADDRESS 0x400075BC /end MEASUREMENT
/begin MEASUREMENT rba_Runtime_MonIsr_ast[0].ctSampleProcessed_u8 "rba_Runtime Measurement Variable[0]/" UBYTE RB_RBA_Common_CentralElements_CompuMethods_Identical 1 100 0.0 255. FORMAT "%5.0" ECU_ADDRESS 0x40007596 /end MEASUREMENT
/begin MEASUREMENT rba_Runtime_MonIsr_ast[1].ctSampleProcessed_u8 "rba_Runtime Measurement Variable[1]/" UBYTE RB_RBA_Common_CentralElements_CompuMethods_Identical 1 100 0.0 255. FORMAT "%5.0" ECU_ADDRESS 0x400075BE /end MEASUREMENT
/begin MEASUREMENT rba_Runtime_MonTask_ast[0].tiCurRT_u32 "rba_Runtime Measurement Variable[0]/" ULONG RB_RBA_rba_Runtime_CompuMethods_rba_Runtime_Time 1 100 0.0 4.E9 FORMAT "%5.0" ECU_ADDRESS 0x400075C0 /end MEASUREMENT
/begin MEASUREMENT rba_Runtime_MonTask_ast[1].tiCurRT_u32 "rba_Runtime Measurement Variable[1]/" ULONG RB_RBA_rba_Runtime_CompuMethods_rba_Runtime_Time 1 100 0.0 4.E9 FORMAT "%5.0" ECU_ADDRESS 0x400075F4 /end MEASUREMENT
/begin MEASUREMENT rba_Runtime_MonTask_ast[2].tiCurRT_u32 "rba_Runtime Measurement Variable[2]/" ULONG RB_RBA_rba_Runtime_CompuMethods_rba_Runtime_Time 1 100 0.0 4.E9 FORMAT "%5.0" ECU_ADDRESS 0x40007628 /end MEASUREMENT
/begin MEASUREMENT rba_Runtime_MonTask_ast[3].tiCurRT_u32 "rba_Runtime Measurement Variable[3]/" ULONG RB_RBA_rba_Runtime_CompuMethods_rba_Runtime_Time 1 100 0.0 4.E9 FORMAT "%5.0" ECU_ADDRESS 0x4000765C /end MEASUREMENT
/begin MEASUREMENT rba_Runtime_MonTask_ast[4].tiCurRT_u32 "rba_Runtime Measurement Variable[4]/" ULONG RB_RBA_rba_Runtime_CompuMethods_rba_Runtime_Time 1 100 0.0 4.E9 FORMAT "%5.0" ECU_ADDRESS 0x40007690 /end MEASUREMENT
/begin MEASUREMENT rba_Runtime_MonTask_ast[5].tiCurRT_u32 "rba_Runtime Measurement Variable[5]/" ULONG RB_RBA_rba_Runtime_CompuMethods_rba_Runtime_Time 1 100 0.0 4.E9 FORMAT "%5.0" ECU_ADDRESS 0x400076C4 /end MEASUREMENT
/begin MEASUREMENT rba_Runtime_MonTask_ast[6].tiCurRT_u32 "rba_Runtime Measurement Variable[6]/" ULONG RB_RBA_rba_Runtime_CompuMethods_rba_Runtime_Time 1 100 0.0 4.E9 FORMAT "%5.0" ECU_ADDRESS 0x400076F8 /end MEASUREMENT
/begin MEASUREMENT rba_Runtime_MonTask_ast[7].tiCurRT_u32 "rba_Runtime Measurement Variable[7]/" ULONG RB_RBA_rba_Runtime_CompuMethods_rba_Runtime_Time 1 100 0.0 4.E9 FORMAT "%5.0" ECU_ADDRESS 0x4000772C /end MEASUREMENT
/begin MEASUREMENT rba_Runtime_MonTask_ast[8].tiCurRT_u32 "rba_Runtime Measurement Variable[8]/" ULONG RB_RBA_rba_Runtime_CompuMethods_rba_Runtime_Time 1 100 0.0 4.E9 FORMAT "%5.0" ECU_ADDRESS 0x40007760 /end MEASUREMENT
/begin MEASUREMENT rba_Runtime_MonTask_ast[9].tiCurRT_u32 "rba_Runtime Measurement Variable[9]/" ULONG RB_RBA_rba_Runtime_CompuMethods_rba_Runtime_Time 1 100 0.0 4.E9 FORMAT "%5.0" ECU_ADDRESS 0x40007794 /end MEASUREMENT
/begin MEASUREMENT rba_Runtime_MonTask_ast[10].tiCurRT_u32 "rba_Runtime Measurement Variable[10]/" ULONG RB_RBA_rba_Runtime_CompuMethods_rba_Runtime_Time 1 100 0.0 4.E9 FORMAT "%5.0" ECU_ADDRESS 0x400077C8 /end MEASUREMENT
/begin MEASUREMENT rba_Runtime_MonTask_ast[11].tiCurRT_u32 "rba_Runtime Measurement Variable[11]/" ULONG RB_RBA_rba_Runtime_CompuMethods_rba_Runtime_Time 1 100 0.0 4.E9 FORMAT "%5.0" ECU_ADDRESS 0x400077FC /end MEASUREMENT
/begin MEASUREMENT rba_Runtime_MonTask_ast[12].tiCurRT_u32 "rba_Runtime Measurement Variable[12]/" ULONG RB_RBA_rba_Runtime_CompuMethods_rba_Runtime_Time 1 100 0.0 4.E9 FORMAT "%5.0" ECU_ADDRESS 0x40007830 /end MEASUREMENT
/begin MEASUREMENT rba_Runtime_MonTask_ast[13].tiCurRT_u32 "rba_Runtime Measurement Variable[13]/" ULONG RB_RBA_rba_Runtime_CompuMethods_rba_Runtime_Time 1 100 0.0 4.E9 FORMAT "%5.0" ECU_ADDRESS 0x40007864 /end MEASUREMENT
/begin MEASUREMENT rba_Runtime_MonTask_ast[14].tiCurRT_u32 "rba_Runtime Measurement Variable[14]/" ULONG RB_RBA_rba_Runtime_CompuMethods_rba_Runtime_Time 1 100 0.0 4.E9 FORMAT "%5.0" ECU_ADDRESS 0x40007898 /end MEASUREMENT
/begin MEASUREMENT rba_Runtime_MonTask_ast[15].tiCurRT_u32 "rba_Runtime Measurement Variable[15]/" ULONG RB_RBA_rba_Runtime_CompuMethods_rba_Runtime_Time 1 100 0.0 4.E9 FORMAT "%5.0" ECU_ADDRESS 0x400078CC /end MEASUREMENT
/begin MEASUREMENT rba_Runtime_MonTask_ast[16].tiCurRT_u32 "rba_Runtime Measurement Variable[16]/" ULONG RB_RBA_rba_Runtime_CompuMethods_rba_Runtime_Time 1 100 0.0 4.E9 FORMAT "%5.0" ECU_ADDRESS 0x40007900 /end MEASUREMENT
/begin MEASUREMENT rba_Runtime_MonTask_ast[17].tiCurRT_u32 "rba_Runtime Measurement Variable[17]/" ULONG RB_RBA_rba_Runtime_CompuMethods_rba_Runtime_Time 1 100 0.0 4.E9 FORMAT "%5.0" ECU_ADDRESS 0x40007934 /end MEASUREMENT
/begin MEASUREMENT rba_Runtime_MonTask_ast[18].tiCurRT_u32 "rba_Runtime Measurement Variable[18]/" ULONG RB_RBA_rba_Runtime_CompuMethods_rba_Runtime_Time 1 100 0.0 4.E9 FORMAT "%5.0" ECU_ADDRESS 0x40007968 /end MEASUREMENT
/begin MEASUREMENT rba_Runtime_MonTask_ast[19].tiCurRT_u32 "rba_Runtime Measurement Variable[19]/" ULONG RB_RBA_rba_Runtime_CompuMethods_rba_Runtime_Time 1 100 0.0 4.E9 FORMAT "%5.0" ECU_ADDRESS 0x4000799C /end MEASUREMENT
/begin MEASUREMENT rba_Runtime_MonTask_ast[20].tiCurRT_u32 "rba_Runtime Measurement Variable[20]/" ULONG RB_RBA_rba_Runtime_CompuMethods_rba_Runtime_Time 1 100 0.0 4.E9 FORMAT "%5.0" ECU_ADDRESS 0x400079D0 /end MEASUREMENT
/begin MEASUREMENT rba_Runtime_MonTask_ast[21].tiCurRT_u32 "rba_Runtime Measurement Variable[21]/" ULONG RB_RBA_rba_Runtime_CompuMethods_rba_Runtime_Time 1 100 0.0 4.E9 FORMAT "%5.0" ECU_ADDRESS 0x40007A04 /end MEASUREMENT
/begin MEASUREMENT rba_Runtime_MonTask_ast[22].tiCurRT_u32 "rba_Runtime Measurement Variable[22]/" ULONG RB_RBA_rba_Runtime_CompuMethods_rba_Runtime_Time 1 100 0.0 4.E9 FORMAT "%5.0" ECU_ADDRESS 0x40007A38 /end MEASUREMENT
/begin MEASUREMENT rba_Runtime_MonTask_ast[23].tiCurRT_u32 "rba_Runtime Measurement Variable[23]/" ULONG RB_RBA_rba_Runtime_CompuMethods_rba_Runtime_Time 1 100 0.0 4.E9 FORMAT "%5.0" ECU_ADDRESS 0x40007A6C /end MEASUREMENT
/begin MEASUREMENT rba_Runtime_MonTask_ast[24].tiCurRT_u32 "rba_Runtime Measurement Variable[24]/" ULONG RB_RBA_rba_Runtime_CompuMethods_rba_Runtime_Time 1 100 0.0 4.E9 FORMAT "%5.0" ECU_ADDRESS 0x40007AA0 /end MEASUREMENT
/begin MEASUREMENT rba_Runtime_MonTask_ast[25].tiCurRT_u32 "rba_Runtime Measurement Variable[25]/" ULONG RB_RBA_rba_Runtime_CompuMethods_rba_Runtime_Time 1 100 0.0 4.E9 FORMAT "%5.0" ECU_ADDRESS 0x40007AD4 /end MEASUREMENT
/begin MEASUREMENT rba_Runtime_MonTask_ast[26].tiCurRT_u32 "rba_Runtime Measurement Variable[26]/" ULONG RB_RBA_rba_Runtime_CompuMethods_rba_Runtime_Time 1 100 0.0 4.E9 FORMAT "%5.0" ECU_ADDRESS 0x40007B08 /end MEASUREMENT
/begin MEASUREMENT rba_Runtime_MonTask_ast[27].tiCurRT_u32 "rba_Runtime Measurement Variable[27]/" ULONG RB_RBA_rba_Runtime_CompuMethods_rba_Runtime_Time 1 100 0.0 4.E9 FORMAT "%5.0" ECU_ADDRESS 0x40007B3C /end MEASUREMENT
/begin MEASUREMENT rba_Runtime_MonTask_ast[28].tiCurRT_u32 "rba_Runtime Measurement Variable[28]/" ULONG RB_RBA_rba_Runtime_CompuMethods_rba_Runtime_Time 1 100 0.0 4.E9 FORMAT "%5.0" ECU_ADDRESS 0x40007B70 /end MEASUREMENT
/begin MEASUREMENT rba_Runtime_MonTask_ast[29].tiCurRT_u32 "rba_Runtime Measurement Variable[29]/" ULONG RB_RBA_rba_Runtime_CompuMethods_rba_Runtime_Time 1 100 0.0 4.E9 FORMAT "%5.0" ECU_ADDRESS 0x40007BA4 /end MEASUREMENT
/begin MEASUREMENT rba_Runtime_MonTask_ast[30].tiCurRT_u32 "rba_Runtime Measurement Variable[30]/" ULONG RB_RBA_rba_Runtime_CompuMethods_rba_Runtime_Time 1 100 0.0 4.E9 FORMAT "%5.0" ECU_ADDRESS 0x40007BD8 /end MEASUREMENT
/begin MEASUREMENT rba_Runtime_MonTask_ast[31].tiCurRT_u32 "rba_Runtime Measurement Variable[31]/" ULONG RB_RBA_rba_Runtime_CompuMethods_rba_Runtime_Time 1 100 0.0 4.E9 FORMAT "%5.0" ECU_ADDRESS 0x40007C0C /end MEASUREMENT
/begin MEASUREMENT rba_Runtime_MonTask_ast[32].tiCurRT_u32 "rba_Runtime Measurement Variable[32]/" ULONG RB_RBA_rba_Runtime_CompuMethods_rba_Runtime_Time 1 100 0.0 4.E9 FORMAT "%5.0" ECU_ADDRESS 0x40007C40 /end MEASUREMENT
/begin MEASUREMENT rba_Runtime_MonTask_ast[33].tiCurRT_u32 "rba_Runtime Measurement Variable[33]/" ULONG RB_RBA_rba_Runtime_CompuMethods_rba_Runtime_Time 1 100 0.0 4.E9 FORMAT "%5.0" ECU_ADDRESS 0x40007C74 /end MEASUREMENT
/begin MEASUREMENT rba_Runtime_MonTask_ast[34].tiCurRT_u32 "rba_Runtime Measurement Variable[34]/" ULONG RB_RBA_rba_Runtime_CompuMethods_rba_Runtime_Time 1 100 0.0 4.E9 FORMAT "%5.0" ECU_ADDRESS 0x40007CA8 /end MEASUREMENT
/begin MEASUREMENT rba_Runtime_MonTask_ast[35].tiCurRT_u32 "rba_Runtime Measurement Variable[35]/" ULONG RB_RBA_rba_Runtime_CompuMethods_rba_Runtime_Time 1 100 0.0 4.E9 FORMAT "%5.0" ECU_ADDRESS 0x40007CDC /end MEASUREMENT
/begin MEASUREMENT rba_Runtime_MonTask_ast[36].tiCurRT_u32 "rba_Runtime Measurement Variable[36]/" ULONG RB_RBA_rba_Runtime_CompuMethods_rba_Runtime_Time 1 100 0.0 4.E9 FORMAT "%5.0" ECU_ADDRESS 0x40007D10 /end MEASUREMENT
/begin MEASUREMENT rba_Runtime_MonTask_ast[37].tiCurRT_u32 "rba_Runtime Measurement Variable[37]/" ULONG RB_RBA_rba_Runtime_CompuMethods_rba_Runtime_Time 1 100 0.0 4.E9 FORMAT "%5.0" ECU_ADDRESS 0x40007D44 /end MEASUREMENT
/begin MEASUREMENT rba_Runtime_MonTask_ast[0].tiMinRT_u32 "rba_Runtime Measurement Variable[0]/" ULONG RB_RBA_rba_Runtime_CompuMethods_rba_Runtime_Time 1 100 0.0 4.E9 FORMAT "%5.0" ECU_ADDRESS 0x400075C4 /end MEASUREMENT
/begin MEASUREMENT rba_Runtime_MonTask_ast[1].tiMinRT_u32 "rba_Runtime Measurement Variable[1]/" ULONG RB_RBA_rba_Runtime_CompuMethods_rba_Runtime_Time 1 100 0.0 4.E9 FORMAT "%5.0" ECU_ADDRESS 0x400075F8 /end MEASUREMENT
/begin MEASUREMENT rba_Runtime_MonTask_ast[2].tiMinRT_u32 "rba_Runtime Measurement Variable[2]/" ULONG RB_RBA_rba_Runtime_CompuMethods_rba_Runtime_Time 1 100 0.0 4.E9 FORMAT "%5.0" ECU_ADDRESS 0x4000762C /end MEASUREMENT
/begin MEASUREMENT rba_Runtime_MonTask_ast[3].tiMinRT_u32 "rba_Runtime Measurement Variable[3]/" ULONG RB_RBA_rba_Runtime_CompuMethods_rba_Runtime_Time 1 100 0.0 4.E9 FORMAT "%5.0" ECU_ADDRESS 0x40007660 /end MEASUREMENT
/begin MEASUREMENT rba_Runtime_MonTask_ast[4].tiMinRT_u32 "rba_Runtime Measurement Variable[4]/" ULONG RB_RBA_rba_Runtime_CompuMethods_rba_Runtime_Time 1 100 0.0 4.E9 FORMAT "%5.0" ECU_ADDRESS 0x40007694 /end MEASUREMENT
/begin MEASUREMENT rba_Runtime_MonTask_ast[5].tiMinRT_u32 "rba_Runtime Measurement Variable[5]/" ULONG RB_RBA_rba_Runtime_CompuMethods_rba_Runtime_Time 1 100 0.0 4.E9 FORMAT "%5.0" ECU_ADDRESS 0x400076C8 /end MEASUREMENT
/begin MEASUREMENT rba_Runtime_MonTask_ast[6].tiMinRT_u32 "rba_Runtime Measurement Variable[6]/" ULONG RB_RBA_rba_Runtime_CompuMethods_rba_Runtime_Time 1 100 0.0 4.E9 FORMAT "%5.0" ECU_ADDRESS 0x400076FC /end MEASUREMENT
/begin MEASUREMENT rba_Runtime_MonTask_ast[7].tiMinRT_u32 "rba_Runtime Measurement Variable[7]/" ULONG RB_RBA_rba_Runtime_CompuMethods_rba_Runtime_Time 1 100 0.0 4.E9 FORMAT "%5.0" ECU_ADDRESS 0x40007730 /end MEASUREMENT
/begin MEASUREMENT rba_Runtime_MonTask_ast[8].tiMinRT_u32 "rba_Runtime Measurement Variable[8]/" ULONG RB_RBA_rba_Runtime_CompuMethods_rba_Runtime_Time 1 100 0.0 4.E9 FORMAT "%5.0" ECU_ADDRESS 0x40007764 /end MEASUREMENT
/begin MEASUREMENT rba_Runtime_MonTask_ast[9].tiMinRT_u32 "rba_Runtime Measurement Variable[9]/" ULONG RB_RBA_rba_Runtime_CompuMethods_rba_Runtime_Time 1 100 0.0 4.E9 FORMAT "%5.0" ECU_ADDRESS 0x40007798 /end MEASUREMENT
/begin MEASUREMENT rba_Runtime_MonTask_ast[10].tiMinRT_u32 "rba_Runtime Measurement Variable[10]/" ULONG RB_RBA_rba_Runtime_CompuMethods_rba_Runtime_Time 1 100 0.0 4.E9 FORMAT "%5.0" ECU_ADDRESS 0x400077CC /end MEASUREMENT
/begin MEASUREMENT rba_Runtime_MonTask_ast[11].tiMinRT_u32 "rba_Runtime Measurement Variable[11]/" ULONG RB_RBA_rba_Runtime_CompuMethods_rba_Runtime_Time 1 100 0.0 4.E9 FORMAT "%5.0" ECU_ADDRESS 0x40007800 /end MEASUREMENT
/begin MEASUREMENT rba_Runtime_MonTask_ast[12].tiMinRT_u32 "rba_Runtime Measurement Variable[12]/" ULONG RB_RBA_rba_Runtime_CompuMethods_rba_Runtime_Time 1 100 0.0 4.E9 FORMAT "%5.0" ECU_ADDRESS 0x40007834 /end MEASUREMENT
/begin MEASUREMENT rba_Runtime_MonTask_ast[13].tiMinRT_u32 "rba_Runtime Measurement Variable[13]/" ULONG RB_RBA_rba_Runtime_CompuMethods_rba_Runtime_Time 1 100 0.0 4.E9 FORMAT "%5.0" ECU_ADDRESS 0x40007868 /end MEASUREMENT
/begin MEASUREMENT rba_Runtime_MonTask_ast[14].tiMinRT_u32 "rba_Runtime Measurement Variable[14]/" ULONG RB_RBA_rba_Runtime_CompuMethods_rba_Runtime_Time 1 100 0.0 4.E9 FORMAT "%5.0" ECU_ADDRESS 0x4000789C /end MEASUREMENT
/begin MEASUREMENT rba_Runtime_MonTask_ast[15].tiMinRT_u32 "rba_Runtime Measurement Variable[15]/" ULONG RB_RBA_rba_Runtime_CompuMethods_rba_Runtime_Time 1 100 0.0 4.E9 FORMAT "%5.0" ECU_ADDRESS 0x400078D0 /end MEASUREMENT
/begin MEASUREMENT rba_Runtime_MonTask_ast[16].tiMinRT_u32 "rba_Runtime Measurement Variable[16]/" ULONG RB_RBA_rba_Runtime_CompuMethods_rba_Runtime_Time 1 100 0.0 4.E9 FORMAT "%5.0" ECU_ADDRESS 0x40007904 /end MEASUREMENT
/begin MEASUREMENT rba_Runtime_MonTask_ast[17].tiMinRT_u32 "rba_Runtime Measurement Variable[17]/" ULONG RB_RBA_rba_Runtime_CompuMethods_rba_Runtime_Time 1 100 0.0 4.E9 FORMAT "%5.0" ECU_ADDRESS 0x40007938 /end MEASUREMENT
/begin MEASUREMENT rba_Runtime_MonTask_ast[18].tiMinRT_u32 "rba_Runtime Measurement Variable[18]/" ULONG RB_RBA_rba_Runtime_CompuMethods_rba_Runtime_Time 1 100 0.0 4.E9 FORMAT "%5.0" ECU_ADDRESS 0x4000796C /end MEASUREMENT
/begin MEASUREMENT rba_Runtime_MonTask_ast[19].tiMinRT_u32 "rba_Runtime Measurement Variable[19]/" ULONG RB_RBA_rba_Runtime_CompuMethods_rba_Runtime_Time 1 100 0.0 4.E9 FORMAT "%5.0" ECU_ADDRESS 0x400079A0 /end MEASUREMENT
/begin MEASUREMENT rba_Runtime_MonTask_ast[20].tiMinRT_u32 "rba_Runtime Measurement Variable[20]/" ULONG RB_RBA_rba_Runtime_CompuMethods_rba_Runtime_Time 1 100 0.0 4.E9 FORMAT "%5.0" ECU_ADDRESS 0x400079D4 /end MEASUREMENT
/begin MEASUREMENT rba_Runtime_MonTask_ast[21].tiMinRT_u32 "rba_Runtime Measurement Variable[21]/" ULONG RB_RBA_rba_Runtime_CompuMethods_rba_Runtime_Time 1 100 0.0 4.E9 FORMAT "%5.0" ECU_ADDRESS 0x40007A08 /end MEASUREMENT
/begin MEASUREMENT rba_Runtime_MonTask_ast[22].tiMinRT_u32 "rba_Runtime Measurement Variable[22]/" ULONG RB_RBA_rba_Runtime_CompuMethods_rba_Runtime_Time 1 100 0.0 4.E9 FORMAT "%5.0" ECU_ADDRESS 0x40007A3C /end MEASUREMENT
/begin MEASUREMENT rba_Runtime_MonTask_ast[23].tiMinRT_u32 "rba_Runtime Measurement Variable[23]/" ULONG RB_RBA_rba_Runtime_CompuMethods_rba_Runtime_Time 1 100 0.0 4.E9 FORMAT "%5.0" ECU_ADDRESS 0x40007A70 /end MEASUREMENT
/begin MEASUREMENT rba_Runtime_MonTask_ast[24].tiMinRT_u32 "rba_Runtime Measurement Variable[24]/" ULONG RB_RBA_rba_Runtime_CompuMethods_rba_Runtime_Time 1 100 0.0 4.E9 FORMAT "%5.0" ECU_ADDRESS 0x40007AA4 /end MEASUREMENT
/begin MEASUREMENT rba_Runtime_MonTask_ast[25].tiMinRT_u32 "rba_Runtime Measurement Variable[25]/" ULONG RB_RBA_rba_Runtime_CompuMethods_rba_Runtime_Time 1 100 0.0 4.E9 FORMAT "%5.0" ECU_ADDRESS 0x40007AD8 /end MEASUREMENT
/begin MEASUREMENT rba_Runtime_MonTask_ast[26].tiMinRT_u32 "rba_Runtime Measurement Variable[26]/" ULONG RB_RBA_rba_Runtime_CompuMethods_rba_Runtime_Time 1 100 0.0 4.E9 FORMAT "%5.0" ECU_ADDRESS 0x40007B0C /end MEASUREMENT
/begin MEASUREMENT rba_Runtime_MonTask_ast[27].tiMinRT_u32 "rba_Runtime Measurement Variable[27]/" ULONG RB_RBA_rba_Runtime_CompuMethods_rba_Runtime_Time 1 100 0.0 4.E9 FORMAT "%5.0" ECU_ADDRESS 0x40007B40 /end MEASUREMENT
/begin MEASUREMENT rba_Runtime_MonTask_ast[28].tiMinRT_u32 "rba_Runtime Measurement Variable[28]/" ULONG RB_RBA_rba_Runtime_CompuMethods_rba_Runtime_Time 1 100 0.0 4.E9 FORMAT "%5.0" ECU_ADDRESS 0x40007B74 /end MEASUREMENT
/begin MEASUREMENT rba_Runtime_MonTask_ast[29].tiMinRT_u32 "rba_Runtime Measurement Variable[29]/" ULONG RB_RBA_rba_Runtime_CompuMethods_rba_Runtime_Time 1 100 0.0 4.E9 FORMAT "%5.0" ECU_ADDRESS 0x40007BA8 /end MEASUREMENT
/begin MEASUREMENT rba_Runtime_MonTask_ast[30].tiMinRT_u32 "rba_Runtime Measurement Variable[30]/" ULONG RB_RBA_rba_Runtime_CompuMethods_rba_Runtime_Time 1 100 0.0 4.E9 FORMAT "%5.0" ECU_ADDRESS 0x40007BDC /end MEASUREMENT
/begin MEASUREMENT rba_Runtime_MonTask_ast[31].tiMinRT_u32 "rba_Runtime Measurement Variable[31]/" ULONG RB_RBA_rba_Runtime_CompuMethods_rba_Runtime_Time 1 100 0.0 4.E9 FORMAT "%5.0" ECU_ADDRESS 0x40007C10 /end MEASUREMENT
/begin MEASUREMENT rba_Runtime_MonTask_ast[32].tiMinRT_u32 "rba_Runtime Measurement Variable[32]/" ULONG RB_RBA_rba_Runtime_CompuMethods_rba_Runtime_Time 1 100 0.0 4.E9 FORMAT "%5.0" ECU_ADDRESS 0x40007C44 /end MEASUREMENT
/begin MEASUREMENT rba_Runtime_MonTask_ast[33].tiMinRT_u32 "rba_Runtime Measurement Variable[33]/" ULONG RB_RBA_rba_Runtime_CompuMethods_rba_Runtime_Time 1 100 0.0 4.E9 FORMAT "%5.0" ECU_ADDRESS 0x40007C78 /end MEASUREMENT
/begin MEASUREMENT rba_Runtime_MonTask_ast[34].tiMinRT_u32 "rba_Runtime Measurement Variable[34]/" ULONG RB_RBA_rba_Runtime_CompuMethods_rba_Runtime_Time 1 100 0.0 4.E9 FORMAT "%5.0" ECU_ADDRESS 0x40007CAC /end MEASUREMENT
/begin MEASUREMENT rba_Runtime_MonTask_ast[35].tiMinRT_u32 "rba_Runtime Measurement Variable[35]/" ULONG RB_RBA_rba_Runtime_CompuMethods_rba_Runtime_Time 1 100 0.0 4.E9 FORMAT "%5.0" ECU_ADDRESS 0x40007CE0 /end MEASUREMENT
/begin MEASUREMENT rba_Runtime_MonTask_ast[36].tiMinRT_u32 "rba_Runtime Measurement Variable[36]/" ULONG RB_RBA_rba_Runtime_CompuMethods_rba_Runtime_Time 1 100 0.0 4.E9 FORMAT "%5.0" ECU_ADDRESS 0x40007D14 /end MEASUREMENT
/begin MEASUREMENT rba_Runtime_MonTask_ast[37].tiMinRT_u32 "rba_Runtime Measurement Variable[37]/" ULONG RB_RBA_rba_Runtime_CompuMethods_rba_Runtime_Time 1 100 0.0 4.E9 FORMAT "%5.0" ECU_ADDRESS 0x40007D48 /end MEASUREMENT
/begin MEASUREMENT rba_Runtime_MonTask_ast[0].tiMaxRT_u32 "rba_Runtime Measurement Variable[0]/" ULONG RB_RBA_rba_Runtime_CompuMethods_rba_Runtime_Time 1 100 0.0 4.E9 FORMAT "%5.0" ECU_ADDRESS 0x400075C8 /end MEASUREMENT
/begin MEASUREMENT rba_Runtime_MonTask_ast[1].tiMaxRT_u32 "rba_Runtime Measurement Variable[1]/" ULONG RB_RBA_rba_Runtime_CompuMethods_rba_Runtime_Time 1 100 0.0 4.E9 FORMAT "%5.0" ECU_ADDRESS 0x400075FC /end MEASUREMENT
/begin MEASUREMENT rba_Runtime_MonTask_ast[2].tiMaxRT_u32 "rba_Runtime Measurement Variable[2]/" ULONG RB_RBA_rba_Runtime_CompuMethods_rba_Runtime_Time 1 100 0.0 4.E9 FORMAT "%5.0" ECU_ADDRESS 0x40007630 /end MEASUREMENT
/begin MEASUREMENT rba_Runtime_MonTask_ast[3].tiMaxRT_u32 "rba_Runtime Measurement Variable[3]/" ULONG RB_RBA_rba_Runtime_CompuMethods_rba_Runtime_Time 1 100 0.0 4.E9 FORMAT "%5.0" ECU_ADDRESS 0x40007664 /end MEASUREMENT
/begin MEASUREMENT rba_Runtime_MonTask_ast[4].tiMaxRT_u32 "rba_Runtime Measurement Variable[4]/" ULONG RB_RBA_rba_Runtime_CompuMethods_rba_Runtime_Time 1 100 0.0 4.E9 FORMAT "%5.0" ECU_ADDRESS 0x40007698 /end MEASUREMENT
/begin MEASUREMENT rba_Runtime_MonTask_ast[5].tiMaxRT_u32 "rba_Runtime Measurement Variable[5]/" ULONG RB_RBA_rba_Runtime_CompuMethods_rba_Runtime_Time 1 100 0.0 4.E9 FORMAT "%5.0" ECU_ADDRESS 0x400076CC /end MEASUREMENT
/begin MEASUREMENT rba_Runtime_MonTask_ast[6].tiMaxRT_u32 "rba_Runtime Measurement Variable[6]/" ULONG RB_RBA_rba_Runtime_CompuMethods_rba_Runtime_Time 1 100 0.0 4.E9 FORMAT "%5.0" ECU_ADDRESS 0x40007700 /end MEASUREMENT
/begin MEASUREMENT rba_Runtime_MonTask_ast[7].tiMaxRT_u32 "rba_Runtime Measurement Variable[7]/" ULONG RB_RBA_rba_Runtime_CompuMethods_rba_Runtime_Time 1 100 0.0 4.E9 FORMAT "%5.0" ECU_ADDRESS 0x40007734 /end MEASUREMENT
/begin MEASUREMENT rba_Runtime_MonTask_ast[8].tiMaxRT_u32 "rba_Runtime Measurement Variable[8]/" ULONG RB_RBA_rba_Runtime_CompuMethods_rba_Runtime_Time 1 100 0.0 4.E9 FORMAT "%5.0" ECU_ADDRESS 0x40007768 /end MEASUREMENT
/begin MEASUREMENT rba_Runtime_MonTask_ast[9].tiMaxRT_u32 "rba_Runtime Measurement Variable[9]/" ULONG RB_RBA_rba_Runtime_CompuMethods_rba_Runtime_Time 1 100 0.0 4.E9 FORMAT "%5.0" ECU_ADDRESS 0x4000779C /end MEASUREMENT
/begin MEASUREMENT rba_Runtime_MonTask_ast[10].tiMaxRT_u32 "rba_Runtime Measurement Variable[10]/" ULONG RB_RBA_rba_Runtime_CompuMethods_rba_Runtime_Time 1 100 0.0 4.E9 FORMAT "%5.0" ECU_ADDRESS 0x400077D0 /end MEASUREMENT
/begin MEASUREMENT rba_Runtime_MonTask_ast[11].tiMaxRT_u32 "rba_Runtime Measurement Variable[11]/" ULONG RB_RBA_rba_Runtime_CompuMethods_rba_Runtime_Time 1 100 0.0 4.E9 FORMAT "%5.0" ECU_ADDRESS 0x40007804 /end MEASUREMENT
/begin MEASUREMENT rba_Runtime_MonTask_ast[12].tiMaxRT_u32 "rba_Runtime Measurement Variable[12]/" ULONG RB_RBA_rba_Runtime_CompuMethods_rba_Runtime_Time 1 100 0.0 4.E9 FORMAT "%5.0" ECU_ADDRESS 0x40007838 /end MEASUREMENT
/begin MEASUREMENT rba_Runtime_MonTask_ast[13].tiMaxRT_u32 "rba_Runtime Measurement Variable[13]/" ULONG RB_RBA_rba_Runtime_CompuMethods_rba_Runtime_Time 1 100 0.0 4.E9 FORMAT "%5.0" ECU_ADDRESS 0x4000786C /end MEASUREMENT
/begin MEASUREMENT rba_Runtime_MonTask_ast[14].tiMaxRT_u32 "rba_Runtime Measurement Variable[14]/" ULONG RB_RBA_rba_Runtime_CompuMethods_rba_Runtime_Time 1 100 0.0 4.E9 FORMAT "%5.0" ECU_ADDRESS 0x400078A0 /end MEASUREMENT
/begin MEASUREMENT rba_Runtime_MonTask_ast[15].tiMaxRT_u32 "rba_Runtime Measurement Variable[15]/" ULONG RB_RBA_rba_Runtime_CompuMethods_rba_Runtime_Time 1 100 0.0 4.E9 FORMAT "%5.0" ECU_ADDRESS 0x400078D4 /end MEASUREMENT
/begin MEASUREMENT rba_Runtime_MonTask_ast[16].tiMaxRT_u32 "rba_Runtime Measurement Variable[16]/" ULONG RB_RBA_rba_Runtime_CompuMethods_rba_Runtime_Time 1 100 0.0 4.E9 FORMAT "%5.0" ECU_ADDRESS 0x40007908 /end MEASUREMENT
/begin MEASUREMENT rba_Runtime_MonTask_ast[17].tiMaxRT_u32 "rba_Runtime Measurement Variable[17]/" ULONG RB_RBA_rba_Runtime_CompuMethods_rba_Runtime_Time 1 100 0.0 4.E9 FORMAT "%5.0" ECU_ADDRESS 0x4000793C /end MEASUREMENT
/begin MEASUREMENT rba_Runtime_MonTask_ast[18].tiMaxRT_u32 "rba_Runtime Measurement Variable[18]/" ULONG RB_RBA_rba_Runtime_CompuMethods_rba_Runtime_Time 1 100 0.0 4.E9 FORMAT "%5.0" ECU_ADDRESS 0x40007970 /end MEASUREMENT
/begin MEASUREMENT rba_Runtime_MonTask_ast[19].tiMaxRT_u32 "rba_Runtime Measurement Variable[19]/" ULONG RB_RBA_rba_Runtime_CompuMethods_rba_Runtime_Time 1 100 0.0 4.E9 FORMAT "%5.0" ECU_ADDRESS 0x400079A4 /end MEASUREMENT
/begin MEASUREMENT rba_Runtime_MonTask_ast[20].tiMaxRT_u32 "rba_Runtime Measurement Variable[20]/" ULONG RB_RBA_rba_Runtime_CompuMethods_rba_Runtime_Time 1 100 0.0 4.E9 FORMAT "%5.0" ECU_ADDRESS 0x400079D8 /end MEASUREMENT
/begin MEASUREMENT rba_Runtime_MonTask_ast[21].tiMaxRT_u32 "rba_Runtime Measurement Variable[21]/" ULONG RB_RBA_rba_Runtime_CompuMethods_rba_Runtime_Time 1 100 0.0 4.E9 FORMAT "%5.0" ECU_ADDRESS 0x40007A0C /end MEASUREMENT
/begin MEASUREMENT rba_Runtime_MonTask_ast[22].tiMaxRT_u32 "rba_Runtime Measurement Variable[22]/" ULONG RB_RBA_rba_Runtime_CompuMethods_rba_Runtime_Time 1 100 0.0 4.E9 FORMAT "%5.0" ECU_ADDRESS 0x40007A40 /end MEASUREMENT
/begin MEASUREMENT rba_Runtime_MonTask_ast[23].tiMaxRT_u32 "rba_Runtime Measurement Variable[23]/" ULONG RB_RBA_rba_Runtime_CompuMethods_rba_Runtime_Time 1 100 0.0 4.E9 FORMAT "%5.0" ECU_ADDRESS 0x40007A74 /end MEASUREMENT
/begin MEASUREMENT rba_Runtime_MonTask_ast[24].tiMaxRT_u32 "rba_Runtime Measurement Variable[24]/" ULONG RB_RBA_rba_Runtime_CompuMethods_rba_Runtime_Time 1 100 0.0 4.E9 FORMAT "%5.0" ECU_ADDRESS 0x40007AA8 /end MEASUREMENT
/begin MEASUREMENT rba_Runtime_MonTask_ast[25].tiMaxRT_u32 "rba_Runtime Measurement Variable[25]/" ULONG RB_RBA_rba_Runtime_CompuMethods_rba_Runtime_Time 1 100 0.0 4.E9 FORMAT "%5.0" ECU_ADDRESS 0x40007ADC /end MEASUREMENT
/begin MEASUREMENT rba_Runtime_MonTask_ast[26].tiMaxRT_u32 "rba_Runtime Measurement Variable[26]/" ULONG RB_RBA_rba_Runtime_CompuMethods_rba_Runtime_Time 1 100 0.0 4.E9 FORMAT "%5.0" ECU_ADDRESS 0x40007B10 /end MEASUREMENT
/begin MEASUREMENT rba_Runtime_MonTask_ast[27].tiMaxRT_u32 "rba_Runtime Measurement Variable[27]/" ULONG RB_RBA_rba_Runtime_CompuMethods_rba_Runtime_Time 1 100 0.0 4.E9 FORMAT "%5.0" ECU_ADDRESS 0x40007B44 /end MEASUREMENT
/begin MEASUREMENT rba_Runtime_MonTask_ast[28].tiMaxRT_u32 "rba_Runtime Measurement Variable[28]/" ULONG RB_RBA_rba_Runtime_CompuMethods_rba_Runtime_Time 1 100 0.0 4.E9 FORMAT "%5.0" ECU_ADDRESS 0x40007B78 /end MEASUREMENT
/begin MEASUREMENT rba_Runtime_MonTask_ast[29].tiMaxRT_u32 "rba_Runtime Measurement Variable[29]/" ULONG RB_RBA_rba_Runtime_CompuMethods_rba_Runtime_Time 1 100 0.0 4.E9 FORMAT "%5.0" ECU_ADDRESS 0x40007BAC /end MEASUREMENT
/begin MEASUREMENT rba_Runtime_MonTask_ast[30].tiMaxRT_u32 "rba_Runtime Measurement Variable[30]/" ULONG RB_RBA_rba_Runtime_CompuMethods_rba_Runtime_Time 1 100 0.0 4.E9 FORMAT "%5.0" ECU_ADDRESS 0x40007BE0 /end MEASUREMENT
/begin MEASUREMENT rba_Runtime_MonTask_ast[31].tiMaxRT_u32 "rba_Runtime Measurement Variable[31]/" ULONG RB_RBA_rba_Runtime_CompuMethods_rba_Runtime_Time 1 100 0.0 4.E9 FORMAT "%5.0" ECU_ADDRESS 0x40007C14 /end MEASUREMENT
/begin MEASUREMENT rba_Runtime_MonTask_ast[32].tiMaxRT_u32 "rba_Runtime Measurement Variable[32]/" ULONG RB_RBA_rba_Runtime_CompuMethods_rba_Runtime_Time 1 100 0.0 4.E9 FORMAT "%5.0" ECU_ADDRESS 0x40007C48 /end MEASUREMENT
/begin MEASUREMENT rba_Runtime_MonTask_ast[33].tiMaxRT_u32 "rba_Runtime Measurement Variable[33]/" ULONG RB_RBA_rba_Runtime_CompuMethods_rba_Runtime_Time 1 100 0.0 4.E9 FORMAT "%5.0" ECU_ADDRESS 0x40007C7C /end MEASUREMENT
/begin MEASUREMENT rba_Runtime_MonTask_ast[34].tiMaxRT_u32 "rba_Runtime Measurement Variable[34]/" ULONG RB_RBA_rba_Runtime_CompuMethods_rba_Runtime_Time 1 100 0.0 4.E9 FORMAT "%5.0" ECU_ADDRESS 0x40007CB0 /end MEASUREMENT
/begin MEASUREMENT rba_Runtime_MonTask_ast[35].tiMaxRT_u32 "rba_Runtime Measurement Variable[35]/" ULONG RB_RBA_rba_Runtime_CompuMethods_rba_Runtime_Time 1 100 0.0 4.E9 FORMAT "%5.0" ECU_ADDRESS 0x40007CE4 /end MEASUREMENT
/begin MEASUREMENT rba_Runtime_MonTask_ast[36].tiMaxRT_u32 "rba_Runtime Measurement Variable[36]/" ULONG RB_RBA_rba_Runtime_CompuMethods_rba_Runtime_Time 1 100 0.0 4.E9 FORMAT "%5.0" ECU_ADDRESS 0x40007D18 /end MEASUREMENT
/begin MEASUREMENT rba_Runtime_MonTask_ast[37].tiMaxRT_u32 "rba_Runtime Measurement Variable[37]/" ULONG RB_RBA_rba_Runtime_CompuMethods_rba_Runtime_Time 1 100 0.0 4.E9 FORMAT "%5.0" ECU_ADDRESS 0x40007D4C /end MEASUREMENT
/begin MEASUREMENT rba_Runtime_MonTask_ast[0].tiCurResponseT_u32 "rba_Runtime Measurement Variable[0]/" ULONG RB_RBA_rba_Runtime_CompuMethods_rba_Runtime_Time 1 100 0.0 4.E9 FORMAT "%5.0" ECU_ADDRESS 0x400075CC /end MEASUREMENT
/begin MEASUREMENT rba_Runtime_MonTask_ast[1].tiCurResponseT_u32 "rba_Runtime Measurement Variable[1]/" ULONG RB_RBA_rba_Runtime_CompuMethods_rba_Runtime_Time 1 100 0.0 4.E9 FORMAT "%5.0" ECU_ADDRESS 0x40007600 /end MEASUREMENT
/begin MEASUREMENT rba_Runtime_MonTask_ast[2].tiCurResponseT_u32 "rba_Runtime Measurement Variable[2]/" ULONG RB_RBA_rba_Runtime_CompuMethods_rba_Runtime_Time 1 100 0.0 4.E9 FORMAT "%5.0" ECU_ADDRESS 0x40007634 /end MEASUREMENT
/begin MEASUREMENT rba_Runtime_MonTask_ast[3].tiCurResponseT_u32 "rba_Runtime Measurement Variable[3]/" ULONG RB_RBA_rba_Runtime_CompuMethods_rba_Runtime_Time 1 100 0.0 4.E9 FORMAT "%5.0" ECU_ADDRESS 0x40007668 /end MEASUREMENT
/begin MEASUREMENT rba_Runtime_MonTask_ast[4].tiCurResponseT_u32 "rba_Runtime Measurement Variable[4]/" ULONG RB_RBA_rba_Runtime_CompuMethods_rba_Runtime_Time 1 100 0.0 4.E9 FORMAT "%5.0" ECU_ADDRESS 0x4000769C /end MEASUREMENT
/begin MEASUREMENT rba_Runtime_MonTask_ast[5].tiCurResponseT_u32 "rba_Runtime Measurement Variable[5]/" ULONG RB_RBA_rba_Runtime_CompuMethods_rba_Runtime_Time 1 100 0.0 4.E9 FORMAT "%5.0" ECU_ADDRESS 0x400076D0 /end MEASUREMENT
/begin MEASUREMENT rba_Runtime_MonTask_ast[6].tiCurResponseT_u32 "rba_Runtime Measurement Variable[6]/" ULONG RB_RBA_rba_Runtime_CompuMethods_rba_Runtime_Time 1 100 0.0 4.E9 FORMAT "%5.0" ECU_ADDRESS 0x40007704 /end MEASUREMENT
/begin MEASUREMENT rba_Runtime_MonTask_ast[7].tiCurResponseT_u32 "rba_Runtime Measurement Variable[7]/" ULONG RB_RBA_rba_Runtime_CompuMethods_rba_Runtime_Time 1 100 0.0 4.E9 FORMAT "%5.0" ECU_ADDRESS 0x40007738 /end MEASUREMENT
/begin MEASUREMENT rba_Runtime_MonTask_ast[8].tiCurResponseT_u32 "rba_Runtime Measurement Variable[8]/" ULONG RB_RBA_rba_Runtime_CompuMethods_rba_Runtime_Time 1 100 0.0 4.E9 FORMAT "%5.0" ECU_ADDRESS 0x4000776C /end MEASUREMENT
/begin MEASUREMENT rba_Runtime_MonTask_ast[9].tiCurResponseT_u32 "rba_Runtime Measurement Variable[9]/" ULONG RB_RBA_rba_Runtime_CompuMethods_rba_Runtime_Time 1 100 0.0 4.E9 FORMAT "%5.0" ECU_ADDRESS 0x400077A0 /end MEASUREMENT
/begin MEASUREMENT rba_Runtime_MonTask_ast[10].tiCurResponseT_u32 "rba_Runtime Measurement Variable[10]/" ULONG RB_RBA_rba_Runtime_CompuMethods_rba_Runtime_Time 1 100 0.0 4.E9 FORMAT "%5.0" ECU_ADDRESS 0x400077D4 /end MEASUREMENT
/begin MEASUREMENT rba_Runtime_MonTask_ast[11].tiCurResponseT_u32 "rba_Runtime Measurement Variable[11]/" ULONG RB_RBA_rba_Runtime_CompuMethods_rba_Runtime_Time 1 100 0.0 4.E9 FORMAT "%5.0" ECU_ADDRESS 0x40007808 /end MEASUREMENT
/begin MEASUREMENT rba_Runtime_MonTask_ast[12].tiCurResponseT_u32 "rba_Runtime Measurement Variable[12]/" ULONG RB_RBA_rba_Runtime_CompuMethods_rba_Runtime_Time 1 100 0.0 4.E9 FORMAT "%5.0" ECU_ADDRESS 0x4000783C /end MEASUREMENT
/begin MEASUREMENT rba_Runtime_MonTask_ast[13].tiCurResponseT_u32 "rba_Runtime Measurement Variable[13]/" ULONG RB_RBA_rba_Runtime_CompuMethods_rba_Runtime_Time 1 100 0.0 4.E9 FORMAT "%5.0" ECU_ADDRESS 0x40007870 /end MEASUREMENT
/begin MEASUREMENT rba_Runtime_MonTask_ast[14].tiCurResponseT_u32 "rba_Runtime Measurement Variable[14]/" ULONG RB_RBA_rba_Runtime_CompuMethods_rba_Runtime_Time 1 100 0.0 4.E9 FORMAT "%5.0" ECU_ADDRESS 0x400078A4 /end MEASUREMENT
/begin MEASUREMENT rba_Runtime_MonTask_ast[15].tiCurResponseT_u32 "rba_Runtime Measurement Variable[15]/" ULONG RB_RBA_rba_Runtime_CompuMethods_rba_Runtime_Time 1 100 0.0 4.E9 FORMAT "%5.0" ECU_ADDRESS 0x400078D8 /end MEASUREMENT
/begin MEASUREMENT rba_Runtime_MonTask_ast[16].tiCurResponseT_u32 "rba_Runtime Measurement Variable[16]/" ULONG RB_RBA_rba_Runtime_CompuMethods_rba_Runtime_Time 1 100 0.0 4.E9 FORMAT "%5.0" ECU_ADDRESS 0x4000790C /end MEASUREMENT
/begin MEASUREMENT rba_Runtime_MonTask_ast[17].tiCurResponseT_u32 "rba_Runtime Measurement Variable[17]/" ULONG RB_RBA_rba_Runtime_CompuMethods_rba_Runtime_Time 1 100 0.0 4.E9 FORMAT "%5.0" ECU_ADDRESS 0x40007940 /end MEASUREMENT
/begin MEASUREMENT rba_Runtime_MonTask_ast[18].tiCurResponseT_u32 "rba_Runtime Measurement Variable[18]/" ULONG RB_RBA_rba_Runtime_CompuMethods_rba_Runtime_Time 1 100 0.0 4.E9 FORMAT "%5.0" ECU_ADDRESS 0x40007974 /end MEASUREMENT
/begin MEASUREMENT rba_Runtime_MonTask_ast[19].tiCurResponseT_u32 "rba_Runtime Measurement Variable[19]/" ULONG RB_RBA_rba_Runtime_CompuMethods_rba_Runtime_Time 1 100 0.0 4.E9 FORMAT "%5.0" ECU_ADDRESS 0x400079A8 /end MEASUREMENT
/begin MEASUREMENT rba_Runtime_MonTask_ast[20].tiCurResponseT_u32 "rba_Runtime Measurement Variable[20]/" ULONG RB_RBA_rba_Runtime_CompuMethods_rba_Runtime_Time 1 100 0.0 4.E9 FORMAT "%5.0" ECU_ADDRESS 0x400079DC /end MEASUREMENT
/begin MEASUREMENT rba_Runtime_MonTask_ast[21].tiCurResponseT_u32 "rba_Runtime Measurement Variable[21]/" ULONG RB_RBA_rba_Runtime_CompuMethods_rba_Runtime_Time 1 100 0.0 4.E9 FORMAT "%5.0" ECU_ADDRESS 0x40007A10 /end MEASUREMENT
/begin MEASUREMENT rba_Runtime_MonTask_ast[22].tiCurResponseT_u32 "rba_Runtime Measurement Variable[22]/" ULONG RB_RBA_rba_Runtime_CompuMethods_rba_Runtime_Time 1 100 0.0 4.E9 FORMAT "%5.0" ECU_ADDRESS 0x40007A44 /end MEASUREMENT
/begin MEASUREMENT rba_Runtime_MonTask_ast[23].tiCurResponseT_u32 "rba_Runtime Measurement Variable[23]/" ULONG RB_RBA_rba_Runtime_CompuMethods_rba_Runtime_Time 1 100 0.0 4.E9 FORMAT "%5.0" ECU_ADDRESS 0x40007A78 /end MEASUREMENT
/begin MEASUREMENT rba_Runtime_MonTask_ast[24].tiCurResponseT_u32 "rba_Runtime Measurement Variable[24]/" ULONG RB_RBA_rba_Runtime_CompuMethods_rba_Runtime_Time 1 100 0.0 4.E9 FORMAT "%5.0" ECU_ADDRESS 0x40007AAC /end MEASUREMENT
/begin MEASUREMENT rba_Runtime_MonTask_ast[25].tiCurResponseT_u32 "rba_Runtime Measurement Variable[25]/" ULONG RB_RBA_rba_Runtime_CompuMethods_rba_Runtime_Time 1 100 0.0 4.E9 FORMAT "%5.0" ECU_ADDRESS 0x40007AE0 /end MEASUREMENT
/begin MEASUREMENT rba_Runtime_MonTask_ast[26].tiCurResponseT_u32 "rba_Runtime Measurement Variable[26]/" ULONG RB_RBA_rba_Runtime_CompuMethods_rba_Runtime_Time 1 100 0.0 4.E9 FORMAT "%5.0" ECU_ADDRESS 0x40007B14 /end MEASUREMENT
/begin MEASUREMENT rba_Runtime_MonTask_ast[27].tiCurResponseT_u32 "rba_Runtime Measurement Variable[27]/" ULONG RB_RBA_rba_Runtime_CompuMethods_rba_Runtime_Time 1 100 0.0 4.E9 FORMAT "%5.0" ECU_ADDRESS 0x40007B48 /end MEASUREMENT
/begin MEASUREMENT rba_Runtime_MonTask_ast[28].tiCurResponseT_u32 "rba_Runtime Measurement Variable[28]/" ULONG RB_RBA_rba_Runtime_CompuMethods_rba_Runtime_Time 1 100 0.0 4.E9 FORMAT "%5.0" ECU_ADDRESS 0x40007B7C /end MEASUREMENT
/begin MEASUREMENT rba_Runtime_MonTask_ast[29].tiCurResponseT_u32 "rba_Runtime Measurement Variable[29]/" ULONG RB_RBA_rba_Runtime_CompuMethods_rba_Runtime_Time 1 100 0.0 4.E9 FORMAT "%5.0" ECU_ADDRESS 0x40007BB0 /end MEASUREMENT
/begin MEASUREMENT rba_Runtime_MonTask_ast[30].tiCurResponseT_u32 "rba_Runtime Measurement Variable[30]/" ULONG RB_RBA_rba_Runtime_CompuMethods_rba_Runtime_Time 1 100 0.0 4.E9 FORMAT "%5.0" ECU_ADDRESS 0x40007BE4 /end MEASUREMENT
/begin MEASUREMENT rba_Runtime_MonTask_ast[31].tiCurResponseT_u32 "rba_Runtime Measurement Variable[31]/" ULONG RB_RBA_rba_Runtime_CompuMethods_rba_Runtime_Time 1 100 0.0 4.E9 FORMAT "%5.0" ECU_ADDRESS 0x40007C18 /end MEASUREMENT
/begin MEASUREMENT rba_Runtime_MonTask_ast[32].tiCurResponseT_u32 "rba_Runtime Measurement Variable[32]/" ULONG RB_RBA_rba_Runtime_CompuMethods_rba_Runtime_Time 1 100 0.0 4.E9 FORMAT "%5.0" ECU_ADDRESS 0x40007C4C /end MEASUREMENT
/begin MEASUREMENT rba_Runtime_MonTask_ast[33].tiCurResponseT_u32 "rba_Runtime Measurement Variable[33]/" ULONG RB_RBA_rba_Runtime_CompuMethods_rba_Runtime_Time 1 100 0.0 4.E9 FORMAT "%5.0" ECU_ADDRESS 0x40007C80 /end MEASUREMENT
/begin MEASUREMENT rba_Runtime_MonTask_ast[34].tiCurResponseT_u32 "rba_Runtime Measurement Variable[34]/" ULONG RB_RBA_rba_Runtime_CompuMethods_rba_Runtime_Time 1 100 0.0 4.E9 FORMAT "%5.0" ECU_ADDRESS 0x40007CB4 /end MEASUREMENT
/begin MEASUREMENT rba_Runtime_MonTask_ast[35].tiCurResponseT_u32 "rba_Runtime Measurement Variable[35]/" ULONG RB_RBA_rba_Runtime_CompuMethods_rba_Runtime_Time 1 100 0.0 4.E9 FORMAT "%5.0" ECU_ADDRESS 0x40007CE8 /end MEASUREMENT
/begin MEASUREMENT rba_Runtime_MonTask_ast[36].tiCurResponseT_u32 "rba_Runtime Measurement Variable[36]/" ULONG RB_RBA_rba_Runtime_CompuMethods_rba_Runtime_Time 1 100 0.0 4.E9 FORMAT "%5.0" ECU_ADDRESS 0x40007D1C /end MEASUREMENT
/begin MEASUREMENT rba_Runtime_MonTask_ast[37].tiCurResponseT_u32 "rba_Runtime Measurement Variable[37]/" ULONG RB_RBA_rba_Runtime_CompuMethods_rba_Runtime_Time 1 100 0.0 4.E9 FORMAT "%5.0" ECU_ADDRESS 0x40007D50 /end MEASUREMENT
/begin MEASUREMENT rba_Runtime_MonTask_ast[0].tiMinResponseT_u32 "rba_Runtime Measurement Variable[0]/" ULONG RB_RBA_rba_Runtime_CompuMethods_rba_Runtime_Time 1 100 0.0 4.E9 FORMAT "%5.0" ECU_ADDRESS 0x400075D0 /end MEASUREMENT
/begin MEASUREMENT rba_Runtime_MonTask_ast[1].tiMinResponseT_u32 "rba_Runtime Measurement Variable[1]/" ULONG RB_RBA_rba_Runtime_CompuMethods_rba_Runtime_Time 1 100 0.0 4.E9 FORMAT "%5.0" ECU_ADDRESS 0x40007604 /end MEASUREMENT
/begin MEASUREMENT rba_Runtime_MonTask_ast[2].tiMinResponseT_u32 "rba_Runtime Measurement Variable[2]/" ULONG RB_RBA_rba_Runtime_CompuMethods_rba_Runtime_Time 1 100 0.0 4.E9 FORMAT "%5.0" ECU_ADDRESS 0x40007638 /end MEASUREMENT
/begin MEASUREMENT rba_Runtime_MonTask_ast[3].tiMinResponseT_u32 "rba_Runtime Measurement Variable[3]/" ULONG RB_RBA_rba_Runtime_CompuMethods_rba_Runtime_Time 1 100 0.0 4.E9 FORMAT "%5.0" ECU_ADDRESS 0x4000766C /end MEASUREMENT
/begin MEASUREMENT rba_Runtime_MonTask_ast[4].tiMinResponseT_u32 "rba_Runtime Measurement Variable[4]/" ULONG RB_RBA_rba_Runtime_CompuMethods_rba_Runtime_Time 1 100 0.0 4.E9 FORMAT "%5.0" ECU_ADDRESS 0x400076A0 /end MEASUREMENT
/begin MEASUREMENT rba_Runtime_MonTask_ast[5].tiMinResponseT_u32 "rba_Runtime Measurement Variable[5]/" ULONG RB_RBA_rba_Runtime_CompuMethods_rba_Runtime_Time 1 100 0.0 4.E9 FORMAT "%5.0" ECU_ADDRESS 0x400076D4 /end MEASUREMENT
/begin MEASUREMENT rba_Runtime_MonTask_ast[6].tiMinResponseT_u32 "rba_Runtime Measurement Variable[6]/" ULONG RB_RBA_rba_Runtime_CompuMethods_rba_Runtime_Time 1 100 0.0 4.E9 FORMAT "%5.0" ECU_ADDRESS 0x40007708 /end MEASUREMENT
/begin MEASUREMENT rba_Runtime_MonTask_ast[7].tiMinResponseT_u32 "rba_Runtime Measurement Variable[7]/" ULONG RB_RBA_rba_Runtime_CompuMethods_rba_Runtime_Time 1 100 0.0 4.E9 FORMAT "%5.0" ECU_ADDRESS 0x4000773C /end MEASUREMENT
/begin MEASUREMENT rba_Runtime_MonTask_ast[8].tiMinResponseT_u32 "rba_Runtime Measurement Variable[8]/" ULONG RB_RBA_rba_Runtime_CompuMethods_rba_Runtime_Time 1 100 0.0 4.E9 FORMAT "%5.0" ECU_ADDRESS 0x40007770 /end MEASUREMENT
/begin MEASUREMENT rba_Runtime_MonTask_ast[9].tiMinResponseT_u32 "rba_Runtime Measurement Variable[9]/" ULONG RB_RBA_rba_Runtime_CompuMethods_rba_Runtime_Time 1 100 0.0 4.E9 FORMAT "%5.0" ECU_ADDRESS 0x400077A4 /end MEASUREMENT
/begin MEASUREMENT rba_Runtime_MonTask_ast[10].tiMinResponseT_u32 "rba_Runtime Measurement Variable[10]/" ULONG RB_RBA_rba_Runtime_CompuMethods_rba_Runtime_Time 1 100 0.0 4.E9 FORMAT "%5.0" ECU_ADDRESS 0x400077D8 /end MEASUREMENT
/begin MEASUREMENT rba_Runtime_MonTask_ast[11].tiMinResponseT_u32 "rba_Runtime Measurement Variable[11]/" ULONG RB_RBA_rba_Runtime_CompuMethods_rba_Runtime_Time 1 100 0.0 4.E9 FORMAT "%5.0" ECU_ADDRESS 0x4000780C /end MEASUREMENT
/begin MEASUREMENT rba_Runtime_MonTask_ast[12].tiMinResponseT_u32 "rba_Runtime Measurement Variable[12]/" ULONG RB_RBA_rba_Runtime_CompuMethods_rba_Runtime_Time 1 100 0.0 4.E9 FORMAT "%5.0" ECU_ADDRESS 0x40007840 /end MEASUREMENT
/begin MEASUREMENT rba_Runtime_MonTask_ast[13].tiMinResponseT_u32 "rba_Runtime Measurement Variable[13]/" ULONG RB_RBA_rba_Runtime_CompuMethods_rba_Runtime_Time 1 100 0.0 4.E9 FORMAT "%5.0" ECU_ADDRESS 0x40007874 /end MEASUREMENT
/begin MEASUREMENT rba_Runtime_MonTask_ast[14].tiMinResponseT_u32 "rba_Runtime Measurement Variable[14]/" ULONG RB_RBA_rba_Runtime_CompuMethods_rba_Runtime_Time 1 100 0.0 4.E9 FORMAT "%5.0" ECU_ADDRESS 0x400078A8 /end MEASUREMENT
/begin MEASUREMENT rba_Runtime_MonTask_ast[15].tiMinResponseT_u32 "rba_Runtime Measurement Variable[15]/" ULONG RB_RBA_rba_Runtime_CompuMethods_rba_Runtime_Time 1 100 0.0 4.E9 FORMAT "%5.0" ECU_ADDRESS 0x400078DC /end MEASUREMENT
/begin MEASUREMENT rba_Runtime_MonTask_ast[16].tiMinResponseT_u32 "rba_Runtime Measurement Variable[16]/" ULONG RB_RBA_rba_Runtime_CompuMethods_rba_Runtime_Time 1 100 0.0 4.E9 FORMAT "%5.0" ECU_ADDRESS 0x40007910 /end MEASUREMENT
/begin MEASUREMENT rba_Runtime_MonTask_ast[17].tiMinResponseT_u32 "rba_Runtime Measurement Variable[17]/" ULONG RB_RBA_rba_Runtime_CompuMethods_rba_Runtime_Time 1 100 0.0 4.E9 FORMAT "%5.0" ECU_ADDRESS 0x40007944 /end MEASUREMENT
/begin MEASUREMENT rba_Runtime_MonTask_ast[18].tiMinResponseT_u32 "rba_Runtime Measurement Variable[18]/" ULONG RB_RBA_rba_Runtime_CompuMethods_rba_Runtime_Time 1 100 0.0 4.E9 FORMAT "%5.0" ECU_ADDRESS 0x40007978 /end MEASUREMENT
/begin MEASUREMENT rba_Runtime_MonTask_ast[19].tiMinResponseT_u32 "rba_Runtime Measurement Variable[19]/" ULONG RB_RBA_rba_Runtime_CompuMethods_rba_Runtime_Time 1 100 0.0 4.E9 FORMAT "%5.0" ECU_ADDRESS 0x400079AC /end MEASUREMENT
/begin MEASUREMENT rba_Runtime_MonTask_ast[20].tiMinResponseT_u32 "rba_Runtime Measurement Variable[20]/" ULONG RB_RBA_rba_Runtime_CompuMethods_rba_Runtime_Time 1 100 0.0 4.E9 FORMAT "%5.0" ECU_ADDRESS 0x400079E0 /end MEASUREMENT
/begin MEASUREMENT rba_Runtime_MonTask_ast[21].tiMinResponseT_u32 "rba_Runtime Measurement Variable[21]/" ULONG RB_RBA_rba_Runtime_CompuMethods_rba_Runtime_Time 1 100 0.0 4.E9 FORMAT "%5.0" ECU_ADDRESS 0x40007A14 /end MEASUREMENT
/begin MEASUREMENT rba_Runtime_MonTask_ast[22].tiMinResponseT_u32 "rba_Runtime Measurement Variable[22]/" ULONG RB_RBA_rba_Runtime_CompuMethods_rba_Runtime_Time 1 100 0.0 4.E9 FORMAT "%5.0" ECU_ADDRESS 0x40007A48 /end MEASUREMENT
/begin MEASUREMENT rba_Runtime_MonTask_ast[23].tiMinResponseT_u32 "rba_Runtime Measurement Variable[23]/" ULONG RB_RBA_rba_Runtime_CompuMethods_rba_Runtime_Time 1 100 0.0 4.E9 FORMAT "%5.0" ECU_ADDRESS 0x40007A7C /end MEASUREMENT
/begin MEASUREMENT rba_Runtime_MonTask_ast[24].tiMinResponseT_u32 "rba_Runtime Measurement Variable[24]/" ULONG RB_RBA_rba_Runtime_CompuMethods_rba_Runtime_Time 1 100 0.0 4.E9 FORMAT "%5.0" ECU_ADDRESS 0x40007AB0 /end MEASUREMENT
/begin MEASUREMENT rba_Runtime_MonTask_ast[25].tiMinResponseT_u32 "rba_Runtime Measurement Variable[25]/" ULONG RB_RBA_rba_Runtime_CompuMethods_rba_Runtime_Time 1 100 0.0 4.E9 FORMAT "%5.0" ECU_ADDRESS 0x40007AE4 /end MEASUREMENT
/begin MEASUREMENT rba_Runtime_MonTask_ast[26].tiMinResponseT_u32 "rba_Runtime Measurement Variable[26]/" ULONG RB_RBA_rba_Runtime_CompuMethods_rba_Runtime_Time 1 100 0.0 4.E9 FORMAT "%5.0" ECU_ADDRESS 0x40007B18 /end MEASUREMENT
/begin MEASUREMENT rba_Runtime_MonTask_ast[27].tiMinResponseT_u32 "rba_Runtime Measurement Variable[27]/" ULONG RB_RBA_rba_Runtime_CompuMethods_rba_Runtime_Time 1 100 0.0 4.E9 FORMAT "%5.0" ECU_ADDRESS 0x40007B4C /end MEASUREMENT
/begin MEASUREMENT rba_Runtime_MonTask_ast[28].tiMinResponseT_u32 "rba_Runtime Measurement Variable[28]/" ULONG RB_RBA_rba_Runtime_CompuMethods_rba_Runtime_Time 1 100 0.0 4.E9 FORMAT "%5.0" ECU_ADDRESS 0x40007B80 /end MEASUREMENT
/begin MEASUREMENT rba_Runtime_MonTask_ast[29].tiMinResponseT_u32 "rba_Runtime Measurement Variable[29]/" ULONG RB_RBA_rba_Runtime_CompuMethods_rba_Runtime_Time 1 100 0.0 4.E9 FORMAT "%5.0" ECU_ADDRESS 0x40007BB4 /end MEASUREMENT
/begin MEASUREMENT rba_Runtime_MonTask_ast[30].tiMinResponseT_u32 "rba_Runtime Measurement Variable[30]/" ULONG RB_RBA_rba_Runtime_CompuMethods_rba_Runtime_Time 1 100 0.0 4.E9 FORMAT "%5.0" ECU_ADDRESS 0x40007BE8 /end MEASUREMENT
/begin MEASUREMENT rba_Runtime_MonTask_ast[31].tiMinResponseT_u32 "rba_Runtime Measurement Variable[31]/" ULONG RB_RBA_rba_Runtime_CompuMethods_rba_Runtime_Time 1 100 0.0 4.E9 FORMAT "%5.0" ECU_ADDRESS 0x40007C1C /end MEASUREMENT
/begin MEASUREMENT rba_Runtime_MonTask_ast[32].tiMinResponseT_u32 "rba_Runtime Measurement Variable[32]/" ULONG RB_RBA_rba_Runtime_CompuMethods_rba_Runtime_Time 1 100 0.0 4.E9 FORMAT "%5.0" ECU_ADDRESS 0x40007C50 /end MEASUREMENT
/begin MEASUREMENT rba_Runtime_MonTask_ast[33].tiMinResponseT_u32 "rba_Runtime Measurement Variable[33]/" ULONG RB_RBA_rba_Runtime_CompuMethods_rba_Runtime_Time 1 100 0.0 4.E9 FORMAT "%5.0" ECU_ADDRESS 0x40007C84 /end MEASUREMENT
/begin MEASUREMENT rba_Runtime_MonTask_ast[34].tiMinResponseT_u32 "rba_Runtime Measurement Variable[34]/" ULONG RB_RBA_rba_Runtime_CompuMethods_rba_Runtime_Time 1 100 0.0 4.E9 FORMAT "%5.0" ECU_ADDRESS 0x40007CB8 /end MEASUREMENT
/begin MEASUREMENT rba_Runtime_MonTask_ast[35].tiMinResponseT_u32 "rba_Runtime Measurement Variable[35]/" ULONG RB_RBA_rba_Runtime_CompuMethods_rba_Runtime_Time 1 100 0.0 4.E9 FORMAT "%5.0" ECU_ADDRESS 0x40007CEC /end MEASUREMENT
/begin MEASUREMENT rba_Runtime_MonTask_ast[36].tiMinResponseT_u32 "rba_Runtime Measurement Variable[36]/" ULONG RB_RBA_rba_Runtime_CompuMethods_rba_Runtime_Time 1 100 0.0 4.E9 FORMAT "%5.0" ECU_ADDRESS 0x40007D20 /end MEASUREMENT
/begin MEASUREMENT rba_Runtime_MonTask_ast[37].tiMinResponseT_u32 "rba_Runtime Measurement Variable[37]/" ULONG RB_RBA_rba_Runtime_CompuMethods_rba_Runtime_Time 1 100 0.0 4.E9 FORMAT "%5.0" ECU_ADDRESS 0x40007D54 /end MEASUREMENT
/begin MEASUREMENT rba_Runtime_MonTask_ast[0].tiMaxResponseT_u32 "rba_Runtime Measurement Variable[0]/" ULONG RB_RBA_rba_Runtime_CompuMethods_rba_Runtime_Time 1 100 0.0 4.E9 FORMAT "%5.0" ECU_ADDRESS 0x400075D4 /end MEASUREMENT
/begin MEASUREMENT rba_Runtime_MonTask_ast[1].tiMaxResponseT_u32 "rba_Runtime Measurement Variable[1]/" ULONG RB_RBA_rba_Runtime_CompuMethods_rba_Runtime_Time 1 100 0.0 4.E9 FORMAT "%5.0" ECU_ADDRESS 0x40007608 /end MEASUREMENT
/begin MEASUREMENT rba_Runtime_MonTask_ast[2].tiMaxResponseT_u32 "rba_Runtime Measurement Variable[2]/" ULONG RB_RBA_rba_Runtime_CompuMethods_rba_Runtime_Time 1 100 0.0 4.E9 FORMAT "%5.0" ECU_ADDRESS 0x4000763C /end MEASUREMENT
/begin MEASUREMENT rba_Runtime_MonTask_ast[3].tiMaxResponseT_u32 "rba_Runtime Measurement Variable[3]/" ULONG RB_RBA_rba_Runtime_CompuMethods_rba_Runtime_Time 1 100 0.0 4.E9 FORMAT "%5.0" ECU_ADDRESS 0x40007670 /end MEASUREMENT
/begin MEASUREMENT rba_Runtime_MonTask_ast[4].tiMaxResponseT_u32 "rba_Runtime Measurement Variable[4]/" ULONG RB_RBA_rba_Runtime_CompuMethods_rba_Runtime_Time 1 100 0.0 4.E9 FORMAT "%5.0" ECU_ADDRESS 0x400076A4 /end MEASUREMENT
/begin MEASUREMENT rba_Runtime_MonTask_ast[5].tiMaxResponseT_u32 "rba_Runtime Measurement Variable[5]/" ULONG RB_RBA_rba_Runtime_CompuMethods_rba_Runtime_Time 1 100 0.0 4.E9 FORMAT "%5.0" ECU_ADDRESS 0x400076D8 /end MEASUREMENT
/begin MEASUREMENT rba_Runtime_MonTask_ast[6].tiMaxResponseT_u32 "rba_Runtime Measurement Variable[6]/" ULONG RB_RBA_rba_Runtime_CompuMethods_rba_Runtime_Time 1 100 0.0 4.E9 FORMAT "%5.0" ECU_ADDRESS 0x4000770C /end MEASUREMENT
/begin MEASUREMENT rba_Runtime_MonTask_ast[7].tiMaxResponseT_u32 "rba_Runtime Measurement Variable[7]/" ULONG RB_RBA_rba_Runtime_CompuMethods_rba_Runtime_Time 1 100 0.0 4.E9 FORMAT "%5.0" ECU_ADDRESS 0x40007740 /end MEASUREMENT
/begin MEASUREMENT rba_Runtime_MonTask_ast[8].tiMaxResponseT_u32 "rba_Runtime Measurement Variable[8]/" ULONG RB_RBA_rba_Runtime_CompuMethods_rba_Runtime_Time 1 100 0.0 4.E9 FORMAT "%5.0" ECU_ADDRESS 0x40007774 /end MEASUREMENT
/begin MEASUREMENT rba_Runtime_MonTask_ast[9].tiMaxResponseT_u32 "rba_Runtime Measurement Variable[9]/" ULONG RB_RBA_rba_Runtime_CompuMethods_rba_Runtime_Time 1 100 0.0 4.E9 FORMAT "%5.0" ECU_ADDRESS 0x400077A8 /end MEASUREMENT
/begin MEASUREMENT rba_Runtime_MonTask_ast[10].tiMaxResponseT_u32 "rba_Runtime Measurement Variable[10]/" ULONG RB_RBA_rba_Runtime_CompuMethods_rba_Runtime_Time 1 100 0.0 4.E9 FORMAT "%5.0" ECU_ADDRESS 0x400077DC /end MEASUREMENT
/begin MEASUREMENT rba_Runtime_MonTask_ast[11].tiMaxResponseT_u32 "rba_Runtime Measurement Variable[11]/" ULONG RB_RBA_rba_Runtime_CompuMethods_rba_Runtime_Time 1 100 0.0 4.E9 FORMAT "%5.0" ECU_ADDRESS 0x40007810 /end MEASUREMENT
/begin MEASUREMENT rba_Runtime_MonTask_ast[12].tiMaxResponseT_u32 "rba_Runtime Measurement Variable[12]/" ULONG RB_RBA_rba_Runtime_CompuMethods_rba_Runtime_Time 1 100 0.0 4.E9 FORMAT "%5.0" ECU_ADDRESS 0x40007844 /end MEASUREMENT
/begin MEASUREMENT rba_Runtime_MonTask_ast[13].tiMaxResponseT_u32 "rba_Runtime Measurement Variable[13]/" ULONG RB_RBA_rba_Runtime_CompuMethods_rba_Runtime_Time 1 100 0.0 4.E9 FORMAT "%5.0" ECU_ADDRESS 0x40007878 /end MEASUREMENT
/begin MEASUREMENT rba_Runtime_MonTask_ast[14].tiMaxResponseT_u32 "rba_Runtime Measurement Variable[14]/" ULONG RB_RBA_rba_Runtime_CompuMethods_rba_Runtime_Time 1 100 0.0 4.E9 FORMAT "%5.0" ECU_ADDRESS 0x400078AC /end MEASUREMENT
/begin MEASUREMENT rba_Runtime_MonTask_ast[15].tiMaxResponseT_u32 "rba_Runtime Measurement Variable[15]/" ULONG RB_RBA_rba_Runtime_CompuMethods_rba_Runtime_Time 1 100 0.0 4.E9 FORMAT "%5.0" ECU_ADDRESS 0x400078E0 /end MEASUREMENT
/begin MEASUREMENT rba_Runtime_MonTask_ast[16].tiMaxResponseT_u32 "rba_Runtime Measurement Variable[16]/" ULONG RB_RBA_rba_Runtime_CompuMethods_rba_Runtime_Time 1 100 0.0 4.E9 FORMAT "%5.0" ECU_ADDRESS 0x40007914 /end MEASUREMENT
/begin MEASUREMENT rba_Runtime_MonTask_ast[17].tiMaxResponseT_u32 "rba_Runtime Measurement Variable[17]/" ULONG RB_RBA_rba_Runtime_CompuMethods_rba_Runtime_Time 1 100 0.0 4.E9 FORMAT "%5.0" ECU_ADDRESS 0x40007948 /end MEASUREMENT
/begin MEASUREMENT rba_Runtime_MonTask_ast[18].tiMaxResponseT_u32 "rba_Runtime Measurement Variable[18]/" ULONG RB_RBA_rba_Runtime_CompuMethods_rba_Runtime_Time 1 100 0.0 4.E9 FORMAT "%5.0" ECU_ADDRESS 0x4000797C /end MEASUREMENT
/begin MEASUREMENT rba_Runtime_MonTask_ast[19].tiMaxResponseT_u32 "rba_Runtime Measurement Variable[19]/" ULONG RB_RBA_rba_Runtime_CompuMethods_rba_Runtime_Time 1 100 0.0 4.E9 FORMAT "%5.0" ECU_ADDRESS 0x400079B0 /end MEASUREMENT
/begin MEASUREMENT rba_Runtime_MonTask_ast[20].tiMaxResponseT_u32 "rba_Runtime Measurement Variable[20]/" ULONG RB_RBA_rba_Runtime_CompuMethods_rba_Runtime_Time 1 100 0.0 4.E9 FORMAT "%5.0" ECU_ADDRESS 0x400079E4 /end MEASUREMENT
/begin MEASUREMENT rba_Runtime_MonTask_ast[21].tiMaxResponseT_u32 "rba_Runtime Measurement Variable[21]/" ULONG RB_RBA_rba_Runtime_CompuMethods_rba_Runtime_Time 1 100 0.0 4.E9 FORMAT "%5.0" ECU_ADDRESS 0x40007A18 /end MEASUREMENT
/begin MEASUREMENT rba_Runtime_MonTask_ast[22].tiMaxResponseT_u32 "rba_Runtime Measurement Variable[22]/" ULONG RB_RBA_rba_Runtime_CompuMethods_rba_Runtime_Time 1 100 0.0 4.E9 FORMAT "%5.0" ECU_ADDRESS 0x40007A4C /end MEASUREMENT
/begin MEASUREMENT rba_Runtime_MonTask_ast[23].tiMaxResponseT_u32 "rba_Runtime Measurement Variable[23]/" ULONG RB_RBA_rba_Runtime_CompuMethods_rba_Runtime_Time 1 100 0.0 4.E9 FORMAT "%5.0" ECU_ADDRESS 0x40007A80 /end MEASUREMENT
/begin MEASUREMENT rba_Runtime_MonTask_ast[24].tiMaxResponseT_u32 "rba_Runtime Measurement Variable[24]/" ULONG RB_RBA_rba_Runtime_CompuMethods_rba_Runtime_Time 1 100 0.0 4.E9 FORMAT "%5.0" ECU_ADDRESS 0x40007AB4 /end MEASUREMENT
/begin MEASUREMENT rba_Runtime_MonTask_ast[25].tiMaxResponseT_u32 "rba_Runtime Measurement Variable[25]/" ULONG RB_RBA_rba_Runtime_CompuMethods_rba_Runtime_Time 1 100 0.0 4.E9 FORMAT "%5.0" ECU_ADDRESS 0x40007AE8 /end MEASUREMENT
/begin MEASUREMENT rba_Runtime_MonTask_ast[26].tiMaxResponseT_u32 "rba_Runtime Measurement Variable[26]/" ULONG RB_RBA_rba_Runtime_CompuMethods_rba_Runtime_Time 1 100 0.0 4.E9 FORMAT "%5.0" ECU_ADDRESS 0x40007B1C /end MEASUREMENT
/begin MEASUREMENT rba_Runtime_MonTask_ast[27].tiMaxResponseT_u32 "rba_Runtime Measurement Variable[27]/" ULONG RB_RBA_rba_Runtime_CompuMethods_rba_Runtime_Time 1 100 0.0 4.E9 FORMAT "%5.0" ECU_ADDRESS 0x40007B50 /end MEASUREMENT
/begin MEASUREMENT rba_Runtime_MonTask_ast[28].tiMaxResponseT_u32 "rba_Runtime Measurement Variable[28]/" ULONG RB_RBA_rba_Runtime_CompuMethods_rba_Runtime_Time 1 100 0.0 4.E9 FORMAT "%5.0" ECU_ADDRESS 0x40007B84 /end MEASUREMENT
/begin MEASUREMENT rba_Runtime_MonTask_ast[29].tiMaxResponseT_u32 "rba_Runtime Measurement Variable[29]/" ULONG RB_RBA_rba_Runtime_CompuMethods_rba_Runtime_Time 1 100 0.0 4.E9 FORMAT "%5.0" ECU_ADDRESS 0x40007BB8 /end MEASUREMENT
/begin MEASUREMENT rba_Runtime_MonTask_ast[30].tiMaxResponseT_u32 "rba_Runtime Measurement Variable[30]/" ULONG RB_RBA_rba_Runtime_CompuMethods_rba_Runtime_Time 1 100 0.0 4.E9 FORMAT "%5.0" ECU_ADDRESS 0x40007BEC /end MEASUREMENT
/begin MEASUREMENT rba_Runtime_MonTask_ast[31].tiMaxResponseT_u32 "rba_Runtime Measurement Variable[31]/" ULONG RB_RBA_rba_Runtime_CompuMethods_rba_Runtime_Time 1 100 0.0 4.E9 FORMAT "%5.0" ECU_ADDRESS 0x40007C20 /end MEASUREMENT
/begin MEASUREMENT rba_Runtime_MonTask_ast[32].tiMaxResponseT_u32 "rba_Runtime Measurement Variable[32]/" ULONG RB_RBA_rba_Runtime_CompuMethods_rba_Runtime_Time 1 100 0.0 4.E9 FORMAT "%5.0" ECU_ADDRESS 0x40007C54 /end MEASUREMENT
/begin MEASUREMENT rba_Runtime_MonTask_ast[33].tiMaxResponseT_u32 "rba_Runtime Measurement Variable[33]/" ULONG RB_RBA_rba_Runtime_CompuMethods_rba_Runtime_Time 1 100 0.0 4.E9 FORMAT "%5.0" ECU_ADDRESS 0x40007C88 /end MEASUREMENT
/begin MEASUREMENT rba_Runtime_MonTask_ast[34].tiMaxResponseT_u32 "rba_Runtime Measurement Variable[34]/" ULONG RB_RBA_rba_Runtime_CompuMethods_rba_Runtime_Time 1 100 0.0 4.E9 FORMAT "%5.0" ECU_ADDRESS 0x40007CBC /end MEASUREMENT
/begin MEASUREMENT rba_Runtime_MonTask_ast[35].tiMaxResponseT_u32 "rba_Runtime Measurement Variable[35]/" ULONG RB_RBA_rba_Runtime_CompuMethods_rba_Runtime_Time 1 100 0.0 4.E9 FORMAT "%5.0" ECU_ADDRESS 0x40007CF0 /end MEASUREMENT
/begin MEASUREMENT rba_Runtime_MonTask_ast[36].tiMaxResponseT_u32 "rba_Runtime Measurement Variable[36]/" ULONG RB_RBA_rba_Runtime_CompuMethods_rba_Runtime_Time 1 100 0.0 4.E9 FORMAT "%5.0" ECU_ADDRESS 0x40007D24 /end MEASUREMENT
/begin MEASUREMENT rba_Runtime_MonTask_ast[37].tiMaxResponseT_u32 "rba_Runtime Measurement Variable[37]/" ULONG RB_RBA_rba_Runtime_CompuMethods_rba_Runtime_Time 1 100 0.0 4.E9 FORMAT "%5.0" ECU_ADDRESS 0x40007D58 /end MEASUREMENT
/begin MEASUREMENT rba_Runtime_MonTask_ast[0].ctCallsTotal_u32 "rba_Runtime Measurement Variable[0]/" ULONG RB_RBA_Common_CentralElements_CompuMethods_Identical 1 100 0.0 4.E9 FORMAT "%5.0" ECU_ADDRESS 0x400075D8 /end MEASUREMENT
/begin MEASUREMENT rba_Runtime_MonTask_ast[1].ctCallsTotal_u32 "rba_Runtime Measurement Variable[1]/" ULONG RB_RBA_Common_CentralElements_CompuMethods_Identical 1 100 0.0 4.E9 FORMAT "%5.0" ECU_ADDRESS 0x4000760C /end MEASUREMENT
/begin MEASUREMENT rba_Runtime_MonTask_ast[2].ctCallsTotal_u32 "rba_Runtime Measurement Variable[2]/" ULONG RB_RBA_Common_CentralElements_CompuMethods_Identical 1 100 0.0 4.E9 FORMAT "%5.0" ECU_ADDRESS 0x40007640 /end MEASUREMENT
/begin MEASUREMENT rba_Runtime_MonTask_ast[3].ctCallsTotal_u32 "rba_Runtime Measurement Variable[3]/" ULONG RB_RBA_Common_CentralElements_CompuMethods_Identical 1 100 0.0 4.E9 FORMAT "%5.0" ECU_ADDRESS 0x40007674 /end MEASUREMENT
/begin MEASUREMENT rba_Runtime_MonTask_ast[4].ctCallsTotal_u32 "rba_Runtime Measurement Variable[4]/" ULONG RB_RBA_Common_CentralElements_CompuMethods_Identical 1 100 0.0 4.E9 FORMAT "%5.0" ECU_ADDRESS 0x400076A8 /end MEASUREMENT
/begin MEASUREMENT rba_Runtime_MonTask_ast[5].ctCallsTotal_u32 "rba_Runtime Measurement Variable[5]/" ULONG RB_RBA_Common_CentralElements_CompuMethods_Identical 1 100 0.0 4.E9 FORMAT "%5.0" ECU_ADDRESS 0x400076DC /end MEASUREMENT
/begin MEASUREMENT rba_Runtime_MonTask_ast[6].ctCallsTotal_u32 "rba_Runtime Measurement Variable[6]/" ULONG RB_RBA_Common_CentralElements_CompuMethods_Identical 1 100 0.0 4.E9 FORMAT "%5.0" ECU_ADDRESS 0x40007710 /end MEASUREMENT
/begin MEASUREMENT rba_Runtime_MonTask_ast[7].ctCallsTotal_u32 "rba_Runtime Measurement Variable[7]/" ULONG RB_RBA_Common_CentralElements_CompuMethods_Identical 1 100 0.0 4.E9 FORMAT "%5.0" ECU_ADDRESS 0x40007744 /end MEASUREMENT
/begin MEASUREMENT rba_Runtime_MonTask_ast[8].ctCallsTotal_u32 "rba_Runtime Measurement Variable[8]/" ULONG RB_RBA_Common_CentralElements_CompuMethods_Identical 1 100 0.0 4.E9 FORMAT "%5.0" ECU_ADDRESS 0x40007778 /end MEASUREMENT
/begin MEASUREMENT rba_Runtime_MonTask_ast[9].ctCallsTotal_u32 "rba_Runtime Measurement Variable[9]/" ULONG RB_RBA_Common_CentralElements_CompuMethods_Identical 1 100 0.0 4.E9 FORMAT "%5.0" ECU_ADDRESS 0x400077AC /end MEASUREMENT
/begin MEASUREMENT rba_Runtime_MonTask_ast[10].ctCallsTotal_u32 "rba_Runtime Measurement Variable[10]/" ULONG RB_RBA_Common_CentralElements_CompuMethods_Identical 1 100 0.0 4.E9 FORMAT "%5.0" ECU_ADDRESS 0x400077E0 /end MEASUREMENT
/begin MEASUREMENT rba_Runtime_MonTask_ast[11].ctCallsTotal_u32 "rba_Runtime Measurement Variable[11]/" ULONG RB_RBA_Common_CentralElements_CompuMethods_Identical 1 100 0.0 4.E9 FORMAT "%5.0" ECU_ADDRESS 0x40007814 /end MEASUREMENT
/begin MEASUREMENT rba_Runtime_MonTask_ast[12].ctCallsTotal_u32 "rba_Runtime Measurement Variable[12]/" ULONG RB_RBA_Common_CentralElements_CompuMethods_Identical 1 100 0.0 4.E9 FORMAT "%5.0" ECU_ADDRESS 0x40007848 /end MEASUREMENT
/begin MEASUREMENT rba_Runtime_MonTask_ast[13].ctCallsTotal_u32 "rba_Runtime Measurement Variable[13]/" ULONG RB_RBA_Common_CentralElements_CompuMethods_Identical 1 100 0.0 4.E9 FORMAT "%5.0" ECU_ADDRESS 0x4000787C /end MEASUREMENT
/begin MEASUREMENT rba_Runtime_MonTask_ast[14].ctCallsTotal_u32 "rba_Runtime Measurement Variable[14]/" ULONG RB_RBA_Common_CentralElements_CompuMethods_Identical 1 100 0.0 4.E9 FORMAT "%5.0" ECU_ADDRESS 0x400078B0 /end MEASUREMENT
/begin MEASUREMENT rba_Runtime_MonTask_ast[15].ctCallsTotal_u32 "rba_Runtime Measurement Variable[15]/" ULONG RB_RBA_Common_CentralElements_CompuMethods_Identical 1 100 0.0 4.E9 FORMAT "%5.0" ECU_ADDRESS 0x400078E4 /end MEASUREMENT
/begin MEASUREMENT rba_Runtime_MonTask_ast[16].ctCallsTotal_u32 "rba_Runtime Measurement Variable[16]/" ULONG RB_RBA_Common_CentralElements_CompuMethods_Identical 1 100 0.0 4.E9 FORMAT "%5.0" ECU_ADDRESS 0x40007918 /end MEASUREMENT
/begin MEASUREMENT rba_Runtime_MonTask_ast[17].ctCallsTotal_u32 "rba_Runtime Measurement Variable[17]/" ULONG RB_RBA_Common_CentralElements_CompuMethods_Identical 1 100 0.0 4.E9 FORMAT "%5.0" ECU_ADDRESS 0x4000794C /end MEASUREMENT
/begin MEASUREMENT rba_Runtime_MonTask_ast[18].ctCallsTotal_u32 "rba_Runtime Measurement Variable[18]/" ULONG RB_RBA_Common_CentralElements_CompuMethods_Identical 1 100 0.0 4.E9 FORMAT "%5.0" ECU_ADDRESS 0x40007980 /end MEASUREMENT
/begin MEASUREMENT rba_Runtime_MonTask_ast[19].ctCallsTotal_u32 "rba_Runtime Measurement Variable[19]/" ULONG RB_RBA_Common_CentralElements_CompuMethods_Identical 1 100 0.0 4.E9 FORMAT "%5.0" ECU_ADDRESS 0x400079B4 /end MEASUREMENT
/begin MEASUREMENT rba_Runtime_MonTask_ast[20].ctCallsTotal_u32 "rba_Runtime Measurement Variable[20]/" ULONG RB_RBA_Common_CentralElements_CompuMethods_Identical 1 100 0.0 4.E9 FORMAT "%5.0" ECU_ADDRESS 0x400079E8 /end MEASUREMENT
/begin MEASUREMENT rba_Runtime_MonTask_ast[21].ctCallsTotal_u32 "rba_Runtime Measurement Variable[21]/" ULONG RB_RBA_Common_CentralElements_CompuMethods_Identical 1 100 0.0 4.E9 FORMAT "%5.0" ECU_ADDRESS 0x40007A1C /end MEASUREMENT
/begin MEASUREMENT rba_Runtime_MonTask_ast[22].ctCallsTotal_u32 "rba_Runtime Measurement Variable[22]/" ULONG RB_RBA_Common_CentralElements_CompuMethods_Identical 1 100 0.0 4.E9 FORMAT "%5.0" ECU_ADDRESS 0x40007A50 /end MEASUREMENT
/begin MEASUREMENT rba_Runtime_MonTask_ast[23].ctCallsTotal_u32 "rba_Runtime Measurement Variable[23]/" ULONG RB_RBA_Common_CentralElements_CompuMethods_Identical 1 100 0.0 4.E9 FORMAT "%5.0" ECU_ADDRESS 0x40007A84 /end MEASUREMENT
/begin MEASUREMENT rba_Runtime_MonTask_ast[24].ctCallsTotal_u32 "rba_Runtime Measurement Variable[24]/" ULONG RB_RBA_Common_CentralElements_CompuMethods_Identical 1 100 0.0 4.E9 FORMAT "%5.0" ECU_ADDRESS 0x40007AB8 /end MEASUREMENT
/begin MEASUREMENT rba_Runtime_MonTask_ast[25].ctCallsTotal_u32 "rba_Runtime Measurement Variable[25]/" ULONG RB_RBA_Common_CentralElements_CompuMethods_Identical 1 100 0.0 4.E9 FORMAT "%5.0" ECU_ADDRESS 0x40007AEC /end MEASUREMENT
/begin MEASUREMENT rba_Runtime_MonTask_ast[26].ctCallsTotal_u32 "rba_Runtime Measurement Variable[26]/" ULONG RB_RBA_Common_CentralElements_CompuMethods_Identical 1 100 0.0 4.E9 FORMAT "%5.0" ECU_ADDRESS 0x40007B20 /end MEASUREMENT
/begin MEASUREMENT rba_Runtime_MonTask_ast[27].ctCallsTotal_u32 "rba_Runtime Measurement Variable[27]/" ULONG RB_RBA_Common_CentralElements_CompuMethods_Identical 1 100 0.0 4.E9 FORMAT "%5.0" ECU_ADDRESS 0x40007B54 /end MEASUREMENT
/begin MEASUREMENT rba_Runtime_MonTask_ast[28].ctCallsTotal_u32 "rba_Runtime Measurement Variable[28]/" ULONG RB_RBA_Common_CentralElements_CompuMethods_Identical 1 100 0.0 4.E9 FORMAT "%5.0" ECU_ADDRESS 0x40007B88 /end MEASUREMENT
/begin MEASUREMENT rba_Runtime_MonTask_ast[29].ctCallsTotal_u32 "rba_Runtime Measurement Variable[29]/" ULONG RB_RBA_Common_CentralElements_CompuMethods_Identical 1 100 0.0 4.E9 FORMAT "%5.0" ECU_ADDRESS 0x40007BBC /end MEASUREMENT
/begin MEASUREMENT rba_Runtime_MonTask_ast[30].ctCallsTotal_u32 "rba_Runtime Measurement Variable[30]/" ULONG RB_RBA_Common_CentralElements_CompuMethods_Identical 1 100 0.0 4.E9 FORMAT "%5.0" ECU_ADDRESS 0x40007BF0 /end MEASUREMENT
/begin MEASUREMENT rba_Runtime_MonTask_ast[31].ctCallsTotal_u32 "rba_Runtime Measurement Variable[31]/" ULONG RB_RBA_Common_CentralElements_CompuMethods_Identical 1 100 0.0 4.E9 FORMAT "%5.0" ECU_ADDRESS 0x40007C24 /end MEASUREMENT
/begin MEASUREMENT rba_Runtime_MonTask_ast[32].ctCallsTotal_u32 "rba_Runtime Measurement Variable[32]/" ULONG RB_RBA_Common_CentralElements_CompuMethods_Identical 1 100 0.0 4.E9 FORMAT "%5.0" ECU_ADDRESS 0x40007C58 /end MEASUREMENT
/begin MEASUREMENT rba_Runtime_MonTask_ast[33].ctCallsTotal_u32 "rba_Runtime Measurement Variable[33]/" ULONG RB_RBA_Common_CentralElements_CompuMethods_Identical 1 100 0.0 4.E9 FORMAT "%5.0" ECU_ADDRESS 0x40007C8C /end MEASUREMENT
/begin MEASUREMENT rba_Runtime_MonTask_ast[34].ctCallsTotal_u32 "rba_Runtime Measurement Variable[34]/" ULONG RB_RBA_Common_CentralElements_CompuMethods_Identical 1 100 0.0 4.E9 FORMAT "%5.0" ECU_ADDRESS 0x40007CC0 /end MEASUREMENT
/begin MEASUREMENT rba_Runtime_MonTask_ast[35].ctCallsTotal_u32 "rba_Runtime Measurement Variable[35]/" ULONG RB_RBA_Common_CentralElements_CompuMethods_Identical 1 100 0.0 4.E9 FORMAT "%5.0" ECU_ADDRESS 0x40007CF4 /end MEASUREMENT
/begin MEASUREMENT rba_Runtime_MonTask_ast[36].ctCallsTotal_u32 "rba_Runtime Measurement Variable[36]/" ULONG RB_RBA_Common_CentralElements_CompuMethods_Identical 1 100 0.0 4.E9 FORMAT "%5.0" ECU_ADDRESS 0x40007D28 /end MEASUREMENT
/begin MEASUREMENT rba_Runtime_MonTask_ast[37].ctCallsTotal_u32 "rba_Runtime Measurement Variable[37]/" ULONG RB_RBA_Common_CentralElements_CompuMethods_Identical 1 100 0.0 4.E9 FORMAT "%5.0" ECU_ADDRESS 0x40007D5C /end MEASUREMENT
/begin MEASUREMENT rba_Runtime_MonTask_ast[0].tiAvrgRT_u32 "rba_Runtime Measurement Variable[0]/" ULONG RB_RBA_rba_Runtime_CompuMethods_rba_Runtime_Time 1 100 0.0 4.E9 FORMAT "%5.0" ECU_ADDRESS 0x400075DC /end MEASUREMENT
/begin MEASUREMENT rba_Runtime_MonTask_ast[1].tiAvrgRT_u32 "rba_Runtime Measurement Variable[1]/" ULONG RB_RBA_rba_Runtime_CompuMethods_rba_Runtime_Time 1 100 0.0 4.E9 FORMAT "%5.0" ECU_ADDRESS 0x40007610 /end MEASUREMENT
/begin MEASUREMENT rba_Runtime_MonTask_ast[2].tiAvrgRT_u32 "rba_Runtime Measurement Variable[2]/" ULONG RB_RBA_rba_Runtime_CompuMethods_rba_Runtime_Time 1 100 0.0 4.E9 FORMAT "%5.0" ECU_ADDRESS 0x40007644 /end MEASUREMENT
/begin MEASUREMENT rba_Runtime_MonTask_ast[3].tiAvrgRT_u32 "rba_Runtime Measurement Variable[3]/" ULONG RB_RBA_rba_Runtime_CompuMethods_rba_Runtime_Time 1 100 0.0 4.E9 FORMAT "%5.0" ECU_ADDRESS 0x40007678 /end MEASUREMENT
/begin MEASUREMENT rba_Runtime_MonTask_ast[4].tiAvrgRT_u32 "rba_Runtime Measurement Variable[4]/" ULONG RB_RBA_rba_Runtime_CompuMethods_rba_Runtime_Time 1 100 0.0 4.E9 FORMAT "%5.0" ECU_ADDRESS 0x400076AC /end MEASUREMENT
/begin MEASUREMENT rba_Runtime_MonTask_ast[5].tiAvrgRT_u32 "rba_Runtime Measurement Variable[5]/" ULONG RB_RBA_rba_Runtime_CompuMethods_rba_Runtime_Time 1 100 0.0 4.E9 FORMAT "%5.0" ECU_ADDRESS 0x400076E0 /end MEASUREMENT
/begin MEASUREMENT rba_Runtime_MonTask_ast[6].tiAvrgRT_u32 "rba_Runtime Measurement Variable[6]/" ULONG RB_RBA_rba_Runtime_CompuMethods_rba_Runtime_Time 1 100 0.0 4.E9 FORMAT "%5.0" ECU_ADDRESS 0x40007714 /end MEASUREMENT
/begin MEASUREMENT rba_Runtime_MonTask_ast[7].tiAvrgRT_u32 "rba_Runtime Measurement Variable[7]/" ULONG RB_RBA_rba_Runtime_CompuMethods_rba_Runtime_Time 1 100 0.0 4.E9 FORMAT "%5.0" ECU_ADDRESS 0x40007748 /end MEASUREMENT
/begin MEASUREMENT rba_Runtime_MonTask_ast[8].tiAvrgRT_u32 "rba_Runtime Measurement Variable[8]/" ULONG RB_RBA_rba_Runtime_CompuMethods_rba_Runtime_Time 1 100 0.0 4.E9 FORMAT "%5.0" ECU_ADDRESS 0x4000777C /end MEASUREMENT
/begin MEASUREMENT rba_Runtime_MonTask_ast[9].tiAvrgRT_u32 "rba_Runtime Measurement Variable[9]/" ULONG RB_RBA_rba_Runtime_CompuMethods_rba_Runtime_Time 1 100 0.0 4.E9 FORMAT "%5.0" ECU_ADDRESS 0x400077B0 /end MEASUREMENT
/begin MEASUREMENT rba_Runtime_MonTask_ast[10].tiAvrgRT_u32 "rba_Runtime Measurement Variable[10]/" ULONG RB_RBA_rba_Runtime_CompuMethods_rba_Runtime_Time 1 100 0.0 4.E9 FORMAT "%5.0" ECU_ADDRESS 0x400077E4 /end MEASUREMENT
/begin MEASUREMENT rba_Runtime_MonTask_ast[11].tiAvrgRT_u32 "rba_Runtime Measurement Variable[11]/" ULONG RB_RBA_rba_Runtime_CompuMethods_rba_Runtime_Time 1 100 0.0 4.E9 FORMAT "%5.0" ECU_ADDRESS 0x40007818 /end MEASUREMENT
/begin MEASUREMENT rba_Runtime_MonTask_ast[12].tiAvrgRT_u32 "rba_Runtime Measurement Variable[12]/" ULONG RB_RBA_rba_Runtime_CompuMethods_rba_Runtime_Time 1 100 0.0 4.E9 FORMAT "%5.0" ECU_ADDRESS 0x4000784C /end MEASUREMENT
/begin MEASUREMENT rba_Runtime_MonTask_ast[13].tiAvrgRT_u32 "rba_Runtime Measurement Variable[13]/" ULONG RB_RBA_rba_Runtime_CompuMethods_rba_Runtime_Time 1 100 0.0 4.E9 FORMAT "%5.0" ECU_ADDRESS 0x40007880 /end MEASUREMENT
/begin MEASUREMENT rba_Runtime_MonTask_ast[14].tiAvrgRT_u32 "rba_Runtime Measurement Variable[14]/" ULONG RB_RBA_rba_Runtime_CompuMethods_rba_Runtime_Time 1 100 0.0 4.E9 FORMAT "%5.0" ECU_ADDRESS 0x400078B4 /end MEASUREMENT
/begin MEASUREMENT rba_Runtime_MonTask_ast[15].tiAvrgRT_u32 "rba_Runtime Measurement Variable[15]/" ULONG RB_RBA_rba_Runtime_CompuMethods_rba_Runtime_Time 1 100 0.0 4.E9 FORMAT "%5.0" ECU_ADDRESS 0x400078E8 /end MEASUREMENT
/begin MEASUREMENT rba_Runtime_MonTask_ast[16].tiAvrgRT_u32 "rba_Runtime Measurement Variable[16]/" ULONG RB_RBA_rba_Runtime_CompuMethods_rba_Runtime_Time 1 100 0.0 4.E9 FORMAT "%5.0" ECU_ADDRESS 0x4000791C /end MEASUREMENT
/begin MEASUREMENT rba_Runtime_MonTask_ast[17].tiAvrgRT_u32 "rba_Runtime Measurement Variable[17]/" ULONG RB_RBA_rba_Runtime_CompuMethods_rba_Runtime_Time 1 100 0.0 4.E9 FORMAT "%5.0" ECU_ADDRESS 0x40007950 /end MEASUREMENT
/begin MEASUREMENT rba_Runtime_MonTask_ast[18].tiAvrgRT_u32 "rba_Runtime Measurement Variable[18]/" ULONG RB_RBA_rba_Runtime_CompuMethods_rba_Runtime_Time 1 100 0.0 4.E9 FORMAT "%5.0" ECU_ADDRESS 0x40007984 /end MEASUREMENT
/begin MEASUREMENT rba_Runtime_MonTask_ast[19].tiAvrgRT_u32 "rba_Runtime Measurement Variable[19]/" ULONG RB_RBA_rba_Runtime_CompuMethods_rba_Runtime_Time 1 100 0.0 4.E9 FORMAT "%5.0" ECU_ADDRESS 0x400079B8 /end MEASUREMENT
/begin MEASUREMENT rba_Runtime_MonTask_ast[20].tiAvrgRT_u32 "rba_Runtime Measurement Variable[20]/" ULONG RB_RBA_rba_Runtime_CompuMethods_rba_Runtime_Time 1 100 0.0 4.E9 FORMAT "%5.0" ECU_ADDRESS 0x400079EC /end MEASUREMENT
/begin MEASUREMENT rba_Runtime_MonTask_ast[21].tiAvrgRT_u32 "rba_Runtime Measurement Variable[21]/" ULONG RB_RBA_rba_Runtime_CompuMethods_rba_Runtime_Time 1 100 0.0 4.E9 FORMAT "%5.0" ECU_ADDRESS 0x40007A20 /end MEASUREMENT
/begin MEASUREMENT rba_Runtime_MonTask_ast[22].tiAvrgRT_u32 "rba_Runtime Measurement Variable[22]/" ULONG RB_RBA_rba_Runtime_CompuMethods_rba_Runtime_Time 1 100 0.0 4.E9 FORMAT "%5.0" ECU_ADDRESS 0x40007A54 /end MEASUREMENT
/begin MEASUREMENT rba_Runtime_MonTask_ast[23].tiAvrgRT_u32 "rba_Runtime Measurement Variable[23]/" ULONG RB_RBA_rba_Runtime_CompuMethods_rba_Runtime_Time 1 100 0.0 4.E9 FORMAT "%5.0" ECU_ADDRESS 0x40007A88 /end MEASUREMENT
/begin MEASUREMENT rba_Runtime_MonTask_ast[24].tiAvrgRT_u32 "rba_Runtime Measurement Variable[24]/" ULONG RB_RBA_rba_Runtime_CompuMethods_rba_Runtime_Time 1 100 0.0 4.E9 FORMAT "%5.0" ECU_ADDRESS 0x40007ABC /end MEASUREMENT
/begin MEASUREMENT rba_Runtime_MonTask_ast[25].tiAvrgRT_u32 "rba_Runtime Measurement Variable[25]/" ULONG RB_RBA_rba_Runtime_CompuMethods_rba_Runtime_Time 1 100 0.0 4.E9 FORMAT "%5.0" ECU_ADDRESS 0x40007AF0 /end MEASUREMENT
/begin MEASUREMENT rba_Runtime_MonTask_ast[26].tiAvrgRT_u32 "rba_Runtime Measurement Variable[26]/" ULONG RB_RBA_rba_Runtime_CompuMethods_rba_Runtime_Time 1 100 0.0 4.E9 FORMAT "%5.0" ECU_ADDRESS 0x40007B24 /end MEASUREMENT
/begin MEASUREMENT rba_Runtime_MonTask_ast[27].tiAvrgRT_u32 "rba_Runtime Measurement Variable[27]/" ULONG RB_RBA_rba_Runtime_CompuMethods_rba_Runtime_Time 1 100 0.0 4.E9 FORMAT "%5.0" ECU_ADDRESS 0x40007B58 /end MEASUREMENT
/begin MEASUREMENT rba_Runtime_MonTask_ast[28].tiAvrgRT_u32 "rba_Runtime Measurement Variable[28]/" ULONG RB_RBA_rba_Runtime_CompuMethods_rba_Runtime_Time 1 100 0.0 4.E9 FORMAT "%5.0" ECU_ADDRESS 0x40007B8C /end MEASUREMENT
/begin MEASUREMENT rba_Runtime_MonTask_ast[29].tiAvrgRT_u32 "rba_Runtime Measurement Variable[29]/" ULONG RB_RBA_rba_Runtime_CompuMethods_rba_Runtime_Time 1 100 0.0 4.E9 FORMAT "%5.0" ECU_ADDRESS 0x40007BC0 /end MEASUREMENT
/begin MEASUREMENT rba_Runtime_MonTask_ast[30].tiAvrgRT_u32 "rba_Runtime Measurement Variable[30]/" ULONG RB_RBA_rba_Runtime_CompuMethods_rba_Runtime_Time 1 100 0.0 4.E9 FORMAT "%5.0" ECU_ADDRESS 0x40007BF4 /end MEASUREMENT
/begin MEASUREMENT rba_Runtime_MonTask_ast[31].tiAvrgRT_u32 "rba_Runtime Measurement Variable[31]/" ULONG RB_RBA_rba_Runtime_CompuMethods_rba_Runtime_Time 1 100 0.0 4.E9 FORMAT "%5.0" ECU_ADDRESS 0x40007C28 /end MEASUREMENT
/begin MEASUREMENT rba_Runtime_MonTask_ast[32].tiAvrgRT_u32 "rba_Runtime Measurement Variable[32]/" ULONG RB_RBA_rba_Runtime_CompuMethods_rba_Runtime_Time 1 100 0.0 4.E9 FORMAT "%5.0" ECU_ADDRESS 0x40007C5C /end MEASUREMENT
/begin MEASUREMENT rba_Runtime_MonTask_ast[33].tiAvrgRT_u32 "rba_Runtime Measurement Variable[33]/" ULONG RB_RBA_rba_Runtime_CompuMethods_rba_Runtime_Time 1 100 0.0 4.E9 FORMAT "%5.0" ECU_ADDRESS 0x40007C90 /end MEASUREMENT
/begin MEASUREMENT rba_Runtime_MonTask_ast[34].tiAvrgRT_u32 "rba_Runtime Measurement Variable[34]/" ULONG RB_RBA_rba_Runtime_CompuMethods_rba_Runtime_Time 1 100 0.0 4.E9 FORMAT "%5.0" ECU_ADDRESS 0x40007CC4 /end MEASUREMENT
/begin MEASUREMENT rba_Runtime_MonTask_ast[35].tiAvrgRT_u32 "rba_Runtime Measurement Variable[35]/" ULONG RB_RBA_rba_Runtime_CompuMethods_rba_Runtime_Time 1 100 0.0 4.E9 FORMAT "%5.0" ECU_ADDRESS 0x40007CF8 /end MEASUREMENT
/begin MEASUREMENT rba_Runtime_MonTask_ast[36].tiAvrgRT_u32 "rba_Runtime Measurement Variable[36]/" ULONG RB_RBA_rba_Runtime_CompuMethods_rba_Runtime_Time 1 100 0.0 4.E9 FORMAT "%5.0" ECU_ADDRESS 0x40007D2C /end MEASUREMENT
/begin MEASUREMENT rba_Runtime_MonTask_ast[37].tiAvrgRT_u32 "rba_Runtime Measurement Variable[37]/" ULONG RB_RBA_rba_Runtime_CompuMethods_rba_Runtime_Time 1 100 0.0 4.E9 FORMAT "%5.0" ECU_ADDRESS 0x40007D60 /end MEASUREMENT
/begin MEASUREMENT rba_Runtime_MonTask_ast[0].ctCalls_u32 "rba_Runtime Measurement Variable[0]/" ULONG RB_RBA_Common_CentralElements_CompuMethods_Identical 1 100 0.0 4.E9 FORMAT "%5.0" ECU_ADDRESS 0x400075E0 /end MEASUREMENT
/begin MEASUREMENT rba_Runtime_MonTask_ast[1].ctCalls_u32 "rba_Runtime Measurement Variable[1]/" ULONG RB_RBA_Common_CentralElements_CompuMethods_Identical 1 100 0.0 4.E9 FORMAT "%5.0" ECU_ADDRESS 0x40007614 /end MEASUREMENT
/begin MEASUREMENT rba_Runtime_MonTask_ast[2].ctCalls_u32 "rba_Runtime Measurement Variable[2]/" ULONG RB_RBA_Common_CentralElements_CompuMethods_Identical 1 100 0.0 4.E9 FORMAT "%5.0" ECU_ADDRESS 0x40007648 /end MEASUREMENT
/begin MEASUREMENT rba_Runtime_MonTask_ast[3].ctCalls_u32 "rba_Runtime Measurement Variable[3]/" ULONG RB_RBA_Common_CentralElements_CompuMethods_Identical 1 100 0.0 4.E9 FORMAT "%5.0" ECU_ADDRESS 0x4000767C /end MEASUREMENT
/begin MEASUREMENT rba_Runtime_MonTask_ast[4].ctCalls_u32 "rba_Runtime Measurement Variable[4]/" ULONG RB_RBA_Common_CentralElements_CompuMethods_Identical 1 100 0.0 4.E9 FORMAT "%5.0" ECU_ADDRESS 0x400076B0 /end MEASUREMENT
/begin MEASUREMENT rba_Runtime_MonTask_ast[5].ctCalls_u32 "rba_Runtime Measurement Variable[5]/" ULONG RB_RBA_Common_CentralElements_CompuMethods_Identical 1 100 0.0 4.E9 FORMAT "%5.0" ECU_ADDRESS 0x400076E4 /end MEASUREMENT
/begin MEASUREMENT rba_Runtime_MonTask_ast[6].ctCalls_u32 "rba_Runtime Measurement Variable[6]/" ULONG RB_RBA_Common_CentralElements_CompuMethods_Identical 1 100 0.0 4.E9 FORMAT "%5.0" ECU_ADDRESS 0x40007718 /end MEASUREMENT
/begin MEASUREMENT rba_Runtime_MonTask_ast[7].ctCalls_u32 "rba_Runtime Measurement Variable[7]/" ULONG RB_RBA_Common_CentralElements_CompuMethods_Identical 1 100 0.0 4.E9 FORMAT "%5.0" ECU_ADDRESS 0x4000774C /end MEASUREMENT
/begin MEASUREMENT rba_Runtime_MonTask_ast[8].ctCalls_u32 "rba_Runtime Measurement Variable[8]/" ULONG RB_RBA_Common_CentralElements_CompuMethods_Identical 1 100 0.0 4.E9 FORMAT "%5.0" ECU_ADDRESS 0x40007780 /end MEASUREMENT
/begin MEASUREMENT rba_Runtime_MonTask_ast[9].ctCalls_u32 "rba_Runtime Measurement Variable[9]/" ULONG RB_RBA_Common_CentralElements_CompuMethods_Identical 1 100 0.0 4.E9 FORMAT "%5.0" ECU_ADDRESS 0x400077B4 /end MEASUREMENT
/begin MEASUREMENT rba_Runtime_MonTask_ast[10].ctCalls_u32 "rba_Runtime Measurement Variable[10]/" ULONG RB_RBA_Common_CentralElements_CompuMethods_Identical 1 100 0.0 4.E9 FORMAT "%5.0" ECU_ADDRESS 0x400077E8 /end MEASUREMENT
/begin MEASUREMENT rba_Runtime_MonTask_ast[11].ctCalls_u32 "rba_Runtime Measurement Variable[11]/" ULONG RB_RBA_Common_CentralElements_CompuMethods_Identical 1 100 0.0 4.E9 FORMAT "%5.0" ECU_ADDRESS 0x4000781C /end MEASUREMENT
/begin MEASUREMENT rba_Runtime_MonTask_ast[12].ctCalls_u32 "rba_Runtime Measurement Variable[12]/" ULONG RB_RBA_Common_CentralElements_CompuMethods_Identical 1 100 0.0 4.E9 FORMAT "%5.0" ECU_ADDRESS 0x40007850 /end MEASUREMENT
/begin MEASUREMENT rba_Runtime_MonTask_ast[13].ctCalls_u32 "rba_Runtime Measurement Variable[13]/" ULONG RB_RBA_Common_CentralElements_CompuMethods_Identical 1 100 0.0 4.E9 FORMAT "%5.0" ECU_ADDRESS 0x40007884 /end MEASUREMENT
/begin MEASUREMENT rba_Runtime_MonTask_ast[14].ctCalls_u32 "rba_Runtime Measurement Variable[14]/" ULONG RB_RBA_Common_CentralElements_CompuMethods_Identical 1 100 0.0 4.E9 FORMAT "%5.0" ECU_ADDRESS 0x400078B8 /end MEASUREMENT
/begin MEASUREMENT rba_Runtime_MonTask_ast[15].ctCalls_u32 "rba_Runtime Measurement Variable[15]/" ULONG RB_RBA_Common_CentralElements_CompuMethods_Identical 1 100 0.0 4.E9 FORMAT "%5.0" ECU_ADDRESS 0x400078EC /end MEASUREMENT
/begin MEASUREMENT rba_Runtime_MonTask_ast[16].ctCalls_u32 "rba_Runtime Measurement Variable[16]/" ULONG RB_RBA_Common_CentralElements_CompuMethods_Identical 1 100 0.0 4.E9 FORMAT "%5.0" ECU_ADDRESS 0x40007920 /end MEASUREMENT
/begin MEASUREMENT rba_Runtime_MonTask_ast[17].ctCalls_u32 "rba_Runtime Measurement Variable[17]/" ULONG RB_RBA_Common_CentralElements_CompuMethods_Identical 1 100 0.0 4.E9 FORMAT "%5.0" ECU_ADDRESS 0x40007954 /end MEASUREMENT
/begin MEASUREMENT rba_Runtime_MonTask_ast[18].ctCalls_u32 "rba_Runtime Measurement Variable[18]/" ULONG RB_RBA_Common_CentralElements_CompuMethods_Identical 1 100 0.0 4.E9 FORMAT "%5.0" ECU_ADDRESS 0x40007988 /end MEASUREMENT
/begin MEASUREMENT rba_Runtime_MonTask_ast[19].ctCalls_u32 "rba_Runtime Measurement Variable[19]/" ULONG RB_RBA_Common_CentralElements_CompuMethods_Identical 1 100 0.0 4.E9 FORMAT "%5.0" ECU_ADDRESS 0x400079BC /end MEASUREMENT
/begin MEASUREMENT rba_Runtime_MonTask_ast[20].ctCalls_u32 "rba_Runtime Measurement Variable[20]/" ULONG RB_RBA_Common_CentralElements_CompuMethods_Identical 1 100 0.0 4.E9 FORMAT "%5.0" ECU_ADDRESS 0x400079F0 /end MEASUREMENT
/begin MEASUREMENT rba_Runtime_MonTask_ast[21].ctCalls_u32 "rba_Runtime Measurement Variable[21]/" ULONG RB_RBA_Common_CentralElements_CompuMethods_Identical 1 100 0.0 4.E9 FORMAT "%5.0" ECU_ADDRESS 0x40007A24 /end MEASUREMENT
/begin MEASUREMENT rba_Runtime_MonTask_ast[22].ctCalls_u32 "rba_Runtime Measurement Variable[22]/" ULONG RB_RBA_Common_CentralElements_CompuMethods_Identical 1 100 0.0 4.E9 FORMAT "%5.0" ECU_ADDRESS 0x40007A58 /end MEASUREMENT
/begin MEASUREMENT rba_Runtime_MonTask_ast[23].ctCalls_u32 "rba_Runtime Measurement Variable[23]/" ULONG RB_RBA_Common_CentralElements_CompuMethods_Identical 1 100 0.0 4.E9 FORMAT "%5.0" ECU_ADDRESS 0x40007A8C /end MEASUREMENT
/begin MEASUREMENT rba_Runtime_MonTask_ast[24].ctCalls_u32 "rba_Runtime Measurement Variable[24]/" ULONG RB_RBA_Common_CentralElements_CompuMethods_Identical 1 100 0.0 4.E9 FORMAT "%5.0" ECU_ADDRESS 0x40007AC0 /end MEASUREMENT
/begin MEASUREMENT rba_Runtime_MonTask_ast[25].ctCalls_u32 "rba_Runtime Measurement Variable[25]/" ULONG RB_RBA_Common_CentralElements_CompuMethods_Identical 1 100 0.0 4.E9 FORMAT "%5.0" ECU_ADDRESS 0x40007AF4 /end MEASUREMENT
/begin MEASUREMENT rba_Runtime_MonTask_ast[26].ctCalls_u32 "rba_Runtime Measurement Variable[26]/" ULONG RB_RBA_Common_CentralElements_CompuMethods_Identical 1 100 0.0 4.E9 FORMAT "%5.0" ECU_ADDRESS 0x40007B28 /end MEASUREMENT
/begin MEASUREMENT rba_Runtime_MonTask_ast[27].ctCalls_u32 "rba_Runtime Measurement Variable[27]/" ULONG RB_RBA_Common_CentralElements_CompuMethods_Identical 1 100 0.0 4.E9 FORMAT "%5.0" ECU_ADDRESS 0x40007B5C /end MEASUREMENT
/begin MEASUREMENT rba_Runtime_MonTask_ast[28].ctCalls_u32 "rba_Runtime Measurement Variable[28]/" ULONG RB_RBA_Common_CentralElements_CompuMethods_Identical 1 100 0.0 4.E9 FORMAT "%5.0" ECU_ADDRESS 0x40007B90 /end MEASUREMENT
/begin MEASUREMENT rba_Runtime_MonTask_ast[29].ctCalls_u32 "rba_Runtime Measurement Variable[29]/" ULONG RB_RBA_Common_CentralElements_CompuMethods_Identical 1 100 0.0 4.E9 FORMAT "%5.0" ECU_ADDRESS 0x40007BC4 /end MEASUREMENT
/begin MEASUREMENT rba_Runtime_MonTask_ast[30].ctCalls_u32 "rba_Runtime Measurement Variable[30]/" ULONG RB_RBA_Common_CentralElements_CompuMethods_Identical 1 100 0.0 4.E9 FORMAT "%5.0" ECU_ADDRESS 0x40007BF8 /end MEASUREMENT
/begin MEASUREMENT rba_Runtime_MonTask_ast[31].ctCalls_u32 "rba_Runtime Measurement Variable[31]/" ULONG RB_RBA_Common_CentralElements_CompuMethods_Identical 1 100 0.0 4.E9 FORMAT "%5.0" ECU_ADDRESS 0x40007C2C /end MEASUREMENT
/begin MEASUREMENT rba_Runtime_MonTask_ast[32].ctCalls_u32 "rba_Runtime Measurement Variable[32]/" ULONG RB_RBA_Common_CentralElements_CompuMethods_Identical 1 100 0.0 4.E9 FORMAT "%5.0" ECU_ADDRESS 0x40007C60 /end MEASUREMENT
/begin MEASUREMENT rba_Runtime_MonTask_ast[33].ctCalls_u32 "rba_Runtime Measurement Variable[33]/" ULONG RB_RBA_Common_CentralElements_CompuMethods_Identical 1 100 0.0 4.E9 FORMAT "%5.0" ECU_ADDRESS 0x40007C94 /end MEASUREMENT
/begin MEASUREMENT rba_Runtime_MonTask_ast[34].ctCalls_u32 "rba_Runtime Measurement Variable[34]/" ULONG RB_RBA_Common_CentralElements_CompuMethods_Identical 1 100 0.0 4.E9 FORMAT "%5.0" ECU_ADDRESS 0x40007CC8 /end MEASUREMENT
/begin MEASUREMENT rba_Runtime_MonTask_ast[35].ctCalls_u32 "rba_Runtime Measurement Variable[35]/" ULONG RB_RBA_Common_CentralElements_CompuMethods_Identical 1 100 0.0 4.E9 FORMAT "%5.0" ECU_ADDRESS 0x40007CFC /end MEASUREMENT
/begin MEASUREMENT rba_Runtime_MonTask_ast[36].ctCalls_u32 "rba_Runtime Measurement Variable[36]/" ULONG RB_RBA_Common_CentralElements_CompuMethods_Identical 1 100 0.0 4.E9 FORMAT "%5.0" ECU_ADDRESS 0x40007D30 /end MEASUREMENT
/begin MEASUREMENT rba_Runtime_MonTask_ast[37].ctCalls_u32 "rba_Runtime Measurement Variable[37]/" ULONG RB_RBA_Common_CentralElements_CompuMethods_Identical 1 100 0.0 4.E9 FORMAT "%5.0" ECU_ADDRESS 0x40007D64 /end MEASUREMENT
/begin MEASUREMENT rba_Runtime_MonTask_ast[0].internal_st.tiAccuRT_u32 "rba_Runtime Measurement Variable[0]//" ULONG RB_RBA_rba_Runtime_CompuMethods_rba_Runtime_Time 1 100 0.0 4.E9 FORMAT "%5.0" ECU_ADDRESS 0x400075E4 /end MEASUREMENT
/begin MEASUREMENT rba_Runtime_MonTask_ast[1].internal_st.tiAccuRT_u32 "rba_Runtime Measurement Variable[1]//" ULONG RB_RBA_rba_Runtime_CompuMethods_rba_Runtime_Time 1 100 0.0 4.E9 FORMAT "%5.0" ECU_ADDRESS 0x40007618 /end MEASUREMENT
/begin MEASUREMENT rba_Runtime_MonTask_ast[2].internal_st.tiAccuRT_u32 "rba_Runtime Measurement Variable[2]//" ULONG RB_RBA_rba_Runtime_CompuMethods_rba_Runtime_Time 1 100 0.0 4.E9 FORMAT "%5.0" ECU_ADDRESS 0x4000764C /end MEASUREMENT
/begin MEASUREMENT rba_Runtime_MonTask_ast[3].internal_st.tiAccuRT_u32 "rba_Runtime Measurement Variable[3]//" ULONG RB_RBA_rba_Runtime_CompuMethods_rba_Runtime_Time 1 100 0.0 4.E9 FORMAT "%5.0" ECU_ADDRESS 0x40007680 /end MEASUREMENT
/begin MEASUREMENT rba_Runtime_MonTask_ast[4].internal_st.tiAccuRT_u32 "rba_Runtime Measurement Variable[4]//" ULONG RB_RBA_rba_Runtime_CompuMethods_rba_Runtime_Time 1 100 0.0 4.E9 FORMAT "%5.0" ECU_ADDRESS 0x400076B4 /end MEASUREMENT
/begin MEASUREMENT rba_Runtime_MonTask_ast[5].internal_st.tiAccuRT_u32 "rba_Runtime Measurement Variable[5]//" ULONG RB_RBA_rba_Runtime_CompuMethods_rba_Runtime_Time 1 100 0.0 4.E9 FORMAT "%5.0" ECU_ADDRESS 0x400076E8 /end MEASUREMENT
/begin MEASUREMENT rba_Runtime_MonTask_ast[6].internal_st.tiAccuRT_u32 "rba_Runtime Measurement Variable[6]//" ULONG RB_RBA_rba_Runtime_CompuMethods_rba_Runtime_Time 1 100 0.0 4.E9 FORMAT "%5.0" ECU_ADDRESS 0x4000771C /end MEASUREMENT
/begin MEASUREMENT rba_Runtime_MonTask_ast[7].internal_st.tiAccuRT_u32 "rba_Runtime Measurement Variable[7]//" ULONG RB_RBA_rba_Runtime_CompuMethods_rba_Runtime_Time 1 100 0.0 4.E9 FORMAT "%5.0" ECU_ADDRESS 0x40007750 /end MEASUREMENT
/begin MEASUREMENT rba_Runtime_MonTask_ast[8].internal_st.tiAccuRT_u32 "rba_Runtime Measurement Variable[8]//" ULONG RB_RBA_rba_Runtime_CompuMethods_rba_Runtime_Time 1 100 0.0 4.E9 FORMAT "%5.0" ECU_ADDRESS 0x40007784 /end MEASUREMENT
/begin MEASUREMENT rba_Runtime_MonTask_ast[9].internal_st.tiAccuRT_u32 "rba_Runtime Measurement Variable[9]//" ULONG RB_RBA_rba_Runtime_CompuMethods_rba_Runtime_Time 1 100 0.0 4.E9 FORMAT "%5.0" ECU_ADDRESS 0x400077B8 /end MEASUREMENT
/begin MEASUREMENT rba_Runtime_MonTask_ast[10].internal_st.tiAccuRT_u32 "rba_Runtime Measurement Variable[10]//" ULONG RB_RBA_rba_Runtime_CompuMethods_rba_Runtime_Time 1 100 0.0 4.E9 FORMAT "%5.0" ECU_ADDRESS 0x400077EC /end MEASUREMENT
/begin MEASUREMENT rba_Runtime_MonTask_ast[11].internal_st.tiAccuRT_u32 "rba_Runtime Measurement Variable[11]//" ULONG RB_RBA_rba_Runtime_CompuMethods_rba_Runtime_Time 1 100 0.0 4.E9 FORMAT "%5.0" ECU_ADDRESS 0x40007820 /end MEASUREMENT
/begin MEASUREMENT rba_Runtime_MonTask_ast[12].internal_st.tiAccuRT_u32 "rba_Runtime Measurement Variable[12]//" ULONG RB_RBA_rba_Runtime_CompuMethods_rba_Runtime_Time 1 100 0.0 4.E9 FORMAT "%5.0" ECU_ADDRESS 0x40007854 /end MEASUREMENT
/begin MEASUREMENT rba_Runtime_MonTask_ast[13].internal_st.tiAccuRT_u32 "rba_Runtime Measurement Variable[13]//" ULONG RB_RBA_rba_Runtime_CompuMethods_rba_Runtime_Time 1 100 0.0 4.E9 FORMAT "%5.0" ECU_ADDRESS 0x40007888 /end MEASUREMENT
/begin MEASUREMENT rba_Runtime_MonTask_ast[14].internal_st.tiAccuRT_u32 "rba_Runtime Measurement Variable[14]//" ULONG RB_RBA_rba_Runtime_CompuMethods_rba_Runtime_Time 1 100 0.0 4.E9 FORMAT "%5.0" ECU_ADDRESS 0x400078BC /end MEASUREMENT
/begin MEASUREMENT rba_Runtime_MonTask_ast[15].internal_st.tiAccuRT_u32 "rba_Runtime Measurement Variable[15]//" ULONG RB_RBA_rba_Runtime_CompuMethods_rba_Runtime_Time 1 100 0.0 4.E9 FORMAT "%5.0" ECU_ADDRESS 0x400078F0 /end MEASUREMENT
/begin MEASUREMENT rba_Runtime_MonTask_ast[16].internal_st.tiAccuRT_u32 "rba_Runtime Measurement Variable[16]//" ULONG RB_RBA_rba_Runtime_CompuMethods_rba_Runtime_Time 1 100 0.0 4.E9 FORMAT "%5.0" ECU_ADDRESS 0x40007924 /end MEASUREMENT
/begin MEASUREMENT rba_Runtime_MonTask_ast[17].internal_st.tiAccuRT_u32 "rba_Runtime Measurement Variable[17]//" ULONG RB_RBA_rba_Runtime_CompuMethods_rba_Runtime_Time 1 100 0.0 4.E9 FORMAT "%5.0" ECU_ADDRESS 0x40007958 /end MEASUREMENT
/begin MEASUREMENT rba_Runtime_MonTask_ast[18].internal_st.tiAccuRT_u32 "rba_Runtime Measurement Variable[18]//" ULONG RB_RBA_rba_Runtime_CompuMethods_rba_Runtime_Time 1 100 0.0 4.E9 FORMAT "%5.0" ECU_ADDRESS 0x4000798C /end MEASUREMENT
/begin MEASUREMENT rba_Runtime_MonTask_ast[19].internal_st.tiAccuRT_u32 "rba_Runtime Measurement Variable[19]//" ULONG RB_RBA_rba_Runtime_CompuMethods_rba_Runtime_Time 1 100 0.0 4.E9 FORMAT "%5.0" ECU_ADDRESS 0x400079C0 /end MEASUREMENT
/begin MEASUREMENT rba_Runtime_MonTask_ast[20].internal_st.tiAccuRT_u32 "rba_Runtime Measurement Variable[20]//" ULONG RB_RBA_rba_Runtime_CompuMethods_rba_Runtime_Time 1 100 0.0 4.E9 FORMAT "%5.0" ECU_ADDRESS 0x400079F4 /end MEASUREMENT
/begin MEASUREMENT rba_Runtime_MonTask_ast[21].internal_st.tiAccuRT_u32 "rba_Runtime Measurement Variable[21]//" ULONG RB_RBA_rba_Runtime_CompuMethods_rba_Runtime_Time 1 100 0.0 4.E9 FORMAT "%5.0" ECU_ADDRESS 0x40007A28 /end MEASUREMENT
/begin MEASUREMENT rba_Runtime_MonTask_ast[22].internal_st.tiAccuRT_u32 "rba_Runtime Measurement Variable[22]//" ULONG RB_RBA_rba_Runtime_CompuMethods_rba_Runtime_Time 1 100 0.0 4.E9 FORMAT "%5.0" ECU_ADDRESS 0x40007A5C /end MEASUREMENT
/begin MEASUREMENT rba_Runtime_MonTask_ast[23].internal_st.tiAccuRT_u32 "rba_Runtime Measurement Variable[23]//" ULONG RB_RBA_rba_Runtime_CompuMethods_rba_Runtime_Time 1 100 0.0 4.E9 FORMAT "%5.0" ECU_ADDRESS 0x40007A90 /end MEASUREMENT
/begin MEASUREMENT rba_Runtime_MonTask_ast[24].internal_st.tiAccuRT_u32 "rba_Runtime Measurement Variable[24]//" ULONG RB_RBA_rba_Runtime_CompuMethods_rba_Runtime_Time 1 100 0.0 4.E9 FORMAT "%5.0" ECU_ADDRESS 0x40007AC4 /end MEASUREMENT
/begin MEASUREMENT rba_Runtime_MonTask_ast[25].internal_st.tiAccuRT_u32 "rba_Runtime Measurement Variable[25]//" ULONG RB_RBA_rba_Runtime_CompuMethods_rba_Runtime_Time 1 100 0.0 4.E9 FORMAT "%5.0" ECU_ADDRESS 0x40007AF8 /end MEASUREMENT
/begin MEASUREMENT rba_Runtime_MonTask_ast[26].internal_st.tiAccuRT_u32 "rba_Runtime Measurement Variable[26]//" ULONG RB_RBA_rba_Runtime_CompuMethods_rba_Runtime_Time 1 100 0.0 4.E9 FORMAT "%5.0" ECU_ADDRESS 0x40007B2C /end MEASUREMENT
/begin MEASUREMENT rba_Runtime_MonTask_ast[27].internal_st.tiAccuRT_u32 "rba_Runtime Measurement Variable[27]//" ULONG RB_RBA_rba_Runtime_CompuMethods_rba_Runtime_Time 1 100 0.0 4.E9 FORMAT "%5.0" ECU_ADDRESS 0x40007B60 /end MEASUREMENT
/begin MEASUREMENT rba_Runtime_MonTask_ast[28].internal_st.tiAccuRT_u32 "rba_Runtime Measurement Variable[28]//" ULONG RB_RBA_rba_Runtime_CompuMethods_rba_Runtime_Time 1 100 0.0 4.E9 FORMAT "%5.0" ECU_ADDRESS 0x40007B94 /end MEASUREMENT
/begin MEASUREMENT rba_Runtime_MonTask_ast[29].internal_st.tiAccuRT_u32 "rba_Runtime Measurement Variable[29]//" ULONG RB_RBA_rba_Runtime_CompuMethods_rba_Runtime_Time 1 100 0.0 4.E9 FORMAT "%5.0" ECU_ADDRESS 0x40007BC8 /end MEASUREMENT
/begin MEASUREMENT rba_Runtime_MonTask_ast[30].internal_st.tiAccuRT_u32 "rba_Runtime Measurement Variable[30]//" ULONG RB_RBA_rba_Runtime_CompuMethods_rba_Runtime_Time 1 100 0.0 4.E9 FORMAT "%5.0" ECU_ADDRESS 0x40007BFC /end MEASUREMENT
/begin MEASUREMENT rba_Runtime_MonTask_ast[31].internal_st.tiAccuRT_u32 "rba_Runtime Measurement Variable[31]//" ULONG RB_RBA_rba_Runtime_CompuMethods_rba_Runtime_Time 1 100 0.0 4.E9 FORMAT "%5.0" ECU_ADDRESS 0x40007C30 /end MEASUREMENT
/begin MEASUREMENT rba_Runtime_MonTask_ast[32].internal_st.tiAccuRT_u32 "rba_Runtime Measurement Variable[32]//" ULONG RB_RBA_rba_Runtime_CompuMethods_rba_Runtime_Time 1 100 0.0 4.E9 FORMAT "%5.0" ECU_ADDRESS 0x40007C64 /end MEASUREMENT
/begin MEASUREMENT rba_Runtime_MonTask_ast[33].internal_st.tiAccuRT_u32 "rba_Runtime Measurement Variable[33]//" ULONG RB_RBA_rba_Runtime_CompuMethods_rba_Runtime_Time 1 100 0.0 4.E9 FORMAT "%5.0" ECU_ADDRESS 0x40007C98 /end MEASUREMENT
/begin MEASUREMENT rba_Runtime_MonTask_ast[34].internal_st.tiAccuRT_u32 "rba_Runtime Measurement Variable[34]//" ULONG RB_RBA_rba_Runtime_CompuMethods_rba_Runtime_Time 1 100 0.0 4.E9 FORMAT "%5.0" ECU_ADDRESS 0x40007CCC /end MEASUREMENT
/begin MEASUREMENT rba_Runtime_MonTask_ast[35].internal_st.tiAccuRT_u32 "rba_Runtime Measurement Variable[35]//" ULONG RB_RBA_rba_Runtime_CompuMethods_rba_Runtime_Time 1 100 0.0 4.E9 FORMAT "%5.0" ECU_ADDRESS 0x40007D00 /end MEASUREMENT
/begin MEASUREMENT rba_Runtime_MonTask_ast[36].internal_st.tiAccuRT_u32 "rba_Runtime Measurement Variable[36]//" ULONG RB_RBA_rba_Runtime_CompuMethods_rba_Runtime_Time 1 100 0.0 4.E9 FORMAT "%5.0" ECU_ADDRESS 0x40007D34 /end MEASUREMENT
/begin MEASUREMENT rba_Runtime_MonTask_ast[37].internal_st.tiAccuRT_u32 "rba_Runtime Measurement Variable[37]//" ULONG RB_RBA_rba_Runtime_CompuMethods_rba_Runtime_Time 1 100 0.0 4.E9 FORMAT "%5.0" ECU_ADDRESS 0x40007D68 /end MEASUREMENT
/begin MEASUREMENT rba_Runtime_MonTask_ast[0].internal_st.ctBeginCalls_u32 "rba_Runtime Measurement Variable[0]//" ULONG RB_RBA_Common_CentralElements_CompuMethods_Identical 1 100 0.0 4.E9 FORMAT "%5.0" ECU_ADDRESS 0x400075E8 /end MEASUREMENT
/begin MEASUREMENT rba_Runtime_MonTask_ast[1].internal_st.ctBeginCalls_u32 "rba_Runtime Measurement Variable[1]//" ULONG RB_RBA_Common_CentralElements_CompuMethods_Identical 1 100 0.0 4.E9 FORMAT "%5.0" ECU_ADDRESS 0x4000761C /end MEASUREMENT
/begin MEASUREMENT rba_Runtime_MonTask_ast[2].internal_st.ctBeginCalls_u32 "rba_Runtime Measurement Variable[2]//" ULONG RB_RBA_Common_CentralElements_CompuMethods_Identical 1 100 0.0 4.E9 FORMAT "%5.0" ECU_ADDRESS 0x40007650 /end MEASUREMENT
/begin MEASUREMENT rba_Runtime_MonTask_ast[3].internal_st.ctBeginCalls_u32 "rba_Runtime Measurement Variable[3]//" ULONG RB_RBA_Common_CentralElements_CompuMethods_Identical 1 100 0.0 4.E9 FORMAT "%5.0" ECU_ADDRESS 0x40007684 /end MEASUREMENT
/begin MEASUREMENT rba_Runtime_MonTask_ast[4].internal_st.ctBeginCalls_u32 "rba_Runtime Measurement Variable[4]//" ULONG RB_RBA_Common_CentralElements_CompuMethods_Identical 1 100 0.0 4.E9 FORMAT "%5.0" ECU_ADDRESS 0x400076B8 /end MEASUREMENT
/begin MEASUREMENT rba_Runtime_MonTask_ast[5].internal_st.ctBeginCalls_u32 "rba_Runtime Measurement Variable[5]//" ULONG RB_RBA_Common_CentralElements_CompuMethods_Identical 1 100 0.0 4.E9 FORMAT "%5.0" ECU_ADDRESS 0x400076EC /end MEASUREMENT
/begin MEASUREMENT rba_Runtime_MonTask_ast[6].internal_st.ctBeginCalls_u32 "rba_Runtime Measurement Variable[6]//" ULONG RB_RBA_Common_CentralElements_CompuMethods_Identical 1 100 0.0 4.E9 FORMAT "%5.0" ECU_ADDRESS 0x40007720 /end MEASUREMENT
/begin MEASUREMENT rba_Runtime_MonTask_ast[7].internal_st.ctBeginCalls_u32 "rba_Runtime Measurement Variable[7]//" ULONG RB_RBA_Common_CentralElements_CompuMethods_Identical 1 100 0.0 4.E9 FORMAT "%5.0" ECU_ADDRESS 0x40007754 /end MEASUREMENT
/begin MEASUREMENT rba_Runtime_MonTask_ast[8].internal_st.ctBeginCalls_u32 "rba_Runtime Measurement Variable[8]//" ULONG RB_RBA_Common_CentralElements_CompuMethods_Identical 1 100 0.0 4.E9 FORMAT "%5.0" ECU_ADDRESS 0x40007788 /end MEASUREMENT
/begin MEASUREMENT rba_Runtime_MonTask_ast[9].internal_st.ctBeginCalls_u32 "rba_Runtime Measurement Variable[9]//" ULONG RB_RBA_Common_CentralElements_CompuMethods_Identical 1 100 0.0 4.E9 FORMAT "%5.0" ECU_ADDRESS 0x400077BC /end MEASUREMENT
/begin MEASUREMENT rba_Runtime_MonTask_ast[10].internal_st.ctBeginCalls_u32 "rba_Runtime Measurement Variable[10]//" ULONG RB_RBA_Common_CentralElements_CompuMethods_Identical 1 100 0.0 4.E9 FORMAT "%5.0" ECU_ADDRESS 0x400077F0 /end MEASUREMENT
/begin MEASUREMENT rba_Runtime_MonTask_ast[11].internal_st.ctBeginCalls_u32 "rba_Runtime Measurement Variable[11]//" ULONG RB_RBA_Common_CentralElements_CompuMethods_Identical 1 100 0.0 4.E9 FORMAT "%5.0" ECU_ADDRESS 0x40007824 /end MEASUREMENT
/begin MEASUREMENT rba_Runtime_MonTask_ast[12].internal_st.ctBeginCalls_u32 "rba_Runtime Measurement Variable[12]//" ULONG RB_RBA_Common_CentralElements_CompuMethods_Identical 1 100 0.0 4.E9 FORMAT "%5.0" ECU_ADDRESS 0x40007858 /end MEASUREMENT
/begin MEASUREMENT rba_Runtime_MonTask_ast[13].internal_st.ctBeginCalls_u32 "rba_Runtime Measurement Variable[13]//" ULONG RB_RBA_Common_CentralElements_CompuMethods_Identical 1 100 0.0 4.E9 FORMAT "%5.0" ECU_ADDRESS 0x4000788C /end MEASUREMENT
/begin MEASUREMENT rba_Runtime_MonTask_ast[14].internal_st.ctBeginCalls_u32 "rba_Runtime Measurement Variable[14]//" ULONG RB_RBA_Common_CentralElements_CompuMethods_Identical 1 100 0.0 4.E9 FORMAT "%5.0" ECU_ADDRESS 0x400078C0 /end MEASUREMENT
/begin MEASUREMENT rba_Runtime_MonTask_ast[15].internal_st.ctBeginCalls_u32 "rba_Runtime Measurement Variable[15]//" ULONG RB_RBA_Common_CentralElements_CompuMethods_Identical 1 100 0.0 4.E9 FORMAT "%5.0" ECU_ADDRESS 0x400078F4 /end MEASUREMENT
/begin MEASUREMENT rba_Runtime_MonTask_ast[16].internal_st.ctBeginCalls_u32 "rba_Runtime Measurement Variable[16]//" ULONG RB_RBA_Common_CentralElements_CompuMethods_Identical 1 100 0.0 4.E9 FORMAT "%5.0" ECU_ADDRESS 0x40007928 /end MEASUREMENT
/begin MEASUREMENT rba_Runtime_MonTask_ast[17].internal_st.ctBeginCalls_u32 "rba_Runtime Measurement Variable[17]//" ULONG RB_RBA_Common_CentralElements_CompuMethods_Identical 1 100 0.0 4.E9 FORMAT "%5.0" ECU_ADDRESS 0x4000795C /end MEASUREMENT
/begin MEASUREMENT rba_Runtime_MonTask_ast[18].internal_st.ctBeginCalls_u32 "rba_Runtime Measurement Variable[18]//" ULONG RB_RBA_Common_CentralElements_CompuMethods_Identical 1 100 0.0 4.E9 FORMAT "%5.0" ECU_ADDRESS 0x40007990 /end MEASUREMENT
/begin MEASUREMENT rba_Runtime_MonTask_ast[19].internal_st.ctBeginCalls_u32 "rba_Runtime Measurement Variable[19]//" ULONG RB_RBA_Common_CentralElements_CompuMethods_Identical 1 100 0.0 4.E9 FORMAT "%5.0" ECU_ADDRESS 0x400079C4 /end MEASUREMENT
/begin MEASUREMENT rba_Runtime_MonTask_ast[20].internal_st.ctBeginCalls_u32 "rba_Runtime Measurement Variable[20]//" ULONG RB_RBA_Common_CentralElements_CompuMethods_Identical 1 100 0.0 4.E9 FORMAT "%5.0" ECU_ADDRESS 0x400079F8 /end MEASUREMENT
/begin MEASUREMENT rba_Runtime_MonTask_ast[21].internal_st.ctBeginCalls_u32 "rba_Runtime Measurement Variable[21]//" ULONG RB_RBA_Common_CentralElements_CompuMethods_Identical 1 100 0.0 4.E9 FORMAT "%5.0" ECU_ADDRESS 0x40007A2C /end MEASUREMENT
/begin MEASUREMENT rba_Runtime_MonTask_ast[22].internal_st.ctBeginCalls_u32 "rba_Runtime Measurement Variable[22]//" ULONG RB_RBA_Common_CentralElements_CompuMethods_Identical 1 100 0.0 4.E9 FORMAT "%5.0" ECU_ADDRESS 0x40007A60 /end MEASUREMENT
/begin MEASUREMENT rba_Runtime_MonTask_ast[23].internal_st.ctBeginCalls_u32 "rba_Runtime Measurement Variable[23]//" ULONG RB_RBA_Common_CentralElements_CompuMethods_Identical 1 100 0.0 4.E9 FORMAT "%5.0" ECU_ADDRESS 0x40007A94 /end MEASUREMENT
/begin MEASUREMENT rba_Runtime_MonTask_ast[24].internal_st.ctBeginCalls_u32 "rba_Runtime Measurement Variable[24]//" ULONG RB_RBA_Common_CentralElements_CompuMethods_Identical 1 100 0.0 4.E9 FORMAT "%5.0" ECU_ADDRESS 0x40007AC8 /end MEASUREMENT
/begin MEASUREMENT rba_Runtime_MonTask_ast[25].internal_st.ctBeginCalls_u32 "rba_Runtime Measurement Variable[25]//" ULONG RB_RBA_Common_CentralElements_CompuMethods_Identical 1 100 0.0 4.E9 FORMAT "%5.0" ECU_ADDRESS 0x40007AFC /end MEASUREMENT
/begin MEASUREMENT rba_Runtime_MonTask_ast[26].internal_st.ctBeginCalls_u32 "rba_Runtime Measurement Variable[26]//" ULONG RB_RBA_Common_CentralElements_CompuMethods_Identical 1 100 0.0 4.E9 FORMAT "%5.0" ECU_ADDRESS 0x40007B30 /end MEASUREMENT
/begin MEASUREMENT rba_Runtime_MonTask_ast[27].internal_st.ctBeginCalls_u32 "rba_Runtime Measurement Variable[27]//" ULONG RB_RBA_Common_CentralElements_CompuMethods_Identical 1 100 0.0 4.E9 FORMAT "%5.0" ECU_ADDRESS 0x40007B64 /end MEASUREMENT
/begin MEASUREMENT rba_Runtime_MonTask_ast[28].internal_st.ctBeginCalls_u32 "rba_Runtime Measurement Variable[28]//" ULONG RB_RBA_Common_CentralElements_CompuMethods_Identical 1 100 0.0 4.E9 FORMAT "%5.0" ECU_ADDRESS 0x40007B98 /end MEASUREMENT
/begin MEASUREMENT rba_Runtime_MonTask_ast[29].internal_st.ctBeginCalls_u32 "rba_Runtime Measurement Variable[29]//" ULONG RB_RBA_Common_CentralElements_CompuMethods_Identical 1 100 0.0 4.E9 FORMAT "%5.0" ECU_ADDRESS 0x40007BCC /end MEASUREMENT
/begin MEASUREMENT rba_Runtime_MonTask_ast[30].internal_st.ctBeginCalls_u32 "rba_Runtime Measurement Variable[30]//" ULONG RB_RBA_Common_CentralElements_CompuMethods_Identical 1 100 0.0 4.E9 FORMAT "%5.0" ECU_ADDRESS 0x40007C00 /end MEASUREMENT
/begin MEASUREMENT rba_Runtime_MonTask_ast[31].internal_st.ctBeginCalls_u32 "rba_Runtime Measurement Variable[31]//" ULONG RB_RBA_Common_CentralElements_CompuMethods_Identical 1 100 0.0 4.E9 FORMAT "%5.0" ECU_ADDRESS 0x40007C34 /end MEASUREMENT
/begin MEASUREMENT rba_Runtime_MonTask_ast[32].internal_st.ctBeginCalls_u32 "rba_Runtime Measurement Variable[32]//" ULONG RB_RBA_Common_CentralElements_CompuMethods_Identical 1 100 0.0 4.E9 FORMAT "%5.0" ECU_ADDRESS 0x40007C68 /end MEASUREMENT
/begin MEASUREMENT rba_Runtime_MonTask_ast[33].internal_st.ctBeginCalls_u32 "rba_Runtime Measurement Variable[33]//" ULONG RB_RBA_Common_CentralElements_CompuMethods_Identical 1 100 0.0 4.E9 FORMAT "%5.0" ECU_ADDRESS 0x40007C9C /end MEASUREMENT
/begin MEASUREMENT rba_Runtime_MonTask_ast[34].internal_st.ctBeginCalls_u32 "rba_Runtime Measurement Variable[34]//" ULONG RB_RBA_Common_CentralElements_CompuMethods_Identical 1 100 0.0 4.E9 FORMAT "%5.0" ECU_ADDRESS 0x40007CD0 /end MEASUREMENT
/begin MEASUREMENT rba_Runtime_MonTask_ast[35].internal_st.ctBeginCalls_u32 "rba_Runtime Measurement Variable[35]//" ULONG RB_RBA_Common_CentralElements_CompuMethods_Identical 1 100 0.0 4.E9 FORMAT "%5.0" ECU_ADDRESS 0x40007D04 /end MEASUREMENT
/begin MEASUREMENT rba_Runtime_MonTask_ast[36].internal_st.ctBeginCalls_u32 "rba_Runtime Measurement Variable[36]//" ULONG RB_RBA_Common_CentralElements_CompuMethods_Identical 1 100 0.0 4.E9 FORMAT "%5.0" ECU_ADDRESS 0x40007D38 /end MEASUREMENT
/begin MEASUREMENT rba_Runtime_MonTask_ast[37].internal_st.ctBeginCalls_u32 "rba_Runtime Measurement Variable[37]//" ULONG RB_RBA_Common_CentralElements_CompuMethods_Identical 1 100 0.0 4.E9 FORMAT "%5.0" ECU_ADDRESS 0x40007D6C /end MEASUREMENT
/begin MEASUREMENT rba_Runtime_MonTask_ast[0].internal_st.tiBeginFree_u32 "rba_Runtime Measurement Variable[0]//" ULONG RB_RBA_rba_Runtime_CompuMethods_rba_Runtime_Time 1 100 0.0 4.E9 FORMAT "%5.0" ECU_ADDRESS 0x400075EC /end MEASUREMENT
/begin MEASUREMENT rba_Runtime_MonTask_ast[1].internal_st.tiBeginFree_u32 "rba_Runtime Measurement Variable[1]//" ULONG RB_RBA_rba_Runtime_CompuMethods_rba_Runtime_Time 1 100 0.0 4.E9 FORMAT "%5.0" ECU_ADDRESS 0x40007620 /end MEASUREMENT
/begin MEASUREMENT rba_Runtime_MonTask_ast[2].internal_st.tiBeginFree_u32 "rba_Runtime Measurement Variable[2]//" ULONG RB_RBA_rba_Runtime_CompuMethods_rba_Runtime_Time 1 100 0.0 4.E9 FORMAT "%5.0" ECU_ADDRESS 0x40007654 /end MEASUREMENT
/begin MEASUREMENT rba_Runtime_MonTask_ast[3].internal_st.tiBeginFree_u32 "rba_Runtime Measurement Variable[3]//" ULONG RB_RBA_rba_Runtime_CompuMethods_rba_Runtime_Time 1 100 0.0 4.E9 FORMAT "%5.0" ECU_ADDRESS 0x40007688 /end MEASUREMENT
/begin MEASUREMENT rba_Runtime_MonTask_ast[4].internal_st.tiBeginFree_u32 "rba_Runtime Measurement Variable[4]//" ULONG RB_RBA_rba_Runtime_CompuMethods_rba_Runtime_Time 1 100 0.0 4.E9 FORMAT "%5.0" ECU_ADDRESS 0x400076BC /end MEASUREMENT
/begin MEASUREMENT rba_Runtime_MonTask_ast[5].internal_st.tiBeginFree_u32 "rba_Runtime Measurement Variable[5]//" ULONG RB_RBA_rba_Runtime_CompuMethods_rba_Runtime_Time 1 100 0.0 4.E9 FORMAT "%5.0" ECU_ADDRESS 0x400076F0 /end MEASUREMENT
/begin MEASUREMENT rba_Runtime_MonTask_ast[6].internal_st.tiBeginFree_u32 "rba_Runtime Measurement Variable[6]//" ULONG RB_RBA_rba_Runtime_CompuMethods_rba_Runtime_Time 1 100 0.0 4.E9 FORMAT "%5.0" ECU_ADDRESS 0x40007724 /end MEASUREMENT
/begin MEASUREMENT rba_Runtime_MonTask_ast[7].internal_st.tiBeginFree_u32 "rba_Runtime Measurement Variable[7]//" ULONG RB_RBA_rba_Runtime_CompuMethods_rba_Runtime_Time 1 100 0.0 4.E9 FORMAT "%5.0" ECU_ADDRESS 0x40007758 /end MEASUREMENT
/begin MEASUREMENT rba_Runtime_MonTask_ast[8].internal_st.tiBeginFree_u32 "rba_Runtime Measurement Variable[8]//" ULONG RB_RBA_rba_Runtime_CompuMethods_rba_Runtime_Time 1 100 0.0 4.E9 FORMAT "%5.0" ECU_ADDRESS 0x4000778C /end MEASUREMENT
/begin MEASUREMENT rba_Runtime_MonTask_ast[9].internal_st.tiBeginFree_u32 "rba_Runtime Measurement Variable[9]//" ULONG RB_RBA_rba_Runtime_CompuMethods_rba_Runtime_Time 1 100 0.0 4.E9 FORMAT "%5.0" ECU_ADDRESS 0x400077C0 /end MEASUREMENT
/begin MEASUREMENT rba_Runtime_MonTask_ast[10].internal_st.tiBeginFree_u32 "rba_Runtime Measurement Variable[10]//" ULONG RB_RBA_rba_Runtime_CompuMethods_rba_Runtime_Time 1 100 0.0 4.E9 FORMAT "%5.0" ECU_ADDRESS 0x400077F4 /end MEASUREMENT
/begin MEASUREMENT rba_Runtime_MonTask_ast[11].internal_st.tiBeginFree_u32 "rba_Runtime Measurement Variable[11]//" ULONG RB_RBA_rba_Runtime_CompuMethods_rba_Runtime_Time 1 100 0.0 4.E9 FORMAT "%5.0" ECU_ADDRESS 0x40007828 /end MEASUREMENT
/begin MEASUREMENT rba_Runtime_MonTask_ast[12].internal_st.tiBeginFree_u32 "rba_Runtime Measurement Variable[12]//" ULONG RB_RBA_rba_Runtime_CompuMethods_rba_Runtime_Time 1 100 0.0 4.E9 FORMAT "%5.0" ECU_ADDRESS 0x4000785C /end MEASUREMENT
/begin MEASUREMENT rba_Runtime_MonTask_ast[13].internal_st.tiBeginFree_u32 "rba_Runtime Measurement Variable[13]//" ULONG RB_RBA_rba_Runtime_CompuMethods_rba_Runtime_Time 1 100 0.0 4.E9 FORMAT "%5.0" ECU_ADDRESS 0x40007890 /end MEASUREMENT
/begin MEASUREMENT rba_Runtime_MonTask_ast[14].internal_st.tiBeginFree_u32 "rba_Runtime Measurement Variable[14]//" ULONG RB_RBA_rba_Runtime_CompuMethods_rba_Runtime_Time 1 100 0.0 4.E9 FORMAT "%5.0" ECU_ADDRESS 0x400078C4 /end MEASUREMENT
/begin MEASUREMENT rba_Runtime_MonTask_ast[15].internal_st.tiBeginFree_u32 "rba_Runtime Measurement Variable[15]//" ULONG RB_RBA_rba_Runtime_CompuMethods_rba_Runtime_Time 1 100 0.0 4.E9 FORMAT "%5.0" ECU_ADDRESS 0x400078F8 /end MEASUREMENT
/begin MEASUREMENT rba_Runtime_MonTask_ast[16].internal_st.tiBeginFree_u32 "rba_Runtime Measurement Variable[16]//" ULONG RB_RBA_rba_Runtime_CompuMethods_rba_Runtime_Time 1 100 0.0 4.E9 FORMAT "%5.0" ECU_ADDRESS 0x4000792C /end MEASUREMENT
/begin MEASUREMENT rba_Runtime_MonTask_ast[17].internal_st.tiBeginFree_u32 "rba_Runtime Measurement Variable[17]//" ULONG RB_RBA_rba_Runtime_CompuMethods_rba_Runtime_Time 1 100 0.0 4.E9 FORMAT "%5.0" ECU_ADDRESS 0x40007960 /end MEASUREMENT
/begin MEASUREMENT rba_Runtime_MonTask_ast[18].internal_st.tiBeginFree_u32 "rba_Runtime Measurement Variable[18]//" ULONG RB_RBA_rba_Runtime_CompuMethods_rba_Runtime_Time 1 100 0.0 4.E9 FORMAT "%5.0" ECU_ADDRESS 0x40007994 /end MEASUREMENT
/begin MEASUREMENT rba_Runtime_MonTask_ast[19].internal_st.tiBeginFree_u32 "rba_Runtime Measurement Variable[19]//" ULONG RB_RBA_rba_Runtime_CompuMethods_rba_Runtime_Time 1 100 0.0 4.E9 FORMAT "%5.0" ECU_ADDRESS 0x400079C8 /end MEASUREMENT
/begin MEASUREMENT rba_Runtime_MonTask_ast[20].internal_st.tiBeginFree_u32 "rba_Runtime Measurement Variable[20]//" ULONG RB_RBA_rba_Runtime_CompuMethods_rba_Runtime_Time 1 100 0.0 4.E9 FORMAT "%5.0" ECU_ADDRESS 0x400079FC /end MEASUREMENT
/begin MEASUREMENT rba_Runtime_MonTask_ast[21].internal_st.tiBeginFree_u32 "rba_Runtime Measurement Variable[21]//" ULONG RB_RBA_rba_Runtime_CompuMethods_rba_Runtime_Time 1 100 0.0 4.E9 FORMAT "%5.0" ECU_ADDRESS 0x40007A30 /end MEASUREMENT
/begin MEASUREMENT rba_Runtime_MonTask_ast[22].internal_st.tiBeginFree_u32 "rba_Runtime Measurement Variable[22]//" ULONG RB_RBA_rba_Runtime_CompuMethods_rba_Runtime_Time 1 100 0.0 4.E9 FORMAT "%5.0" ECU_ADDRESS 0x40007A64 /end MEASUREMENT
/begin MEASUREMENT rba_Runtime_MonTask_ast[23].internal_st.tiBeginFree_u32 "rba_Runtime Measurement Variable[23]//" ULONG RB_RBA_rba_Runtime_CompuMethods_rba_Runtime_Time 1 100 0.0 4.E9 FORMAT "%5.0" ECU_ADDRESS 0x40007A98 /end MEASUREMENT
/begin MEASUREMENT rba_Runtime_MonTask_ast[24].internal_st.tiBeginFree_u32 "rba_Runtime Measurement Variable[24]//" ULONG RB_RBA_rba_Runtime_CompuMethods_rba_Runtime_Time 1 100 0.0 4.E9 FORMAT "%5.0" ECU_ADDRESS 0x40007ACC /end MEASUREMENT
/begin MEASUREMENT rba_Runtime_MonTask_ast[25].internal_st.tiBeginFree_u32 "rba_Runtime Measurement Variable[25]//" ULONG RB_RBA_rba_Runtime_CompuMethods_rba_Runtime_Time 1 100 0.0 4.E9 FORMAT "%5.0" ECU_ADDRESS 0x40007B00 /end MEASUREMENT
/begin MEASUREMENT rba_Runtime_MonTask_ast[26].internal_st.tiBeginFree_u32 "rba_Runtime Measurement Variable[26]//" ULONG RB_RBA_rba_Runtime_CompuMethods_rba_Runtime_Time 1 100 0.0 4.E9 FORMAT "%5.0" ECU_ADDRESS 0x40007B34 /end MEASUREMENT
/begin MEASUREMENT rba_Runtime_MonTask_ast[27].internal_st.tiBeginFree_u32 "rba_Runtime Measurement Variable[27]//" ULONG RB_RBA_rba_Runtime_CompuMethods_rba_Runtime_Time 1 100 0.0 4.E9 FORMAT "%5.0" ECU_ADDRESS 0x40007B68 /end MEASUREMENT
/begin MEASUREMENT rba_Runtime_MonTask_ast[28].internal_st.tiBeginFree_u32 "rba_Runtime Measurement Variable[28]//" ULONG RB_RBA_rba_Runtime_CompuMethods_rba_Runtime_Time 1 100 0.0 4.E9 FORMAT "%5.0" ECU_ADDRESS 0x40007B9C /end MEASUREMENT
/begin MEASUREMENT rba_Runtime_MonTask_ast[29].internal_st.tiBeginFree_u32 "rba_Runtime Measurement Variable[29]//" ULONG RB_RBA_rba_Runtime_CompuMethods_rba_Runtime_Time 1 100 0.0 4.E9 FORMAT "%5.0" ECU_ADDRESS 0x40007BD0 /end MEASUREMENT
/begin MEASUREMENT rba_Runtime_MonTask_ast[30].internal_st.tiBeginFree_u32 "rba_Runtime Measurement Variable[30]//" ULONG RB_RBA_rba_Runtime_CompuMethods_rba_Runtime_Time 1 100 0.0 4.E9 FORMAT "%5.0" ECU_ADDRESS 0x40007C04 /end MEASUREMENT
/begin MEASUREMENT rba_Runtime_MonTask_ast[31].internal_st.tiBeginFree_u32 "rba_Runtime Measurement Variable[31]//" ULONG RB_RBA_rba_Runtime_CompuMethods_rba_Runtime_Time 1 100 0.0 4.E9 FORMAT "%5.0" ECU_ADDRESS 0x40007C38 /end MEASUREMENT
/begin MEASUREMENT rba_Runtime_MonTask_ast[32].internal_st.tiBeginFree_u32 "rba_Runtime Measurement Variable[32]//" ULONG RB_RBA_rba_Runtime_CompuMethods_rba_Runtime_Time 1 100 0.0 4.E9 FORMAT "%5.0" ECU_ADDRESS 0x40007C6C /end MEASUREMENT
/begin MEASUREMENT rba_Runtime_MonTask_ast[33].internal_st.tiBeginFree_u32 "rba_Runtime Measurement Variable[33]//" ULONG RB_RBA_rba_Runtime_CompuMethods_rba_Runtime_Time 1 100 0.0 4.E9 FORMAT "%5.0" ECU_ADDRESS 0x40007CA0 /end MEASUREMENT
/begin MEASUREMENT rba_Runtime_MonTask_ast[34].internal_st.tiBeginFree_u32 "rba_Runtime Measurement Variable[34]//" ULONG RB_RBA_rba_Runtime_CompuMethods_rba_Runtime_Time 1 100 0.0 4.E9 FORMAT "%5.0" ECU_ADDRESS 0x40007CD4 /end MEASUREMENT
/begin MEASUREMENT rba_Runtime_MonTask_ast[35].internal_st.tiBeginFree_u32 "rba_Runtime Measurement Variable[35]//" ULONG RB_RBA_rba_Runtime_CompuMethods_rba_Runtime_Time 1 100 0.0 4.E9 FORMAT "%5.0" ECU_ADDRESS 0x40007D08 /end MEASUREMENT
/begin MEASUREMENT rba_Runtime_MonTask_ast[36].internal_st.tiBeginFree_u32 "rba_Runtime Measurement Variable[36]//" ULONG RB_RBA_rba_Runtime_CompuMethods_rba_Runtime_Time 1 100 0.0 4.E9 FORMAT "%5.0" ECU_ADDRESS 0x40007D3C /end MEASUREMENT
/begin MEASUREMENT rba_Runtime_MonTask_ast[37].internal_st.tiBeginFree_u32 "rba_Runtime Measurement Variable[37]//" ULONG RB_RBA_rba_Runtime_CompuMethods_rba_Runtime_Time 1 100 0.0 4.E9 FORMAT "%5.0" ECU_ADDRESS 0x40007D70 /end MEASUREMENT
/begin MEASUREMENT rba_Runtime_MonTask_ast[0].loadPer64k_u16 "rba_Runtime Measurement Variable[0]/" UWORD RB_RBA_rba_Runtime_CompuMethods_rba_Runtime_Percentage 1 100 0.0 65535. FORMAT "%5.0" ECU_ADDRESS 0x400075F0 /end MEASUREMENT
/begin MEASUREMENT rba_Runtime_MonTask_ast[1].loadPer64k_u16 "rba_Runtime Measurement Variable[1]/" UWORD RB_RBA_rba_Runtime_CompuMethods_rba_Runtime_Percentage 1 100 0.0 65535. FORMAT "%5.0" ECU_ADDRESS 0x40007624 /end MEASUREMENT
/begin MEASUREMENT rba_Runtime_MonTask_ast[2].loadPer64k_u16 "rba_Runtime Measurement Variable[2]/" UWORD RB_RBA_rba_Runtime_CompuMethods_rba_Runtime_Percentage 1 100 0.0 65535. FORMAT "%5.0" ECU_ADDRESS 0x40007658 /end MEASUREMENT
/begin MEASUREMENT rba_Runtime_MonTask_ast[3].loadPer64k_u16 "rba_Runtime Measurement Variable[3]/" UWORD RB_RBA_rba_Runtime_CompuMethods_rba_Runtime_Percentage 1 100 0.0 65535. FORMAT "%5.0" ECU_ADDRESS 0x4000768C /end MEASUREMENT
/begin MEASUREMENT rba_Runtime_MonTask_ast[4].loadPer64k_u16 "rba_Runtime Measurement Variable[4]/" UWORD RB_RBA_rba_Runtime_CompuMethods_rba_Runtime_Percentage 1 100 0.0 65535. FORMAT "%5.0" ECU_ADDRESS 0x400076C0 /end MEASUREMENT
/begin MEASUREMENT rba_Runtime_MonTask_ast[5].loadPer64k_u16 "rba_Runtime Measurement Variable[5]/" UWORD RB_RBA_rba_Runtime_CompuMethods_rba_Runtime_Percentage 1 100 0.0 65535. FORMAT "%5.0" ECU_ADDRESS 0x400076F4 /end MEASUREMENT
/begin MEASUREMENT rba_Runtime_MonTask_ast[6].loadPer64k_u16 "rba_Runtime Measurement Variable[6]/" UWORD RB_RBA_rba_Runtime_CompuMethods_rba_Runtime_Percentage 1 100 0.0 65535. FORMAT "%5.0" ECU_ADDRESS 0x40007728 /end MEASUREMENT
/begin MEASUREMENT rba_Runtime_MonTask_ast[7].loadPer64k_u16 "rba_Runtime Measurement Variable[7]/" UWORD RB_RBA_rba_Runtime_CompuMethods_rba_Runtime_Percentage 1 100 0.0 65535. FORMAT "%5.0" ECU_ADDRESS 0x4000775C /end MEASUREMENT
/begin MEASUREMENT rba_Runtime_MonTask_ast[8].loadPer64k_u16 "rba_Runtime Measurement Variable[8]/" UWORD RB_RBA_rba_Runtime_CompuMethods_rba_Runtime_Percentage 1 100 0.0 65535. FORMAT "%5.0" ECU_ADDRESS 0x40007790 /end MEASUREMENT
/begin MEASUREMENT rba_Runtime_MonTask_ast[9].loadPer64k_u16 "rba_Runtime Measurement Variable[9]/" UWORD RB_RBA_rba_Runtime_CompuMethods_rba_Runtime_Percentage 1 100 0.0 65535. FORMAT "%5.0" ECU_ADDRESS 0x400077C4 /end MEASUREMENT
/begin MEASUREMENT rba_Runtime_MonTask_ast[10].loadPer64k_u16 "rba_Runtime Measurement Variable[10]/" UWORD RB_RBA_rba_Runtime_CompuMethods_rba_Runtime_Percentage 1 100 0.0 65535. FORMAT "%5.0" ECU_ADDRESS 0x400077F8 /end MEASUREMENT
/begin MEASUREMENT rba_Runtime_MonTask_ast[11].loadPer64k_u16 "rba_Runtime Measurement Variable[11]/" UWORD RB_RBA_rba_Runtime_CompuMethods_rba_Runtime_Percentage 1 100 0.0 65535. FORMAT "%5.0" ECU_ADDRESS 0x4000782C /end MEASUREMENT
/begin MEASUREMENT rba_Runtime_MonTask_ast[12].loadPer64k_u16 "rba_Runtime Measurement Variable[12]/" UWORD RB_RBA_rba_Runtime_CompuMethods_rba_Runtime_Percentage 1 100 0.0 65535. FORMAT "%5.0" ECU_ADDRESS 0x40007860 /end MEASUREMENT
/begin MEASUREMENT rba_Runtime_MonTask_ast[13].loadPer64k_u16 "rba_Runtime Measurement Variable[13]/" UWORD RB_RBA_rba_Runtime_CompuMethods_rba_Runtime_Percentage 1 100 0.0 65535. FORMAT "%5.0" ECU_ADDRESS 0x40007894 /end MEASUREMENT
/begin MEASUREMENT rba_Runtime_MonTask_ast[14].loadPer64k_u16 "rba_Runtime Measurement Variable[14]/" UWORD RB_RBA_rba_Runtime_CompuMethods_rba_Runtime_Percentage 1 100 0.0 65535. FORMAT "%5.0" ECU_ADDRESS 0x400078C8 /end MEASUREMENT
/begin MEASUREMENT rba_Runtime_MonTask_ast[15].loadPer64k_u16 "rba_Runtime Measurement Variable[15]/" UWORD RB_RBA_rba_Runtime_CompuMethods_rba_Runtime_Percentage 1 100 0.0 65535. FORMAT "%5.0" ECU_ADDRESS 0x400078FC /end MEASUREMENT
/begin MEASUREMENT rba_Runtime_MonTask_ast[16].loadPer64k_u16 "rba_Runtime Measurement Variable[16]/" UWORD RB_RBA_rba_Runtime_CompuMethods_rba_Runtime_Percentage 1 100 0.0 65535. FORMAT "%5.0" ECU_ADDRESS 0x40007930 /end MEASUREMENT
/begin MEASUREMENT rba_Runtime_MonTask_ast[17].loadPer64k_u16 "rba_Runtime Measurement Variable[17]/" UWORD RB_RBA_rba_Runtime_CompuMethods_rba_Runtime_Percentage 1 100 0.0 65535. FORMAT "%5.0" ECU_ADDRESS 0x40007964 /end MEASUREMENT
/begin MEASUREMENT rba_Runtime_MonTask_ast[18].loadPer64k_u16 "rba_Runtime Measurement Variable[18]/" UWORD RB_RBA_rba_Runtime_CompuMethods_rba_Runtime_Percentage 1 100 0.0 65535. FORMAT "%5.0" ECU_ADDRESS 0x40007998 /end MEASUREMENT
/begin MEASUREMENT rba_Runtime_MonTask_ast[19].loadPer64k_u16 "rba_Runtime Measurement Variable[19]/" UWORD RB_RBA_rba_Runtime_CompuMethods_rba_Runtime_Percentage 1 100 0.0 65535. FORMAT "%5.0" ECU_ADDRESS 0x400079CC /end MEASUREMENT
/begin MEASUREMENT rba_Runtime_MonTask_ast[20].loadPer64k_u16 "rba_Runtime Measurement Variable[20]/" UWORD RB_RBA_rba_Runtime_CompuMethods_rba_Runtime_Percentage 1 100 0.0 65535. FORMAT "%5.0" ECU_ADDRESS 0x40007A00 /end MEASUREMENT
/begin MEASUREMENT rba_Runtime_MonTask_ast[21].loadPer64k_u16 "rba_Runtime Measurement Variable[21]/" UWORD RB_RBA_rba_Runtime_CompuMethods_rba_Runtime_Percentage 1 100 0.0 65535. FORMAT "%5.0" ECU_ADDRESS 0x40007A34 /end MEASUREMENT
/begin MEASUREMENT rba_Runtime_MonTask_ast[22].loadPer64k_u16 "rba_Runtime Measurement Variable[22]/" UWORD RB_RBA_rba_Runtime_CompuMethods_rba_Runtime_Percentage 1 100 0.0 65535. FORMAT "%5.0" ECU_ADDRESS 0x40007A68 /end MEASUREMENT
/begin MEASUREMENT rba_Runtime_MonTask_ast[23].loadPer64k_u16 "rba_Runtime Measurement Variable[23]/" UWORD RB_RBA_rba_Runtime_CompuMethods_rba_Runtime_Percentage 1 100 0.0 65535. FORMAT "%5.0" ECU_ADDRESS 0x40007A9C /end MEASUREMENT
/begin MEASUREMENT rba_Runtime_MonTask_ast[24].loadPer64k_u16 "rba_Runtime Measurement Variable[24]/" UWORD RB_RBA_rba_Runtime_CompuMethods_rba_Runtime_Percentage 1 100 0.0 65535. FORMAT "%5.0" ECU_ADDRESS 0x40007AD0 /end MEASUREMENT
/begin MEASUREMENT rba_Runtime_MonTask_ast[25].loadPer64k_u16 "rba_Runtime Measurement Variable[25]/" UWORD RB_RBA_rba_Runtime_CompuMethods_rba_Runtime_Percentage 1 100 0.0 65535. FORMAT "%5.0" ECU_ADDRESS 0x40007B04 /end MEASUREMENT
/begin MEASUREMENT rba_Runtime_MonTask_ast[26].loadPer64k_u16 "rba_Runtime Measurement Variable[26]/" UWORD RB_RBA_rba_Runtime_CompuMethods_rba_Runtime_Percentage 1 100 0.0 65535. FORMAT "%5.0" ECU_ADDRESS 0x40007B38 /end MEASUREMENT
/begin MEASUREMENT rba_Runtime_MonTask_ast[27].loadPer64k_u16 "rba_Runtime Measurement Variable[27]/" UWORD RB_RBA_rba_Runtime_CompuMethods_rba_Runtime_Percentage 1 100 0.0 65535. FORMAT "%5.0" ECU_ADDRESS 0x40007B6C /end MEASUREMENT
/begin MEASUREMENT rba_Runtime_MonTask_ast[28].loadPer64k_u16 "rba_Runtime Measurement Variable[28]/" UWORD RB_RBA_rba_Runtime_CompuMethods_rba_Runtime_Percentage 1 100 0.0 65535. FORMAT "%5.0" ECU_ADDRESS 0x40007BA0 /end MEASUREMENT
/begin MEASUREMENT rba_Runtime_MonTask_ast[29].loadPer64k_u16 "rba_Runtime Measurement Variable[29]/" UWORD RB_RBA_rba_Runtime_CompuMethods_rba_Runtime_Percentage 1 100 0.0 65535. FORMAT "%5.0" ECU_ADDRESS 0x40007BD4 /end MEASUREMENT
/begin MEASUREMENT rba_Runtime_MonTask_ast[30].loadPer64k_u16 "rba_Runtime Measurement Variable[30]/" UWORD RB_RBA_rba_Runtime_CompuMethods_rba_Runtime_Percentage 1 100 0.0 65535. FORMAT "%5.0" ECU_ADDRESS 0x40007C08 /end MEASUREMENT
/begin MEASUREMENT rba_Runtime_MonTask_ast[31].loadPer64k_u16 "rba_Runtime Measurement Variable[31]/" UWORD RB_RBA_rba_Runtime_CompuMethods_rba_Runtime_Percentage 1 100 0.0 65535. FORMAT "%5.0" ECU_ADDRESS 0x40007C3C /end MEASUREMENT
/begin MEASUREMENT rba_Runtime_MonTask_ast[32].loadPer64k_u16 "rba_Runtime Measurement Variable[32]/" UWORD RB_RBA_rba_Runtime_CompuMethods_rba_Runtime_Percentage 1 100 0.0 65535. FORMAT "%5.0" ECU_ADDRESS 0x40007C70 /end MEASUREMENT
/begin MEASUREMENT rba_Runtime_MonTask_ast[33].loadPer64k_u16 "rba_Runtime Measurement Variable[33]/" UWORD RB_RBA_rba_Runtime_CompuMethods_rba_Runtime_Percentage 1 100 0.0 65535. FORMAT "%5.0" ECU_ADDRESS 0x40007CA4 /end MEASUREMENT
/begin MEASUREMENT rba_Runtime_MonTask_ast[34].loadPer64k_u16 "rba_Runtime Measurement Variable[34]/" UWORD RB_RBA_rba_Runtime_CompuMethods_rba_Runtime_Percentage 1 100 0.0 65535. FORMAT "%5.0" ECU_ADDRESS 0x40007CD8 /end MEASUREMENT
/begin MEASUREMENT rba_Runtime_MonTask_ast[35].loadPer64k_u16 "rba_Runtime Measurement Variable[35]/" UWORD RB_RBA_rba_Runtime_CompuMethods_rba_Runtime_Percentage 1 100 0.0 65535. FORMAT "%5.0" ECU_ADDRESS 0x40007D0C /end MEASUREMENT
/begin MEASUREMENT rba_Runtime_MonTask_ast[36].loadPer64k_u16 "rba_Runtime Measurement Variable[36]/" UWORD RB_RBA_rba_Runtime_CompuMethods_rba_Runtime_Percentage 1 100 0.0 65535. FORMAT "%5.0" ECU_ADDRESS 0x40007D40 /end MEASUREMENT
/begin MEASUREMENT rba_Runtime_MonTask_ast[37].loadPer64k_u16 "rba_Runtime Measurement Variable[37]/" UWORD RB_RBA_rba_Runtime_CompuMethods_rba_Runtime_Percentage 1 100 0.0 65535. FORMAT "%5.0" ECU_ADDRESS 0x40007D74 /end MEASUREMENT
/begin MEASUREMENT rba_Runtime_MonTask_ast[0].ctSampleProcessed_u8 "rba_Runtime Measurement Variable[0]/" UBYTE RB_RBA_Common_CentralElements_CompuMethods_Identical 1 100 0.0 255. FORMAT "%5.0" ECU_ADDRESS 0x400075F2 /end MEASUREMENT
/begin MEASUREMENT rba_Runtime_MonTask_ast[1].ctSampleProcessed_u8 "rba_Runtime Measurement Variable[1]/" UBYTE RB_RBA_Common_CentralElements_CompuMethods_Identical 1 100 0.0 255. FORMAT "%5.0" ECU_ADDRESS 0x40007626 /end MEASUREMENT
/begin MEASUREMENT rba_Runtime_MonTask_ast[2].ctSampleProcessed_u8 "rba_Runtime Measurement Variable[2]/" UBYTE RB_RBA_Common_CentralElements_CompuMethods_Identical 1 100 0.0 255. FORMAT "%5.0" ECU_ADDRESS 0x4000765A /end MEASUREMENT
/begin MEASUREMENT rba_Runtime_MonTask_ast[3].ctSampleProcessed_u8 "rba_Runtime Measurement Variable[3]/" UBYTE RB_RBA_Common_CentralElements_CompuMethods_Identical 1 100 0.0 255. FORMAT "%5.0" ECU_ADDRESS 0x4000768E /end MEASUREMENT
/begin MEASUREMENT rba_Runtime_MonTask_ast[4].ctSampleProcessed_u8 "rba_Runtime Measurement Variable[4]/" UBYTE RB_RBA_Common_CentralElements_CompuMethods_Identical 1 100 0.0 255. FORMAT "%5.0" ECU_ADDRESS 0x400076C2 /end MEASUREMENT
/begin MEASUREMENT rba_Runtime_MonTask_ast[5].ctSampleProcessed_u8 "rba_Runtime Measurement Variable[5]/" UBYTE RB_RBA_Common_CentralElements_CompuMethods_Identical 1 100 0.0 255. FORMAT "%5.0" ECU_ADDRESS 0x400076F6 /end MEASUREMENT
/begin MEASUREMENT rba_Runtime_MonTask_ast[6].ctSampleProcessed_u8 "rba_Runtime Measurement Variable[6]/" UBYTE RB_RBA_Common_CentralElements_CompuMethods_Identical 1 100 0.0 255. FORMAT "%5.0" ECU_ADDRESS 0x4000772A /end MEASUREMENT
/begin MEASUREMENT rba_Runtime_MonTask_ast[7].ctSampleProcessed_u8 "rba_Runtime Measurement Variable[7]/" UBYTE RB_RBA_Common_CentralElements_CompuMethods_Identical 1 100 0.0 255. FORMAT "%5.0" ECU_ADDRESS 0x4000775E /end MEASUREMENT
/begin MEASUREMENT rba_Runtime_MonTask_ast[8].ctSampleProcessed_u8 "rba_Runtime Measurement Variable[8]/" UBYTE RB_RBA_Common_CentralElements_CompuMethods_Identical 1 100 0.0 255. FORMAT "%5.0" ECU_ADDRESS 0x40007792 /end MEASUREMENT
/begin MEASUREMENT rba_Runtime_MonTask_ast[9].ctSampleProcessed_u8 "rba_Runtime Measurement Variable[9]/" UBYTE RB_RBA_Common_CentralElements_CompuMethods_Identical 1 100 0.0 255. FORMAT "%5.0" ECU_ADDRESS 0x400077C6 /end MEASUREMENT
/begin MEASUREMENT rba_Runtime_MonTask_ast[10].ctSampleProcessed_u8 "rba_Runtime Measurement Variable[10]/" UBYTE RB_RBA_Common_CentralElements_CompuMethods_Identical 1 100 0.0 255. FORMAT "%5.0" ECU_ADDRESS 0x400077FA /end MEASUREMENT
/begin MEASUREMENT rba_Runtime_MonTask_ast[11].ctSampleProcessed_u8 "rba_Runtime Measurement Variable[11]/" UBYTE RB_RBA_Common_CentralElements_CompuMethods_Identical 1 100 0.0 255. FORMAT "%5.0" ECU_ADDRESS 0x4000782E /end MEASUREMENT
/begin MEASUREMENT rba_Runtime_MonTask_ast[12].ctSampleProcessed_u8 "rba_Runtime Measurement Variable[12]/" UBYTE RB_RBA_Common_CentralElements_CompuMethods_Identical 1 100 0.0 255. FORMAT "%5.0" ECU_ADDRESS 0x40007862 /end MEASUREMENT
/begin MEASUREMENT rba_Runtime_MonTask_ast[13].ctSampleProcessed_u8 "rba_Runtime Measurement Variable[13]/" UBYTE RB_RBA_Common_CentralElements_CompuMethods_Identical 1 100 0.0 255. FORMAT "%5.0" ECU_ADDRESS 0x40007896 /end MEASUREMENT
/begin MEASUREMENT rba_Runtime_MonTask_ast[14].ctSampleProcessed_u8 "rba_Runtime Measurement Variable[14]/" UBYTE RB_RBA_Common_CentralElements_CompuMethods_Identical 1 100 0.0 255. FORMAT "%5.0" ECU_ADDRESS 0x400078CA /end MEASUREMENT
/begin MEASUREMENT rba_Runtime_MonTask_ast[15].ctSampleProcessed_u8 "rba_Runtime Measurement Variable[15]/" UBYTE RB_RBA_Common_CentralElements_CompuMethods_Identical 1 100 0.0 255. FORMAT "%5.0" ECU_ADDRESS 0x400078FE /end MEASUREMENT
/begin MEASUREMENT rba_Runtime_MonTask_ast[16].ctSampleProcessed_u8 "rba_Runtime Measurement Variable[16]/" UBYTE RB_RBA_Common_CentralElements_CompuMethods_Identical 1 100 0.0 255. FORMAT "%5.0" ECU_ADDRESS 0x40007932 /end MEASUREMENT
/begin MEASUREMENT rba_Runtime_MonTask_ast[17].ctSampleProcessed_u8 "rba_Runtime Measurement Variable[17]/" UBYTE RB_RBA_Common_CentralElements_CompuMethods_Identical 1 100 0.0 255. FORMAT "%5.0" ECU_ADDRESS 0x40007966 /end MEASUREMENT
/begin MEASUREMENT rba_Runtime_MonTask_ast[18].ctSampleProcessed_u8 "rba_Runtime Measurement Variable[18]/" UBYTE RB_RBA_Common_CentralElements_CompuMethods_Identical 1 100 0.0 255. FORMAT "%5.0" ECU_ADDRESS 0x4000799A /end MEASUREMENT
/begin MEASUREMENT rba_Runtime_MonTask_ast[19].ctSampleProcessed_u8 "rba_Runtime Measurement Variable[19]/" UBYTE RB_RBA_Common_CentralElements_CompuMethods_Identical 1 100 0.0 255. FORMAT "%5.0" ECU_ADDRESS 0x400079CE /end MEASUREMENT
/begin MEASUREMENT rba_Runtime_MonTask_ast[20].ctSampleProcessed_u8 "rba_Runtime Measurement Variable[20]/" UBYTE RB_RBA_Common_CentralElements_CompuMethods_Identical 1 100 0.0 255. FORMAT "%5.0" ECU_ADDRESS 0x40007A02 /end MEASUREMENT
/begin MEASUREMENT rba_Runtime_MonTask_ast[21].ctSampleProcessed_u8 "rba_Runtime Measurement Variable[21]/" UBYTE RB_RBA_Common_CentralElements_CompuMethods_Identical 1 100 0.0 255. FORMAT "%5.0" ECU_ADDRESS 0x40007A36 /end MEASUREMENT
/begin MEASUREMENT rba_Runtime_MonTask_ast[22].ctSampleProcessed_u8 "rba_Runtime Measurement Variable[22]/" UBYTE RB_RBA_Common_CentralElements_CompuMethods_Identical 1 100 0.0 255. FORMAT "%5.0" ECU_ADDRESS 0x40007A6A /end MEASUREMENT
/begin MEASUREMENT rba_Runtime_MonTask_ast[23].ctSampleProcessed_u8 "rba_Runtime Measurement Variable[23]/" UBYTE RB_RBA_Common_CentralElements_CompuMethods_Identical 1 100 0.0 255. FORMAT "%5.0" ECU_ADDRESS 0x40007A9E /end MEASUREMENT
/begin MEASUREMENT rba_Runtime_MonTask_ast[24].ctSampleProcessed_u8 "rba_Runtime Measurement Variable[24]/" UBYTE RB_RBA_Common_CentralElements_CompuMethods_Identical 1 100 0.0 255. FORMAT "%5.0" ECU_ADDRESS 0x40007AD2 /end MEASUREMENT
/begin MEASUREMENT rba_Runtime_MonTask_ast[25].ctSampleProcessed_u8 "rba_Runtime Measurement Variable[25]/" UBYTE RB_RBA_Common_CentralElements_CompuMethods_Identical 1 100 0.0 255. FORMAT "%5.0" ECU_ADDRESS 0x40007B06 /end MEASUREMENT
/begin MEASUREMENT rba_Runtime_MonTask_ast[26].ctSampleProcessed_u8 "rba_Runtime Measurement Variable[26]/" UBYTE RB_RBA_Common_CentralElements_CompuMethods_Identical 1 100 0.0 255. FORMAT "%5.0" ECU_ADDRESS 0x40007B3A /end MEASUREMENT
/begin MEASUREMENT rba_Runtime_MonTask_ast[27].ctSampleProcessed_u8 "rba_Runtime Measurement Variable[27]/" UBYTE RB_RBA_Common_CentralElements_CompuMethods_Identical 1 100 0.0 255. FORMAT "%5.0" ECU_ADDRESS 0x40007B6E /end MEASUREMENT
/begin MEASUREMENT rba_Runtime_MonTask_ast[28].ctSampleProcessed_u8 "rba_Runtime Measurement Variable[28]/" UBYTE RB_RBA_Common_CentralElements_CompuMethods_Identical 1 100 0.0 255. FORMAT "%5.0" ECU_ADDRESS 0x40007BA2 /end MEASUREMENT
/begin MEASUREMENT rba_Runtime_MonTask_ast[29].ctSampleProcessed_u8 "rba_Runtime Measurement Variable[29]/" UBYTE RB_RBA_Common_CentralElements_CompuMethods_Identical 1 100 0.0 255. FORMAT "%5.0" ECU_ADDRESS 0x40007BD6 /end MEASUREMENT
/begin MEASUREMENT rba_Runtime_MonTask_ast[30].ctSampleProcessed_u8 "rba_Runtime Measurement Variable[30]/" UBYTE RB_RBA_Common_CentralElements_CompuMethods_Identical 1 100 0.0 255. FORMAT "%5.0" ECU_ADDRESS 0x40007C0A /end MEASUREMENT
/begin MEASUREMENT rba_Runtime_MonTask_ast[31].ctSampleProcessed_u8 "rba_Runtime Measurement Variable[31]/" UBYTE RB_RBA_Common_CentralElements_CompuMethods_Identical 1 100 0.0 255. FORMAT "%5.0" ECU_ADDRESS 0x40007C3E /end MEASUREMENT
/begin MEASUREMENT rba_Runtime_MonTask_ast[32].ctSampleProcessed_u8 "rba_Runtime Measurement Variable[32]/" UBYTE RB_RBA_Common_CentralElements_CompuMethods_Identical 1 100 0.0 255. FORMAT "%5.0" ECU_ADDRESS 0x40007C72 /end MEASUREMENT
/begin MEASUREMENT rba_Runtime_MonTask_ast[33].ctSampleProcessed_u8 "rba_Runtime Measurement Variable[33]/" UBYTE RB_RBA_Common_CentralElements_CompuMethods_Identical 1 100 0.0 255. FORMAT "%5.0" ECU_ADDRESS 0x40007CA6 /end MEASUREMENT
/begin MEASUREMENT rba_Runtime_MonTask_ast[34].ctSampleProcessed_u8 "rba_Runtime Measurement Variable[34]/" UBYTE RB_RBA_Common_CentralElements_CompuMethods_Identical 1 100 0.0 255. FORMAT "%5.0" ECU_ADDRESS 0x40007CDA /end MEASUREMENT
/begin MEASUREMENT rba_Runtime_MonTask_ast[35].ctSampleProcessed_u8 "rba_Runtime Measurement Variable[35]/" UBYTE RB_RBA_Common_CentralElements_CompuMethods_Identical 1 100 0.0 255. FORMAT "%5.0" ECU_ADDRESS 0x40007D0E /end MEASUREMENT
/begin MEASUREMENT rba_Runtime_MonTask_ast[36].ctSampleProcessed_u8 "rba_Runtime Measurement Variable[36]/" UBYTE RB_RBA_Common_CentralElements_CompuMethods_Identical 1 100 0.0 255. FORMAT "%5.0" ECU_ADDRESS 0x40007D42 /end MEASUREMENT
/begin MEASUREMENT rba_Runtime_MonTask_ast[37].ctSampleProcessed_u8 "rba_Runtime Measurement Variable[37]/" UBYTE RB_RBA_Common_CentralElements_CompuMethods_Identical 1 100 0.0 255. FORMAT "%5.0" ECU_ADDRESS 0x40007D76 /end MEASUREMENT
/begin MEASUREMENT rba_Runtime_Output_st.cores_ast[0].results_ast[0].tiAvrgRT_u32 "rba_Runtime Measurement Variable/[0]/[0]/" ULONG RB_RBA_rba_Runtime_CompuMethods_rba_Runtime_Time 1 100 0.0 4.E9 FORMAT "%5.0" ECU_ADDRESS 0x400073D0 /end MEASUREMENT
/begin MEASUREMENT rba_Runtime_Output_st.cores_ast[0].results_ast[0].tiMinRT_u32 "rba_Runtime Measurement Variable/[0]/[0]/" ULONG RB_RBA_rba_Runtime_CompuMethods_rba_Runtime_Time 1 100 0.0 4.E9 FORMAT "%5.0" ECU_ADDRESS 0x400073D4 /end MEASUREMENT
/begin MEASUREMENT rba_Runtime_Output_st.cores_ast[0].results_ast[0].tiMaxRT_u32 "rba_Runtime Measurement Variable/[0]/[0]/" ULONG RB_RBA_rba_Runtime_CompuMethods_rba_Runtime_Time 1 100 0.0 4.E9 FORMAT "%5.0" ECU_ADDRESS 0x400073D8 /end MEASUREMENT
/begin MEASUREMENT rba_Runtime_Output_st.cores_ast[0].results_ast[0].tiAvrgCD_u32 "rba_Runtime Measurement Variable/[0]/[0]/" ULONG RB_RBA_rba_Runtime_CompuMethods_rba_Runtime_Time 1 100 0.0 4.E9 FORMAT "%5.0" ECU_ADDRESS 0x400073DC /end MEASUREMENT
/begin MEASUREMENT rba_Runtime_Output_st.cores_ast[0].results_ast[0].tiMinCD_u32 "rba_Runtime Measurement Variable/[0]/[0]/" ULONG RB_RBA_rba_Runtime_CompuMethods_rba_Runtime_Time 1 100 0.0 4.E9 FORMAT "%5.0" ECU_ADDRESS 0x400073E0 /end MEASUREMENT
/begin MEASUREMENT rba_Runtime_Output_st.cores_ast[0].results_ast[0].tiMaxCD_u32 "rba_Runtime Measurement Variable/[0]/[0]/" ULONG RB_RBA_rba_Runtime_CompuMethods_rba_Runtime_Time 1 100 0.0 4.E9 FORMAT "%5.0" ECU_ADDRESS 0x400073E4 /end MEASUREMENT
/begin MEASUREMENT rba_Runtime_Output_st.cores_ast[0].results_ast[0].ctCalls_u32 "rba_Runtime Measurement Variable/[0]/[0]/" ULONG RB_RBA_Common_CentralElements_CompuMethods_Identical 1 100 0.0 4.E9 FORMAT "%5.0" ECU_ADDRESS 0x400073E8 /end MEASUREMENT
/begin MEASUREMENT rba_Runtime_Output_st.cores_ast[0].results_ast[0].ctReentCalls_u32 "rba_Runtime Measurement Variable/[0]/[0]/" ULONG RB_RBA_Common_CentralElements_CompuMethods_Identical 1 100 0.0 4.E9 FORMAT "%5.0" ECU_ADDRESS 0x400073EC /end MEASUREMENT
/begin MEASUREMENT rba_Runtime_Output_st.cores_ast[0].tiSampleDuration_u32 "rba_Runtime Measurement Variable/[0]/" ULONG RB_RBA_rba_Runtime_CompuMethods_rba_Runtime_Time 1 100 0.0 4.E9 FORMAT "%5.0" ECU_ADDRESS 0x400073F0 /end MEASUREMENT
/begin MEASUREMENT rba_Runtime_Output_st.ctSample_u8 "rba_Runtime Measurement Variable/" UBYTE RB_RBA_Common_CentralElements_CompuMethods_Identical 1 100 0.0 255. FORMAT "%5.0" ECU_ADDRESS 0x400073F4 /end MEASUREMENT
/begin MEASUREMENT rba_SyC_EcuOffTime_Validity_MP "Indicate the validity of the ECU Off Time" UBYTE RB_RBA_rba_SyC_BswModuleDescriptions_rba_SyC_EcuOffTime_CompuMethod 1 100 0.0 11.000 FORMAT "%8.3" ECU_ADDRESS 0x40009ED9
 /begin ANNOTATION ANNOTATION_LABEL "Description (coming from AUTOSAR DESC field)" /begin ANNOTATION_TEXT "Indicate the validity of the ECU Off Time\r\n" /end ANNOTATION_TEXT /end ANNOTATION
/end MEASUREMENT
/begin MEASUREMENT rba_SyC_EcuOffTime_Value_MP "ECU Off Time in seconds" ULONG DefaultIdenticalCompu 1 100 0.0 4.294967295E9 ECU_ADDRESS 0x40009EA0
 /begin ANNOTATION ANNOTATION_LABEL "Description (coming from AUTOSAR DESC field)" /begin ANNOTATION_TEXT "ECU Off Time in seconds\r\n" /end ANNOTATION_TEXT /end ANNOTATION
/end MEASUREMENT
/begin MEASUREMENT rba_SyC_ObservationCounters_IrrSwOffTrigEngRun_Value_MP "ObservationCounter: Irregular Switch Off Counter Triggered by Engine Running" UBYTE DefaultIdenticalCompu 1 100 0.0 255.0 ECU_ADDRESS 0x40009EDA
 /begin ANNOTATION ANNOTATION_LABEL "Description (coming from AUTOSAR DESC field)"
  /begin ANNOTATION_TEXT "ObservationCounter: Irregular Switch Off Counter Triggered by Engine Running\r\n" /end ANNOTATION_TEXT
 /end ANNOTATION
/end MEASUREMENT
/begin MEASUREMENT rba_SyC_ObservationCounters_IrrSwOff_Value_MP "ObservationCounter: Irregular SwitchOff Counter" UBYTE DefaultIdenticalCompu 1 100 0.0 255.0 ECU_ADDRESS 0x40009EDB
 /begin ANNOTATION ANNOTATION_LABEL "Description (coming from AUTOSAR DESC field)" /begin ANNOTATION_TEXT "ObservationCounter: Irregular SwitchOff Counter\r\n" /end ANNOTATION_TEXT /end ANNOTATION
/end MEASUREMENT
/begin MEASUREMENT rba_SyC_PowerOn_Reasons_MP "Switch on reasons of the ECU" UBYTE DefaultIdenticalCompu 1 100 0.0 255.0 ECU_ADDRESS 0x40009EA9
 /begin ANNOTATION ANNOTATION_LABEL "Description (coming from AUTOSAR DESC field)" /begin ANNOTATION_TEXT "Switch on reasons of the ECU\r\n" /end ANNOTATION_TEXT /end ANNOTATION
/end MEASUREMENT
/begin MEASUREMENT rba_SyC_States_CurrentState_MP "Current state of System Control" UBYTE RB_RBA_rba_SyC_BswModuleDescriptions_rba_SyC_States_CompuMethod 1 100 0.0 7.000 FORMAT "%8.3" ECU_ADDRESS 0x40009EAB
 /begin ANNOTATION ANNOTATION_LABEL "Description (coming from AUTOSAR DESC field)" /begin ANNOTATION_TEXT "Current state of System Control\r\n" /end ANNOTATION_TEXT /end ANNOTATION
/end MEASUREMENT
/begin MEASUREMENT rba_SyC_States_PostDrive_TimeoutHistoryBegin_MP "Timeout history for PostDrive Begin" UBYTE DefaultIdenticalCompu 1 100 0.0 255.0 ECU_ADDRESS 0x40009EAE
 /begin ANNOTATION ANNOTATION_LABEL "Description (coming from AUTOSAR DESC field)" /begin ANNOTATION_TEXT "Timeout history for PostDrive Begin\r\n" /end ANNOTATION_TEXT /end ANNOTATION
/end MEASUREMENT
/begin MEASUREMENT rba_SyC_States_PostDrive_TimeoutHistoryEnd_MP "Timeout history for PostDrive End" UBYTE DefaultIdenticalCompu 1 100 0.0 255.0 ECU_ADDRESS 0x40009EAC
 /begin ANNOTATION ANNOTATION_LABEL "Description (coming from AUTOSAR DESC field)" /begin ANNOTATION_TEXT "Timeout history for PostDrive End\r\n" /end ANNOTATION_TEXT /end ANNOTATION
/end MEASUREMENT
/begin MEASUREMENT rba_SyC_States_PostDrive_TimeoutHistoryNetwork_MP "Timeout history for PostDrive Network" UBYTE DefaultIdenticalCompu 1 100 0.0 255.0 ECU_ADDRESS 0x40009EAD
 /begin ANNOTATION ANNOTATION_LABEL "Description (coming from AUTOSAR DESC field)" /begin ANNOTATION_TEXT "Timeout history for PostDrive Network\r\n" /end ANNOTATION_TEXT /end ANNOTATION
/end MEASUREMENT
/begin MEASUREMENT rba_SyC_States_PostDrive_substate_MP "Sub-state of System Control state PostDrive" UBYTE RB_RBA_rba_SyC_BswModuleDescriptions_rba_SyC_States_PostDrive_CompuMethod 1 100 0.0 9.000 FORMAT "%8.3" ECU_ADDRESS 0x40009EB1
 /begin ANNOTATION ANNOTATION_LABEL "Description (coming from AUTOSAR DESC field)" /begin ANNOTATION_TEXT "Sub-state of System Control state PostDrive\r\n" /end ANNOTATION_TEXT /end ANNOTATION
/end MEASUREMENT
/begin MEASUREMENT rba_SyC_States_PrepareDrive_substate_MP "Sub-state of System Control state PrepareDrive" UBYTE RB_RBA_rba_SyC_BswModuleDescriptions_rba_SyC_States_PrepareDrive_CompuMethod 1 100 0.0 3.000 FORMAT "%8.3" ECU_ADDRESS 0x40009EB2
 /begin ANNOTATION ANNOTATION_LABEL "Description (coming from AUTOSAR DESC field)" /begin ANNOTATION_TEXT "Sub-state of System Control state PrepareDrive\r\n" /end ANNOTATION_TEXT /end ANNOTATION
/end MEASUREMENT
/begin MEASUREMENT rba_SyC_States_PrepareShutdown_TimeoutHistoryComplete_MP "Timeout history for PrepareShutdown Complete" UBYTE DefaultIdenticalCompu 1 100 0.0 255.0 ECU_ADDRESS 0x40009EB3
 /begin ANNOTATION ANNOTATION_LABEL "Description (coming from AUTOSAR DESC field)" /begin ANNOTATION_TEXT "Timeout history for PrepareShutdown Complete\r\n" /end ANNOTATION_TEXT /end ANNOTATION
/end MEASUREMENT
/begin MEASUREMENT rba_SyC_States_PrepareShutdown_substate_MP "Sub-state of System Control state PrepareShutdown" UBYTE RB_RBA_rba_SyC_BswModuleDescriptions_rba_SyC_States_PrepareShutdown_CompuMethod 1 100 0.0 6.000 FORMAT "%8.3" ECU_ADDRESS 0x40009EB5
 /begin ANNOTATION ANNOTATION_LABEL "Description (coming from AUTOSAR DESC field)" /begin ANNOTATION_TEXT "Sub-state of System Control state PrepareShutdown\r\n" /end ANNOTATION_TEXT /end ANNOTATION
/end MEASUREMENT
/begin MEASUREMENT rba_SyC_States_PreviousState_MP "Previous state of System Control" UBYTE RB_RBA_rba_SyC_BswModuleDescriptions_rba_SyC_States_CompuMethod 1 100 0.0 7.000 FORMAT "%8.3" ECU_ADDRESS 0x40009EAA
 /begin ANNOTATION ANNOTATION_LABEL "Description (coming from AUTOSAR DESC field)" /begin ANNOTATION_TEXT "Previous state of System Control\r\n" /end ANNOTATION_TEXT /end ANNOTATION
/end MEASUREMENT
/begin MEASUREMENT rba_SyC_States_Wait_TimeoutHistoryDelay_MP "Timeout history for Wait Delay" UBYTE DefaultIdenticalCompu 1 100 0.0 255.0 ECU_ADDRESS 0x40009EB6
 /begin ANNOTATION ANNOTATION_LABEL "Description (coming from AUTOSAR DESC field)" /begin ANNOTATION_TEXT "Timeout history for Wait Delay\r\n" /end ANNOTATION_TEXT /end ANNOTATION
/end MEASUREMENT
/begin MEASUREMENT rba_SyC_States_Wait_TimeoutHistoryNetwork_MP "Timeout history for Wait Network" UBYTE DefaultIdenticalCompu 1 100 0.0 255.0 ECU_ADDRESS 0x40009EB7
 /begin ANNOTATION ANNOTATION_LABEL "Description (coming from AUTOSAR DESC field)" /begin ANNOTATION_TEXT "Timeout history for Wait Network\r\n" /end ANNOTATION_TEXT /end ANNOTATION
/end MEASUREMENT
/begin MEASUREMENT rba_SyC_States_Wait_TimeoutHistoryProlong_MP "Timeout history for Wait Prolong" UBYTE DefaultIdenticalCompu 1 100 0.0 255.0 ECU_ADDRESS 0x40009EB8
 /begin ANNOTATION ANNOTATION_LABEL "Description (coming from AUTOSAR DESC field)" /begin ANNOTATION_TEXT "Timeout history for Wait Prolong\r\n" /end ANNOTATION_TEXT /end ANNOTATION
/end MEASUREMENT
/begin MEASUREMENT rba_SyC_States_Wait_substate_MP "Sub-state of System Control state Wait" UBYTE RB_RBA_rba_SyC_BswModuleDescriptions_rba_SyC_States_Wait_CompuMethod 1 100 0.0 5.000 FORMAT "%8.3" ECU_ADDRESS 0x40009EBD
 /begin ANNOTATION ANNOTATION_LABEL "Description (coming from AUTOSAR DESC field)" /begin ANNOTATION_TEXT "Sub-state of System Control state Wait\r\n" /end ANNOTATION_TEXT /end ANNOTATION
/end MEASUREMENT
/begin MEASUREMENT rba_SyC_tiBoot_us_MP "Time elapsed for BOOT State in micro seconds" ULONG DefaultIdenticalCompu 1 100 0.0 4.294967295E9 ECU_ADDRESS 0x40009E9C
 /begin ANNOTATION ANNOTATION_LABEL "Description (coming from AUTOSAR DESC field)" /begin ANNOTATION_TEXT "Time elapsed for BOOT State in micro seconds\r\n" /end ANNOTATION_TEXT /end ANNOTATION
/end MEASUREMENT
/begin MEASUREMENT rba_SyC_tiDrive_10ms_MP "Time elapsed for Drive State in 10 milli seconds" ULONG DefaultIdenticalCompu 1 100 0.0 4.294967295E9 ECU_ADDRESS 0x40009E8C
 /begin ANNOTATION ANNOTATION_LABEL "Description (coming from AUTOSAR DESC field)" /begin ANNOTATION_TEXT "Time elapsed for Drive State in 10 milli seconds\r\n" /end ANNOTATION_TEXT /end ANNOTATION
/end MEASUREMENT
/begin MEASUREMENT rba_SyC_tiInit_us_MP "Time elapsed for Init State in micro seconds" ULONG DefaultIdenticalCompu 1 100 0.0 4.294967295E9 ECU_ADDRESS 0x40009E98
 /begin ANNOTATION ANNOTATION_LABEL "Description (coming from AUTOSAR DESC field)" /begin ANNOTATION_TEXT "Time elapsed for Init State in micro seconds\r\n" /end ANNOTATION_TEXT /end ANNOTATION
/end MEASUREMENT
/begin MEASUREMENT rba_SyC_tiLastShutdown_us_MP "Time elapsed for Last Shutdown State in micro seconds" ULONG DefaultIdenticalCompu 1 100 0.0 4.294967295E9 ECU_ADDRESS 0x40009E80
 /begin ANNOTATION ANNOTATION_LABEL "Description (coming from AUTOSAR DESC field)" /begin ANNOTATION_TEXT "Time elapsed for Shutdown State in micro seconds\r\n" /end ANNOTATION_TEXT /end ANNOTATION
/end MEASUREMENT
/begin MEASUREMENT rba_SyC_tiPostDrive_10ms_MP "Time elapsed for Post Drive State in 10 milli seconds" ULONG DefaultIdenticalCompu 1 100 0.0 4.294967295E9 ECU_ADDRESS 0x40009E88
 /begin ANNOTATION ANNOTATION_LABEL "Description (coming from AUTOSAR DESC field)"
  /begin ANNOTATION_TEXT "Time elapsed for Post Drive State in 10 milli seconds\r\n" /end ANNOTATION_TEXT
 /end ANNOTATION
/end MEASUREMENT
/begin MEASUREMENT rba_SyC_tiPrepareDrive_10ms_MP "Time elapsed for Prepare drive State in 10 milli seconds" ULONG DefaultIdenticalCompu 1 100 0.0 4.294967295E9 ECU_ADDRESS 0x40009E90
 /begin ANNOTATION ANNOTATION_LABEL "Description (coming from AUTOSAR DESC field)"
  /begin ANNOTATION_TEXT "Time elapsed for Prepare drive State in 10 milli seconds\r\n" /end ANNOTATION_TEXT
 /end ANNOTATION
/end MEASUREMENT
/begin MEASUREMENT rba_SyC_tiPrepareShutdown_10ms_MP "Time elapsed for Prepare Shutdown State in 10 milli seconds" ULONG DefaultIdenticalCompu 1 100 0.0 4.294967295E9 ECU_ADDRESS 0x40009E84
 /begin ANNOTATION ANNOTATION_LABEL "Description (coming from AUTOSAR DESC field)"
  /begin ANNOTATION_TEXT "Time elapsed for Prepare Shutdown State in 10 milli seconds\r\n" /end ANNOTATION_TEXT
 /end ANNOTATION
/end MEASUREMENT
/begin MEASUREMENT rba_SyC_tiWait_10ms_MP "Time elapsed for Wait State in 10 milli seconds" ULONG DefaultIdenticalCompu 1 100 0.0 4.294967295E9 ECU_ADDRESS 0x40009E94
 /begin ANNOTATION ANNOTATION_LABEL "Description (coming from AUTOSAR DESC field)" /begin ANNOTATION_TEXT "Time elapsed for Wait State in 10 milli seconds\r\n" /end ANNOTATION_TEXT /end ANNOTATION
/end MEASUREMENT
/begin MEASUREMENT rba_T15_Signal_Debounced_MP "Debounced signal status of Terminal 15" UBYTE RB_RBA_rba_T15_BswModuleDescriptions_rba_T15_Signal_Status_CompuMethod 1 100 0.0 1.000 FORMAT "%8.3" ECU_ADDRESS 0x40009ED7
 /begin ANNOTATION ANNOTATION_LABEL "Description (coming from AUTOSAR DESC field)" /begin ANNOTATION_TEXT "Debounced signal status of Terminal 15\r\n" /end ANNOTATION_TEXT /end ANNOTATION
/end MEASUREMENT
/begin MEASUREMENT rba_T15_Signal_Logical_MP "Logical signal status of Terminal 15" UBYTE RB_RBA_rba_T15_BswModuleDescriptions_rba_T15_Signal_Status_CompuMethod 1 100 0.0 1.000 FORMAT "%8.3" ECU_ADDRESS 0x40009ED8
 /begin ANNOTATION ANNOTATION_LABEL "Description (coming from AUTOSAR DESC field)" /begin ANNOTATION_TEXT "Logical signal status of Terminal 15\r\n" /end ANNOTATION_TEXT /end ANNOTATION
/end MEASUREMENT
/begin MEASUREMENT rba_T15_Signal_UndebouncedValid_MP "Validity of undebounced signal status of Terminal 15" UBYTE RB_RBA_rba_T15_BswModuleDescriptions_rba_T15_Signal_StatusValid_CompuMethod 1 100 0.0 1.000 FORMAT "%8.3" ECU_ADDRESS 0x40009ED5
 /begin ANNOTATION ANNOTATION_LABEL "Description (coming from AUTOSAR DESC field)" /begin ANNOTATION_TEXT "Validity of undebounced signal status of Terminal 15\r\n" /end ANNOTATION_TEXT /end ANNOTATION
/end MEASUREMENT
/begin MEASUREMENT rba_T15_Signal_Undebounced_MP "Undebounced signal status of Terminal 15" UBYTE RB_RBA_rba_T15_BswModuleDescriptions_rba_T15_Signal_Status_CompuMethod 1 100 0.0 1.000 FORMAT "%8.3" ECU_ADDRESS 0x40009ED6
 /begin ANNOTATION ANNOTATION_LABEL "Description (coming from AUTOSAR DESC field)" /begin ANNOTATION_TEXT "Undebounced signal status of Terminal 15\r\n" /end ANNOTATION_TEXT /end ANNOTATION
/end MEASUREMENT
/begin MEASUREMENT B_ekp "Release of EKP-supply" UBYTE B_TRUE 1 100 0.00 1.00000000000 BIT_MASK 0x1 FORMAT "%13.11" ECU_ADDRESS 0x400087B9
 /begin IF_DATA XCPplus 0x0102
  /begin DAQ_EVENT VARIABLE /begin AVAILABLE_EVENT_LIST EVENT 0 EVENT 1 EVENT 2 EVENT 3 /end AVAILABLE_EVENT_LIST /begin DEFAULT_EVENT_LIST EVENT 1 /end DEFAULT_EVENT_LIST /end DAQ_EVENT
 /end IF_DATA
/end MEASUREMENT
/begin MEASUREMENT dekpe "Statusbyte diagnosis EKP output stage" UBYTE dez 1 100 0.00 255.0 FORMAT "%5.1" ECU_ADDRESS 0x400087BB
 /begin IF_DATA XCPplus 0x0102
  /begin DAQ_EVENT VARIABLE /begin AVAILABLE_EVENT_LIST EVENT 0 EVENT 1 EVENT 2 EVENT 3 /end AVAILABLE_EVENT_LIST /begin DEFAULT_EVENT_LIST EVENT 2 /end DEFAULT_EVENT_LIST /end DAQ_EVENT
 /end IF_DATA
/end MEASUREMENT
/begin MEASUREMENT ekppz "Power stage diagnostic EKP relay: counter test puls trigger" UBYTE dez 1 100 0.00 255.0 FORMAT "%5.1" ECU_ADDRESS 0x400087BA
 /begin IF_DATA XCPplus 0x0102
  /begin DAQ_EVENT VARIABLE /begin AVAILABLE_EVENT_LIST EVENT 0 EVENT 1 EVENT 2 EVENT 3 /end AVAILABLE_EVENT_LIST /begin DEFAULT_EVENT_LIST EVENT 2 /end DEFAULT_EVENT_LIST /end DAQ_EVENT
 /end IF_DATA
/end MEASUREMENT
/begin MEASUREMENT udss_w "Voltage pressure sensor manifold pressure (word)" UWORD spg_uw_q0p00488 1 100 0.00 319.9951 FORMAT "%8.4" ECU_ADDRESS 0x400083C0 /end MEASUREMENT
/begin MEASUREMENT uneutgear_w "Neutral Raw voltage" UWORD spg_uw_q0p00488 1 100 0.00 319.9951 FORMAT "%8.4" ECU_ADDRESS 0x400083BE /end MEASUREMENT
/begin MEASUREMENT uquickshiftr_w "quickshift sensor voltage" UWORD spg_uw_q0p00488 1 100 0.00 319.9951 FORMAT "%8.4" ECU_ADDRESS 0x400083BC /end MEASUREMENT
/begin MEASUREMENT urovs_w "Tilt sensor voltage" UWORD spg_uw_q0p00488 1 100 0.00 319.9951 FORMAT "%8.4" ECU_ADDRESS 0x400083BA /end MEASUREMENT
/begin MEASUREMENT usdst_w "Side stand sensor voltage" UWORD spg_uw_q0p00488 1 100 0.00 319.9951 FORMAT "%8.4" ECU_ADDRESS 0x400083B8 /end MEASUREMENT
/begin MEASUREMENT uwdk_w "ADC-signal throttle angle 16 bit" UWORD spg_uw_q0p001222 1 100 0.00 79.99878 FORMAT "%8.5" ECU_ADDRESS 0x400083B6 /end MEASUREMENT
/begin MEASUREMENT wtans "ADC-value for intake air temperature tans" UBYTE spg_ub_q0p019 1 100 0.00 4.980 FORMAT "%5.3" ECU_ADDRESS 0x400087B8 /end MEASUREMENT
/begin MEASUREMENT wtmot_w "ADC result of engine temperature sensor 10 bit" UWORD spg_uw_q0p00488 1 100 0.00 319.9951 FORMAT "%8.4" ECU_ADDRESS 0x400083B4 /end MEASUREMENT
/begin MEASUREMENT wub "battery voltage; scanned value of ADC" UBYTE spg_ubatt 1 100 0.00 17.95 FORMAT "%5.2" ECU_ADDRESS 0x400087B7 /end MEASUREMENT
/begin FUNCTION rba_Runtime "McFunction rba_Runtime Created by MCFunctionUpdater"
 /begin LOC_MEASUREMENT rba_Runtime_Input_st.configs_ast[0].idElement_u32 rba_Runtime_Input_st.configs_ast[0].idTask_u16 rba_Runtime_Input_st.ctTrigger_u8 rba_Runtime_Input_st.tiSampleTime_u8 rba_Runtime_MonIsr_ast[0].ctCallsTotal_u32 rba_Runtime_MonIsr_ast[0].ctCalls_u32 rba_Runtime_MonIsr_ast[0].ctSampleProcessed_u8 rba_Runtime_MonIsr_ast[0].internal_st.ctBeginCalls_u32 rba_Runtime_MonIsr_ast[0].internal_st.tiAccuRT_u32 rba_Runtime_MonIsr_ast[0].internal_st.tiBeginFree_u32 rba_Runtime_MonIsr_ast[0].loadPer64k_u16 rba_Runtime_MonIsr_ast[0].tiAvrgRT_u32 rba_Runtime_MonIsr_ast[0].tiCurRT_u32 rba_Runtime_MonIsr_ast[0].tiMaxRT_u32 rba_Runtime_MonIsr_ast[0].tiMinRT_u32 rba_Runtime_MonIsr_ast[1].ctCallsTotal_u32 rba_Runtime_MonIsr_ast[1].ctCalls_u32 rba_Runtime_MonIsr_ast[1].ctSampleProcessed_u8 rba_Runtime_MonIsr_ast[1].internal_st.ctBeginCalls_u32 rba_Runtime_MonIsr_ast[1].internal_st.tiAccuRT_u32 rba_Runtime_MonIsr_ast[1].internal_st.tiBeginFree_u32 rba_Runtime_MonIsr_ast[1].loadPer64k_u16 rba_Runtime_MonIsr_ast[1].tiAvrgRT_u32 rba_Runtime_MonIsr_ast[1].tiCurRT_u32 rba_Runtime_MonIsr_ast[1].tiMaxRT_u32 rba_Runtime_MonIsr_ast[1].tiMinRT_u32 rba_Runtime_MonTask_ast[0].ctCallsTotal_u32 rba_Runtime_MonTask_ast[0].ctCalls_u32 rba_Runtime_MonTask_ast[0].ctSampleProcessed_u8 rba_Runtime_MonTask_ast[0].internal_st.ctBeginCalls_u32 rba_Runtime_MonTask_ast[0].internal_st.tiAccuRT_u32 rba_Runtime_MonTask_ast[0].internal_st.tiBeginFree_u32 rba_Runtime_MonTask_ast[0].loadPer64k_u16 rba_Runtime_MonTask_ast[0].tiAvrgRT_u32 rba_Runtime_MonTask_ast[0].tiCurRT_u32 rba_Runtime_MonTask_ast[0].tiCurResponseT_u32 rba_Runtime_MonTask_ast[0].tiMaxRT_u32 rba_Runtime_MonTask_ast[0].tiMaxResponseT_u32 rba_Runtime_MonTask_ast[0].tiMinRT_u32 rba_Runtime_MonTask_ast[0].tiMinResponseT_u32 rba_Runtime_MonTask_ast[10].ctCallsTotal_u32 rba_Runtime_MonTask_ast[10].ctCalls_u32 rba_Runtime_MonTask_ast[10].ctSampleProcessed_u8 rba_Runtime_MonTask_ast[10].internal_st.ctBeginCalls_u32 rba_Runtime_MonTask_ast[10].internal_st.tiAccuRT_u32 rba_Runtime_MonTask_ast[10].internal_st.tiBeginFree_u32 rba_Runtime_MonTask_ast[10].loadPer64k_u16 rba_Runtime_MonTask_ast[10].tiAvrgRT_u32 rba_Runtime_MonTask_ast[10].tiCurRT_u32 rba_Runtime_MonTask_ast[10].tiCurResponseT_u32 rba_Runtime_MonTask_ast[10].tiMaxRT_u32 rba_Runtime_MonTask_ast[10].tiMaxResponseT_u32 rba_Runtime_MonTask_ast[10].tiMinRT_u32 rba_Runtime_MonTask_ast[10].tiMinResponseT_u32 rba_Runtime_MonTask_ast[11].ctCallsTotal_u32 rba_Runtime_MonTask_ast[11].ctCalls_u32 rba_Runtime_MonTask_ast[11].ctSampleProcessed_u8 rba_Runtime_MonTask_ast[11].internal_st.ctBeginCalls_u32 rba_Runtime_MonTask_ast[11].internal_st.tiAccuRT_u32 rba_Runtime_MonTask_ast[11].internal_st.tiBeginFree_u32 rba_Runtime_MonTask_ast[11].loadPer64k_u16 rba_Runtime_MonTask_ast[11].tiAvrgRT_u32 rba_Runtime_MonTask_ast[11].tiCurRT_u32 rba_Runtime_MonTask_ast[11].tiCurResponseT_u32 rba_Runtime_MonTask_ast[11].tiMaxRT_u32 rba_Runtime_MonTask_ast[11].tiMaxResponseT_u32 rba_Runtime_MonTask_ast[11].tiMinRT_u32 rba_Runtime_MonTask_ast[11].tiMinResponseT_u32 rba_Runtime_MonTask_ast[12].ctCallsTotal_u32 rba_Runtime_MonTask_ast[12].ctCalls_u32 rba_Runtime_MonTask_ast[12].ctSampleProcessed_u8 rba_Runtime_MonTask_ast[12].internal_st.ctBeginCalls_u32 rba_Runtime_MonTask_ast[12].internal_st.tiAccuRT_u32 rba_Runtime_MonTask_ast[12].internal_st.tiBeginFree_u32 rba_Runtime_MonTask_ast[12].loadPer64k_u16 rba_Runtime_MonTask_ast[12].tiAvrgRT_u32 rba_Runtime_MonTask_ast[12].tiCurRT_u32 rba_Runtime_MonTask_ast[12].tiCurResponseT_u32 rba_Runtime_MonTask_ast[12].tiMaxRT_u32 rba_Runtime_MonTask_ast[12].tiMaxResponseT_u32 rba_Runtime_MonTask_ast[12].tiMinRT_u32 rba_Runtime_MonTask_ast[12].tiMinResponseT_u32 rba_Runtime_MonTask_ast[13].ctCallsTotal_u32 rba_Runtime_MonTask_ast[13].ctCalls_u32 rba_Runtime_MonTask_ast[13].ctSampleProcessed_u8 rba_Runtime_MonTask_ast[13].internal_st.ctBeginCalls_u32 rba_Runtime_MonTask_ast[13].internal_st.tiAccuRT_u32 rba_Runtime_MonTask_ast[13].internal_st.tiBeginFree_u32 rba_Runtime_MonTask_ast[13].loadPer64k_u16 rba_Runtime_MonTask_ast[13].tiAvrgRT_u32 rba_Runtime_MonTask_ast[13].tiCurRT_u32 rba_Runtime_MonTask_ast[13].tiCurResponseT_u32 rba_Runtime_MonTask_ast[13].tiMaxRT_u32 rba_Runtime_MonTask_ast[13].tiMaxResponseT_u32 rba_Runtime_MonTask_ast[13].tiMinRT_u32 rba_Runtime_MonTask_ast[13].tiMinResponseT_u32 rba_Runtime_MonTask_ast[14].ctCallsTotal_u32 rba_Runtime_MonTask_ast[14].ctCalls_u32 rba_Runtime_MonTask_ast[14].ctSampleProcessed_u8 rba_Runtime_MonTask_ast[14].internal_st.ctBeginCalls_u32 rba_Runtime_MonTask_ast[14].internal_st.tiAccuRT_u32 rba_Runtime_MonTask_ast[14].internal_st.tiBeginFree_u32 rba_Runtime_MonTask_ast[14].loadPer64k_u16 rba_Runtime_MonTask_ast[14].tiAvrgRT_u32 rba_Runtime_MonTask_ast[14].tiCurRT_u32 rba_Runtime_MonTask_ast[14].tiCurResponseT_u32 rba_Runtime_MonTask_ast[14].tiMaxRT_u32 rba_Runtime_MonTask_ast[14].tiMaxResponseT_u32 rba_Runtime_MonTask_ast[14].tiMinRT_u32 rba_Runtime_MonTask_ast[14].tiMinResponseT_u32 rba_Runtime_MonTask_ast[15].ctCallsTotal_u32 rba_Runtime_MonTask_ast[15].ctCalls_u32 rba_Runtime_MonTask_ast[15].ctSampleProcessed_u8 rba_Runtime_MonTask_ast[15].internal_st.ctBeginCalls_u32 rba_Runtime_MonTask_ast[15].internal_st.tiAccuRT_u32 rba_Runtime_MonTask_ast[15].internal_st.tiBeginFree_u32 rba_Runtime_MonTask_ast[15].loadPer64k_u16 rba_Runtime_MonTask_ast[15].tiAvrgRT_u32 rba_Runtime_MonTask_ast[15].tiCurRT_u32 rba_Runtime_MonTask_ast[15].tiCurResponseT_u32 rba_Runtime_MonTask_ast[15].tiMaxRT_u32 rba_Runtime_MonTask_ast[15].tiMaxResponseT_u32 rba_Runtime_MonTask_ast[15].tiMinRT_u32 rba_Runtime_MonTask_ast[15].tiMinResponseT_u32 rba_Runtime_MonTask_ast[16].ctCallsTotal_u32 rba_Runtime_MonTask_ast[16].ctCalls_u32 rba_Runtime_MonTask_ast[16].ctSampleProcessed_u8 rba_Runtime_MonTask_ast[16].internal_st.ctBeginCalls_u32 rba_Runtime_MonTask_ast[16].internal_st.tiAccuRT_u32 rba_Runtime_MonTask_ast[16].internal_st.tiBeginFree_u32 rba_Runtime_MonTask_ast[16].loadPer64k_u16 rba_Runtime_MonTask_ast[16].tiAvrgRT_u32 rba_Runtime_MonTask_ast[16].tiCurRT_u32 rba_Runtime_MonTask_ast[16].tiCurResponseT_u32 rba_Runtime_MonTask_ast[16].tiMaxRT_u32 rba_Runtime_MonTask_ast[16].tiMaxResponseT_u32 rba_Runtime_MonTask_ast[16].tiMinRT_u32 rba_Runtime_MonTask_ast[16].tiMinResponseT_u32 rba_Runtime_MonTask_ast[17].ctCallsTotal_u32 rba_Runtime_MonTask_ast[17].ctCalls_u32 rba_Runtime_MonTask_ast[17].ctSampleProcessed_u8 rba_Runtime_MonTask_ast[17].internal_st.ctBeginCalls_u32 rba_Runtime_MonTask_ast[17].internal_st.tiAccuRT_u32 rba_Runtime_MonTask_ast[17].internal_st.tiBeginFree_u32 rba_Runtime_MonTask_ast[17].loadPer64k_u16 rba_Runtime_MonTask_ast[17].tiAvrgRT_u32 rba_Runtime_MonTask_ast[17].tiCurRT_u32 rba_Runtime_MonTask_ast[17].tiCurResponseT_u32 rba_Runtime_MonTask_ast[17].tiMaxRT_u32 rba_Runtime_MonTask_ast[17].tiMaxResponseT_u32 rba_Runtime_MonTask_ast[17].tiMinRT_u32 rba_Runtime_MonTask_ast[17].tiMinResponseT_u32 rba_Runtime_MonTask_ast[18].ctCallsTotal_u32 rba_Runtime_MonTask_ast[18].ctCalls_u32 rba_Runtime_MonTask_ast[18].ctSampleProcessed_u8 rba_Runtime_MonTask_ast[18].internal_st.ctBeginCalls_u32 rba_Runtime_MonTask_ast[18].internal_st.tiAccuRT_u32 rba_Runtime_MonTask_ast[18].internal_st.tiBeginFree_u32 rba_Runtime_MonTask_ast[18].loadPer64k_u16 rba_Runtime_MonTask_ast[18].tiAvrgRT_u32 rba_Runtime_MonTask_ast[18].tiCurRT_u32 rba_Runtime_MonTask_ast[18].tiCurResponseT_u32 rba_Runtime_MonTask_ast[18].tiMaxRT_u32 rba_Runtime_MonTask_ast[18].tiMaxResponseT_u32 rba_Runtime_MonTask_ast[18].tiMinRT_u32 rba_Runtime_MonTask_ast[18].tiMinResponseT_u32 rba_Runtime_MonTask_ast[19].ctCallsTotal_u32 rba_Runtime_MonTask_ast[19].ctCalls_u32 rba_Runtime_MonTask_ast[19].ctSampleProcessed_u8 rba_Runtime_MonTask_ast[19].internal_st.ctBeginCalls_u32 rba_Runtime_MonTask_ast[19].internal_st.tiAccuRT_u32 rba_Runtime_MonTask_ast[19].internal_st.tiBeginFree_u32 rba_Runtime_MonTask_ast[19].loadPer64k_u16 rba_Runtime_MonTask_ast[19].tiAvrgRT_u32 rba_Runtime_MonTask_ast[19].tiCurRT_u32 rba_Runtime_MonTask_ast[19].tiCurResponseT_u32 rba_Runtime_MonTask_ast[19].tiMaxRT_u32 rba_Runtime_MonTask_ast[19].tiMaxResponseT_u32 rba_Runtime_MonTask_ast[19].tiMinRT_u32 rba_Runtime_MonTask_ast[19].tiMinResponseT_u32 rba_Runtime_MonTask_ast[1].ctCallsTotal_u32 rba_Runtime_MonTask_ast[1].ctCalls_u32 rba_Runtime_MonTask_ast[1].ctSampleProcessed_u8 rba_Runtime_MonTask_ast[1].internal_st.ctBeginCalls_u32 rba_Runtime_MonTask_ast[1].internal_st.tiAccuRT_u32 rba_Runtime_MonTask_ast[1].internal_st.tiBeginFree_u32 rba_Runtime_MonTask_ast[1].loadPer64k_u16 rba_Runtime_MonTask_ast[1].tiAvrgRT_u32 rba_Runtime_MonTask_ast[1].tiCurRT_u32 rba_Runtime_MonTask_ast[1].tiCurResponseT_u32 rba_Runtime_MonTask_ast[1].tiMaxRT_u32 rba_Runtime_MonTask_ast[1].tiMaxResponseT_u32 rba_Runtime_MonTask_ast[1].tiMinRT_u32 rba_Runtime_MonTask_ast[1].tiMinResponseT_u32 rba_Runtime_MonTask_ast[20].ctCallsTotal_u32 rba_Runtime_MonTask_ast[20].ctCalls_u32 rba_Runtime_MonTask_ast[20].ctSampleProcessed_u8 rba_Runtime_MonTask_ast[20].internal_st.ctBeginCalls_u32 rba_Runtime_MonTask_ast[20].internal_st.tiAccuRT_u32 rba_Runtime_MonTask_ast[20].internal_st.tiBeginFree_u32 rba_Runtime_MonTask_ast[20].loadPer64k_u16 rba_Runtime_MonTask_ast[20].tiAvrgRT_u32 rba_Runtime_MonTask_ast[20].tiCurRT_u32 rba_Runtime_MonTask_ast[20].tiCurResponseT_u32 rba_Runtime_MonTask_ast[20].tiMaxRT_u32 rba_Runtime_MonTask_ast[20].tiMaxResponseT_u32 rba_Runtime_MonTask_ast[20].tiMinRT_u32 rba_Runtime_MonTask_ast[20].tiMinResponseT_u32 rba_Runtime_MonTask_ast[21].ctCallsTotal_u32 rba_Runtime_MonTask_ast[21].ctCalls_u32 rba_Runtime_MonTask_ast[21].ctSampleProcessed_u8 rba_Runtime_MonTask_ast[21].internal_st.ctBeginCalls_u32 rba_Runtime_MonTask_ast[21].internal_st.tiAccuRT_u32 rba_Runtime_MonTask_ast[21].internal_st.tiBeginFree_u32 rba_Runtime_MonTask_ast[21].loadPer64k_u16 rba_Runtime_MonTask_ast[21].tiAvrgRT_u32 rba_Runtime_MonTask_ast[21].tiCurRT_u32 rba_Runtime_MonTask_ast[21].tiCurResponseT_u32 rba_Runtime_MonTask_ast[21].tiMaxRT_u32 rba_Runtime_MonTask_ast[21].tiMaxResponseT_u32 rba_Runtime_MonTask_ast[21].tiMinRT_u32 rba_Runtime_MonTask_ast[21].tiMinResponseT_u32 rba_Runtime_MonTask_ast[22].ctCallsTotal_u32 rba_Runtime_MonTask_ast[22].ctCalls_u32 rba_Runtime_MonTask_ast[22].ctSampleProcessed_u8 rba_Runtime_MonTask_ast[22].internal_st.ctBeginCalls_u32 rba_Runtime_MonTask_ast[22].internal_st.tiAccuRT_u32 rba_Runtime_MonTask_ast[22].internal_st.tiBeginFree_u32 rba_Runtime_MonTask_ast[22].loadPer64k_u16 rba_Runtime_MonTask_ast[22].tiAvrgRT_u32 rba_Runtime_MonTask_ast[22].tiCurRT_u32 rba_Runtime_MonTask_ast[22].tiCurResponseT_u32 rba_Runtime_MonTask_ast[22].tiMaxRT_u32 rba_Runtime_MonTask_ast[22].tiMaxResponseT_u32 rba_Runtime_MonTask_ast[22].tiMinRT_u32 rba_Runtime_MonTask_ast[22].tiMinResponseT_u32 rba_Runtime_MonTask_ast[23].ctCallsTotal_u32 rba_Runtime_MonTask_ast[23].ctCalls_u32 rba_Runtime_MonTask_ast[23].ctSampleProcessed_u8 rba_Runtime_MonTask_ast[23].internal_st.ctBeginCalls_u32 rba_Runtime_MonTask_ast[23].internal_st.tiAccuRT_u32 rba_Runtime_MonTask_ast[23].internal_st.tiBeginFree_u32 rba_Runtime_MonTask_ast[23].loadPer64k_u16 rba_Runtime_MonTask_ast[23].tiAvrgRT_u32 rba_Runtime_MonTask_ast[23].tiCurRT_u32 rba_Runtime_MonTask_ast[23].tiCurResponseT_u32 rba_Runtime_MonTask_ast[23].tiMaxRT_u32 rba_Runtime_MonTask_ast[23].tiMaxResponseT_u32 rba_Runtime_MonTask_ast[23].tiMinRT_u32 rba_Runtime_MonTask_ast[23].tiMinResponseT_u32 rba_Runtime_MonTask_ast[24].ctCallsTotal_u32 rba_Runtime_MonTask_ast[24].ctCalls_u32 rba_Runtime_MonTask_ast[24].ctSampleProcessed_u8 rba_Runtime_MonTask_ast[24].internal_st.ctBeginCalls_u32 rba_Runtime_MonTask_ast[24].internal_st.tiAccuRT_u32 rba_Runtime_MonTask_ast[24].internal_st.tiBeginFree_u32 rba_Runtime_MonTask_ast[24].loadPer64k_u16 rba_Runtime_MonTask_ast[24].tiAvrgRT_u32 rba_Runtime_MonTask_ast[24].tiCurRT_u32 rba_Runtime_MonTask_ast[24].tiCurResponseT_u32 rba_Runtime_MonTask_ast[24].tiMaxRT_u32 rba_Runtime_MonTask_ast[24].tiMaxResponseT_u32 rba_Runtime_MonTask_ast[24].tiMinRT_u32 rba_Runtime_MonTask_ast[24].tiMinResponseT_u32 rba_Runtime_MonTask_ast[25].ctCallsTotal_u32 rba_Runtime_MonTask_ast[25].ctCalls_u32 rba_Runtime_MonTask_ast[25].ctSampleProcessed_u8 rba_Runtime_MonTask_ast[25].internal_st.ctBeginCalls_u32 rba_Runtime_MonTask_ast[25].internal_st.tiAccuRT_u32 rba_Runtime_MonTask_ast[25].internal_st.tiBeginFree_u32 rba_Runtime_MonTask_ast[25].loadPer64k_u16 rba_Runtime_MonTask_ast[25].tiAvrgRT_u32 rba_Runtime_MonTask_ast[25].tiCurRT_u32 rba_Runtime_MonTask_ast[25].tiCurResponseT_u32 rba_Runtime_MonTask_ast[25].tiMaxRT_u32 rba_Runtime_MonTask_ast[25].tiMaxResponseT_u32 rba_Runtime_MonTask_ast[25].tiMinRT_u32 rba_Runtime_MonTask_ast[25].tiMinResponseT_u32 rba_Runtime_MonTask_ast[26].ctCallsTotal_u32 rba_Runtime_MonTask_ast[26].ctCalls_u32 rba_Runtime_MonTask_ast[26].ctSampleProcessed_u8 rba_Runtime_MonTask_ast[26].internal_st.ctBeginCalls_u32 rba_Runtime_MonTask_ast[26].internal_st.tiAccuRT_u32 rba_Runtime_MonTask_ast[26].internal_st.tiBeginFree_u32 rba_Runtime_MonTask_ast[26].loadPer64k_u16 rba_Runtime_MonTask_ast[26].tiAvrgRT_u32 rba_Runtime_MonTask_ast[26].tiCurRT_u32 rba_Runtime_MonTask_ast[26].tiCurResponseT_u32 rba_Runtime_MonTask_ast[26].tiMaxRT_u32 rba_Runtime_MonTask_ast[26].tiMaxResponseT_u32 rba_Runtime_MonTask_ast[26].tiMinRT_u32 rba_Runtime_MonTask_ast[26].tiMinResponseT_u32 rba_Runtime_MonTask_ast[27].ctCallsTotal_u32 rba_Runtime_MonTask_ast[27].ctCalls_u32 rba_Runtime_MonTask_ast[27].ctSampleProcessed_u8 rba_Runtime_MonTask_ast[27].internal_st.ctBeginCalls_u32 rba_Runtime_MonTask_ast[27].internal_st.tiAccuRT_u32 rba_Runtime_MonTask_ast[27].internal_st.tiBeginFree_u32 rba_Runtime_MonTask_ast[27].loadPer64k_u16 rba_Runtime_MonTask_ast[27].tiAvrgRT_u32 rba_Runtime_MonTask_ast[27].tiCurRT_u32 rba_Runtime_MonTask_ast[27].tiCurResponseT_u32 rba_Runtime_MonTask_ast[27].tiMaxRT_u32 rba_Runtime_MonTask_ast[27].tiMaxResponseT_u32 rba_Runtime_MonTask_ast[27].tiMinRT_u32 rba_Runtime_MonTask_ast[27].tiMinResponseT_u32 rba_Runtime_MonTask_ast[28].ctCallsTotal_u32 rba_Runtime_MonTask_ast[28].ctCalls_u32 rba_Runtime_MonTask_ast[28].ctSampleProcessed_u8 rba_Runtime_MonTask_ast[28].internal_st.ctBeginCalls_u32 rba_Runtime_MonTask_ast[28].internal_st.tiAccuRT_u32 rba_Runtime_MonTask_ast[28].internal_st.tiBeginFree_u32 rba_Runtime_MonTask_ast[28].loadPer64k_u16 rba_Runtime_MonTask_ast[28].tiAvrgRT_u32 rba_Runtime_MonTask_ast[28].tiCurRT_u32 rba_Runtime_MonTask_ast[28].tiCurResponseT_u32 rba_Runtime_MonTask_ast[28].tiMaxRT_u32 rba_Runtime_MonTask_ast[28].tiMaxResponseT_u32 rba_Runtime_MonTask_ast[28].tiMinRT_u32 rba_Runtime_MonTask_ast[28].tiMinResponseT_u32 rba_Runtime_MonTask_ast[29].ctCallsTotal_u32 rba_Runtime_MonTask_ast[29].ctCalls_u32 rba_Runtime_MonTask_ast[29].ctSampleProcessed_u8 rba_Runtime_MonTask_ast[29].internal_st.ctBeginCalls_u32 rba_Runtime_MonTask_ast[29].internal_st.tiAccuRT_u32 rba_Runtime_MonTask_ast[29].internal_st.tiBeginFree_u32 rba_Runtime_MonTask_ast[29].loadPer64k_u16 rba_Runtime_MonTask_ast[29].tiAvrgRT_u32 rba_Runtime_MonTask_ast[29].tiCurRT_u32 rba_Runtime_MonTask_ast[29].tiCurResponseT_u32 rba_Runtime_MonTask_ast[29].tiMaxRT_u32 rba_Runtime_MonTask_ast[29].tiMaxResponseT_u32 rba_Runtime_MonTask_ast[29].tiMinRT_u32 rba_Runtime_MonTask_ast[29].tiMinResponseT_u32 rba_Runtime_MonTask_ast[2].ctCallsTotal_u32 rba_Runtime_MonTask_ast[2].ctCalls_u32 rba_Runtime_MonTask_ast[2].ctSampleProcessed_u8 rba_Runtime_MonTask_ast[2].internal_st.ctBeginCalls_u32 rba_Runtime_MonTask_ast[2].internal_st.tiAccuRT_u32 rba_Runtime_MonTask_ast[2].internal_st.tiBeginFree_u32 rba_Runtime_MonTask_ast[2].loadPer64k_u16 rba_Runtime_MonTask_ast[2].tiAvrgRT_u32 rba_Runtime_MonTask_ast[2].tiCurRT_u32 rba_Runtime_MonTask_ast[2].tiCurResponseT_u32 rba_Runtime_MonTask_ast[2].tiMaxRT_u32 rba_Runtime_MonTask_ast[2].tiMaxResponseT_u32 rba_Runtime_MonTask_ast[2].tiMinRT_u32 rba_Runtime_MonTask_ast[2].tiMinResponseT_u32 rba_Runtime_MonTask_ast[30].ctCallsTotal_u32 rba_Runtime_MonTask_ast[30].ctCalls_u32 rba_Runtime_MonTask_ast[30].ctSampleProcessed_u8 rba_Runtime_MonTask_ast[30].internal_st.ctBeginCalls_u32 rba_Runtime_MonTask_ast[30].internal_st.tiAccuRT_u32 rba_Runtime_MonTask_ast[30].internal_st.tiBeginFree_u32 rba_Runtime_MonTask_ast[30].loadPer64k_u16 rba_Runtime_MonTask_ast[30].tiAvrgRT_u32 rba_Runtime_MonTask_ast[30].tiCurRT_u32 rba_Runtime_MonTask_ast[30].tiCurResponseT_u32 rba_Runtime_MonTask_ast[30].tiMaxRT_u32 rba_Runtime_MonTask_ast[30].tiMaxResponseT_u32 rba_Runtime_MonTask_ast[30].tiMinRT_u32 rba_Runtime_MonTask_ast[30].tiMinResponseT_u32 rba_Runtime_MonTask_ast[31].ctCallsTotal_u32 rba_Runtime_MonTask_ast[31].ctCalls_u32 rba_Runtime_MonTask_ast[31].ctSampleProcessed_u8 rba_Runtime_MonTask_ast[31].internal_st.ctBeginCalls_u32 rba_Runtime_MonTask_ast[31].internal_st.tiAccuRT_u32 rba_Runtime_MonTask_ast[31].internal_st.tiBeginFree_u32 rba_Runtime_MonTask_ast[31].loadPer64k_u16 rba_Runtime_MonTask_ast[31].tiAvrgRT_u32 rba_Runtime_MonTask_ast[31].tiCurRT_u32 rba_Runtime_MonTask_ast[31].tiCurResponseT_u32 rba_Runtime_MonTask_ast[31].tiMaxRT_u32 rba_Runtime_MonTask_ast[31].tiMaxResponseT_u32 rba_Runtime_MonTask_ast[31].tiMinRT_u32 rba_Runtime_MonTask_ast[31].tiMinResponseT_u32 rba_Runtime_MonTask_ast[32].ctCallsTotal_u32 rba_Runtime_MonTask_ast[32].ctCalls_u32 rba_Runtime_MonTask_ast[32].ctSampleProcessed_u8 rba_Runtime_MonTask_ast[32].internal_st.ctBeginCalls_u32 rba_Runtime_MonTask_ast[32].internal_st.tiAccuRT_u32 rba_Runtime_MonTask_ast[32].internal_st.tiBeginFree_u32 rba_Runtime_MonTask_ast[32].loadPer64k_u16 rba_Runtime_MonTask_ast[32].tiAvrgRT_u32 rba_Runtime_MonTask_ast[32].tiCurRT_u32 rba_Runtime_MonTask_ast[32].tiCurResponseT_u32 rba_Runtime_MonTask_ast[32].tiMaxRT_u32 rba_Runtime_MonTask_ast[32].tiMaxResponseT_u32 rba_Runtime_MonTask_ast[32].tiMinRT_u32 rba_Runtime_MonTask_ast[32].tiMinResponseT_u32 rba_Runtime_MonTask_ast[33].ctCallsTotal_u32 rba_Runtime_MonTask_ast[33].ctCalls_u32 rba_Runtime_MonTask_ast[33].ctSampleProcessed_u8 rba_Runtime_MonTask_ast[33].internal_st.ctBeginCalls_u32 rba_Runtime_MonTask_ast[33].internal_st.tiAccuRT_u32 rba_Runtime_MonTask_ast[33].internal_st.tiBeginFree_u32 rba_Runtime_MonTask_ast[33].loadPer64k_u16 rba_Runtime_MonTask_ast[33].tiAvrgRT_u32 rba_Runtime_MonTask_ast[33].tiCurRT_u32 rba_Runtime_MonTask_ast[33].tiCurResponseT_u32 rba_Runtime_MonTask_ast[33].tiMaxRT_u32 rba_Runtime_MonTask_ast[33].tiMaxResponseT_u32 rba_Runtime_MonTask_ast[33].tiMinRT_u32 rba_Runtime_MonTask_ast[33].tiMinResponseT_u32 rba_Runtime_MonTask_ast[34].ctCallsTotal_u32 rba_Runtime_MonTask_ast[34].ctCalls_u32 rba_Runtime_MonTask_ast[34].ctSampleProcessed_u8 rba_Runtime_MonTask_ast[34].internal_st.ctBeginCalls_u32 rba_Runtime_MonTask_ast[34].internal_st.tiAccuRT_u32 rba_Runtime_MonTask_ast[34].internal_st.tiBeginFree_u32 rba_Runtime_MonTask_ast[34].loadPer64k_u16 rba_Runtime_MonTask_ast[34].tiAvrgRT_u32 rba_Runtime_MonTask_ast[34].tiCurRT_u32 rba_Runtime_MonTask_ast[34].tiCurResponseT_u32 rba_Runtime_MonTask_ast[34].tiMaxRT_u32 rba_Runtime_MonTask_ast[34].tiMaxResponseT_u32 rba_Runtime_MonTask_ast[34].tiMinRT_u32 rba_Runtime_MonTask_ast[34].tiMinResponseT_u32 rba_Runtime_MonTask_ast[35].ctCallsTotal_u32 rba_Runtime_MonTask_ast[35].ctCalls_u32 rba_Runtime_MonTask_ast[35].ctSampleProcessed_u8 rba_Runtime_MonTask_ast[35].internal_st.ctBeginCalls_u32 rba_Runtime_MonTask_ast[35].internal_st.tiAccuRT_u32 rba_Runtime_MonTask_ast[35].internal_st.tiBeginFree_u32 rba_Runtime_MonTask_ast[35].loadPer64k_u16 rba_Runtime_MonTask_ast[35].tiAvrgRT_u32 rba_Runtime_MonTask_ast[35].tiCurRT_u32 rba_Runtime_MonTask_ast[35].tiCurResponseT_u32 rba_Runtime_MonTask_ast[35].tiMaxRT_u32 rba_Runtime_MonTask_ast[35].tiMaxResponseT_u32 rba_Runtime_MonTask_ast[35].tiMinRT_u32 rba_Runtime_MonTask_ast[35].tiMinResponseT_u32 rba_Runtime_MonTask_ast[36].ctCallsTotal_u32 rba_Runtime_MonTask_ast[36].ctCalls_u32 rba_Runtime_MonTask_ast[36].ctSampleProcessed_u8 rba_Runtime_MonTask_ast[36].internal_st.ctBeginCalls_u32 rba_Runtime_MonTask_ast[36].internal_st.tiAccuRT_u32 rba_Runtime_MonTask_ast[36].internal_st.tiBeginFree_u32 rba_Runtime_MonTask_ast[36].loadPer64k_u16 rba_Runtime_MonTask_ast[36].tiAvrgRT_u32 rba_Runtime_MonTask_ast[36].tiCurRT_u32 rba_Runtime_MonTask_ast[36].tiCurResponseT_u32 rba_Runtime_MonTask_ast[36].tiMaxRT_u32 rba_Runtime_MonTask_ast[36].tiMaxResponseT_u32 rba_Runtime_MonTask_ast[36].tiMinRT_u32 rba_Runtime_MonTask_ast[36].tiMinResponseT_u32 rba_Runtime_MonTask_ast[37].ctCallsTotal_u32 rba_Runtime_MonTask_ast[37].ctCalls_u32 rba_Runtime_MonTask_ast[37].ctSampleProcessed_u8 rba_Runtime_MonTask_ast[37].internal_st.ctBeginCalls_u32 rba_Runtime_MonTask_ast[37].internal_st.tiAccuRT_u32 rba_Runtime_MonTask_ast[37].internal_st.tiBeginFree_u32 rba_Runtime_MonTask_ast[37].loadPer64k_u16 rba_Runtime_MonTask_ast[37].tiAvrgRT_u32 rba_Runtime_MonTask_ast[37].tiCurRT_u32 rba_Runtime_MonTask_ast[37].tiCurResponseT_u32 rba_Runtime_MonTask_ast[37].tiMaxRT_u32 rba_Runtime_MonTask_ast[37].tiMaxResponseT_u32 rba_Runtime_MonTask_ast[37].tiMinRT_u32 rba_Runtime_MonTask_ast[37].tiMinResponseT_u32 rba_Runtime_MonTask_ast[3].ctCallsTotal_u32 rba_Runtime_MonTask_ast[3].ctCalls_u32 rba_Runtime_MonTask_ast[3].ctSampleProcessed_u8 rba_Runtime_MonTask_ast[3].internal_st.ctBeginCalls_u32 rba_Runtime_MonTask_ast[3].internal_st.tiAccuRT_u32 rba_Runtime_MonTask_ast[3].internal_st.tiBeginFree_u32 rba_Runtime_MonTask_ast[3].loadPer64k_u16 rba_Runtime_MonTask_ast[3].tiAvrgRT_u32 rba_Runtime_MonTask_ast[3].tiCurRT_u32 rba_Runtime_MonTask_ast[3].tiCurResponseT_u32 rba_Runtime_MonTask_ast[3].tiMaxRT_u32 rba_Runtime_MonTask_ast[3].tiMaxResponseT_u32 rba_Runtime_MonTask_ast[3].tiMinRT_u32 rba_Runtime_MonTask_ast[3].tiMinResponseT_u32 rba_Runtime_MonTask_ast[4].ctCallsTotal_u32 rba_Runtime_MonTask_ast[4].ctCalls_u32 rba_Runtime_MonTask_ast[4].ctSampleProcessed_u8 rba_Runtime_MonTask_ast[4].internal_st.ctBeginCalls_u32 rba_Runtime_MonTask_ast[4].internal_st.tiAccuRT_u32 rba_Runtime_MonTask_ast[4].internal_st.tiBeginFree_u32 rba_Runtime_MonTask_ast[4].loadPer64k_u16 rba_Runtime_MonTask_ast[4].tiAvrgRT_u32 rba_Runtime_MonTask_ast[4].tiCurRT_u32 rba_Runtime_MonTask_ast[4].tiCurResponseT_u32 rba_Runtime_MonTask_ast[4].tiMaxRT_u32 rba_Runtime_MonTask_ast[4].tiMaxResponseT_u32 rba_Runtime_MonTask_ast[4].tiMinRT_u32 rba_Runtime_MonTask_ast[4].tiMinResponseT_u32 rba_Runtime_MonTask_ast[5].ctCallsTotal_u32 rba_Runtime_MonTask_ast[5].ctCalls_u32 rba_Runtime_MonTask_ast[5].ctSampleProcessed_u8 rba_Runtime_MonTask_ast[5].internal_st.ctBeginCalls_u32 rba_Runtime_MonTask_ast[5].internal_st.tiAccuRT_u32 rba_Runtime_MonTask_ast[5].internal_st.tiBeginFree_u32 rba_Runtime_MonTask_ast[5].loadPer64k_u16 rba_Runtime_MonTask_ast[5].tiAvrgRT_u32 rba_Runtime_MonTask_ast[5].tiCurRT_u32 rba_Runtime_MonTask_ast[5].tiCurResponseT_u32 rba_Runtime_MonTask_ast[5].tiMaxRT_u32 rba_Runtime_MonTask_ast[5].tiMaxResponseT_u32 rba_Runtime_MonTask_ast[5].tiMinRT_u32 rba_Runtime_MonTask_ast[5].tiMinResponseT_u32 rba_Runtime_MonTask_ast[6].ctCallsTotal_u32 rba_Runtime_MonTask_ast[6].ctCalls_u32 rba_Runtime_MonTask_ast[6].ctSampleProcessed_u8 rba_Runtime_MonTask_ast[6].internal_st.ctBeginCalls_u32 rba_Runtime_MonTask_ast[6].internal_st.tiAccuRT_u32 rba_Runtime_MonTask_ast[6].internal_st.tiBeginFree_u32 rba_Runtime_MonTask_ast[6].loadPer64k_u16 rba_Runtime_MonTask_ast[6].tiAvrgRT_u32 rba_Runtime_MonTask_ast[6].tiCurRT_u32 rba_Runtime_MonTask_ast[6].tiCurResponseT_u32 rba_Runtime_MonTask_ast[6].tiMaxRT_u32 rba_Runtime_MonTask_ast[6].tiMaxResponseT_u32 rba_Runtime_MonTask_ast[6].tiMinRT_u32 rba_Runtime_MonTask_ast[6].tiMinResponseT_u32 rba_Runtime_MonTask_ast[7].ctCallsTotal_u32 rba_Runtime_MonTask_ast[7].ctCalls_u32 rba_Runtime_MonTask_ast[7].ctSampleProcessed_u8 rba_Runtime_MonTask_ast[7].internal_st.ctBeginCalls_u32 rba_Runtime_MonTask_ast[7].internal_st.tiAccuRT_u32 rba_Runtime_MonTask_ast[7].internal_st.tiBeginFree_u32 rba_Runtime_MonTask_ast[7].loadPer64k_u16 rba_Runtime_MonTask_ast[7].tiAvrgRT_u32 rba_Runtime_MonTask_ast[7].tiCurRT_u32 rba_Runtime_MonTask_ast[7].tiCurResponseT_u32 rba_Runtime_MonTask_ast[7].tiMaxRT_u32 rba_Runtime_MonTask_ast[7].tiMaxResponseT_u32 rba_Runtime_MonTask_ast[7].tiMinRT_u32 rba_Runtime_MonTask_ast[7].tiMinResponseT_u32 rba_Runtime_MonTask_ast[8].ctCallsTotal_u32 rba_Runtime_MonTask_ast[8].ctCalls_u32 rba_Runtime_MonTask_ast[8].ctSampleProcessed_u8 rba_Runtime_MonTask_ast[8].internal_st.ctBeginCalls_u32 rba_Runtime_MonTask_ast[8].internal_st.tiAccuRT_u32 rba_Runtime_MonTask_ast[8].internal_st.tiBeginFree_u32 rba_Runtime_MonTask_ast[8].loadPer64k_u16 rba_Runtime_MonTask_ast[8].tiAvrgRT_u32 rba_Runtime_MonTask_ast[8].tiCurRT_u32 rba_Runtime_MonTask_ast[8].tiCurResponseT_u32 rba_Runtime_MonTask_ast[8].tiMaxRT_u32 rba_Runtime_MonTask_ast[8].tiMaxResponseT_u32 rba_Runtime_MonTask_ast[8].tiMinRT_u32 rba_Runtime_MonTask_ast[8].tiMinResponseT_u32 rba_Runtime_MonTask_ast[9].ctCallsTotal_u32 rba_Runtime_MonTask_ast[9].ctCalls_u32 rba_Runtime_MonTask_ast[9].ctSampleProcessed_u8 rba_Runtime_MonTask_ast[9].internal_st.ctBeginCalls_u32 rba_Runtime_MonTask_ast[9].internal_st.tiAccuRT_u32 rba_Runtime_MonTask_ast[9].internal_st.tiBeginFree_u32 rba_Runtime_MonTask_ast[9].loadPer64k_u16 rba_Runtime_MonTask_ast[9].tiAvrgRT_u32 rba_Runtime_MonTask_ast[9].tiCurRT_u32 rba_Runtime_MonTask_ast[9].tiCurResponseT_u32 rba_Runtime_MonTask_ast[9].tiMaxRT_u32 rba_Runtime_MonTask_ast[9].tiMaxResponseT_u32 rba_Runtime_MonTask_ast[9].tiMinRT_u32 rba_Runtime_MonTask_ast[9].tiMinResponseT_u32 rba_Runtime_Output_st.cores_ast[0].results_ast[0].ctCalls_u32 rba_Runtime_Output_st.cores_ast[0].results_ast[0].ctReentCalls_u32 rba_Runtime_Output_st.cores_ast[0].results_ast[0].tiAvrgCD_u32 rba_Runtime_Output_st.cores_ast[0].results_ast[0].tiAvrgRT_u32 rba_Runtime_Output_st.cores_ast[0].results_ast[0].tiMaxCD_u32 rba_Runtime_Output_st.cores_ast[0].results_ast[0].tiMaxRT_u32 rba_Runtime_Output_st.cores_ast[0].results_ast[0].tiMinCD_u32 rba_Runtime_Output_st.cores_ast[0].results_ast[0].tiMinRT_u32 rba_Runtime_Output_st.cores_ast[0].tiSampleDuration_u32 rba_Runtime_Output_st.ctSample_u8 /end LOC_MEASUREMENT
 FUNCTION_VERSION "1.15.0" /end FUNCTION
/begin FUNCTION rba_SyC "1.18.0    System Control"
 /begin DEF_CHARACTERISTIC DFC_CtlMsk2.DFC_rba_SyC_IrrSwOffTrigEngRun_Event_C DFC_DisblMsk2.DFC_rba_SyC_IrrSwOffTrigEngRun_Event_C /end DEF_CHARACTERISTIC
 /begin LOC_MEASUREMENT rba_SyC_EcuOffTime_Validity_MP rba_SyC_EcuOffTime_Value_MP rba_SyC_ObservationCounters_IrrSwOffTrigEngRun_Value_MP rba_SyC_ObservationCounters_IrrSwOff_Value_MP rba_SyC_PowerOn_Reasons_MP rba_SyC_States_CurrentState_MP rba_SyC_States_PostDrive_TimeoutHistoryBegin_MP rba_SyC_States_PostDrive_TimeoutHistoryEnd_MP rba_SyC_States_PostDrive_TimeoutHistoryNetwork_MP rba_SyC_States_PostDrive_substate_MP rba_SyC_States_PrepareDrive_substate_MP rba_SyC_States_PrepareShutdown_TimeoutHistoryComplete_MP rba_SyC_States_PrepareShutdown_substate_MP rba_SyC_States_PreviousState_MP rba_SyC_States_Wait_TimeoutHistoryDelay_MP rba_SyC_States_Wait_TimeoutHistoryNetwork_MP rba_SyC_States_Wait_TimeoutHistoryProlong_MP rba_SyC_States_Wait_substate_MP rba_SyC_tiBoot_us_MP rba_SyC_tiDrive_10ms_MP rba_SyC_tiInit_us_MP rba_SyC_tiLastShutdown_us_MP rba_SyC_tiPostDrive_10ms_MP rba_SyC_tiPrepareDrive_10ms_MP rba_SyC_tiPrepareShutdown_10ms_MP rba_SyC_tiWait_10ms_MP /end LOC_MEASUREMENT
 FUNCTION_VERSION "1.18.0" /end FUNCTION
/begin FUNCTION rba_T15 "2.18.0    Terminal15"
 /begin DEF_CHARACTERISTIC DFC_CtlMsk2.DFC_rba_T15_Diag_ComInVld_Event_C DFC_CtlMsk2.DFC_rba_T15_Diag_ComOff_HwOn_Event_C DFC_CtlMsk2.DFC_rba_T15_Diag_ComOn_HwOff_Event_C DFC_DisblMsk2.DFC_rba_T15_Diag_ComInVld_Event_C DFC_DisblMsk2.DFC_rba_T15_Diag_ComOff_HwOn_Event_C DFC_DisblMsk2.DFC_rba_T15_Diag_ComOn_HwOff_Event_C /end DEF_CHARACTERISTIC
 /begin LOC_MEASUREMENT rba_T15_Signal_Debounced_MP rba_T15_Signal_Logical_MP rba_T15_Signal_UndebouncedValid_MP rba_T15_Signal_Undebounced_MP /end LOC_MEASUREMENT
 FUNCTION_VERSION "2.18.0" /end FUNCTION
/*********** End of merged FUNCTION blocks ***********/
/begin FUNCTION ADCin "9000.3.0_MSE2_BJ_0034_00common device encapsulation for ADC"
 /begin OUT_MEASUREMENT udss_w uneutgear_w uquickshiftr_w urovs_w usdst_w uwdk_w wtans wtmot_w wub /end OUT_MEASUREMENT
 FUNCTION_VERSION "9000.3.0_MSE2_BJ_0034_00" /end FUNCTION
/begin FUNCTION AEKP "9001.6.0_2.1.0Output fuel pump control"
 /begin DEF_CHARACTERISTIC CWEKP DFC_CtlMsk2.DFC_KPEmax_C DFC_CtlMsk2.DFC_KPEmin_C DFC_CtlMsk2.DFC_KPEsig_C DFC_DisblMsk2.DFC_KPEmax_C DFC_DisblMsk2.DFC_KPEmin_C DFC_DisblMsk2.DFC_KPEsig_C EKPPA TABSTEKP TCYCDEKPE TEKPO /end DEF_CHARACTERISTIC
 /begin IN_MEASUREMENT B_desee B_kl15 B_nmot B_tltsig SyC_stSub t_engoff_w /end IN_MEASUREMENT
 /begin OUT_MEASUREMENT B_ekp /end OUT_MEASUREMENT
 /begin LOC_MEASUREMENT dekpe ekppz /end LOC_MEASUREMENT
 FUNCTION_VERSION "9001.6.0_2.1.0" /end FUNCTION
/*********** Start of merged COMPU_METHOD blocks ***********/
/begin COMPU_METHOD RB_RBA_Common_CentralElements_CompuMethods_Identical "The internal value and the physical one are identical. No physical unit available" RAT_FUNC "%10.5" "" COEFFS 0.0 1.0 0.0 0.0 0.0 1.0 /end COMPU_METHOD
/begin COMPU_METHOD RB_RBA_rba_Runtime_CompuMethods_rba_Runtime_Time "Timer ticks in Micro Seconds" RAT_FUNC "%10.5" "us" COEFFS 0.0 -1.0 0.0 0.0 0.0 -0.025 REF_UNIT RB_RBA_rba_Runtime_Units_MicroSec /end COMPU_METHOD
/begin COMPU_METHOD RB_RBA_rba_Runtime_CompuMethods_rba_Runtime_Percentage "Percentage Value" RAT_FUNC "%10.5" "%" COEFFS 0.0 -1.0 0.0 0.0 0.0 -0.001525 REF_UNIT RB_RBA_rba_Runtime_Units_Perc /end COMPU_METHOD
/begin COMPU_METHOD RB_RBA_rba_SyC_BswModuleDescriptions_rba_SyC_EcuOffTime_CompuMethod "" TAB_VERB "%10.5" "" COMPU_TAB_REF RB_RBA_rba_SyC_BswModuleDescriptions_rba_SyC_EcuOffTime_CompuMethod /end COMPU_METHOD
/begin COMPU_METHOD RB_RBA_rba_SyC_BswModuleDescriptions_rba_SyC_States_CompuMethod "" TAB_VERB "%10.5" "" COMPU_TAB_REF RB_RBA_rba_SyC_BswModuleDescriptions_rba_SyC_States_CompuMethod /end COMPU_METHOD
/begin COMPU_METHOD RB_RBA_rba_SyC_BswModuleDescriptions_rba_SyC_States_PostDrive_CompuMethod "" TAB_VERB "%10.5" "" COMPU_TAB_REF RB_RBA_rba_SyC_BswModuleDescriptions_rba_SyC_States_PostDrive_CompuMethod /end COMPU_METHOD
/begin COMPU_METHOD RB_RBA_rba_SyC_BswModuleDescriptions_rba_SyC_States_PrepareDrive_CompuMethod "" TAB_VERB "%10.5" "" COMPU_TAB_REF RB_RBA_rba_SyC_BswModuleDescriptions_rba_SyC_States_PrepareDrive_CompuMethod /end COMPU_METHOD
/begin COMPU_METHOD RB_RBA_rba_SyC_BswModuleDescriptions_rba_SyC_States_PrepareShutdown_CompuMethod "" TAB_VERB "%10.5" "" COMPU_TAB_REF RB_RBA_rba_SyC_BswModuleDescriptions_rba_SyC_States_PrepareShutdown_CompuMethod /end COMPU_METHOD
/begin COMPU_METHOD RB_RBA_rba_SyC_BswModuleDescriptions_rba_SyC_States_Wait_CompuMethod "" TAB_VERB "%10.5" "" COMPU_TAB_REF RB_RBA_rba_SyC_BswModuleDescriptions_rba_SyC_States_Wait_CompuMethod /end COMPU_METHOD
/begin COMPU_METHOD RB_RBA_rba_T15_BswModuleDescriptions_rba_T15_Signal_Status_CompuMethod "" TAB_VERB "%10.5" "" COMPU_TAB_REF RB_RBA_rba_T15_BswModuleDescriptions_rba_T15_Signal_Status_CompuMethod /end COMPU_METHOD
/begin COMPU_METHOD RB_RBA_rba_T15_BswModuleDescriptions_rba_T15_Signal_StatusValid_CompuMethod "" TAB_VERB "%10.5" "" COMPU_TAB_REF RB_RBA_rba_T15_BswModuleDescriptions_rba_T15_Signal_StatusValid_CompuMethod /end COMPU_METHOD
/begin COMPU_METHOD DefaultIdenticalCompu "" RAT_FUNC "%10.5" "" COEFFS 0.0 1.0 0.0 0.0 0.0 1.0 /end COMPU_METHOD
/begin COMPU_VTAB RB_RBA_rba_SyC_BswModuleDescriptions_rba_SyC_EcuOffTime_CompuMethod "" TAB_VERB 12 0 "RBA_SYC_ECUOFFTIME_VALIDITY_UNKNOWN" 1 "RBA_SYC_ECUOFFTIME_VALIDITY_VALID" 2 "RBA_SYC_ECUOFFTIME_VALIDITY_INVALID_DISABLED" 3 "RBA_SYC_ECUOFFTIME_VALIDITY_INVALID_READ_ERROR" 4 "RBA_SYC_ECUOFFTIME_VALIDITY_INVALID_IRRSWOFF" 5 "RBA_SYC_ECUOFFTIME_VALIDITY_INVALID_POWERFAIL" 6 "RBA_SYC_ECUOFFTIME_VALIDITY_INVALID_WRONG_MODE" 7 "RBA_SYC_ECUOFFTIME_VALIDITY_INVALID_NOT_RUNNING" 8 "RBA_SYC_ECUOFFTIME_VALIDITY_INVALID_STORAGE_ERROR" 9 "RBA_SYC_ECUOFFTIME_VALIDITY_INVALID_EXTERNAL" 10 "RBA_SYC_ECUOFFTIME_VALIDITY_VALID_EXPIRED" 11 "RBA_SYC_ECUOFFTIME_VALIDITY_INVALID_DATA" /end COMPU_VTAB
/begin COMPU_VTAB RB_RBA_rba_SyC_BswModuleDescriptions_rba_SyC_States_CompuMethod "" TAB_VERB 8 0 "RBA_SYC_STATES_BOOT" 1 "RBA_SYC_STATES_INIT" 2 "RBA_SYC_STATES_WAIT" 3 "RBA_SYC_STATES_PREPARE_DRIVE" 4 "RBA_SYC_STATES_PREPARE_SHUTDOWN" 5 "RBA_SYC_STATES_DRIVE" 6 "RBA_SYC_STATES_POSTDRIVE" 7 "RBA_SYC_STATES_SHUTDOWN" /end COMPU_VTAB
/begin COMPU_VTAB RB_RBA_rba_SyC_BswModuleDescriptions_rba_SyC_States_PostDrive_CompuMethod "" TAB_VERB 10 0 "RBA_SYC_STATES_POSTDRIVE_NOT_ACTIVE" 1 "RBA_SYC_STATES_POSTDRIVE_INIT" 2 "RBA_SYC_STATES_POSTDRIVE_DIAGNOSIS_BEGIN" 3 "RBA_SYC_STATES_POSTDRIVE_STORAGE_BEGIN" 4 "RBA_SYC_STATES_POSTDRIVE_PROLONG" 5 "RBA_SYC_STATES_POSTDRIVE_NETWORK" 6 "RBA_SYC_STATES_POSTDRIVE_DIAGNOSIS_END" 7 "RBA_SYC_STATES_POSTDRIVE_STORAGE_END" 8 "RBA_SYC_STATES_POSTDRIVE_DELAY" 9 "RBA_SYC_STATES_POSTDRIVE_FINISHED" /end COMPU_VTAB
/begin COMPU_VTAB RB_RBA_rba_SyC_BswModuleDescriptions_rba_SyC_States_PrepareDrive_CompuMethod "" TAB_VERB 4 0 "RBA_SYC_STATES_PREPARE_DRIVE_NOT_ACTIVE" 1 "RBA_SYC_STATES_PREPARE_DRIVE_INIT" 2 "RBA_SYC_STATES_PREPARE_DRIVE_MAINRELAY" 3 "RBA_SYC_STATES_PREPARE_DRIVE_FINISHED" /end COMPU_VTAB
/begin COMPU_VTAB RB_RBA_rba_SyC_BswModuleDescriptions_rba_SyC_States_PrepareShutdown_CompuMethod "" TAB_VERB 7 0 "RBA_SYC_STATES_PREPARE_SHUTDOWN_NOT_ACTIVE" 1 "RBA_SYC_STATES_PREPARE_SHUTDOWN_INIT" 2 "RBA_SYC_STATES_PREPARE_SHUTDOWN_MAINRELAY" 3 "RBA_SYC_STATES_PREPARE_SHUTDOWN_DIAGNOSIS" 4 "RBA_SYC_STATES_PREPARE_SHUTDOWN_STORAGE" 5 "RBA_SYC_STATES_PREPARE_SHUTDOWN_DELAY" 6 "RBA_SYC_STATES_PREPARE_SHUTDOWN_FINISHED" /end COMPU_VTAB
/begin COMPU_VTAB RB_RBA_rba_SyC_BswModuleDescriptions_rba_SyC_States_Wait_CompuMethod "" TAB_VERB 6 0 "RBA_SYC_STATES_WAIT_NOT_ACTIVE" 1 "RBA_SYC_STATES_WAIT_INIT" 2 "RBA_SYC_STATES_WAIT_PROLONG" 3 "RBA_SYC_STATES_WAIT_NETWORK" 4 "RBA_SYC_STATES_WAIT_DELAY" 5 "RBA_SYC_STATES_WAIT_FINISHED" /end COMPU_VTAB
/begin COMPU_VTAB RB_RBA_rba_T15_BswModuleDescriptions_rba_T15_Signal_Status_CompuMethod "" TAB_VERB 2 0 "rba_T15_Signal_Off_e" 1 "rba_T15_Signal_On_e" /end COMPU_VTAB
/begin COMPU_VTAB RB_RBA_rba_T15_BswModuleDescriptions_rba_T15_Signal_StatusValid_CompuMethod "" TAB_VERB 2 0 "rba_T15_Signal_InValid_e" 1 "rba_T15_Signal_Valid_e" /end COMPU_VTAB
/begin COMPU_METHOD AltChpTemp_q8p0_COMPU "" RAT_FUNC "%6.2" "deg C" COEFFS 0 0.125 4 0 0 1 /end COMPU_METHOD
/begin COMPU_METHOD AltCrntLim_A_q0p25_COMPU "" RAT_FUNC "%6.3" "A" COEFFS 0 4 0 0 0 1 /end COMPU_METHOD
/begin COMPU_METHOD AltCrntOut_A_q0p125_COMPU "" RAT_FUNC "%6.3" "A" COEFFS 0 8 0 0 0 1 /end COMPU_METHOD
/begin COMPU_METHOD AltLd_q3p125_COMPU "" RAT_FUNC "%6.2" "%" COEFFS 0 0.32 0 0 0 1 /end COMPU_METHOD
/begin COMPU_METHOD AltVltg_V_q0p1_COMPU "" RAT_FUNC "%6.2" "V" COEFFS 0 10 -106 0 0 1 /end COMPU_METHOD
/begin COMPU_METHOD Ampere "" RAT_FUNC "%6.3" "mA" COEFFS 0 5 0 0 0 1 /end COMPU_METHOD
/begin COMPU_METHOD Ampere_q0p1_COMPU "" RAT_FUNC "%6.3" "uA" COEFFS 0 10 0 0 0 1 /end COMPU_METHOD
/begin COMPU_METHOD AMPT2NOxMPT_COMPU "" RAT_FUNC "%6.5" "(mg/s)/(Kg/h)" COEFFS 0 1000 0 0 0 1 /end COMPU_METHOD
/begin COMPU_METHOD AMPTDer_COMPU "" RAT_FUNC "%6.4" "(Kg/h)/s" COEFFS 0 100 0 0 0 1 /end COMPU_METHOD
/begin COMPU_METHOD AMPTgPerSec "" RAT_FUNC "%6.4" "g/s" COEFFS 0 20 0 0 0 1 /end COMPU_METHOD
/begin COMPU_METHOD AMPT_NOx "" RAT_FUNC "%8.7" "g/s" COEFFS 0 100000 0 0 0 1 /end COMPU_METHOD
/begin COMPU_METHOD AMPT_NOxLdUnld "" RAT_FUNC "%7.6" "g/s" COEFFS 0 10000 0 0 0 1 /end COMPU_METHOD
/begin COMPU_METHOD AMPT_NOxRgn "" RAT_FUNC "%6.5" "g/s" COEFFS 0 2000 0 0 0 1 /end COMPU_METHOD
/begin COMPU_METHOD AMPT_SOx1 "" RAT_FUNC "%6.4" "mg/s" COEFFS 0 333.333333333333 0 0 0 1 /end COMPU_METHOD
/begin COMPU_METHOD AngleIndexCpp "" RAT_FUNC "%6.2" "AgCA" COEFFS 0 -1 180 0 0 1 /end COMPU_METHOD
/begin COMPU_METHOD B_TRUE "" TAB_VERB "%6.3" "" COMPU_TAB_REF B_TRUE /end COMPU_METHOD
/begin COMPU_VTAB B_TRUE "" TAB_VERB 2 0 "FALSE" 1 "TRUE" /end COMPU_VTAB
/begin COMPU_METHOD dez "" RAT_FUNC "%6.2" "" COEFFS 0 1 0 0 0 1 /end COMPU_METHOD
/begin COMPU_METHOD DFES_OneToOne "" RAT_FUNC "%6.2" "-" COEFFS 0 1 0 0 0 1 /end COMPU_METHOD
/begin COMPU_METHOD spg_ubatt "" RAT_FUNC "%6.4" "V" COEFFS 0 14.2045454545455 0 0 0 1 /end COMPU_METHOD
/begin COMPU_METHOD spg_ub_q0p019 "" RAT_FUNC "%6.4" "V" COEFFS 0 256 0 0 0 5 /end COMPU_METHOD
/begin COMPU_METHOD spg_uw_q0p001222 "" RAT_FUNC "%6.4" "V" COEFFS 0 65536 0 0 0 80 /end COMPU_METHOD
/begin COMPU_METHOD spg_uw_q0p00488 "" RAT_FUNC "%6.4" "V" COEFFS 0 1024 0 0 0 5 /end COMPU_METHOD
/begin COMPU_METHOD t_q0p01 "" RAT_FUNC "%6.4" "s" COEFFS 0 100 0 0 0 1 /end COMPU_METHOD
/begin COMPU_METHOD t_q0p1 "" RAT_FUNC "%6.3" "s" COEFFS 0 10 0 0 0 1 /end COMPU_METHOD
/begin COMPU_METHOD t_q1 "" RAT_FUNC "%6.2" "s" COEFFS 0 1 0 0 0 1 /end COMPU_METHOD
/begin RECORD_LAYOUT KwWU16 FNC_VALUES 1 UWORD COLUMN_DIR DIRECT /end RECORD_LAYOUT
/begin RECORD_LAYOUT KwWU8 FNC_VALUES 1 UBYTE COLUMN_DIR DIRECT /end RECORD_LAYOUT
/begin RECORD_LAYOUT Val_Wu8 FNC_VALUES 1 UBYTE COLUMN_DIR DIRECT /end RECORD_LAYOUT
/begin UNIT RB_RBA_rba_Runtime_Units_MicroSec "Micro Second" "us" EXTENDED_SI SI_EXPONENTS 0 0 1 0 0 0 0 /end UNIT
/begin UNIT RB_RBA_rba_Runtime_Units_Perc "Percent" "%" EXTENDED_SI SI_EXPONENTS 0 0 0 0 0 0 0 /end UNIT
/end MODULE
/end PROJECT
