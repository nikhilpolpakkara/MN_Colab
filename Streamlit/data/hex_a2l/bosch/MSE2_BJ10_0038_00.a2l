ASAP2_VERSION 1 60
/begin PROJECT MSE2_BJ10_0038_00 "MDG1"
/begin HEADER "" VERSION "MSE2_BJ10_0038_00" PROJECT_NO MSE2_BJ10_0038_00 /end HEADER
/begin MODULE DIM ""
/begin MOD_COMMON "" BYTE_ORDER MSB_FIRST ALIGNMENT_BYTE 1 ALIGNMENT_WORD 2 ALIGNMENT_LONG 4 ALIGNMENT_INT64 4 ALIGNMENT_FLOAT32_IEEE 4 ALIGNMENT_FLOAT64_IEEE 4 /end MOD_COMMON
/begin CHARACTERISTIC ANZESWNS "minimum number of cam shaft rotations for calculation start/poststart factor line at end of start" CURVE 0x9087830 KlAxU8SstxU16WU16 65535.00 dez 0.00 65535.00 FORMAT "%8.2"
 /begin AXIS_DESCR STD_AXIS InjSyG_EngDa_tStrtLoc Temp_Cels 10 -273.1400 3003.560 FORMAT "%8.3" EXTENDED_LIMITS -273.1400 6280.360 DEPOSIT ABSOLUTE /end AXIS_DESCR
/end CHARACTERISTIC
/begin CHARACTERISTIC ANZTIMXST "max number of injection at start" VALUE 0x908785A KwWU8 255.0 dez 0.00 255.0 FORMAT "%5.1" /end CHARACTERISTIC
/begin CHARACTERISTIC ANZTIMXWST "Max number of injection in previous drive for restart definition" VALUE 0x908785C KwWU16 65535.00 dez 0.00 65535.00 FORMAT "%8.2" /end CHARACTERISTIC
/begin CHARACTERISTIC CWFIP2W "Codeword swith for function InjSyG_FuInjPah" VALUE 0x908785E KwWU8 255.0 dez 0.00 255.0 FORMAT "%5.1" /end CHARACTERISTIC
/begin CHARACTERISTIC CWLFS "Codeword for the fan control: Bit0 is to enable(1) or disable(0) afterrun fan control" VALUE 0x9088C7C KwWU8 255.0 dez 0.00 255.0 FORMAT "%5.1" /end CHARACTERISTIC
/begin CHARACTERISTIC CWLLRBB "Codeword operating conditions for idle speed" VALUE 0x9088CC4 KwWU8 255.0 dez 0.00 255.0 FORMAT "%5.1" /end CHARACTERISTIC
/begin CHARACTERISTIC CWLLRMR "Code word for the configuration of torque reserve in engine speed control" VALUE 0x9088CDE KwWU8 255.0 dez 0.00 255.0 FORMAT "%5.1" /end CHARACTERISTIC
/begin CHARACTERISTIC CWLLRRM "codeword for LLRM" VALUE 0x9088DC4 KwWU8 255.0 dez 0.00 255.0 FORMAT "%5.1" /end CHARACTERISTIC
/begin CHARACTERISTIC CWPSLUES1E "code word for shutdown of output-stage diagnosis fan control 1" VALUE 0x9088C7D KwWU8 255.0 dez 0.00 255.0 FORMAT "%5.1" /end CHARACTERISTIC
/begin CHARACTERISTIC DDMRKHMN "Minimum threshold for additional delta torque reserve for catalyzer heating" VALUE 0x908830A KwWU16 99.99847 rel_uw_b100 0.00 99.99847 FORMAT "%8.5" /end CHARACTERISTIC
/begin CHARACTERISTIC DDMRKHMX "Additional delta torque reserve for catalyzer heating" VALUE 0x908830C KwWU16 99.99847 rel_uw_b100 0.00 99.99847 FORMAT "%8.5" /end CHARACTERISTIC
/begin CHARACTERISTIC DFC_CtlMsk2.DFC_LFS1Max_C "Behaviour control mask / Behaviour control masks of check DFC_LFS1Max" VALUE 0x908040E Val_Wu8 255.0 DFES_OneToOne 0.00 255.0 FORMAT "%5.1" /end CHARACTERISTIC
/begin CHARACTERISTIC DFC_CtlMsk2.DFC_LFS1Min_C "Behaviour control mask / Behaviour control masks of check DFC_LFS1Min" VALUE 0x908040F Val_Wu8 255.0 DFES_OneToOne 0.00 255.0 FORMAT "%5.1" /end CHARACTERISTIC
/begin CHARACTERISTIC DFC_CtlMsk2.DFC_LFS1Sig_C "Behaviour control mask / Behaviour control masks of check DFC_LFS1Sig" VALUE 0x9080410 Val_Wu8 255.0 DFES_OneToOne 0.00 255.0 FORMAT "%5.1" /end CHARACTERISTIC
/begin CHARACTERISTIC DFC_DisblMsk2.DFC_LFS1Max_C "disable mask / Disable masks of check DFC_LFS1Max" VALUE 0x9080DDE Val_Wu8 255.0 DFES_OneToOne 0.00 255.0 FORMAT "%5.1" /end CHARACTERISTIC
/begin CHARACTERISTIC DFC_DisblMsk2.DFC_LFS1Min_C "disable mask / Disable masks of check DFC_LFS1Min" VALUE 0x9080DDF Val_Wu8 255.0 DFES_OneToOne 0.00 255.0 FORMAT "%5.1" /end CHARACTERISTIC
/begin CHARACTERISTIC DFC_DisblMsk2.DFC_LFS1Sig_C "disable mask / Disable masks of check DFC_LFS1Sig" VALUE 0x9080DE0 Val_Wu8 255.0 DFES_OneToOne 0.00 255.0 FORMAT "%5.1" /end CHARACTERISTIC
/begin CHARACTERISTIC DISTLFSTHR1 "Threshold for distance travlled since between two EMC (LFS1) fan ON before fan OFF check" VALUE 0x9088C7E KwWU16 65535.00 dez 0.00 65535.00 FORMAT "%8.2" /end CHARACTERISTIC
/begin CHARACTERISTIC DISTLFSTHR2 "Threshold for distance travlled from EMC (LFS1) fan ON before fan OFF check" VALUE 0x9088C80 KwWU16 65535.00 dez 0.00 65535.00 FORMAT "%8.2" /end CHARACTERISTIC
/begin CHARACTERISTIC DMLLRA "Increase of lower air mass flow threshold for multiplicative learning" VALUE 0x90819B6 RB_Val_Wu16 6553.500 m_uw_b6553p5 0.00 6553.500 FORMAT "%8.3" /end CHARACTERISTIC
/begin CHARACTERISTIC DMLLRLMNN "Lower limit for dmllrl" CURVE 0x9088DC5 GklWS8 49.80 rel_q0p1953 -25.00 24.80 FORMAT "%5.2"
 /begin AXIS_DESCR COM_AXIS nmot_w nmot_uw_q0p25 6 0.00 16383.75 FORMAT "%8.2" AXIS_PTS_REF SNM06LLUB /end AXIS_DESCR
/end CHARACTERISTIC
/begin CHARACTERISTIC DMLLRLMXN "Safety concept: upper limit for dmllrl" CURVE 0x9088DCB GklWS8 49.80 rel_q0p1953 -25.00 24.80 FORMAT "%5.2"
 /begin AXIS_DESCR COM_AXIS nmot_w nmot_uw_q0p25 6 0.00 16383.75 FORMAT "%8.2" AXIS_PTS_REF SNM06LLUB /end AXIS_DESCR
/end CHARACTERISTIC
/begin CHARACTERISTIC DMLLRMNN "Lower limit for dmllr_w" CURVE 0x9088DD1 GklWS8 49.80 rel_q0p1953 -25.00 24.80 FORMAT "%5.2"
 /begin AXIS_DESCR COM_AXIS nmot_w nmot_uw_q0p25 6 0.00 16383.75 FORMAT "%8.2" AXIS_PTS_REF SNM06LLUB /end AXIS_DESCR
/end CHARACTERISTIC
/begin CHARACTERISTIC DMLLRMXN "Safety concept: upper limit for dmllr" CURVE 0x9088DD7 GklWS8 49.80 rel_q0p1953 -25.00 24.80 FORMAT "%5.2"
 /begin AXIS_DESCR COM_AXIS nmot_w nmot_uw_q0p25 6 0.00 16383.75 FORMAT "%8.2" AXIS_PTS_REF SNM06LLUB /end AXIS_DESCR
/end CHARACTERISTIC
/begin CHARACTERISTIC DNLLRIST "Overspeed threshold for integrator reset" VALUE 0x9088DDD KwWS8 2550. nmotd_sb_q10 -1280. 1270. FORMAT "%5.0" /end CHARACTERISTIC
/begin CHARACTERISTIC DNMNI "Lowest possible value for dn for the I-controller" VALUE 0x9088DDE KwWS16 16383.75 nmot_sw_q0p25 -8192.000 8191.750 FORMAT "%8.3" /end CHARACTERISTIC
/begin CHARACTERISTIC DNSLLREIN "Idle speed offset to activate the idle control" VALUE 0x9088CC5 KwWU8 2550. nmot_ub_q10 0.00 2550. FORMAT "%5.0" /end CHARACTERISTIC
/begin CHARACTERISTIC DRLLRHU "Delta lower load threshold for lambda control downstream catalyst" VALUE 0x9088E6A KwUb 191.3 rel_ub_q0p75 0.00 191.3 FORMAT "%5.1" /end CHARACTERISTIC
/begin CHARACTERISTIC DTBTS "Exhaust temperature hysteresis for component protection" VALUE 0x908843E KwWU8 1275. temp_ub_q5 0.00 1275. FORMAT "%5.0" /end CHARACTERISTIC
/begin CHARACTERISTIC DTEMN "Min-threshold for delta effective injection period" VALUE 0x9087860 KwWU16 65.53500 t1p0usxms 0.00 65.53500 FORMAT "%8.5" /end CHARACTERISTIC
/begin CHARACTERISTIC ExhMgT_iaDesDeltaIgCatHeatg_M "Desired delta ignition-timing towards zwopt for cat heating" MAP 0x908830E KfAxU8AyU8SstxU16SstyU16WS16 191.2500 zw_sb_q0p75 -96.00000 95.25000 FORMAT "%8.5" EXTENDED_LIMITS -24576.00 24575.25
 /begin AXIS_DESCR STD_AXIS mifal_w rel_uw_b100 6 0.00 99.99847 FORMAT "%8.5" DEPOSIT ABSOLUTE /end AXIS_DESCR
 /begin AXIS_DESCR STD_AXIS nmotfihy_w nmot_uw_q0p25 6 0.00 16383.75 FORMAT "%8.2" DEPOSIT ABSOLUTE /end AXIS_DESCR
/end CHARACTERISTIC
/begin CHARACTERISTIC ExhMgT_rLamSprkSeatProtn_M "Nominal lamda for spark seat temperature reduction" MAP 0x9088440 KfAxU8AyU8SstxU16SstyU16WU16 0.9960938 fak_q0p0039_op0p5 0.5000000 1.496094 FORMAT "%8.6" EXTENDED_LIMITS 0.5000000 256.4961
 /begin AXIS_DESCR STD_AXIS nmot_w nmot_uw_q0p25 20 0.00 16383.75 FORMAT "%8.2" DEPOSIT ABSOLUTE /end AXIS_DESCR
 /begin AXIS_DESCR STD_AXIS rl_w rel_uw_q0p0234 30 0.00 1535.977 FORMAT "%8.3" DEPOSIT ABSOLUTE /end AXIS_DESCR
/end CHARACTERISTIC
/begin CHARACTERISTIC ExhMgT_stTqResvCatHeatg_C "Code word for torque reserve in catalyzer heating" VALUE 0x9088372 KwWU8 255.0 dez 0.00 255.0 FORMAT "%5.1" /end CHARACTERISTIC
/begin CHARACTERISTIC ExhMgT_tCatAllwdFuCutOff_C "Catalyst temperature limit to permit fuel cut-off" VALUE 0x9088958 KwWU8 1275. temp_ub_q5_o50 -50.00 1225. FORMAT "%5.0" /end CHARACTERISTIC
/begin CHARACTERISTIC ExhMgT_tDeltaCatAllwdFuCutOff_C "Catalyst Delta temperature limit to permit fuel cut-off" VALUE 0x9088959 KwWU8 1275. temp_ub_q5 0.00 1275. FORMAT "%5.0" /end CHARACTERISTIC
/begin CHARACTERISTIC ExhMgT_tDeltaSprkSeatProtn_C "Temperature hysteresis for spark seat component protection" VALUE 0x908895A KwWS16 6553.500 temp_q0p1 -3276.800 3276.700 FORMAT "%8.3" /end CHARACTERISTIC
/begin CHARACTERISTIC ExhMgT_tiEnaLamSprkSeatProtn_C "Delay time for spark seat component protection if catalyst temp. is exceeded." VALUE 0x908895C KwWU8 25.50 t_q0p1 0.00 25.50 FORMAT "%5.2" /end CHARACTERISTIC
/begin CHARACTERISTIC ExhMgT_tiLamSprkSeatFil_C "Time constant for LamSprkSeat component protection" VALUE 0x908895D KwWU8 25.40 t_q0p1 0.1000 25.50 FORMAT "%5.2" EXTENDED_LIMITS 0.00 25.50 /end CHARACTERISTIC
/begin CHARACTERISTIC ExhMgT_tSprkSeatProtn_C "Temperature threshold for spark seat component protection" VALUE 0x908895E KwWS16 6553.500 Temp_Cels -3549.940 3003.560 FORMAT "%8.3" /end CHARACTERISTIC
/begin CHARACTERISTIC FAKMIFAKH "factor to retard the torque during catalyst heating" VALUE 0x9088373 KwWU8 1.000000 fak_ub_b2 0.00 1.000000 FORMAT "%8.6" EXTENDED_LIMITS 0.00 1.992188 /end CHARACTERISTIC
/begin CHARACTERISTIC FKKVS "Factor to correct fuel delivery system" MAP 0x9087862 KfAxU8AyU8SstxU16SstyU16WU16 0.4980469 fak_ub_q0p0019_o0p75 0.7500000 1.248047 FORMAT "%8.6" EXTENDED_LIMITS 0.7500000 128.7480
 /begin AXIS_DESCR STD_AXIS nmot_w nmot_uw_q0p25 10 0.00 16383.75 FORMAT "%8.2" DEPOSIT ABSOLUTE /end AXIS_DESCR
 /begin AXIS_DESCR STD_AXIS tieffr_w t_q0p0064_ms 15 0.00 419.4240 FORMAT "%8.4" DEPOSIT ABSOLUTE /end AXIS_DESCR
/end CHARACTERISTIC
/begin CHARACTERISTIC FlMA_cntrNrZon_C "The maximum number of zones that exist for MPA." VALUE 0x90819B8 RB_Val_Wu8 21.00 OneToOne 0.00 21.00 FORMAT "%5.2" EXTENDED_LIMITS 0.00 255.0 /end CHARACTERISTIC
/begin CHARACTERISTIC FlMA_facEngSpdGrdtCnvr_T "Curve to convert Engine Speed Difference to Engine speed Gradient Factor ." CURVE 0x90819BA RB_Curve_U16_U8_Static 0.9921875 fak_ub_b2 0.007812500 1.000000 FORMAT "%8.6" EXTENDED_LIMITS 0.00 1.992188
 /begin AXIS_DESCR STD_AXIS FlMA_nDeltaEngFild nmot_uw_q0p25 4 0.00 16383.75 FORMAT "%8.2" DEPOSIT ABSOLUTE /end AXIS_DESCR
/end CHARACTERISTIC
/begin CHARACTERISTIC FlMA_facMFlowSubLoadCorrnThd "Calibrated threshold for correction due to fkmsdk_w" VALUE 0x90819C8 RB_Val_Wu16 3.999939 fak_uw_b4 0.00 3.999939 FORMAT "%8.6" /end CHARACTERISTIC
/begin CHARACTERISTIC FlMA_nARbdDeltaLimDeltaEngSpd "Acceleration rebound delta limit for Engine Speed" VALUE 0x90819CA RB_Val_Wu16 16383.75 nmot_uw_q0p25 0.00 16383.75 FORMAT "%8.2" /end CHARACTERISTIC
/begin CHARACTERISTIC FlMA_nARbdLimDeltaEngSpd "Acceleration rebound limit for Engine Speed" VALUE 0x90819CC RB_Val_Wu16 16383.75 nmot_uw_q0p25 0.00 16383.75 FORMAT "%8.2" /end CHARACTERISTIC
/begin CHARACTERISTIC FlMA_nDecelRbdDeltaLimDeltaEngSpd "Deceleration rebound delta limit for Engine speed" VALUE 0x90819CE RB_Val_Wu16 16383.75 nmot_uw_q0p25 0.00 16383.75 FORMAT "%8.2" /end CHARACTERISTIC
/begin CHARACTERISTIC FlMA_nDecelRbdLimDeltaEngSpd "Deceleration rebound limit for Engine Speed" VALUE 0x90819D0 RB_Val_Wu16 16383.75 nmot_uw_q0p25 0.00 16383.75 FORMAT "%8.2" /end CHARACTERISTIC
/begin CHARACTERISTIC FlMA_stCfgDftZonSelnStrt_C "Code word to switch the default zone selection based on calibration or based on EngineSpeed and rl." VALUE 0x90819D2 RB_Val_Wu8 255.0 OneToOne 0.00 255.0 FORMAT "%5.1" /end CHARACTERISTIC
/begin CHARACTERISTIC FlMA_stCfgDurgInin_C "Code Word to initialize all the elements of multiplicative adaptation and offset adaptation array during Ini" VALUE 0x90819D3 RB_Val_Wu8 255.0 OneToOne 0.00 255.0 FORMAT "%5.1" /end CHARACTERISTIC
/begin CHARACTERISTIC FlMA_stCfgLRA_C "Code Word to differentiate the enabling conditions for MPFGA 2 point Mixture adaptation" VALUE 0x90819D4 RB_Val_Wu8 255.0 OneToOne 0.00 255.0 FORMAT "%5.1" /end CHARACTERISTIC
/begin CHARACTERISTIC FlMA_stDftZonSelnStrt "The default zone to be selected at engine start." VALUE 0x90819D5 RB_Val_Wu8 20.00 OneToOne 0.00 20.00 FORMAT "%5.2" EXTENDED_LIMITS 0.00 255.0 /end CHARACTERISTIC
/begin CHARACTERISTIC FlMA_stLowrThdRelAirChrg_C "Upper limit for relative air charge for Offset adaptation Learning" VALUE 0x90819D6 RB_Val_Wu8 191.3 rel_ub_q0p75 0.00 191.3 FORMAT "%5.1" /end CHARACTERISTIC
/begin CHARACTERISTIC FlMA_stZonSelnEngSpdLoad_M "MAP to give the output of the current Zone based on the engine speed and rl." MAP 0x90819D8 RB_Map_U16U16_U16 20.00000 OneToOne 0.00 20.00000 FORMAT "%8.5" EXTENDED_LIMITS 0.00 65535.00
 /begin AXIS_DESCR STD_AXIS nmot_w nmot_uw_q0p25 41 0.00 16383.75 FORMAT "%8.2" DEPOSIT ABSOLUTE /end AXIS_DESCR
 /begin AXIS_DESCR STD_AXIS rl rel_ub_q0p75 41 0.00 191.2500 FORMAT "%8.4" EXTENDED_LIMITS 0.00 49151.25 DEPOSIT ABSOLUTE /end AXIS_DESCR
/end CHARACTERISTIC
/begin CHARACTERISTIC FlMA_tiDeltaEngSpdFildTn_C "Time constant for filtering difference in Engine speed" VALUE 0x90827A2 RB_Val_Wu16 13106.80 t_q0p2 0.2000000 13107.00 FORMAT "%8.2" EXTENDED_LIMITS 0.00 13107.00 /end CHARACTERISTIC
/begin CHARACTERISTIC FlMA_tiDeltaMFlowSubLoadFildTn_C "Time constant for filtering difference in fkmsdk_w" VALUE 0x90827A4 RB_Val_Wu16 13106.80 t_q0p2 0.2000000 13107.00 FORMAT "%8.2" EXTENDED_LIMITS 0.00 13107.00 /end CHARACTERISTIC
/begin CHARACTERISTIC FlMA_tiDlyIdleSpd "De-bounce time to check if engine is in steady idle" VALUE 0x90827A6 RB_Val_Wu16 13107.00 t_q0p2 0.00 13107.00 FORMAT "%8.2" /end CHARACTERISTIC
/begin CHARACTERISTIC FlMA_tiZonChgfraTn_C "Initial time constant value for ramping up old adaptaion value to new adaptation value(FRA)" VALUE 0x90827A8 RB_Val_Wu16 13106.80 t_q0p2 0.2000000 13107.00 FORMAT "%8.2" EXTENDED_LIMITS 0.00 13107.00 /end CHARACTERISTIC
/begin CHARACTERISTIC FlMA_tiZonChgoraTn_C "Initial time constant value for ramping up old adaptaion value to new adaptation value(ORA)" VALUE 0x90827AA RB_Val_Wu16 13106.80 t_q0p2 0.2000000 13107.00 FORMAT "%8.2" EXTENDED_LIMITS 0.00 13107.00 /end CHARACTERISTIC
/begin CHARACTERISTIC FlMA_tLowrThdEngT_C "Lower Temperature threshold for Engine Temperature" VALUE 0x90827AC RB_Val_Ws16 6553.500 Temp_Cels -3549.940 3003.560 FORMAT "%8.3" /end CHARACTERISTIC
/begin CHARACTERISTIC FlMA_tLowrThdIntkAirT_C "Lower Temperature threshold for Intake air Temperature" VALUE 0x90827AE RB_Val_Ws16 6553.500 Temp_Cels -3549.940 3003.560 FORMAT "%8.3" /end CHARACTERISTIC
/begin CHARACTERISTIC FlMA_tUpprThdEngT_C "Upper temperature threshold of engine temperature." VALUE 0x90827B0 RB_Val_Ws16 6553.500 Temp_Cels -3549.940 3003.560 FORMAT "%8.3" /end CHARACTERISTIC
/begin CHARACTERISTIC FlMA_tUpprThdIntkAirT_C "Upper Temperature threshold for Intake air Temperature" VALUE 0x90827B2 RB_Val_Ws16 6553.500 Temp_Cels -3549.940 3003.560 FORMAT "%8.3" /end CHARACTERISTIC
/begin CHARACTERISTIC FRAMN "Lower limit for multiplicative correction of the mixture adaptation(fra)" VALUE 0x90827B4 RB_Val_Wu16 1.999969 fak_uw_b2 0.00 1.999969 FORMAT "%8.6" /end CHARACTERISTIC
/begin CHARACTERISTIC FRAMX "Upper limit for multiplicative correction of the mixture adaptation(fra)" VALUE 0x90827B6 RB_Val_Wu16 1.999969 fak_uw_b2 0.00 1.999969 FORMAT "%8.6" /end CHARACTERISTIC
/begin CHARACTERISTIC FSTNSHO "Altitude correction for Start/ post start factor" CURVE 0x90879C4 KlAxU8SstxU8WU8 3.984 fak_ub_b4 0.00 3.984 FORMAT "%5.3"
 /begin AXIS_DESCR STD_AXIS fho fak_ub_b4 4 0.00 3.984 FORMAT "%5.3" DEPOSIT ABSOLUTE /end AXIS_DESCR
/end CHARACTERISTIC
/begin CHARACTERISTIC FSTNSHST "start/post start factor for hot start" CURVE 0x90879CE KlAxU8SstxU16WU16 63.99902 fak_uw_b64 0.00 63.99902 FORMAT "%8.5"
 /begin AXIS_DESCR STD_AXIS anzesw_w dez 4 0.00 65535.00 FORMAT "%8.2" DEPOSIT ABSOLUTE /end AXIS_DESCR
/end CHARACTERISTIC
/begin CHARACTERISTIC FTLRSFRM "Multiplication factor for the filter time constant" VALUE 0x9088F50 KwWU8 25.50 fak_q0p1 0.00 25.50 FORMAT "%5.2" /end CHARACTERISTIC
/begin CHARACTERISTIC FZDKADR "Factor for filter time constant of differentiator for signal amplitude, for controller" VALUE 0x9088E6B KwUb 25.50 fak_q0p1 0.00 25.50 FORMAT "%5.2" /end CHARACTERISTIC
/begin CHARACTERISTIC FZDKAFR "Factor for time constant ""absolute value filter"" for signal amplitude, for controller" VALUE 0x9088E6C KwUb 25.50 fak_q0p1 0.00 25.50 FORMAT "%5.2" /end CHARACTERISTIC
/begin CHARACTERISTIC IMLLRMN "Min. threshold for air mass flow from start lambda control" VALUE 0x9088E6E KwUw 7281.667 m_uw_b7281 0.00 7281.667 FORMAT "%8.3" /end CHARACTERISTIC
/begin CHARACTERISTIC InjSys_facCorFuCons_M "Factor for calculation fuel consumption" MAP 0x90879E0 KfAxU8AyU8SstxU16SstyU16WU16 1.999969 fak_uw_b2 0.00 1.999969 FORMAT "%8.6"
 /begin AXIS_DESCR STD_AXIS nmot_w nmot_uw_q0p25 20 0.00 16383.75 FORMAT "%8.2" DEPOSIT ABSOLUTE /end AXIS_DESCR
 /begin AXIS_DESCR STD_AXIS tieff_w t_q0p0064_ms 20 0.00 419.4240 FORMAT "%8.4" DEPOSIT ABSOLUTE /end AXIS_DESCR
/end CHARACTERISTIC
/begin CHARACTERISTIC InjSys_facCorrnFuTCalcn_M "Weighting factor calculation of fuel temperature based on fresh air flow over throttle blade and intake air temperature." MAP 0x9087D54 KfAxU8AyU8SstxU16SstyU16WU16 1.992188 fak_ub_b2 0.00 1.992188 FORMAT "%8.6" EXTENDED_LIMITS 0.00 511.9922
 /begin AXIS_DESCR STD_AXIS msdkrohq_w m_uw_b655p35 6 0.00 655.3500 FORMAT "%8.4" DEPOSIT ABSOLUTE /end AXIS_DESCR
 /begin AXIS_DESCR STD_AXIS InjSys_tansLoc Temp_Cels 6 -273.1400 3003.560 FORMAT "%8.3" EXTENDED_LIMITS -273.1400 6280.360 DEPOSIT ABSOLUTE /end AXIS_DESCR
/end CHARACTERISTIC
/begin CHARACTERISTIC InjSys_facInjrFlowCorrn_T "injection correction for RLFS" CURVE 0x9087DB8 KlAxU8SstxS16WU16_Static 0.4980469 fak_ub_q0p0019_o0p75 0.7500000 1.248047 FORMAT "%8.6" EXTENDED_LIMITS 0.7500000 128.7480
 /begin AXIS_DESCR STD_AXIS dpus_w p_sw_q0p078 4 -2560.000 2559.922 FORMAT "%8.3" DEPOSIT ABSOLUTE /end AXIS_DESCR
/end CHARACTERISTIC
/begin CHARACTERISTIC InjSys_mfStatInjrFlowRate_C "Static flow rate of injector" VALUE 0x9087DCA KwWU16 6553.500 m_q0p1_g_DIV_min 0.00 6553.500 FORMAT "%8.3" /end CHARACTERISTIC
/begin CHARACTERISTIC InjSys_mlgSpFco_T "Speed to Mileage conversion factor curve" CURVE 0x9088418 KlAxU8SstxS16WU16_Static 6553.500 fak_q0p1 0.00 6553.500 FORMAT "%8.3"
 /begin AXIS_DESCR STD_AXIS VehV_vAvrg vel 8 -327.6800 327.6700 FORMAT "%8.4" DEPOSIT ABSOLUTE /end AXIS_DESCR
/end CHARACTERISTIC
/begin CHARACTERISTIC InjSys_nrAvrgMlgDrvgCyc_C "Parameter to select number of Avergae Mileage Driving Cycles" VALUE 0x908843A KwWU8 254.0 dez 1.000 255.0 FORMAT "%5.1" EXTENDED_LIMITS 0.00 255.0 /end CHARACTERISTIC
/begin CHARACTERISTIC InjSys_ratStoic_C "Calibration for Stoichiometric ratio air fuel" VALUE 0x9087DCC KwWU16 31.99902 fak_q0p000488 0.0004882813 31.99951 FORMAT "%8.5" EXTENDED_LIMITS 0.00 31.99951 /end CHARACTERISTIC
/begin CHARACTERISTIC InjSys_rhoFuDens_T "Curve: Modelled Real time Fuel density" CURVE 0x9087DCE KlAxU8SstxS16WU16_Static 6553.500 m_q0p1_g_DIV_L 0.00 6553.500 FORMAT "%8.3"
 /begin AXIS_DESCR STD_AXIS InjSys_tMdlFuTFild Temp_Cels 8 -3549.940 3003.560 FORMAT "%8.3" DEPOSIT ABSOLUTE /end AXIS_DESCR
/end CHARACTERISTIC
/begin CHARACTERISTIC InjSys_tiDlyInjTiCorrn_C "Delay time factor for battery voltage based injection timing correction" VALUE 0x9087DF0 KwWU16 655.3500 t_q0p01 0.00 655.3500 FORMAT "%8.4" /end CHARACTERISTIC
/begin CHARACTERISTIC InjSys_tiMdlFuTCalcnFastFil_C "Time constant for modelled fuel temperature calculation(faster time constant)" VALUE 0x9087DF2 KwWU16 6553.400 t_q0p1 0.1000000 6553.500 FORMAT "%8.3" EXTENDED_LIMITS 0.00 6553.500 /end CHARACTERISTIC
/begin CHARACTERISTIC InjSys_tiMdlFuTCalcn_C "Time constant for modelled fuel temperature calculation" VALUE 0x9087DF4 KwWU16 6553.400 t_q0p1 0.1000000 6553.500 FORMAT "%8.3" EXTENDED_LIMITS 0.00 6553.500 /end CHARACTERISTIC
/begin CHARACTERISTIC InjSys_tiStrtEndFuDensCorrn_T "Time after start to activate Fuel Density correction." CURVE 0x9087DF6 KlAxU8SstxS16WU16_Static 6553.500 t100msxs_uw_b6553p5 0.00 6553.500 FORMAT "%8.3"
 /begin AXIS_DESCR STD_AXIS EngDa_tStrt Temp_Cels 8 -3549.940 3003.560 FORMAT "%8.3" DEPOSIT ABSOLUTE /end AXIS_DESCR
/end CHARACTERISTIC
/begin CHARACTERISTIC InjSys_tiVehMilg_C "Time constant for Low pass filter of vehicle mileage." VALUE 0x908843C KwWU16 254.0000 t_q1 1.000000 255.0000 FORMAT "%8.4" EXTENDED_LIMITS 0.00 65535.00 /end CHARACTERISTIC
/begin CHARACTERISTIC InjSys_tStatInjrFlowRateCalcn_C "Temperature at which static flow rate of injector is measured" VALUE 0x9087E18 KwWS16 6553.500 Temp_Cels -3549.940 3003.560 FORMAT "%8.3" /end CHARACTERISTIC
/begin CHARACTERISTIC InjSys_volCyl_C "cylinder displacement" VALUE 0x9087E1A KwWU16 3.276700 vol_q5p0Em5_l 0.00005000000 3.276750 FORMAT "%8.6" EXTENDED_LIMITS 0.00 3.276750 /end CHARACTERISTIC
/begin CHARACTERISTIC IVDN "LLR: I-gain for vehicle at rest" CURVE 0x9088DE0 GklWU8 0.1245 rel_q0p000488 0.00 0.1245 FORMAT "%6.4"
 /begin AXIS_DESCR COM_AXIS dn nmotd_sb_q10 6 -1280. 1270. FORMAT "%5.0" AXIS_PTS_REF SDN06LLSB /end AXIS_DESCR
/end CHARACTERISTIC
/begin CHARACTERISTIC IVDNV "LLR: I-gain for vehicle rolling" CURVE 0x9088DE6 GklWU8 0.1245 rel_q0p000488 0.00 0.1245 FORMAT "%6.4"
 /begin AXIS_DESCR COM_AXIS dn nmotd_sb_q10 6 -1280. 1270. FORMAT "%5.0" AXIS_PTS_REF SDN06LLSB /end AXIS_DESCR
/end CHARACTERISTIC
/begin CHARACTERISTIC KDLASHKI "evaluation factor of I-part of LRHK, f(dlashkm)" CURVE 0x9088E70 KlAxU8SstxS8WS8 0.06226 fak_q0p000244 -0.03125 0.03101 FORMAT "%7.5"
 /begin AXIS_DESCR STD_AXIS dlashkm fak_q0p000244 6 -0.03125 0.03101 FORMAT "%7.5" DEPOSIT ABSOLUTE /end AXIS_DESCR
/end CHARACTERISTIC
/begin CHARACTERISTIC KDLASHKP "evaluation factor of P-part of LRHK, f(dlashkm_w)" CURVE 0x9088E7D KlAxU8SstxS8WS8 0.06226 fak_q0p000244 -0.03125 0.03101 FORMAT "%7.5"
 /begin AXIS_DESCR STD_AXIS dlashkm fak_q0p000244 6 -0.03125 0.03101 FORMAT "%7.5" DEPOSIT ABSOLUTE /end AXIS_DESCR
/end CHARACTERISTIC
/begin CHARACTERISTIC KFDLAV "lambda delay of lambda control upstream catalyst" MAP 0x9088F51 GkfWS8 0.06226 fak_q0p000244 -0.03125 0.03101 FORMAT "%7.5"
 /begin AXIS_DESCR COM_AXIS nmot_w nmot_uw_q0p25 10 0.00 16383.75 FORMAT "%8.2" AXIS_PTS_REF SNM05LRUW /end AXIS_DESCR
 /begin AXIS_DESCR COM_AXIS rl rel_ub_q0p75 10 0.00 191.3 FORMAT "%5.1" AXIS_PTS_REF SRL05LRUB /end AXIS_DESCR
/end CHARACTERISTIC
/begin CHARACTERISTIC KFDWEEST "Delta angle injection end at start" MAP 0x9087E1C KfAxU8AyU8SstxU16SstyU16WS16 1530.000 zw_sb_q6 -768.0000 762.0000 FORMAT "%8.4" EXTENDED_LIMITS -196608.0 196602.0
 /begin AXIS_DESCR STD_AXIS InjSyG_EngDa_tStrtLoc Temp_Cels 8 -273.1400 3003.560 FORMAT "%8.3" EXTENDED_LIMITS -273.1400 6280.360 DEPOSIT ABSOLUTE /end AXIS_DESCR
 /begin AXIS_DESCR STD_AXIS anztib_w dez 8 0.00 65535.00 FORMAT "%8.2" DEPOSIT ABSOLUTE /end AXIS_DESCR
/end CHARACTERISTIC
/begin CHARACTERISTIC KFDZWLONE "Ignition angle correction offset" MAP 0x9088960 GkfWS8 191.3 zw_sb_q0p75 -96.00 95.25 FORMAT "%5.2"
 /begin AXIS_DESCR COM_AXIS nmot_w nmot_uw_q0p25 16 0.00 16383.75 FORMAT "%8.2" AXIS_PTS_REF SNM16BTSUW /end AXIS_DESCR
 /begin AXIS_DESCR COM_AXIS rl_w rel_uw_q0p0234 12 0.00 1535.977 FORMAT "%8.3" AXIS_PTS_REF SRL12BTSUW /end AXIS_DESCR
/end CHARACTERISTIC
/begin CHARACTERISTIC KFFDLBTS "Factor delta nominal Lambda for component protection" MAP 0x9088A20 GkfWU8 1.992188 fak_ub_b2 0.00 1.992188 FORMAT "%8.6"
 /begin AXIS_DESCR COM_AXIS nmot_w nmot_uw_q0p25 16 0.00 16383.75 FORMAT "%8.2" AXIS_PTS_REF SNM16BTSUW /end AXIS_DESCR
 /begin AXIS_DESCR COM_AXIS rl_w rel_uw_q0p0234 12 0.00 1535.977 FORMAT "%8.3" AXIS_PTS_REF SRL12BTSUW /end AXIS_DESCR
/end CHARACTERISTIC
/begin CHARACTERISTIC KFFSTNS "Map for Start/post start enrichment factor" MAP 0x9087EC0 KfAxU8AyU8SstxU16SstyU16WU16 63.99902 fak_uw_b64 0.00 63.99902 FORMAT "%8.5"
 /begin AXIS_DESCR STD_AXIS anzesw_w dez 16 0.00 65535.00 FORMAT "%8.2" DEPOSIT ABSOLUTE /end AXIS_DESCR
 /begin AXIS_DESCR STD_AXIS InjSyG_EngDa_tStrtLoc Temp_Cels 10 -273.1400 3003.560 FORMAT "%8.3" EXTENDED_LIMITS -273.1400 6280.360 DEPOSIT ABSOLUTE /end AXIS_DESCR
/end CHARACTERISTIC
/begin CHARACTERISTIC KFFWL "map warm-up factor" MAP 0x9088038 KfAxU8AyU8SstxU16SstyU16WU16 1.992188 fak_ub_b2 0.00 1.992188 FORMAT "%8.6" EXTENDED_LIMITS 0.00 511.9922
 /begin AXIS_DESCR STD_AXIS InjSyG_EngDa_tEngLoc Temp_Cels 14 -273.1400 3003.560 FORMAT "%8.3" EXTENDED_LIMITS -273.1400 6280.360 DEPOSIT ABSOLUTE /end AXIS_DESCR
 /begin AXIS_DESCR STD_AXIS InjSyG_EngDa_tStrtLoc Temp_Cels 10 -273.1400 3003.560 FORMAT "%8.3" EXTENDED_LIMITS -273.1400 6280.360 DEPOSIT ABSOLUTE /end AXIS_DESCR
/end CHARACTERISTIC
/begin CHARACTERISTIC KFLANS "map lambda engine during afterstart" MAP 0x9088C16 KfAxU8AyU8SstxU16SstyU16WS16 0.9960938 fak_q0p0039_op0p5 0.5000000 1.496094 FORMAT "%8.6" EXTENDED_LIMITS -127.5000 128.4961
 /begin AXIS_DESCR STD_AXIS anztib_w dez 6 0.00 65535.00 FORMAT "%8.2" DEPOSIT ABSOLUTE /end AXIS_DESCR
 /begin AXIS_DESCR STD_AXIS LamCtrl_tEngStrtWpDisp Temp_Cels 6 -273.1400 3003.560 FORMAT "%8.3" EXTENDED_LIMITS -273.1400 6280.360 DEPOSIT ABSOLUTE /end AXIS_DESCR
/end CHARACTERISTIC
/begin CHARACTERISTIC KFLBTS "Nominal Lambda for component protection" MAP 0x9088AE0 GkfWU8 0.9961 fak_q0p0039_op0p5 0.5000 1.496 FORMAT "%5.3"
 /begin AXIS_DESCR COM_AXIS nmot_w nmot_uw_q0p25 16 0.00 16383.75 FORMAT "%8.2" AXIS_PTS_REF SNM16BTSUW /end AXIS_DESCR
 /begin AXIS_DESCR COM_AXIS rl_w rel_uw_q0p0234 12 0.00 1535.977 FORMAT "%8.3" AXIS_PTS_REF SRL12BTSUW /end AXIS_DESCR
/end CHARACTERISTIC
/begin CHARACTERISTIC KFMRES "Engine speed control: Torque reserve at idle and near-idle zone" MAP 0x9088CDF GkfWU8 24.90 rel_ub_b25 0.00 24.90 FORMAT "%5.2"
 /begin AXIS_DESCR COM_AXIS nmot_w nmot_uw_q0p25 6 0.00 16383.75 FORMAT "%8.2" AXIS_PTS_REF SNM06LLUB /end AXIS_DESCR
 /begin AXIS_DESCR COM_AXIS mifa_w rel_uw_b100 4 0.00 99.99847 FORMAT "%8.5" AXIS_PTS_REF SMI04LLUB /end AXIS_DESCR
/end CHARACTERISTIC
/begin CHARACTERISTIC KFMRESK "Engine speed control: Torque reserve at idle and near-idle zone, closed powertrain" MAP 0x9088CF7 GkfWU8 24.90 rel_ub_b25 0.00 24.90 FORMAT "%5.2"
 /begin AXIS_DESCR COM_AXIS nmot_w nmot_uw_q0p25 6 0.00 16383.75 FORMAT "%8.2" AXIS_PTS_REF SNM06LLUB /end AXIS_DESCR
 /begin AXIS_DESCR COM_AXIS mifa_w rel_uw_b100 4 0.00 99.99847 FORMAT "%8.5" AXIS_PTS_REF SMI04LLUB /end AXIS_DESCR
/end CHARACTERISTIC
/begin CHARACTERISTIC KFMRESNL "Torque reserve in non idling state" MAP 0x9088D0F GkfWU8 24.90 rel_ub_b25 0.00 24.90 FORMAT "%5.2"
 /begin AXIS_DESCR COM_AXIS nmot_w nmot_uw_q0p25 6 0.00 16383.75 FORMAT "%8.2" AXIS_PTS_REF SNM06LLUB /end AXIS_DESCR
 /begin AXIS_DESCR COM_AXIS mifa_w rel_uw_b100 4 0.00 99.99847 FORMAT "%8.5" AXIS_PTS_REF SMI04LLUB /end AXIS_DESCR
/end CHARACTERISTIC
/begin CHARACTERISTIC KFNLLVG "desired speed depending on vehicle speed." MAP 0x9088D2A KfAxU8AyU8SstxU16SstyU8WU8 2550. nmot_ub_q10 0.00 2550. FORMAT "%5.0"
 /begin AXIS_DESCR STD_AXIS vfzg_w vfzg_uw_b512 6 0.00 511.9922 FORMAT "%8.4" DEPOSIT ABSOLUTE /end AXIS_DESCR
 /begin AXIS_DESCR STD_AXIS gangi dez 6 0.00 255.0 FORMAT "%5.1" DEPOSIT ABSOLUTE /end AXIS_DESCR
/end CHARACTERISTIC
/begin CHARACTERISTIC KFRAP "map for ratio amplitude / P part" MAP 0x9088FB6 GkfWU16 655.3500 fak_uw_q0p01 0.00 655.3500 FORMAT "%8.4"
 /begin AXIS_DESCR COM_AXIS nmot_w nmot_uw_q0p25 10 0.00 16383.75 FORMAT "%8.2" AXIS_PTS_REF SNM05LRUW /end AXIS_DESCR
 /begin AXIS_DESCR COM_AXIS rl rel_ub_q0p75 10 0.00 191.3 FORMAT "%5.1" AXIS_PTS_REF SRL05LRUB /end AXIS_DESCR
/end CHARACTERISTIC
/begin CHARACTERISTIC KFRP "P characteristic map" MAP 0x908907E GkfWU8 12.45 fak_ub_b12p45 0.00 12.45 FORMAT "%5.2"
 /begin AXIS_DESCR COM_AXIS nmot_w nmot_uw_q0p25 10 0.00 16383.75 FORMAT "%8.2" AXIS_PTS_REF SNM05LRUW /end AXIS_DESCR
 /begin AXIS_DESCR COM_AXIS rl rel_ub_q0p75 10 0.00 191.3 FORMAT "%5.1" AXIS_PTS_REF SRL05LRUB /end AXIS_DESCR
/end CHARACTERISTIC
/begin CHARACTERISTIC KFTFNSOL "Time constant of filter for desired idle speed" MAP 0x9088D62 KfAxU8AyU8SstxS16SstyS16WS16 5.080000 t20msxs_ub_b5p1 0.02000000 5.100000 FORMAT "%8.6" EXTENDED_LIMITS -655.3600 655.3400
 /begin AXIS_DESCR STD_AXIS LLRNS_nDifIdleSpd nmotd_sb_q10 4 -1280.000 1270.000 FORMAT "%8.3" EXTENDED_LIMITS -327680.0 327670.0 DEPOSIT ABSOLUTE /end AXIS_DESCR
 /begin AXIS_DESCR STD_AXIS LLRNSNSOL_tEng Temp_Cels 3 -3549.940 3003.560 FORMAT "%8.3" DEPOSIT ABSOLUTE /end AXIS_DESCR
/end CHARACTERISTIC
/begin CHARACTERISTIC KFUSHK "lambda sensor reference value for lambda control downstream of catalys" MAP 0x9088E8A GkfWUb 1.275 spg_q0p005 0.00 1.275 FORMAT "%5.3"
 /begin AXIS_DESCR COM_AXIS nmot_w nmot_uw_q0p25 5 0.00 16383.75 FORMAT "%8.2" AXIS_PTS_REF SNM05LHUB /end AXIS_DESCR
 /begin AXIS_DESCR COM_AXIS rl rel_ub_q0p75 10 0.00 191.3 FORMAT "%5.1" AXIS_PTS_REF SRL05LRUB /end AXIS_DESCR
/end CHARACTERISTIC
/begin CHARACTERISTIC KFWEEOF "Angle of injection end at inlet opening without consideration of flight time, depending on engine speed and load" MAP 0x9088184 KfAxU8AyU8SstxU8SstyU16WU8 1530. zw_ub_q6 0.00 1530. FORMAT "%5.0"
 /begin AXIS_DESCR STD_AXIS rl rel_ub_q0p75 8 0.00 191.3 FORMAT "%5.1" DEPOSIT ABSOLUTE /end AXIS_DESCR
 /begin AXIS_DESCR STD_AXIS nmot_w nmot_uw_q0p25 8 0.00 16383.75 FORMAT "%8.2" DEPOSIT ABSOLUTE /end AXIS_DESCR
/end CHARACTERISTIC
/begin CHARACTERISTIC KFWLIML "Map weighting warm-up factor." MAP 0x90881DE KfAxU8AyU8SstxU16SstyU16WU16 1.992188 fak_ub_b2 0.00 1.992188 FORMAT "%8.6" EXTENDED_LIMITS 0.00 511.9922
 /begin AXIS_DESCR STD_AXIS iml_w m_uw_b23p3 6 0.00 23.30133 FORMAT "%8.5" DEPOSIT ABSOLUTE /end AXIS_DESCR
 /begin AXIS_DESCR STD_AXIS InjSyG_EngDa_tStrtLoc Temp_Cels 6 -273.1400 3003.560 FORMAT "%8.3" EXTENDED_LIMITS -273.1400 6280.360 DEPOSIT ABSOLUTE /end AXIS_DESCR
/end CHARACTERISTIC
/begin CHARACTERISTIC KFWLRL "Factor warm-up load and engine speed dependent fraction" MAP 0x9088242 KfAxU8AyU8SstxU8SstyU16WU8 3.984 fak_ub_b4 0.00 3.984 FORMAT "%5.3"
 /begin AXIS_DESCR STD_AXIS rl rel_ub_q0p75 6 0.00 191.3 FORMAT "%5.1" DEPOSIT ABSOLUTE /end AXIS_DESCR
 /begin AXIS_DESCR STD_AXIS nmotfihy_w nmot_uw_q0p25 6 0.00 16383.75 FORMAT "%8.2" DEPOSIT ABSOLUTE /end AXIS_DESCR
/end CHARACTERISTIC
/begin CHARACTERISTIC KFZWKHZ "Map for desired ignition-timing for catalyst heating in case of cold start" MAP 0x9088374 KfAxU8AyU8SstxU16SstyU16WS16 191.2500 zw_sb_q0p75 -96.00000 95.25000 FORMAT "%8.5" EXTENDED_LIMITS -24576.00 24575.25
 /begin AXIS_DESCR STD_AXIS mifal_w rel_uw_b100 6 0.00 99.99847 FORMAT "%8.5" DEPOSIT ABSOLUTE /end AXIS_DESCR
 /begin AXIS_DESCR STD_AXIS nmotfihy_w nmot_uw_q0p25 6 0.00 16383.75 FORMAT "%8.2" DEPOSIT ABSOLUTE /end AXIS_DESCR
/end CHARACTERISTIC
/begin CHARACTERISTIC KLDETAKH "Minimum distance to minimal spark efficiency while spark retard for cat. heat." CURVE 0x90883D8 KlAxU8SstxU8WU8 127.5 rel_ub_b127p5 0.00 127.5 FORMAT "%5.1"
 /begin AXIS_DESCR STD_AXIS etazwmn rel_ub_b127p5 6 0.00 127.5 FORMAT "%5.1" DEPOSIT ABSOLUTE /end AXIS_DESCR
/end CHARACTERISTIC
/begin CHARACTERISTIC KLDISTLFS1OFF "Distance - temperature map to turn off EMC (lfs1) fan" CURVE 0x9088C82 KlAxU8SstxU16WS16_Static 6553.500 Temp_Cels -3549.940 3003.560 FORMAT "%8.3"
 /begin AXIS_DESCR STD_AXIS distlfson dez 4 0.00 65535.00 FORMAT "%8.2" DEPOSIT ABSOLUTE /end AXIS_DESCR
/end CHARACTERISTIC
/begin CHARACTERISTIC KLDLBTS "Delta nominal Lambda for component protection" CURVE 0x9088BA0 KlAxU8SstxS16WS16 511.9922 fak_q0p00781 -256.0000 255.9922 FORMAT "%8.4"
 /begin AXIS_DESCR STD_AXIS detazwbs rel_q0p5 6 -16384.00 16383.50 FORMAT "%8.2" DEPOSIT ABSOLUTE /end AXIS_DESCR
/end CHARACTERISTIC
/begin CHARACTERISTIC KLDTPSVK "Correction for ramp duration" CURVE 0x90890E2 KlAxU8SstxS8WU8_Static 2.550 t10msxs_ub_b2p55 0.00 2.550 FORMAT "%5.3"
 /begin AXIS_DESCR STD_AXIS dtpsvkmf t_q0p02 2 -2.560 2.540 FORMAT "%5.3" DEPOSIT ABSOLUTE /end AXIS_DESCR
/end CHARACTERISTIC
/begin CHARACTERISTIC KLFKTLT "weighting pd-reinforcement (air-path) depending on temperature" CURVE 0x9088DEC KlAxU8SstxS16WU16_Static 511.9922 fak_ub_b2 0.00 511.9922 FORMAT "%8.4"
 /begin AXIS_DESCR STD_AXIS LLRRMAIPA_tEng Temp_Cels 6 -3549.940 3003.560 FORMAT "%8.3" DEPOSIT ABSOLUTE /end AXIS_DESCR
/end CHARACTERISTIC
/begin CHARACTERISTIC KLFKTZT "weighting pd-reinforcement (ignition-angle-path) depending on temperature" CURVE 0x9088E06 KlAxU8SstxS16WU16_Static 511.9922 fak_ub_b2 0.00 511.9922 FORMAT "%8.4"
 /begin AXIS_DESCR STD_AXIS LLRRMIGP_tEng Temp_Cels 6 -3549.940 3003.560 FORMAT "%8.3" DEPOSIT ABSOLUTE /end AXIS_DESCR
/end CHARACTERISTIC
/begin CHARACTERISTIC KLFSTKTFHO "weighting factor for desired engine efficiency for catalyst heating by cold engine in dependence of altitude" CURVE 0x90883E6 KlAxU8SstxU16WU8_Static 0.9961 fak_ub_b1 0.00 0.9961
 /begin AXIS_DESCR STD_AXIS fho_w fak_uw_b4 4 0.00 3.999939 FORMAT "%8.6" DEPOSIT ABSOLUTE /end AXIS_DESCR
/end CHARACTERISTIC
/begin CHARACTERISTIC KLFSTKTMST "weighting factor for desired engine efficiency for catalyst heating by cold engine in dependence of engine start temperature" CURVE 0x90883F4 KlAxU8SstxS16WU16_Static 1.999969 fak_uw_b2 0.00 1.999969 FORMAT "%8.6"
 /begin AXIS_DESCR STD_AXIS EngDa_tStrt Temp_Cels 5 -3549.940 3003.560 FORMAT "%8.3" DEPOSIT ABSOLUTE /end AXIS_DESCR
/end CHARACTERISTIC
/begin CHARACTERISTIC KLFSTKTTNS "weighting factor for desired engine efficiency for catalyst heating by cold engine in dependence of time after start" CURVE 0x908840A KlAxU8SstxU16WU8_Static 1.992188 fak_ub_b2 0.00 1.992188 FORMAT "%8.6"
 /begin AXIS_DESCR STD_AXIS tnse_w t100msxs_uw_b6553p5 4 0.00 6553.500 FORMAT "%8.3" DEPOSIT ABSOLUTE /end AXIS_DESCR
/end CHARACTERISTIC
/begin CHARACTERISTIC KLKTZLR "Correction for Dead time" CURVE 0x90890E7 KlAxU8SstxU8WU8 1.992188 fak_ub_b2 0.00 1.992188 FORMAT "%8.6"
 /begin AXIS_DESCR STD_AXIS taikrm temp_ub_q5_o50 3 -50.00 1225. FORMAT "%5.0" DEPOSIT ABSOLUTE /end AXIS_DESCR
/end CHARACTERISTIC
/begin CHARACTERISTIC KLTDLFSAR "requested engine fan after run time" CURVE 0x9088C94 KlAxU8SstxS16WU16_Static 6553.500 t_q0p1 0.00 6553.500 FORMAT "%8.3"
 /begin AXIS_DESCR STD_AXIS EngDa_tEng Temp_Cels 6 -3549.940 3003.560 FORMAT "%8.3" DEPOSIT ABSOLUTE /end AXIS_DESCR
/end CHARACTERISTIC
/begin CHARACTERISTIC KLZLBTS "Time constant lambd component protection" CURVE 0x9088BBA KlAxU8SstxU16WU16 6553.4999985 zk100msxs_uw_b6553 0.10000152590 6553.6000000 FORMAT "%12.7"
 /begin AXIS_DESCR STD_AXIS ml_w m_uw_b6553p5 6 0.00 6553.500 FORMAT "%8.3" DEPOSIT ABSOLUTE /end AXIS_DESCR
/end CHARACTERISTIC
/begin CHARACTERISTIC KNSNF "Engine speed follow-up inhibition band" VALUE 0x9088D8C KwWU8 2550. nmot_ub_q10 0.00 2550. FORMAT "%5.0" /end CHARACTERISTIC
/begin CHARACTERISTIC KPLRHML "P-component for continuous LRHK" CURVE 0x9088EBC GklWUb 2.550 fak_q0p01 0.00 2.550 FORMAT "%5.3"
 /begin AXIS_DESCR COM_AXIS ml_w m_uw_b6553p5 6 0.00 6553.500 FORMAT "%8.3" AXIS_PTS_REF SML06LHUW /end AXIS_DESCR
/end CHARACTERISTIC
/begin CHARACTERISTIC KRKTE "conversion from relative fuel mass rk into effective injection time te" VALUE 0x908827A KwWU8 0.2720 fak_q0p00107_ms_DIV_pc 0.00 0.2720 /end CHARACTERISTIC
/begin CHARACTERISTIC KTZLR "Constant for model exhaust pipe volume" VALUE 0x90890EE KwWU16 65535.00 dez 0.00 65535.00 FORMAT "%8.2" /end CHARACTERISTIC
/begin CHARACTERISTIC KWANZWST "map: address shift at restart" MAP 0x908827C KfAxU8AyU8SstxS16SstyU16WU16 255.0000 dez 0.00 255.0000 FORMAT "%8.4" EXTENDED_LIMITS 0.00 65535.00
 /begin AXIS_DESCR STD_AXIS EngDa_tEng Temp_Cels 5 -3549.940 3003.560 FORMAT "%8.3" DEPOSIT ABSOLUTE /end AXIS_DESCR
 /begin AXIS_DESCR STD_AXIS InjSys_tiEngoff t_q1 5 0.00 65535.00 FORMAT "%8.2" DEPOSIT ABSOLUTE /end AXIS_DESCR
/end CHARACTERISTIC
/begin CHARACTERISTIC LABRG "lambda limit for combustion" VALUE 0x9088C7A KwWU8 0.9961 fak_q0p0039_op0p5 0.5000 1.496 FORMAT "%5.3" /end CHARACTERISTIC
/begin CHARACTERISTIC LALIUSH "lambda linearization, sensor behind catalyst" CURVE 0x9088EC2 KlAUbSstUbWUb 0.06223 fak_q0p000244_op0p97 0.9690 1.031 FORMAT "%5.3"
 /begin AXIS_DESCR STD_AXIS ushkl spg_q0p005 10 0.00 1.275 FORMAT "%5.3" DEPOSIT ABSOLUTE /end AXIS_DESCR
/end CHARACTERISTIC
/begin CHARACTERISTIC LamCtrl_facAddlPropJmpLeanB1_MAP "Map for Additional proportional-jump in lean side" MAP 0x90890F0 GkfWU8 4.004 fak_ub_b12p45 0.00 4.004 FORMAT "%5.3" EXTENDED_LIMITS 0.00 12.45
 /begin AXIS_DESCR COM_AXIS nmot_w nmot_uw_q0p25 10 0.00 16383.75 FORMAT "%8.2" AXIS_PTS_REF LamCtrl_SNM05LRUW /end AXIS_DESCR
 /begin AXIS_DESCR COM_AXIS rl rel_ub_q0p75 10 0.00 191.3 FORMAT "%5.1" AXIS_PTS_REF LamCtrl_SRL05LRUB /end AXIS_DESCR
/end CHARACTERISTIC
/begin CHARACTERISTIC LamCtrl_facAddlPropJmpRichB1_MAP "Map for Additional proportional-jump in Rich side" MAP 0x9089154 GkfWU8 4.004 fak_ub_b12p45 0.00 4.004 FORMAT "%5.3" EXTENDED_LIMITS 0.00 12.45
 /begin AXIS_DESCR COM_AXIS nmot_w nmot_uw_q0p25 10 0.00 16383.75 FORMAT "%8.2" AXIS_PTS_REF LamCtrl_SNM05LRUW /end AXIS_DESCR
 /begin AXIS_DESCR COM_AXIS rl rel_ub_q0p75 10 0.00 191.3 FORMAT "%5.1" AXIS_PTS_REF LamCtrl_SRL05LRUB /end AXIS_DESCR
/end CHARACTERISTIC
/begin CHARACTERISTIC LamCtrl_facStrtSmotngInin_C "Factor start smooth correction Initialization value" VALUE 0x90891B8 KwWU16 1.000000 fak_q1p5259Em5 0.00 1.000000 FORMAT "%8.6" /end CHARACTERISTIC
/begin AXIS_PTS LamCtrl_SNM05LRUW "Distribution for engine speed for Lambda control" 0x90891BA nmot_w SstAU8SstU16 16383.75 nmot_uw_q0p25 10 0.00 16383.75 FORMAT "%8.2" DEPOSIT ABSOLUTE /end AXIS_PTS
/begin AXIS_PTS LamCtrl_SRL05LRUB "Distribution for engine load lambda control" 0x90891D0 rl SstAU8SstU8 191.3 rel_ub_q0p75 10 0.00 191.3 FORMAT "%5.1" DEPOSIT ABSOLUTE /end AXIS_PTS
/begin CHARACTERISTIC LamCtrl_tiFuDlyB1_T "Curve for fuel delay time from injection valve to intake valve in lambada control Bank1" CURVE 0x90891DC KlAxU8SstxU16WU8_Static 2.550 t10msxs_ub_b2p55 0.00 2.550 FORMAT "%5.3"
 /begin AXIS_DESCR STD_AXIS nmot_w nmot_uw_q0p25 5 0.00 16383.75 FORMAT "%8.2" DEPOSIT ABSOLUTE /end AXIS_DESCR
/end CHARACTERISTIC
/begin CHARACTERISTIC LamCtrl_tiStrtSmotngEngT_T "Time for smooth correction for frp" CURVE 0x90891EE KlAxU8SstxS16WU16_Static 50.402307540 zk10msxs_uw_b655 0.010000152590 50.412307692 FORMAT "%12.9" EXTENDED_LIMITS 0.010000152590 655.36000000
 /begin AXIS_DESCR STD_AXIS tmst Temp_Cels 8 -3549.940 3003.560 FORMAT "%8.3" DEPOSIT ABSOLUTE /end AXIS_DESCR
/end CHARACTERISTIC
/begin CHARACTERISTIC LamCtrl_uLamSwtThd_C "Lambda control switching threshold voltage" VALUE 0x9089210 KwWU16 327.6750 spg_q0p005 0.00 327.6750 FORMAT "%8.4" /end CHARACTERISTIC
/begin CHARACTERISTIC LASOAB "target lambda value for bank shutdown" VALUE 0x9088C7B KwWU8 0.9961 fak_q0p0039_op0p5 0.5000 1.496 FORMAT "%5.3" /end CHARACTERISTIC
/begin CHARACTERISTIC LIMN "lower integrator limit for standing car" VALUE 0x9088E20 KwWS8 49.80 rel_q0p1953 -25.00 24.80 FORMAT "%5.2" /end CHARACTERISTIC
/begin CHARACTERISTIC LIMXDNS "upper integrator limit for standing car" CURVE 0x9088E21 KlAxU8SstxS8WS8 49.80 rel_q0p1953 -25.00 24.80 FORMAT "%5.2"
 /begin AXIS_DESCR STD_AXIS dns nmotd_sb_q10 6 -1280. 1270. FORMAT "%5.0" DEPOSIT ABSOLUTE /end AXIS_DESCR
/end CHARACTERISTIC
/begin CHARACTERISTIC LLRBB_nEngSpdFuOffs_C "Offset engine speed for fuel cut in" VALUE 0x9088CC6 KwWU8 10200. nmot_ub_q40 0.00 10200. FORMAT "%5.0" /end CHARACTERISTIC
/begin CHARACTERISTIC LLRMR_tiTakeOff_C "Time delay for Clutch release." VALUE 0x9088D27 KwWU8 5.100 t_q0p02 0.00 5.100 FORMAT "%5.3" /end CHARACTERISTIC
/begin CHARACTERISTIC LLRNS_flgSpLoRednNeutCond_C "Nuetral gear condition calibration" VALUE 0x9088D8D KwWU8 1.00000000000 B_TRUE 0.00 1.00000000000 FORMAT "%13.11" /end CHARACTERISTIC
/begin CHARACTERISTIC LLRNS_nRednSpLo_T "Curve for stationary reference speed based on Engine Temprature." CURVE 0x9088D8E KlAxU8SstxS16WU16_Static 2550.000 nmot_ub_q10 0.00 2550.000 FORMAT "%8.3" EXTENDED_LIMITS 0.00 655350.0
 /begin AXIS_DESCR STD_AXIS LLRNS_tEng Temp_Cels 3 -3549.940 3003.560 FORMAT "%8.3" DEPOSIT ABSOLUTE /end AXIS_DESCR
/end CHARACTERISTIC
/begin CHARACTERISTIC LLRNS_nSpLoBatt_T "Battery voltage based refence speed" CURVE 0x9088D9C KlAxU8SstxU8WU8 2550. nmot_ub_q10 0.00 2550. FORMAT "%5.0"
 /begin AXIS_DESCR STD_AXIS LLRNS_voltBattBefStrt sgp_q0p1 6 0.00 25.50 FORMAT "%5.2" DEPOSIT ABSOLUTE /end AXIS_DESCR
/end CHARACTERISTIC
/begin CHARACTERISTIC LLRNS_nStatyRstRef_C "Refrence speed to reset Stationary reference speed to correct value during broken after run condition" VALUE 0x9088DA9 KwWS8 1280. nmotd_sb_q10 -10.00 1270. FORMAT "%5.0" EXTENDED_LIMITS -1280. 1270. /end CHARACTERISTIC
/begin CHARACTERISTIC LLRNS_nTakeOff_C "Time delay for Clutch release." VALUE 0x9088DAA KwWU8 2550. nmot_ub_q10 0.00 2550. FORMAT "%5.0" /end CHARACTERISTIC
/begin CHARACTERISTIC LLRNS_tiSpLoRednMaxEnad_C "Time parameter to activate reduction of Stationary reference speed during gear neutral and clutch pressured." VALUE 0x9088DAC KwWU16 1310.700 t_q0p02 0.00 1310.700 FORMAT "%8.3" /end CHARACTERISTIC
/begin CHARACTERISTIC LLRNS_voltBattDiffThd_C "Battery threshold for update of battery voltage based idle speed" VALUE 0x9088DAE KwWU8 25.50 sgp_q0p1 0.00 25.50 FORMAT "%5.2" /end CHARACTERISTIC
/begin CHARACTERISTIC LLRNS_vThdTakeOff_C "Thd vehicle velocity for take off." VALUE 0x9088DB0 KwWU16 511.9922 vfzg_uw_b512 0.00 511.9922 FORMAT "%8.4" /end CHARACTERISTIC
/begin CHARACTERISTIC LLRRM_tiLwrLimIntgr_C "Filter time constant to lomit lower integrator limit" VALUE 0x9088E2E KwWU16 1310.6999997 zk20msxs_uw_b1310p72 0.020000305180 1310.7200000 FORMAT "%12.7" /end CHARACTERISTIC
/begin CHARACTERISTIC LRHIMN "minimum integrator limit of the continuous LRHK" VALUE 0x9088ED7 KwSb 0.06226 fak_q0p000244 -0.03125 0.03101 FORMAT "%7.5" /end CHARACTERISTIC
/begin CHARACTERISTIC LRHIMX "maximum integrator limit of the continuous LRHK" VALUE 0x9088ED8 KwSb 0.06226 fak_q0p000244 -0.03125 0.03101 FORMAT "%7.5" /end CHARACTERISTIC
/begin CHARACTERISTIC MDLF1 "stationary torque for cooling fan 1" VALUE 0x9088CAE KwWU8 49.80 rel_q0p1953 0.00 49.80 FORMAT "%5.2" /end CHARACTERISTIC
/begin CHARACTERISTIC MLLRA "Upper air mass flow threshold for learning of additive correction term" VALUE 0x90827B8 RB_Val_Wu16 6553.500 m_uw_b6553p5 0.00 6553.500 FORMAT "%8.3" /end CHARACTERISTIC
/begin CHARACTERISTIC MLLRHU "Lower air mass threshold for lambda control downstream catalyst" VALUE 0x9088EDA KwUw 6553.500 m_uw_b6553p5 0.00 6553.500 FORMAT "%8.3" /end CHARACTERISTIC
/begin CHARACTERISTIC NLFS1HI "Engine temperature at which FAN should turn ON when engine speed is greater than threshol" VALUE 0x9088CAF KwWU8 10200. nmot_ub_q40 0.00 10200. FORMAT "%5.0" /end CHARACTERISTIC
/begin CHARACTERISTIC NLLTM "Idle speed" CURVE 0x9088DB2 KlAxU8SstxS16WU16_Static 2550.000 nmot_ub_q10 0.00 2550.000 FORMAT "%8.3" EXTENDED_LIMITS 0.00 655350.0
 /begin AXIS_DESCR STD_AXIS LLRNS_tEng Temp_Cels 3 -3549.940 3003.560 FORMAT "%8.3" DEPOSIT ABSOLUTE /end AXIS_DESCR
/end CHARACTERISTIC
/begin CHARACTERISTIC NLRA "Upper engine speed threshold for enabling offset learning" VALUE 0x90827BA RB_Val_Wu16 16383.75 nmot_uw_q0p25 0.00 16383.75 FORMAT "%8.2" /end CHARACTERISTIC
/begin CHARACTERISTIC NLRHO "upper engine speed threshold for lambda control downstream cat" VALUE 0x9088EDC KwUb 10200. nmot_ub_q40 0.00 10200. FORMAT "%5.0" /end CHARACTERISTIC
/begin CHARACTERISTIC NLRHU "lower engine speed threshold for lambda control downstream cat" VALUE 0x9088EDD KwUb 10200. nmot_ub_q40 0.00 10200. FORMAT "%5.0" /end CHARACTERISTIC
/begin CHARACTERISTIC NSLLREINHY "Engine speed threshold for setting B_llrein" VALUE 0x9088CC7 KwWU8 2550. nmot_ub_q10 0.00 2550. FORMAT "%5.0" /end CHARACTERISTIC
/begin CHARACTERISTIC NSTATNOT "Idle speed during limp-home operation" VALUE 0x9088DC0 KwWU8 2550. nmot_ub_q10 0.00 2550. FORMAT "%5.0" /end CHARACTERISTIC
/begin CHARACTERISTIC NSTNM "transition start -> normal" CURVE 0x90882C4 KlAxU8SstxU16WU16 8191.750 nmot_uw_q0p25 0.00 8191.750 FORMAT "%8.3" EXTENDED_LIMITS 0.00 16383.75
 /begin AXIS_DESCR STD_AXIS EngDa_tEngLoc10ms Temp_Cels 3 -273.1400 3003.560 FORMAT "%8.3" EXTENDED_LIMITS -273.1400 6280.360 DEPOSIT ABSOLUTE /end AXIS_DESCR
/end CHARACTERISTIC
/begin CHARACTERISTIC OFLRAMN "Lower threshold of additive correction of LRA" VALUE 0x90827BC RB_Val_Ws16 26.21400 m_q0p0004 -13.10720 13.10680 FORMAT "%8.5" /end CHARACTERISTIC
/begin CHARACTERISTIC OFLRAMX "Upper threshold of additive correction of LRA" VALUE 0x90827BE RB_Val_Ws16 26.21400 m_q0p0004 -13.10720 13.10680 FORMAT "%8.5" /end CHARACTERISTIC
/begin CHARACTERISTIC OLLSBGHY "hysteresis for the comparison between actual and torque structure desired stepper flow" VALUE 0x9088CC8 KwWU16 99.99847 rel_uw_b100 0.00 99.99847 FORMAT "%8.5" /end CHARACTERISTIC
/begin CHARACTERISTIC PLRHAK "Weighting factor for P-part LRHK depending on ushk amplitude" CURVE 0x9088EDE KlAUbSstUbWUb 0.9961 fak_ub_b1 0.00 0.9961
 /begin AXIS_DESCR STD_AXIS TWC_facSnsrAmpDs fak_ub_b1 6 0.00 0.9961 DEPOSIT ABSOLUTE /end AXIS_DESCR
/end CHARACTERISTIC
/begin CHARACTERISTIC PVDN "LLR: P-gain for vehicle at rest" CURVE 0x9088E30 GklWU8 0.09961 fak_q0p00039 0.00 0.09961 FORMAT "%7.5"
 /begin AXIS_DESCR COM_AXIS dn nmotd_sb_q10 6 -1280. 1270. FORMAT "%5.0" AXIS_PTS_REF SDN06LLSB /end AXIS_DESCR
/end CHARACTERISTIC
/begin CHARACTERISTIC PVDNV "LLR: P-gain for vehicle rolling" CURVE 0x9088E36 GklWU8 0.09961 fak_q0p00039 0.00 0.09961 FORMAT "%7.5"
 /begin AXIS_DESCR COM_AXIS dn nmotd_sb_q10 6 -1280. 1270. FORMAT "%5.0" AXIS_PTS_REF SDN06LLSB /end AXIS_DESCR
/end CHARACTERISTIC
/begin CHARACTERISTIC PVLDN "LLR: P-gain for vehicle at rest (air path)" CURVE 0x9088E3C GklWU8 0.09961 fak_q0p00039 0.00 0.09961 FORMAT "%7.5"
 /begin AXIS_DESCR COM_AXIS dn nmotd_sb_q10 6 -1280. 1270. FORMAT "%5.0" AXIS_PTS_REF SDN06LLSB /end AXIS_DESCR
/end CHARACTERISTIC
/begin CHARACTERISTIC PVLDNV "LLR: P-gain for vehicle at rest (air path)" CURVE 0x9088E42 GklWU8 0.09961 fak_q0p00039 0.00 0.09961 FORMAT "%7.5"
 /begin AXIS_DESCR COM_AXIS dn nmotd_sb_q10 6 -1280. 1270. FORMAT "%5.0" AXIS_PTS_REF SDN06LLSB /end AXIS_DESCR
/end CHARACTERISTIC
/begin CHARACTERISTIC RLLRA "Upper load threshold for learning of additive correction learning" VALUE 0x90827C0 RB_Val_Wu8 191.3 rel_ub_q0p75 0.00 191.3 FORMAT "%5.1" /end CHARACTERISTIC
/begin CHARACTERISTIC RLLRHO "Upper load threshold for lambda control downstream catalyst" VALUE 0x9088EEB KwUb 191.3 rel_ub_q0p75 0.00 191.3 FORMAT "%5.1" /end CHARACTERISTIC
/begin AXIS_PTS SDN06LLSB "10 Sst." 0x9088E48 dn SstAU8SstS8 2550. nmotd_sb_q10 6 -1280. 1270. FORMAT "%5.0" DEPOSIT ABSOLUTE /end AXIS_PTS
/begin AXIS_PTS SMI04LLUB "distribution: ind. torque for torque-reserve" 0x9088E50 mifa_w SstAU8SstU16 99.99847 rel_uw_b100 4 0.00 99.99847 FORMAT "%8.5" DEPOSIT ABSOLUTE /end AXIS_PTS
/begin AXIS_PTS SML06LHUW "ml_w dependent basic point (number 6)" 0x9088EEC ml_w SstAUwSstUw 6553.500 m_uw_b6553p5 6 0.00 6553.500 FORMAT "%8.3" DEPOSIT ABSOLUTE /end AXIS_PTS
/begin AXIS_PTS SNM05LHUB "Base point distribution of engine speed for lambda control" 0x9088EFA nmot_w SstAU8SstU16 16383.75 nmot_uw_q0p25 5 0.00 16383.75 FORMAT "%8.2" DEPOSIT ABSOLUTE /end AXIS_PTS
/begin AXIS_PTS SNM05LRUW "Distribution for engine speed" 0x9089212 nmot_w SstAU8SstU16 16383.75 nmot_uw_q0p25 10 0.00 16383.75 FORMAT "%8.2" DEPOSIT ABSOLUTE /end AXIS_PTS
/begin AXIS_PTS SNM06LLUB "distribution of engine speed" 0x9088E5A nmot_w SstAU8SstU16 16383.75 nmot_uw_q0p25 6 0.00 16383.75 FORMAT "%8.2" DEPOSIT ABSOLUTE /end AXIS_PTS
/begin AXIS_PTS SNM16BTSUW "Base point distribution of engine speed, 16 base pts." 0x9088BD4 nmot_w SstAU8SstU16 16383.75 nmot_uw_q0p25 16 0.00 16383.75 FORMAT "%8.2" DEPOSIT ABSOLUTE /end AXIS_PTS
/begin AXIS_PTS SRL05LRUB "Base point distribution of engine load for lambda control" 0x9089228 rl SstAU8SstU8 191.3 rel_ub_q0p75 10 0.00 191.3 FORMAT "%5.1" DEPOSIT ABSOLUTE /end AXIS_PTS
/begin AXIS_PTS SRL12BTSUW "Base point distribution relative air charge" 0x9088BF6 rl_w SstAU8SstU16 1535.977 rel_uw_q0p0234 12 0.00 1535.977 FORMAT "%8.3" DEPOSIT ABSOLUTE /end AXIS_PTS
/begin CHARACTERISTIC TABGBTS "Exhaust temperature threshold for component protection" VALUE 0x9088C10 KwWU8 1275. temp_ub_q5_o50 -50.00 1225. FORMAT "%5.0" /end CHARACTERISTIC
/begin CHARACTERISTIC TAHST "Lower air temp threshold for hot start condition" VALUE 0x90882D2 KwWS16 6553.500 Temp_Cels -3549.940 3003.560 FORMAT "%8.3" /end CHARACTERISTIC
/begin CHARACTERISTIC TDLFSHION "delay time for activate engine fan stage high" VALUE 0x9088CB0 KwWU8 25.50 t_q0p1 0.00 25.50 FORMAT "%5.2" /end CHARACTERISTIC
/begin CHARACTERISTIC TDLFSLOHI "delay time for activate engine fan stage high after reaching low stage" VALUE 0x9088CB1 KwWU8 25.50 t_q0p1 0.00 25.50 FORMAT "%5.2" /end CHARACTERISTIC
/begin CHARACTERISTIC TDLFSLOOF "delay time for deactivate engine fan stage low" VALUE 0x9088CB2 KwWU8 25.50 t_q0p1 0.00 25.50 FORMAT "%5.2" /end CHARACTERISTIC
/begin CHARACTERISTIC TDLFSLOON "delay time for activate engine fan stage low" VALUE 0x9088CB3 KwWU8 25.50 t_q0p1 0.00 25.50 FORMAT "%5.2" /end CHARACTERISTIC
/begin CHARACTERISTIC TDSTENDLFS "delay time for engine fan enabling after start finished detection" VALUE 0x9088CB4 KwWU8 25.50 t_q0p1 0.00 25.50 FORMAT "%5.2" /end CHARACTERISTIC
/begin CHARACTERISTIC TEMIN "minimum effective injection time" VALUE 0x90882D4 KwWU8 1.632 t_q0p0064_ms 0.00 1.632 FORMAT "%5.3" /end CHARACTERISTIC
/begin CHARACTERISTIC TFNSTAT "Time constant of filter for stationary desired idle speed" VALUE 0x9088DC2 KwWU16 1310.6999997 zk20msxs_uw_b1310p72 0.020000305180 1310.7200000 FORMAT "%12.7" /end CHARACTERISTIC
/begin CHARACTERISTIC TIKATBTS "temperature threshold in catalyser for component protection" VALUE 0x9088C11 KwWU8 1275. temp_ub_q5_o50 -50.00 1225. FORMAT "%5.0" /end CHARACTERISTIC
/begin CHARACTERISTIC TKATMLRH "lower catalyst temperature threshold for lambda control downstream cat" VALUE 0x9088F06 KwUb 1275. temp_ub_q5_o50 -50.00 1225. FORMAT "%5.0" /end CHARACTERISTIC
/begin CHARACTERISTIC TKFRA "time constant for multiplicative adaptive mixture adaptation" VALUE 0x90827C2 RB_Val_Wu16 13106.999997 zk200msxs_uw_b13107p2 0.20000305180 13107.200000 FORMAT "%12.6" /end CHARACTERISTIC
/begin CHARACTERISTIC TKORA "time constant for additive adaptive mixture correction" VALUE 0x90827C4 RB_Val_Wu16 13106.999997 zk200msxs_uw_b13107p2 0.20000305180 13107.200000 FORMAT "%12.6" /end CHARACTERISTIC
/begin CHARACTERISTIC TKRFVW "flight time of fuel for calculating injection end" VALUE 0x90882D6 KwWU16 419.4240 t_q0p0064_ms 0.00 419.4240 FORMAT "%8.4" /end CHARACTERISTIC
/begin CHARACTERISTIC TLLRETM "Time after end of start for enabling idle speed control" CURVE 0x9088CCA KlAxU8SstxS16WU16_Static 5.100000 t_q0p02 0.00 5.100000 FORMAT "%8.6" EXTENDED_LIMITS 0.00 1310.700
 /begin AXIS_DESCR STD_AXIS LLRBB_tEng Temp_Cels 3 -3549.940 3003.560 FORMAT "%8.3" DEPOSIT ABSOLUTE /end AXIS_DESCR
/end CHARACTERISTIC
/begin CHARACTERISTIC TLLSBGMX "After start time threshold for setting B_llrein" VALUE 0x9088CD8 KwWU16 6553.500 t100msxs_uw_b6553p5 0.00 6553.500 FORMAT "%8.3" /end CHARACTERISTIC
/begin CHARACTERISTIC TMLFS1DISTHI "Engine temperature below which EMC (LFS1) fan will be turned off if the distance travlled between two fan ON is greated than DISTLFSTHR1" VALUE 0x9088CB6 KwWS16 6553.500 Temp_Cels -3549.940 3003.560 FORMAT "%8.3" /end CHARACTERISTIC
/begin CHARACTERISTIC TMLFS1HI "upper threshold for engine temperature to activate engine fan stage low" VALUE 0x9088CB8 KwWS16 6553.500 Temp_Cels -3549.940 3003.560 FORMAT "%8.3" /end CHARACTERISTIC
/begin CHARACTERISTIC TMLFS1HI_N "if engine speed is greater than threshold, upper threshold for engine temperature to activate engine fan stage low" VALUE 0x9088CBA KwWS16 6553.500 Temp_Cels -3549.940 3003.560 FORMAT "%8.3" /end CHARACTERISTIC
/begin CHARACTERISTIC TMLFSARHI "upper threshold for engine temperature to activate engine fan after run" VALUE 0x9088CBC KwWS16 6553.500 Temp_Cels -3549.940 3003.560 FORMAT "%8.3" /end CHARACTERISTIC
/begin CHARACTERISTIC TMLFSARLO "lower threshold for engine temperature to activate engine fan after run" VALUE 0x9088CBE KwWS16 6553.500 Temp_Cels -3549.940 3003.560 FORMAT "%8.3" /end CHARACTERISTIC
/begin CHARACTERISTIC TMOTHST "Lower engine temperature threshold for hot start condition" VALUE 0x90882D8 KwWS16 6553.500 Temp_Cels -3549.940 3003.560 FORMAT "%8.3" /end CHARACTERISTIC
/begin CHARACTERISTIC TNLWST "max time gap between end of last running and new start for restart" VALUE 0x90882DA KwWU16 65535.00 t_q1 0.00 65535.00 FORMAT "%8.2" /end CHARACTERISTIC
/begin CHARACTERISTIC TVKUPPL "Delay time for the cluch information" VALUE 0x9088CDA KwWU8 5.100 t_q0p02 0.00 5.100 FORMAT "%5.3" /end CHARACTERISTIC
/begin CHARACTERISTIC TVLRA "delay time for activation of the lambda adaption after lambda control active" VALUE 0x90827C6 RB_Val_Wu16 13107.00 t_q0p2 0.00 13107.00 FORMAT "%8.2" /end CHARACTERISTIC
/begin CHARACTERISTIC TVTABLBTS "Delay time for component protection if exhaust gas temp. is exceeded." VALUE 0x9088C12 KwWU8 25.50 t_q0p1 0.00 25.50 FORMAT "%5.2" /end CHARACTERISTIC
/begin CHARACTERISTIC TVTIKLBTS "Delay time for component protection if catalyst temp. is exceeded." VALUE 0x9088C13 KwWU8 25.50 t_q0p1 0.00 25.50 FORMAT "%5.2" /end CHARACTERISTIC
/begin CHARACTERISTIC TVUB "voltage correction" CURVE 0x90882DC KlAxU8SstxU8WU16_Static 419.4240 t_q0p0064_ms 0.00 419.4240 FORMAT "%8.4"
 /begin AXIS_DESCR STD_AXIS InjSys_uBattInj spg_q0p1 5 0.00 25.50 FORMAT "%5.2" DEPOSIT ABSOLUTE /end AXIS_DESCR
/end CHARACTERISTIC
/begin CHARACTERISTIC TWC_flgIntglMfChkLoadChg_C "Flag to select Integral mass flow check based on Load Change" VALUE 0x9088F07 KwUb 1.000 dez 0.00 1.000 FORMAT "%5.3" EXTENDED_LIMITS 0.00 255.0 /end CHARACTERISTIC
/begin CHARACTERISTIC TWC_flgSelMaxSnsrAmpDs_C "Flag to select the maximum of mean value of the amplitude sensor signal and standardized amplitude sensor signal downstream." VALUE 0x9088F08 KwUb 1.000 dez 0.00 1.000 FORMAT "%5.3" EXTENDED_LIMITS 0.00 255.0 /end CHARACTERISTIC
/begin CHARACTERISTIC TWC_mfLoadChgMin_C "Min. threshold of air mass flow during Load change to start dlahi calculation." VALUE 0x9088F0A KwUw 7281.667 m_uw_b7281 0.00 7281.667 FORMAT "%8.3" /end CHARACTERISTIC
/begin CHARACTERISTIC TWC_ratLoadChgDet_C "Threshold to detect the maximum load change in relative air charge." VALUE 0x9088F0C KwSw 49151.25 rel_q0p75 -24576.00 24575.25 FORMAT "%8.2" /end CHARACTERISTIC
/begin CHARACTERISTIC TWC_tiDetLoadChg_C "Minimum time for load change detection." VALUE 0x9088F0E KwUw 6553.4999985 zk100msxs_uw_b6553 0.10000152590 6553.6000000 FORMAT "%12.7" /end CHARACTERISTIC
/begin CHARACTERISTIC UBLFSAR "battery voltage threshold for engine fan after run" VALUE 0x9088CC0 KwWU8 25.50 spg_q0p1 0.00 25.50 FORMAT "%5.2" /end CHARACTERISTIC
/begin CHARACTERISTIC VANF "Speed threshold for approach support" VALUE 0x9088D28 KwWU8 318.8 vfzg_ub_q1p25 0.00 318.8 FORMAT "%5.1" /end CHARACTERISTIC
/begin CHARACTERISTIC VLLR "vehicle speed limit for idle speed control" VALUE 0x9088CDC KwWS16 327.6700 vel_q0p01 0.00 327.6700 FORMAT "%8.4" EXTENDED_LIMITS -327.6800 327.6700 /end CHARACTERISTIC
/begin CHARACTERISTIC WDKCLFLD "Throttle valve angle for Clear Flood activation" VALUE 0x90882EC KwWU16 100.0000 relDK_uw_b100 0.00 100.0000 FORMAT "%8.4" /end CHARACTERISTIC
/begin CHARACTERISTIC WEESTSM "angle end of injection for simultaneous pulses during start, f(tmot)" CURVE 0x90882EE KlAxU8SstxS16WU16_Static 1530.000 zw_ub_q6 0.00 1530.000 FORMAT "%8.3" EXTENDED_LIMITS 0.00 393210.0
 /begin AXIS_DESCR STD_AXIS EngDa_tEng Temp_Cels 6 -3549.940 3003.560 FORMAT "%8.3" DEPOSIT ABSOLUTE /end AXIS_DESCR
/end CHARACTERISTIC
/begin CHARACTERISTIC WESSOT "Angle: intake closes late until TDC" VALUE 0x9088308 KwWU8 1530. zw_ub_q6 0.00 1530. FORMAT "%5.0" /end CHARACTERISTIC
/begin CHARACTERISTIC ZDLBTS "Time constant delta lambda component protection" VALUE 0x9088C14 KwWU16 6553.4999985 zk100msxs_uw_b6553 0.10000152590 6553.6000000 FORMAT "%12.7" /end CHARACTERISTIC
/begin CHARACTERISTIC ZKMD1LF "Filtertime fan-torque." VALUE 0x9088CC2 KwWU16 1310.6999997 zk20msxs_uw_b1310p72 0.020000305180 1310.7200000 FORMAT "%12.7" /end CHARACTERISTIC
/begin CHARACTERISTIC ZLIBG "filter time constant for adjusting integrator limits" VALUE 0x9088E68 KwWU16 1310.6999997 zk20msxs_uw_b1310p72 0.020000305180 1310.7200000 FORMAT "%12.7" /end CHARACTERISTIC
/begin CHARACTERISTIC ZLRHML "time constant of lambda control integrator downstream catalyst" CURVE 0x9088F10 GklWUw 6553.400 t_q0p1 0.1000000 6553.500 FORMAT "%8.3" EXTENDED_LIMITS 0.00 6553.500
 /begin AXIS_DESCR COM_AXIS ml_w m_uw_b6553p5 6 0.00 6553.500 FORMAT "%8.3" AXIS_PTS_REF SML06LHUW /end AXIS_DESCR
/end CHARACTERISTIC
/begin MEASUREMENT ahkatnr "amplitude sensor signal behind catalyst standardized" UBYTE fak_ub_b1 1 100 0.00 0.9961 ECU_ADDRESS 0x40008A53 /end MEASUREMENT
/begin MEASUREMENT anzeswst "Index-offset in warm restart calculations." UBYTE dez 1 100 0.00 255.0 FORMAT "%5.1" ECU_ADDRESS 0x40008A17
 /begin IF_DATA XCPplus 0x0102
  /begin DAQ_EVENT VARIABLE /begin AVAILABLE_EVENT_LIST EVENT 0 EVENT 1 EVENT 2 EVENT 3 /end AVAILABLE_EVENT_LIST /begin DEFAULT_EVENT_LIST EVENT 0 /end DEFAULT_EVENT_LIST /end DAQ_EVENT
 /end IF_DATA
/end MEASUREMENT
/begin MEASUREMENT anzesw_w "No of Cam Shaft revolutions" UWORD dez 1 100 0.00 65535.00 FORMAT "%8.2" ECU_ADDRESS 0x4000864E
 /begin IF_DATA XCPplus 0x0102
  /begin DAQ_EVENT VARIABLE /begin AVAILABLE_EVENT_LIST EVENT 0 EVENT 1 EVENT 2 EVENT 3 /end AVAILABLE_EVENT_LIST /begin DEFAULT_EVENT_LIST EVENT 0 /end DEFAULT_EVENT_LIST /end DAQ_EVENT
 /end IF_DATA
/end MEASUREMENT
/begin MEASUREMENT anzlrzy "time counter for one lambda cycle for average" UBYTE dez 1 100 0.00 255.0 FORMAT "%5.1" ECU_ADDRESS 0x40008A56 /end MEASUREMENT
/begin MEASUREMENT anztistr_w "number of injections of last engine operation" UWORD dez 1 100 0.00 65535.00 FORMAT "%8.2" ECU_ADDRESS 0x4000C6D4
 /begin IF_DATA XCPplus 0x0102
  /begin DAQ_EVENT VARIABLE /begin AVAILABLE_EVENT_LIST EVENT 0 EVENT 1 EVENT 2 EVENT 3 /end AVAILABLE_EVENT_LIST /begin DEFAULT_EVENT_LIST EVENT 0 /end DEFAULT_EVENT_LIST /end DAQ_EVENT
 /end IF_DATA
/end MEASUREMENT
/begin MEASUREMENT B_endelold "Delayed end of start info - old" UBYTE B_TRUE 1 100 0.00 1.00000000000 BIT_MASK 0x1 FORMAT "%13.11" ECU_ADDRESS 0x40008A15
 /begin IF_DATA XCPplus 0x0102
  /begin DAQ_EVENT VARIABLE /begin AVAILABLE_EVENT_LIST EVENT 0 EVENT 1 EVENT 2 EVENT 3 /end AVAILABLE_EVENT_LIST /begin DEFAULT_EVENT_LIST EVENT 3 /end DEFAULT_EVENT_LIST /end DAQ_EVENT
 /end IF_DATA
/end MEASUREMENT
/begin MEASUREMENT B_endely "Delayed end of start info" UBYTE B_TRUE 1 100 0.00 1.00000000000 BIT_MASK 0x1 FORMAT "%13.11" ECU_ADDRESS 0x40008A16
 /begin IF_DATA XCPplus 0x0102
  /begin DAQ_EVENT VARIABLE /begin AVAILABLE_EVENT_LIST EVENT 0 EVENT 1 EVENT 2 EVENT 3 /end AVAILABLE_EVENT_LIST /begin DEFAULT_EVENT_LIST EVENT 3 /end DEFAULT_EVENT_LIST /end DAQ_EVENT
 /end IF_DATA
/end MEASUREMENT
/begin MEASUREMENT B_eobdlr "error flag:OBDII summary fault, disables lambda control" UBYTE B_TRUE 1 100 0.00 1.00000000000 BIT_MASK 0x1 FORMAT "%13.11" ECU_ADDRESS 0x40008A4A
 /begin IF_DATA XCPplus 0x0102
  /begin DAQ_EVENT VARIABLE /begin AVAILABLE_EVENT_LIST EVENT 0 EVENT 1 EVENT 2 EVENT 3 /end AVAILABLE_EVENT_LIST /begin DEFAULT_EVENT_LIST EVENT 2 /end DEFAULT_EVENT_LIST /end DAQ_EVENT
 /end IF_DATA
/end MEASUREMENT
/begin MEASUREMENT B_flgZonStyfra "Steady zone for multiplicative mixture adaptation factor" UBYTE B_TRUE 1 100 0.00 1.00000000000 BIT_MASK 0x1 FORMAT "%13.11" ECU_ADDRESS 0x40008F5D
 /begin IF_DATA XCPplus 0x0102
  /begin DAQ_EVENT VARIABLE /begin AVAILABLE_EVENT_LIST EVENT 0 EVENT 1 EVENT 2 EVENT 3 /end AVAILABLE_EVENT_LIST /begin DEFAULT_EVENT_LIST EVENT 3 /end DEFAULT_EVENT_LIST /end DAQ_EVENT
 /end IF_DATA
/end MEASUREMENT
/begin MEASUREMENT B_flgZonStyora "Steady zone for additive correction of the mixture adaptation" UBYTE B_TRUE 1 100 0.00 1.00000000000 BIT_MASK 0x1 FORMAT "%13.11" ECU_ADDRESS 0x40008F5C
 /begin IF_DATA XCPplus 0x0102
  /begin DAQ_EVENT VARIABLE /begin AVAILABLE_EVENT_LIST EVENT 0 EVENT 1 EVENT 2 EVENT 3 /end AVAILABLE_EVENT_LIST /begin DEFAULT_EVENT_LIST EVENT 3 /end DEFAULT_EVENT_LIST /end DAQ_EVENT
 /end IF_DATA
/end MEASUREMENT
/begin MEASUREMENT B_frmax "lambda control at upper limit without special conditions (e.g. enleanment protection)" UBYTE B_TRUE 1 100 0.00 1.00000000000 BIT_MASK 0x1 FORMAT "%13.11" ECU_ADDRESS 0x40008A38
 /begin IF_DATA XCPplus 0x0102
  /begin DAQ_EVENT VARIABLE /begin AVAILABLE_EVENT_LIST EVENT 0 EVENT 1 EVENT 2 EVENT 3 /end AVAILABLE_EVENT_LIST /begin DEFAULT_EVENT_LIST EVENT 1 /end DEFAULT_EVENT_LIST /end DAQ_EVENT
 /end IF_DATA
/end MEASUREMENT
/begin MEASUREMENT B_frmin "lambda control at lower limit without special conditions (e.g. enleanment protection)" UBYTE B_TRUE 1 100 0.00 1.00000000000 BIT_MASK 0x1 FORMAT "%13.11" ECU_ADDRESS 0x40008A37
 /begin IF_DATA XCPplus 0x0102
  /begin DAQ_EVENT VARIABLE /begin AVAILABLE_EVENT_LIST EVENT 0 EVENT 1 EVENT 2 EVENT 3 /end AVAILABLE_EVENT_LIST /begin DEFAULT_EVENT_LIST EVENT 1 /end DEFAULT_EVENT_LIST /end DAQ_EVENT
 /end IF_DATA
/end MEASUREMENT
/begin MEASUREMENT B_frsp "Flag controller factor fr is jumping" UBYTE B_TRUE 1 100 0.00 1.00000000000 BIT_MASK 0x1 FORMAT "%13.11" ECU_ADDRESS 0x40008A36
 /begin IF_DATA XCPplus 0x0102
  /begin DAQ_EVENT VARIABLE /begin AVAILABLE_EVENT_LIST EVENT 0 EVENT 1 EVENT 2 EVENT 3 /end AVAILABLE_EVENT_LIST /begin DEFAULT_EVENT_LIST EVENT 1 /end DEFAULT_EVENT_LIST /end DAQ_EVENT
 /end IF_DATA
/end MEASUREMENT
/begin MEASUREMENT B_gktiposv "Bit to indicate positive or negative change in air charge" UBYTE B_TRUE 1 100 0.00 1.00000000000 BIT_MASK 0x1 FORMAT "%13.11" ECU_ADDRESS 0x40008A0D
 /begin IF_DATA XCPplus 0x0102
  /begin DAQ_EVENT VARIABLE /begin AVAILABLE_EVENT_LIST EVENT 0 EVENT 1 EVENT 2 EVENT 3 /end AVAILABLE_EVENT_LIST /begin DEFAULT_EVENT_LIST EVENT 1 /end DEFAULT_EVENT_LIST /end DAQ_EVENT
 /end IF_DATA
/end MEASUREMENT
/begin MEASUREMENT B_hst "condition hot start" UBYTE B_TRUE 1 100 0.00 1.00000000000 BIT_MASK 0x1 FORMAT "%13.11" ECU_ADDRESS 0x40008A0C
 /begin IF_DATA XCPplus 0x0102
  /begin DAQ_EVENT VARIABLE /begin AVAILABLE_EVENT_LIST EVENT 0 EVENT 1 EVENT 2 EVENT 3 /end AVAILABLE_EVENT_LIST /begin DEFAULT_EVENT_LIST EVENT 2 /end DEFAULT_EVENT_LIST /end DAQ_EVENT
 /end IF_DATA
/end MEASUREMENT
/begin MEASUREMENT B_imllr "integrated air mass flow from start lambda control to maximum value" UBYTE B_TRUE 1 100 0.00 1.00000000000 BIT_MASK 0x8 FORMAT "%13.11" ECU_ADDRESS 0x40008A4E /end MEASUREMENT
/begin MEASUREMENT B_leandb "lean mixture upstream catalyst, debounced" UBYTE B_TRUE 1 100 0.00 1.00000000000 BIT_MASK 0x1 FORMAT "%13.11" ECU_ADDRESS 0x40008A35
 /begin IF_DATA XCPplus 0x0102
  /begin DAQ_EVENT VARIABLE /begin AVAILABLE_EVENT_LIST EVENT 0 EVENT 1 EVENT 2 EVENT 3 /end AVAILABLE_EVENT_LIST /begin DEFAULT_EVENT_LIST EVENT 1 /end DEFAULT_EVENT_LIST /end DAQ_EVENT
 /end IF_DATA
/end MEASUREMENT
/begin MEASUREMENT B_leandbs "lean mixture upstream catalyst, debounced, 2nd edge" UBYTE B_TRUE 1 100 0.00 1.00000000000 BIT_MASK 0x1 FORMAT "%13.11" ECU_ADDRESS 0x40008A58 /end MEASUREMENT
/begin MEASUREMENT B_leanvk "sensor voltage upstream catalyst shows lean" UBYTE B_TRUE 1 100 0.00 1.00000000000 BIT_MASK 0x1 FORMAT "%13.11" ECU_ADDRESS 0x40008A34
 /begin IF_DATA XCPplus 0x0102
  /begin DAQ_EVENT VARIABLE /begin AVAILABLE_EVENT_LIST EVENT 0 EVENT 1 EVENT 2 EVENT 3 /end AVAILABLE_EVENT_LIST /begin DEFAULT_EVENT_LIST EVENT 1 /end DEFAULT_EVENT_LIST /end DAQ_EVENT
 /end IF_DATA
/end MEASUREMENT
/begin MEASUREMENT B_lf1s "fan 1 on condition" UBYTE B_TRUE 1 100 0.00 1.00000000000 BIT_MASK 0x1 FORMAT "%13.11" ECU_ADDRESS 0x4000877D
 /begin IF_DATA XCPplus 0x0102
  /begin DAQ_EVENT VARIABLE /begin AVAILABLE_EVENT_LIST EVENT 0 EVENT 1 EVENT 2 EVENT 3 /end AVAILABLE_EVENT_LIST /begin DEFAULT_EVENT_LIST EVENT 2 /end DEFAULT_EVENT_LIST /end DAQ_EVENT
 /end IF_DATA
/end MEASUREMENT
/begin MEASUREMENT B_lfsar "condition engine fan demand at engine after run" UBYTE B_TRUE 1 100 0.00 1.00000000000 BIT_MASK 0x4 FORMAT "%13.11" ECU_ADDRESS 0x4000877F
 /begin IF_DATA XCPplus 0x0102
  /begin DAQ_EVENT VARIABLE /begin AVAILABLE_EVENT_LIST EVENT 0 EVENT 1 EVENT 2 EVENT 3 /end AVAILABLE_EVENT_LIST /begin DEFAULT_EVENT_LIST EVENT 2 /end DEFAULT_EVENT_LIST /end DAQ_EVENT
 /end IF_DATA
/end MEASUREMENT
/begin MEASUREMENT B_lfslodrv "condition engine fan stage low demand" UBYTE B_TRUE 1 100 0.00 1.00000000000 BIT_MASK 0x8 FORMAT "%13.11" ECU_ADDRESS 0x40008782
 /begin IF_DATA XCPplus 0x0102
  /begin DAQ_EVENT VARIABLE /begin AVAILABLE_EVENT_LIST EVENT 0 EVENT 1 EVENT 2 EVENT 3 /end AVAILABLE_EVENT_LIST /begin DEFAULT_EVENT_LIST EVENT 2 /end DEFAULT_EVENT_LIST /end DAQ_EVENT
 /end IF_DATA
/end MEASUREMENT
/begin MEASUREMENT B_lfslow "condition engine fan stage low activated" UBYTE B_TRUE 1 100 0.00 1.00000000000 BIT_MASK 0x4 FORMAT "%13.11" ECU_ADDRESS 0x40008782
 /begin IF_DATA XCPplus 0x0102
  /begin DAQ_EVENT VARIABLE /begin AVAILABLE_EVENT_LIST EVENT 0 EVENT 1 EVENT 2 EVENT 3 /end AVAILABLE_EVENT_LIST /begin DEFAULT_EVENT_LIST EVENT 2 /end DEFAULT_EVENT_LIST /end DAQ_EVENT
 /end IF_DATA
/end MEASUREMENT
/begin MEASUREMENT B_lfsrng "Condition fan control state engine running" UBYTE B_TRUE 1 100 0.00 1.00000000000 BIT_MASK 0x1 FORMAT "%13.11" ECU_ADDRESS 0x4000877F
 /begin IF_DATA XCPplus 0x0102
  /begin DAQ_EVENT VARIABLE /begin AVAILABLE_EVENT_LIST EVENT 0 EVENT 1 EVENT 2 EVENT 3 /end AVAILABLE_EVENT_LIST /begin DEFAULT_EVENT_LIST EVENT 2 /end DEFAULT_EVENT_LIST /end DAQ_EVENT
 /end IF_DATA
/end MEASUREMENT
/begin MEASUREMENT B_lfsstd "Condition fan control state engine standstill" UBYTE B_TRUE 1 100 0.00 1.00000000000 BIT_MASK 0x2 FORMAT "%13.11" ECU_ADDRESS 0x4000877F
 /begin IF_DATA XCPplus 0x0102
  /begin DAQ_EVENT VARIABLE /begin AVAILABLE_EVENT_LIST EVENT 0 EVENT 1 EVENT 2 EVENT 3 /end AVAILABLE_EVENT_LIST /begin DEFAULT_EVENT_LIST EVENT 2 /end DEFAULT_EVENT_LIST /end DAQ_EVENT
 /end IF_DATA
/end MEASUREMENT
/begin MEASUREMENT B_llr "condition idle speed control" UBYTE B_TRUE 1 100 0.00 1.00000000000 BIT_MASK 0x1 FORMAT "%13.11" ECU_ADDRESS 0x40008783
 /begin IF_DATA XCPplus 0x0102
  /begin DAQ_EVENT VARIABLE /begin AVAILABLE_EVENT_LIST EVENT 0 EVENT 1 EVENT 2 EVENT 3 /end AVAILABLE_EVENT_LIST /begin DEFAULT_EVENT_LIST EVENT 2 /end DEFAULT_EVENT_LIST /end DAQ_EVENT
 /end IF_DATA
/end MEASUREMENT
/begin MEASUREMENT B_llrein "Idle speed ready to be put into operation after start" UBYTE B_TRUE 1 100 0.00 1.00000000000 BIT_MASK 0x2 FORMAT "%13.11" ECU_ADDRESS 0x40008783
 /begin IF_DATA XCPplus 0x0102
  /begin DAQ_EVENT VARIABLE /begin AVAILABLE_EVENT_LIST EVENT 0 EVENT 1 EVENT 2 EVENT 3 /end AVAILABLE_EVENT_LIST /begin DEFAULT_EVENT_LIST EVENT 2 /end DEFAULT_EVENT_LIST /end DAQ_EVENT
 /end IF_DATA
/end MEASUREMENT
/begin MEASUREMENT B_llri "Condition activation of I-part of idle speed control" UBYTE B_TRUE 1 100 0.00 1.00000000000 BIT_MASK 0x4 FORMAT "%13.11" ECU_ADDRESS 0x40008783
 /begin IF_DATA XCPplus 0x0102
  /begin DAQ_EVENT VARIABLE /begin AVAILABLE_EVENT_LIST EVENT 0 EVENT 1 EVENT 2 EVENT 3 /end AVAILABLE_EVENT_LIST /begin DEFAULT_EVENT_LIST EVENT 2 /end DEFAULT_EVENT_LIST /end DAQ_EVENT
 /end IF_DATA
/end MEASUREMENT
/begin MEASUREMENT B_llrpd "Condition activation of PD-part of idle speed control" UBYTE B_TRUE 1 100 0.00 1.00000000000 BIT_MASK 0x8 FORMAT "%13.11" ECU_ADDRESS 0x40008783
 /begin IF_DATA XCPplus 0x0102
  /begin DAQ_EVENT VARIABLE /begin AVAILABLE_EVENT_LIST EVENT 0 EVENT 1 EVENT 2 EVENT 3 /end AVAILABLE_EVENT_LIST /begin DEFAULT_EVENT_LIST EVENT 2 /end DEFAULT_EVENT_LIST /end DAQ_EVENT
 /end IF_DATA
/end MEASUREMENT
/begin MEASUREMENT B_lotemc "Fan ON request from EMC control" UBYTE B_TRUE 1 100 0.00 1.00000000000 BIT_MASK 0x1 FORMAT "%13.11" ECU_ADDRESS 0x40008781
 /begin IF_DATA XCPplus 0x0102
  /begin DAQ_EVENT VARIABLE /begin AVAILABLE_EVENT_LIST EVENT 0 EVENT 1 EVENT 2 EVENT 3 /end AVAILABLE_EVENT_LIST /begin DEFAULT_EVENT_LIST EVENT 2 /end DEFAULT_EVENT_LIST /end DAQ_EVENT
 /end IF_DATA
/end MEASUREMENT
/begin MEASUREMENT B_lotmp "condition : fan stage 1 switch on due to high engine temperature." UBYTE B_TRUE 1 100 0.00 1.00000000000 BIT_MASK 0x1 FORMAT "%13.11" ECU_ADDRESS 0x4000877E
 /begin IF_DATA XCPplus 0x0102
  /begin DAQ_EVENT VARIABLE /begin AVAILABLE_EVENT_LIST EVENT 0 EVENT 1 EVENT 2 EVENT 3 /end AVAILABLE_EVENT_LIST /begin DEFAULT_EVENT_LIST EVENT 2 /end DEFAULT_EVENT_LIST /end DAQ_EVENT
 /end IF_DATA
/end MEASUREMENT
/begin MEASUREMENT B_lr "LREB: condition for Lambda closed loop control upstream catalyst; bank 1" UBYTE B_TRUE 1 100 0.00 1.00000000000 BIT_MASK 0x1 FORMAT "%13.11" ECU_ADDRESS 0x40008A49
 /begin IF_DATA XCPplus 0x0102
  /begin DAQ_EVENT VARIABLE /begin AVAILABLE_EVENT_LIST EVENT 0 EVENT 1 EVENT 2 EVENT 3 /end AVAILABLE_EVENT_LIST /begin DEFAULT_EVENT_LIST EVENT 2 /end DEFAULT_EVENT_LIST /end DAQ_EVENT
 /end IF_DATA
/end MEASUREMENT
/begin MEASUREMENT B_lra "condition for basic mixture adaptation enabled" UBYTE B_TRUE 1 100 0.00 1.00000000000 BIT_MASK 0x1 FORMAT "%13.11" ECU_ADDRESS 0x40008705
 /begin IF_DATA XCPplus 0x0102
  /begin DAQ_EVENT VARIABLE /begin AVAILABLE_EVENT_LIST EVENT 0 EVENT 1 EVENT 2 EVENT 3 /end AVAILABLE_EVENT_LIST /begin DEFAULT_EVENT_LIST EVENT 3 /end DEFAULT_EVENT_LIST /end DAQ_EVENT
 /end IF_DATA
/end MEASUREMENT
/begin MEASUREMENT B_lrafra "multiplicative range of mixture adaptation is active" UBYTE B_TRUE 1 100 0.00 1.00000000000 BIT_MASK 0x1 FORMAT "%13.11" ECU_ADDRESS 0x40008704
 /begin IF_DATA XCPplus 0x0102
  /begin DAQ_EVENT VARIABLE /begin AVAILABLE_EVENT_LIST EVENT 0 EVENT 1 EVENT 2 EVENT 3 /end AVAILABLE_EVENT_LIST /begin DEFAULT_EVENT_LIST EVENT 3 /end DEFAULT_EVENT_LIST /end DAQ_EVENT
 /end IF_DATA
/end MEASUREMENT
/begin MEASUREMENT B_lrafraf "multiplicative range of mixture adaptation is active for Gasoline." UBYTE B_TRUE 1 100 0.00 1.00000000000 BIT_MASK 0x1 FORMAT "%13.11" ECU_ADDRESS 0x40008703
 /begin IF_DATA XCPplus 0x0102
  /begin DAQ_EVENT VARIABLE /begin AVAILABLE_EVENT_LIST EVENT 0 EVENT 1 EVENT 2 EVENT 3 /end AVAILABLE_EVENT_LIST /begin DEFAULT_EVENT_LIST EVENT 3 /end DEFAULT_EVENT_LIST /end DAQ_EVENT
 /end IF_DATA
/end MEASUREMENT
/begin MEASUREMENT B_lraini "Reset condition to set LRA integrators to neutral values." UBYTE B_TRUE 1 100 0.00 1.00000000000 BIT_MASK 0x1 FORMAT "%13.11" ECU_ADDRESS 0x40008702
 /begin IF_DATA XCPplus 0x0102
  /begin DAQ_EVENT VARIABLE /begin AVAILABLE_EVENT_LIST EVENT 0 EVENT 1 EVENT 2 EVENT 3 /end AVAILABLE_EVENT_LIST /begin DEFAULT_EVENT_LIST EVENT 3 /end DEFAULT_EVENT_LIST /end DAQ_EVENT
 /end IF_DATA
/end MEASUREMENT
/begin MEASUREMENT B_lraora "additive range in der mixture adaptation is active" UBYTE B_TRUE 1 100 0.00 1.00000000000 BIT_MASK 0x1 FORMAT "%13.11" ECU_ADDRESS 0x40008701
 /begin IF_DATA XCPplus 0x0102
  /begin DAQ_EVENT VARIABLE /begin AVAILABLE_EVENT_LIST EVENT 0 EVENT 1 EVENT 2 EVENT 3 /end AVAILABLE_EVENT_LIST /begin DEFAULT_EVENT_LIST EVENT 3 /end DEFAULT_EVENT_LIST /end DAQ_EVENT
 /end IF_DATA
/end MEASUREMENT
/begin MEASUREMENT B_lraoraf "additive range in der mixture adaptation is active for gasoline" UBYTE B_TRUE 1 100 0.00 1.00000000000 BIT_MASK 0x1 FORMAT "%13.11" ECU_ADDRESS 0x40008700
 /begin IF_DATA XCPplus 0x0102
  /begin DAQ_EVENT VARIABLE /begin AVAILABLE_EVENT_LIST EVENT 0 EVENT 1 EVENT 2 EVENT 3 /end AVAILABLE_EVENT_LIST /begin DEFAULT_EVENT_LIST EVENT 3 /end DEFAULT_EVENT_LIST /end DAQ_EVENT
 /end IF_DATA
/end MEASUREMENT
/begin MEASUREMENT B_lrhkgi "bank-independent condition I-part HK controllt" UBYTE B_TRUE 1 100 0.00 1.00000000000 BIT_MASK 0x4 FORMAT "%13.11" ECU_ADDRESS 0x40008A4E /end MEASUREMENT
/begin MEASUREMENT B_lrhkgne "condition lambda control downstream cat disabled due to bank independent errors" UBYTE B_TRUE 1 100 0.00 1.00000000000 BIT_MASK 0x2 FORMAT "%13.11" ECU_ADDRESS 0x40008A58 /end MEASUREMENT
/begin MEASUREMENT B_lrhki "LRHK: condition for I-part lambda closed loop control downstream cat (bank 1)" UBYTE B_TRUE 1 100 0.00 1.00000000000 BIT_MASK 0x1 FORMAT "%13.11" ECU_ADDRESS 0x40008A4E /end MEASUREMENT
/begin MEASUREMENT B_lrhkp "LRHK: condition for P-part lambda closed loop control downstream cat (bank 1)" UBYTE B_TRUE 1 100 0.00 1.00000000000 BIT_MASK 0x2 FORMAT "%13.11" ECU_ADDRESS 0x40008A4E /end MEASUREMENT
/begin MEASUREMENT B_lrtv "delay time tvlr, active for integrator stop" UBYTE B_TRUE 1 100 0.00 1.00000000000 BIT_MASK 0x1 FORMAT "%13.11" ECU_ADDRESS 0x40008A33
 /begin IF_DATA XCPplus 0x0102
  /begin DAQ_EVENT VARIABLE /begin AVAILABLE_EVENT_LIST EVENT 0 EVENT 1 EVENT 2 EVENT 3 /end AVAILABLE_EVENT_LIST /begin DEFAULT_EVENT_LIST EVENT 1 /end DEFAULT_EVENT_LIST /end DAQ_EVENT
 /end IF_DATA
/end MEASUREMENT
/begin MEASUREMENT B_nlmls "request for ECM afterrun from the engine-fan-control" UBYTE B_TRUE 1 100 0.00 1.00000000000 BIT_MASK 0x1 FORMAT "%13.11" ECU_ADDRESS 0x4000C702
 /begin IF_DATA XCPplus 0x0102
  /begin DAQ_EVENT VARIABLE /begin AVAILABLE_EVENT_LIST EVENT 0 EVENT 1 EVENT 2 EVENT 3 /end AVAILABLE_EVENT_LIST /begin DEFAULT_EVENT_LIST EVENT 2 /end DEFAULT_EVENT_LIST /end DAQ_EVENT
 /end IF_DATA
/end MEASUREMENT
/begin MEASUREMENT B_nmotst "Condition engine speed exceeds threshold for end of start" UBYTE B_TRUE 1 100 0.00 1.00000000000 BIT_MASK 0x1 FORMAT "%13.11" ECU_ADDRESS 0x40008A0B
 /begin IF_DATA XCPplus 0x0102
  /begin DAQ_EVENT VARIABLE /begin AVAILABLE_EVENT_LIST EVENT 0 EVENT 1 EVENT 2 EVENT 3 /end AVAILABLE_EVENT_LIST /begin DEFAULT_EVENT_LIST EVENT 1 /end DEFAULT_EVENT_LIST /end DAQ_EVENT
 /end IF_DATA
/end MEASUREMENT
/begin MEASUREMENT B_restvop "integrator stop without p-jump" UBYTE B_TRUE 1 100 0.00 1.00000000000 BIT_MASK 0x1 FORMAT "%13.11" ECU_ADDRESS 0x40008A44
 /begin IF_DATA XCPplus 0x0102
  /begin DAQ_EVENT VARIABLE /begin AVAILABLE_EVENT_LIST EVENT 0 EVENT 1 EVENT 2 EVENT 3 /end AVAILABLE_EVENT_LIST /begin DEFAULT_EVENT_LIST EVENT 1 /end DEFAULT_EVENT_LIST /end DAQ_EVENT
 /end IF_DATA
/end MEASUREMENT
/begin MEASUREMENT B_st "condition for start" UBYTE B_TRUE 1 100 0.00 1.00000000000 BIT_MASK 0x1 FORMAT "%13.11" ECU_ADDRESS 0x40008A0A
 /begin IF_DATA XCPplus 0x0102
  /begin DAQ_EVENT VARIABLE /begin AVAILABLE_EVENT_LIST EVENT 0 EVENT 1 EVENT 2 EVENT 3 /end AVAILABLE_EVENT_LIST /begin DEFAULT_EVENT_LIST EVENT 1 /end DEFAULT_EVENT_LIST /end DAQ_EVENT
 /end IF_DATA
/end MEASUREMENT
/begin MEASUREMENT B_stclfld "Condition: Clear flood (injection stop after danger of flooded engine by fuel )" UBYTE B_TRUE 1 100 0.00 1.00000000000 BIT_MASK 0x1 FORMAT "%13.11" ECU_ADDRESS 0x40008A09
 /begin IF_DATA XCPplus 0x0102
  /begin DAQ_EVENT VARIABLE /begin AVAILABLE_EVENT_LIST EVENT 0 EVENT 1 EVENT 2 EVENT 3 /end AVAILABLE_EVENT_LIST /begin DEFAULT_EVENT_LIST EVENT 2 /end DEFAULT_EVENT_LIST /end DAQ_EVENT
 /end IF_DATA
/end MEASUREMENT
/begin MEASUREMENT B_stend "condition end of start" UBYTE B_TRUE 1 100 0.00 1.00000000000 BIT_MASK 0x1 FORMAT "%13.11" ECU_ADDRESS 0x40008A08
 /begin IF_DATA XCPplus 0x0102
  /begin DAQ_EVENT VARIABLE /begin AVAILABLE_EVENT_LIST EVENT 0 EVENT 1 EVENT 2 EVENT 3 /end AVAILABLE_EVENT_LIST /begin DEFAULT_EVENT_LIST EVENT 1 /end DEFAULT_EVENT_LIST /end DAQ_EVENT
 /end IF_DATA
/end MEASUREMENT
/begin MEASUREMENT B_stendes "Condition end of start also for injection" UBYTE B_TRUE 1 100 0.00 1.00000000000 BIT_MASK 0x1 FORMAT "%13.11" ECU_ADDRESS 0x40008A07
 /begin IF_DATA XCPplus 0x0102
  /begin DAQ_EVENT VARIABLE /begin AVAILABLE_EVENT_LIST EVENT 0 EVENT 1 EVENT 2 EVENT 3 /end AVAILABLE_EVENT_LIST /begin DEFAULT_EVENT_LIST EVENT 1 /end DEFAULT_EVENT_LIST /end DAQ_EVENT
 /end IF_DATA
/end MEASUREMENT
/begin MEASUREMENT B_stendz "condition first end of start in cycle" UBYTE B_TRUE 1 100 0.00 1.00000000000 BIT_MASK 0x1 FORMAT "%13.11" ECU_ADDRESS 0x40008A06
 /begin IF_DATA XCPplus 0x0102
  /begin DAQ_EVENT VARIABLE /begin AVAILABLE_EVENT_LIST EVENT 0 EVENT 1 EVENT 2 EVENT 3 /end AVAILABLE_EVENT_LIST /begin DEFAULT_EVENT_LIST EVENT 1 /end DEFAULT_EVENT_LIST /end DAQ_EVENT
 /end IF_DATA
/end MEASUREMENT
/begin MEASUREMENT B_tabgbts "condition exhaust gas temperature for component protection exceeded" UBYTE B_TRUE 1 100 0.00 1.00000000000 BIT_MASK 0x1 FORMAT "%13.11" ECU_ADDRESS 0x40008A26
 /begin IF_DATA XCPplus 0x0102
  /begin DAQ_EVENT VARIABLE /begin AVAILABLE_EVENT_LIST EVENT 0 EVENT 1 EVENT 2 EVENT 3 /end AVAILABLE_EVENT_LIST /begin DEFAULT_EVENT_LIST EVENT 2 /end DEFAULT_EVENT_LIST /end DAQ_EVENT
 /end IF_DATA
/end MEASUREMENT
/begin MEASUREMENT B_tatmbts "condition: temperature of ATM for componentprotection exceeded" UBYTE B_TRUE 1 100 0.00 1.00000000000 BIT_MASK 0x1 FORMAT "%13.11" ECU_ADDRESS 0x40008A25
 /begin IF_DATA XCPplus 0x0102
  /begin DAQ_EVENT VARIABLE /begin AVAILABLE_EVENT_LIST EVENT 0 EVENT 1 EVENT 2 EVENT 3 /end AVAILABLE_EVENT_LIST /begin DEFAULT_EVENT_LIST EVENT 2 /end DEFAULT_EVENT_LIST /end DAQ_EVENT
 /end IF_DATA
/end MEASUREMENT
/begin MEASUREMENT B_tatmsa "condition: temperatures from ATM permit fuel cut-off" UBYTE B_TRUE 1 100 0.00 1.00000000000 BIT_MASK 0x1 FORMAT "%13.11" ECU_ADDRESS 0x40008A24
 /begin IF_DATA XCPplus 0x0102
  /begin DAQ_EVENT VARIABLE /begin AVAILABLE_EVENT_LIST EVENT 0 EVENT 1 EVENT 2 EVENT 3 /end AVAILABLE_EVENT_LIST /begin DEFAULT_EVENT_LIST EVENT 2 /end DEFAULT_EVENT_LIST /end DAQ_EVENT
 /end IF_DATA
/end MEASUREMENT
/begin MEASUREMENT B_temin "Condition: TEMIN-limitation active, bench 1" UBYTE B_TRUE 1 100 0.00 1.00000000000 BIT_MASK 0x1 FORMAT "%13.11" ECU_ADDRESS 0x40008A05
 /begin IF_DATA XCPplus 0x0102
  /begin DAQ_EVENT VARIABLE /begin AVAILABLE_EVENT_LIST EVENT 0 EVENT 1 EVENT 2 EVENT 3 /end AVAILABLE_EVENT_LIST /begin DEFAULT_EVENT_LIST EVENT 0 /end DEFAULT_EVENT_LIST /end DAQ_EVENT
 /end IF_DATA
/end MEASUREMENT
/begin MEASUREMENT B_tikatbts "condition temperature in catalyst for component protection exceeded" UBYTE B_TRUE 1 100 0.00 1.00000000000 BIT_MASK 0x1 FORMAT "%13.11" ECU_ADDRESS 0x40008A23
 /begin IF_DATA XCPplus 0x0102
  /begin DAQ_EVENT VARIABLE /begin AVAILABLE_EVENT_LIST EVENT 0 EVENT 1 EVENT 2 EVENT 3 /end AVAILABLE_EVENT_LIST /begin DEFAULT_EVENT_LIST EVENT 2 /end DEFAULT_EVENT_LIST /end DAQ_EVENT
 /end IF_DATA
/end MEASUREMENT
/begin MEASUREMENT B_usrih "Sensor voltages after cat for calculation of Ri are ready" UBYTE B_TRUE 1 100 0.00 1.00000000000 BIT_MASK 0x1 FORMAT "%13.11" ECU_ADDRESS 0x40008A1D /end MEASUREMENT
/begin MEASUREMENT B_usriv "Sensor voltages before cat for calculation of Ri are ready" UBYTE B_TRUE 1 100 0.00 1.00000000000 BIT_MASK 0x1 FORMAT "%13.11" ECU_ADDRESS 0x40008A1C
 /begin IF_DATA XCPplus 0x0102
  /begin DAQ_EVENT VARIABLE /begin AVAILABLE_EVENT_LIST EVENT 0 EVENT 1 EVENT 2 EVENT 3 /end AVAILABLE_EVENT_LIST /begin DEFAULT_EVENT_LIST EVENT 1 /end DEFAULT_EVENT_LIST /end DAQ_EVENT
 /end IF_DATA
/end MEASUREMENT
/begin MEASUREMENT B_vllr "Condition vehicle is moving with engaged gear" UBYTE B_TRUE 1 100 0.00 1.00000000000 BIT_MASK 0x10 FORMAT "%13.11" ECU_ADDRESS 0x40008783
 /begin IF_DATA XCPplus 0x0102
  /begin DAQ_EVENT VARIABLE /begin AVAILABLE_EVENT_LIST EVENT 0 EVENT 1 EVENT 2 EVENT 3 /end AVAILABLE_EVENT_LIST /begin DEFAULT_EVENT_LIST EVENT 2 /end DEFAULT_EVENT_LIST /end DAQ_EVENT
 /end IF_DATA
/end MEASUREMENT
/begin MEASUREMENT B_wst "condition for re-start" UBYTE B_TRUE 1 100 0.00 1.00000000000 BIT_MASK 0x1 FORMAT "%13.11" ECU_ADDRESS 0x40008A04
 /begin IF_DATA XCPplus 0x0102
  /begin DAQ_EVENT VARIABLE /begin AVAILABLE_EVENT_LIST EVENT 0 EVENT 1 EVENT 2 EVENT 3 /end AVAILABLE_EVENT_LIST /begin DEFAULT_EVENT_LIST EVENT 0 /end DEFAULT_EVENT_LIST /end DAQ_EVENT
 /end IF_DATA
/end MEASUREMENT
/begin MEASUREMENT ctr_2S "StateMachine counter" UWORD dez 1 100 0.00 65535.00 FORMAT "%8.2" ECU_ADDRESS 0x40008692
 /begin IF_DATA XCPplus 0x0102
  /begin DAQ_EVENT VARIABLE /begin AVAILABLE_EVENT_LIST EVENT 0 EVENT 1 EVENT 2 EVENT 3 /end AVAILABLE_EVENT_LIST /begin DEFAULT_EVENT_LIST EVENT 1 /end DEFAULT_EVENT_LIST /end DAQ_EVENT
 /end IF_DATA
/end MEASUREMENT
/begin MEASUREMENT detazwbs "Delta ignition angle efficiency for component protection" SWORD rel_q0p5 1 100 -16384.00 16383.50 FORMAT "%8.2" ECU_ADDRESS 0x400086A6
 /begin IF_DATA XCPplus 0x0102
  /begin DAQ_EVENT VARIABLE /begin AVAILABLE_EVENT_LIST EVENT 0 EVENT 1 EVENT 2 EVENT 3 /end AVAILABLE_EVENT_LIST /begin DEFAULT_EVENT_LIST EVENT 2 /end DEFAULT_EVENT_LIST /end DAQ_EVENT
 /end IF_DATA
/end MEASUREMENT
/begin MEASUREMENT distlfson "distance travlled from EMC fan ON" UWORD dez 1 100 0.00 65535.00 FORMAT "%8.2" ECU_ADDRESS 0x400082EE
 /begin IF_DATA XCPplus 0x0102
  /begin DAQ_EVENT VARIABLE /begin AVAILABLE_EVENT_LIST EVENT 0 EVENT 1 EVENT 2 EVENT 3 /end AVAILABLE_EVENT_LIST /begin DEFAULT_EVENT_LIST EVENT 2 /end DEFAULT_EVENT_LIST /end DAQ_EVENT
 /end IF_DATA
/end MEASUREMENT
/begin MEASUREMENT dlahc "sum of p part and fast i part used for control of catalyst" SBYTE fak_q0p000244 1 100 -0.03125 0.03101 FORMAT "%7.5" ECU_ADDRESS 0x40008A52 /end MEASUREMENT
/begin MEASUREMENT dlahi "I-portion of the continuous LRHK" SBYTE fak_q0p000244 1 100 -0.03125 0.03101 FORMAT "%7.5" ECU_ADDRESS 0x4000C715 /end MEASUREMENT
/begin MEASUREMENT dlahil_l "I-portion of the continuous LRHK" SLONG undefined 1 100 -2147483648.00 2147483647.00 FORMAT "%13.2" ECU_ADDRESS 0x4000C698 /end MEASUREMENT
/begin MEASUREMENT dlahp "p part of continuous LRHK" SBYTE fak_q0p000244 1 100 -0.03125 0.03101 FORMAT "%7.5" ECU_ADDRESS 0x40008A51 /end MEASUREMENT
/begin MEASUREMENT dlambts "delta lambda for component protection" SBYTE fak_sb_b0p5 1 100 -0.500000000 0.496093750 FORMAT "%11.9" ECU_ADDRESS 0x40008A2E
 /begin IF_DATA XCPplus 0x0102
  /begin DAQ_EVENT VARIABLE /begin AVAILABLE_EVENT_LIST EVENT 0 EVENT 1 EVENT 2 EVENT 3 /end AVAILABLE_EVENT_LIST /begin DEFAULT_EVENT_LIST EVENT 2 /end DEFAULT_EVENT_LIST /end DAQ_EVENT
 /end IF_DATA
/end MEASUREMENT
/begin MEASUREMENT dlashki "int. Ram M4.4 diff. linearised voltage minus downstream sen. threshold" SBYTE fak_q0p000244 1 100 -0.03125 0.03101 FORMAT "%7.5" ECU_ADDRESS 0x40008A5D /end MEASUREMENT
/begin MEASUREMENT dlashkm "Delta lambda used by downstr. lambda control (act. value: fr synchronous mean)" SBYTE fak_q0p000244 1 100 -0.03125 0.03101 FORMAT "%7.5" ECU_ADDRESS 0x40008A5A /end MEASUREMENT
/begin MEASUREMENT dlashkp "Weighting factor for p-part LRHK depending on delta-lambda" SBYTE fak_q0p000244 1 100 -0.03125 0.03101 FORMAT "%7.5" ECU_ADDRESS 0x40008A5B /end MEASUREMENT
/begin MEASUREMENT dlasum "sum of lambda delay of control upstream and downstream catalyst" SBYTE fak_q0p000244 1 100 -0.03125 0.03101 FORMAT "%7.5" ECU_ADDRESS 0x40008A41
 /begin IF_DATA XCPplus 0x0102
  /begin DAQ_EVENT VARIABLE /begin AVAILABLE_EVENT_LIST EVENT 0 EVENT 1 EVENT 2 EVENT 3 /end AVAILABLE_EVENT_LIST /begin DEFAULT_EVENT_LIST EVENT 2 /end DEFAULT_EVENT_LIST /end DAQ_EVENT
 /end IF_DATA
/end MEASUREMENT
/begin MEASUREMENT dlavk "lambda delay of control upstream catalyst" SBYTE fak_q0p000244 1 100 -0.03125 0.03101 FORMAT "%7.5" ECU_ADDRESS 0x40008A40
 /begin IF_DATA XCPplus 0x0102
  /begin DAQ_EVENT VARIABLE /begin AVAILABLE_EVENT_LIST EVENT 0 EVENT 1 EVENT 2 EVENT 3 /end AVAILABLE_EVENT_LIST /begin DEFAULT_EVENT_LIST EVENT 2 /end DEFAULT_EVENT_LIST /end DAQ_EVENT
 /end IF_DATA
/end MEASUREMENT
/begin MEASUREMENT dmkh_w "delta torque for heating catalyst" UWORD rel_uw_b100 1 100 0.00 99.99847 FORMAT "%8.5" ECU_ADDRESS 0x40008678
 /begin IF_DATA XCPplus 0x0102
  /begin DAQ_EVENT VARIABLE /begin AVAILABLE_EVENT_LIST EVENT 0 EVENT 1 EVENT 2 EVENT 3 /end AVAILABLE_EVENT_LIST /begin DEFAULT_EVENT_LIST EVENT 2 /end DEFAULT_EVENT_LIST /end DAQ_EVENT
 /end IF_DATA
/end MEASUREMENT
/begin MEASUREMENT dmllri_w "desired torque change from the idle speed control (I-)" SWORD rel_sw_b100 1 100 -100.0000 99.99695 FORMAT "%8.4" ECU_ADDRESS 0x40008306
 /begin IF_DATA XCPplus 0x0102
  /begin DAQ_EVENT VARIABLE /begin AVAILABLE_EVENT_LIST EVENT 0 EVENT 1 EVENT 2 EVENT 3 /end AVAILABLE_EVENT_LIST /begin DEFAULT_EVENT_LIST EVENT 2 /end DEFAULT_EVENT_LIST /end DAQ_EVENT
 /end IF_DATA
/end MEASUREMENT
/begin MEASUREMENT dmllrl_w "desired torque change from the idle speed control (part on the air path)" SWORD rel_sw_b100 1 100 -100.0000 99.99695 FORMAT "%8.4" ECU_ADDRESS 0x40008304
 /begin IF_DATA XCPplus 0x0102
  /begin DAQ_EVENT VARIABLE /begin AVAILABLE_EVENT_LIST EVENT 0 EVENT 1 EVENT 2 EVENT 3 /end AVAILABLE_EVENT_LIST /begin DEFAULT_EVENT_LIST EVENT 2 /end DEFAULT_EVENT_LIST /end DAQ_EVENT
 /end IF_DATA
/end MEASUREMENT
/begin MEASUREMENT dmllr_w "desired torque change from the idle speed control (PD-part)" SWORD rel_sw_b100 1 100 -100.0000 99.99695 FORMAT "%8.4" ECU_ADDRESS 0x40008302
 /begin IF_DATA XCPplus 0x0102
  /begin DAQ_EVENT VARIABLE /begin AVAILABLE_EVENT_LIST EVENT 0 EVENT 1 EVENT 2 EVENT 3 /end AVAILABLE_EVENT_LIST /begin DEFAULT_EVENT_LIST EVENT 0 /end DEFAULT_EVENT_LIST /end DAQ_EVENT
 /end IF_DATA
/end MEASUREMENT
/begin MEASUREMENT dmrkhr_w "Torque reserve for catalyst heating" UWORD rel_uw_b100 1 100 0.00 99.99847 FORMAT "%8.5" ECU_ADDRESS 0x4000867C
 /begin IF_DATA XCPplus 0x0102
  /begin DAQ_EVENT VARIABLE /begin AVAILABLE_EVENT_LIST EVENT 0 EVENT 1 EVENT 2 EVENT 3 /end AVAILABLE_EVENT_LIST /begin DEFAULT_EVENT_LIST EVENT 2 /end DEFAULT_EVENT_LIST /end DAQ_EVENT
 /end IF_DATA
/end MEASUREMENT
/begin MEASUREMENT dmrkhuf_w "torque reserve for catalyzer heating (unfiltered)" UWORD rel_uw_b100 1 100 0.00 99.99847 FORMAT "%8.5" ECU_ADDRESS 0x4000867A
 /begin IF_DATA XCPplus 0x0102
  /begin DAQ_EVENT VARIABLE /begin AVAILABLE_EVENT_LIST EVENT 0 EVENT 1 EVENT 2 EVENT 3 /end AVAILABLE_EVENT_LIST /begin DEFAULT_EVENT_LIST EVENT 2 /end DEFAULT_EVENT_LIST /end DAQ_EVENT
 /end IF_DATA
/end MEASUREMENT
/begin MEASUREMENT dmrkh_w "Torque reserve for catalyst heating" UWORD rel_uw_b100 1 100 0.00 99.99847 FORMAT "%8.5" ECU_ADDRESS 0x40008676
 /begin IF_DATA XCPplus 0x0102
  /begin DAQ_EVENT VARIABLE /begin AVAILABLE_EVENT_LIST EVENT 0 EVENT 1 EVENT 2 EVENT 3 /end AVAILABLE_EVENT_LIST /begin DEFAULT_EVENT_LIST EVENT 2 /end DEFAULT_EVENT_LIST /end DAQ_EVENT
 /end IF_DATA
/end MEASUREMENT
/begin MEASUREMENT dmrllr_w "torque reserve for idle speed control" UWORD rel_uw_b100 1 100 0.00 99.99847 FORMAT "%8.5" ECU_ADDRESS 0x400086AA
 /begin IF_DATA XCPplus 0x0102
  /begin DAQ_EVENT VARIABLE /begin AVAILABLE_EVENT_LIST EVENT 0 EVENT 1 EVENT 2 EVENT 3 /end AVAILABLE_EVENT_LIST /begin DEFAULT_EVENT_LIST EVENT 2 /end DEFAULT_EVENT_LIST /end DAQ_EVENT
 /end IF_DATA
/end MEASUREMENT
/begin MEASUREMENT dn "speed deviation at idle speed control" SBYTE nmotd_sb_q10 1 100 -1280. 1270. FORMAT "%5.0" ECU_ADDRESS 0x4000878A
 /begin IF_DATA XCPplus 0x0102
  /begin DAQ_EVENT VARIABLE /begin AVAILABLE_EVENT_LIST EVENT 0 EVENT 1 EVENT 2 EVENT 3 /end AVAILABLE_EVENT_LIST /begin DEFAULT_EVENT_LIST EVENT 0 /end DEFAULT_EVENT_LIST /end DAQ_EVENT
 /end IF_DATA
/end MEASUREMENT
/begin MEASUREMENT dns "LLR: difference of idle speed precontrol" SBYTE nmotd_sb_q10 1 100 -1280. 1270. FORMAT "%5.0" ECU_ADDRESS 0x40008785
 /begin IF_DATA XCPplus 0x0102
  /begin DAQ_EVENT VARIABLE /begin AVAILABLE_EVENT_LIST EVENT 0 EVENT 1 EVENT 2 EVENT 3 /end AVAILABLE_EVENT_LIST /begin DEFAULT_EVENT_LIST EVENT 2 /end DEFAULT_EVENT_LIST /end DAQ_EVENT
 /end IF_DATA
/end MEASUREMENT
/begin MEASUREMENT dn_w "speed deviation at idle speed control" SWORD nmot_sw_q0p25 1 100 -8192.000 8191.750 FORMAT "%8.3" ECU_ADDRESS 0x40008300
 /begin IF_DATA XCPplus 0x0102
  /begin DAQ_EVENT VARIABLE /begin AVAILABLE_EVENT_LIST EVENT 0 EVENT 1 EVENT 2 EVENT 3 /end AVAILABLE_EVENT_LIST /begin DEFAULT_EVENT_LIST EVENT 0 /end DEFAULT_EVENT_LIST /end DAQ_EVENT
 /end IF_DATA
/end MEASUREMENT
/begin MEASUREMENT dpus_w "delta between ambient and intake manifold pressure" SWORD p_sw_q0p078 1 100 -2560.000 2559.922 FORMAT "%8.3" ECU_ADDRESS 0x4000864C
 /begin IF_DATA XCPplus 0x0102
  /begin DAQ_EVENT VARIABLE /begin AVAILABLE_EVENT_LIST EVENT 0 EVENT 1 EVENT 2 EVENT 3 /end AVAILABLE_EVENT_LIST /begin DEFAULT_EVENT_LIST EVENT 0 /end DEFAULT_EVENT_LIST /end DAQ_EVENT
 /end IF_DATA
/end MEASUREMENT
/begin MEASUREMENT drk_w "Change in the relative fuel requirements" UWORD rel_uw_b3072 1 100 0.00 3071.953 FORMAT "%8.3" ECU_ADDRESS 0x4000864A
 /begin IF_DATA XCPplus 0x0102
  /begin DAQ_EVENT VARIABLE /begin AVAILABLE_EVENT_LIST EVENT 0 EVENT 1 EVENT 2 EVENT 3 /end AVAILABLE_EVENT_LIST /begin DEFAULT_EVENT_LIST EVENT 0 /end DEFAULT_EVENT_LIST /end DAQ_EVENT
 /end IF_DATA
/end MEASUREMENT
/begin MEASUREMENT dtemnkt_w "Min-threshold for delta effective injection period" UWORD t1p0usxms 1 100 0.00 65.53500 FORMAT "%8.5" ECU_ADDRESS 0x40008648 /end MEASUREMENT
/begin MEASUREMENT dtiefftr_w "Delta Inj.Time for post injection in 1ms" UWORD t_q0p0064_ms 1 100 0.00 419.4240 FORMAT "%8.4" ECU_ADDRESS 0x40008646
 /begin IF_DATA XCPplus 0x0102
  /begin DAQ_EVENT VARIABLE /begin AVAILABLE_EVENT_LIST EVENT 0 EVENT 1 EVENT 2 EVENT 3 /end AVAILABLE_EVENT_LIST /begin DEFAULT_EVENT_LIST EVENT 0 /end DEFAULT_EVENT_LIST /end DAQ_EVENT
 /end IF_DATA
/end MEASUREMENT
/begin MEASUREMENT dtpsvkor "Correction for ramp duration" UBYTE t10msxs_ub_b2p55 1 100 0.00 2.550 FORMAT "%5.3" ECU_ADDRESS 0x40008A47
 /begin IF_DATA XCPplus 0x0102
  /begin DAQ_EVENT VARIABLE /begin AVAILABLE_EVENT_LIST EVENT 0 EVENT 1 EVENT 2 EVENT 3 /end AVAILABLE_EVENT_LIST /begin DEFAULT_EVENT_LIST EVENT 2 /end DEFAULT_EVENT_LIST /end DAQ_EVENT
 /end IF_DATA
/end MEASUREMENT
/begin MEASUREMENT dweest "Delta angle injection end at start" SBYTE zw_sb_q6 1 100 -768.0 762.0 FORMAT "%5.1" ECU_ADDRESS 0x40008A12
 /begin IF_DATA XCPplus 0x0102
  /begin DAQ_EVENT VARIABLE /begin AVAILABLE_EVENT_LIST EVENT 0 EVENT 1 EVENT 2 EVENT 3 /end AVAILABLE_EVENT_LIST /begin DEFAULT_EVENT_LIST EVENT 0 /end DEFAULT_EVENT_LIST /end DAQ_EVENT
 /end IF_DATA
/end MEASUREMENT
/begin MEASUREMENT dzw "Delta ignition angle between optimum and calculated" SBYTE zw_sb_q0p75 1 100 -96.00 95.25 FORMAT "%5.2" ECU_ADDRESS 0x40008A19
 /begin IF_DATA XCPplus 0x0102
  /begin DAQ_EVENT VARIABLE /begin AVAILABLE_EVENT_LIST EVENT 0 EVENT 1 EVENT 2 EVENT 3 /end AVAILABLE_EVENT_LIST /begin DEFAULT_EVENT_LIST EVENT 2 /end DEFAULT_EVENT_LIST /end DAQ_EVENT
 /end IF_DATA
/end MEASUREMENT
/begin MEASUREMENT dzwg "Delta ignition timing, basis ZW to optimum ZW" UBYTE zw_ub_q0p75 1 100 0.00 191.3 FORMAT "%5.1" ECU_ADDRESS 0x40008A29
 /begin IF_DATA XCPplus 0x0102
  /begin DAQ_EVENT VARIABLE /begin AVAILABLE_EVENT_LIST EVENT 0 EVENT 1 EVENT 2 EVENT 3 /end AVAILABLE_EVENT_LIST /begin DEFAULT_EVENT_LIST EVENT 2 /end DEFAULT_EVENT_LIST /end DAQ_EVENT
 /end IF_DATA
/end MEASUREMENT
/begin MEASUREMENT EngDa_tEngLoc10ms "Local variable in 10ms for Engine temperature" UWORD Temp_Cels 1 100 -273.1400 3003.560 FORMAT "%8.3" ECU_ADDRESS 0x40008662
 /begin IF_DATA XCPplus 0x0102
  /begin DAQ_EVENT VARIABLE /begin AVAILABLE_EVENT_LIST EVENT 0 EVENT 1 EVENT 2 EVENT 3 /end AVAILABLE_EVENT_LIST /begin DEFAULT_EVENT_LIST EVENT 1 /end DEFAULT_EVENT_LIST /end DAQ_EVENT
 /end IF_DATA
/end MEASUREMENT
/begin MEASUREMENT esst_sml06lhuw "result for search in distribution sml06lhuw" ULONG dez 1 100 0.00 4294967295.00 FORMAT "%13.2" ECU_ADDRESS 0x40008EEC /end MEASUREMENT
/begin MEASUREMENT esst_snm05lhub "result for search in distribution SNM05LHUB" ULONG dez 1 100 0.00 4294967295.00 FORMAT "%13.2" ECU_ADDRESS 0x40008EE8 /end MEASUREMENT
/begin MEASUREMENT etakh "efficiency while catalyst heating" UBYTE rel_ub_b127p5 1 100 0.00 127.5 FORMAT "%5.1" ECU_ADDRESS 0x40008A18
 /begin IF_DATA XCPplus 0x0102
  /begin DAQ_EVENT VARIABLE /begin AVAILABLE_EVENT_LIST EVENT 0 EVENT 1 EVENT 2 EVENT 3 /end AVAILABLE_EVENT_LIST /begin DEFAULT_EVENT_LIST EVENT 2 /end DEFAULT_EVENT_LIST /end DAQ_EVENT
 /end IF_DATA
/end MEASUREMENT
/begin MEASUREMENT etakhkt "desired ignition efficiency for catalyst heating by cold start" UBYTE rel_ub_b127p5 1 100 0.00 127.5 FORMAT "%5.1" ECU_ADDRESS 0x40008A1B
 /begin IF_DATA XCPplus 0x0102
  /begin DAQ_EVENT VARIABLE /begin AVAILABLE_EVENT_LIST EVENT 0 EVENT 1 EVENT 2 EVENT 3 /end AVAILABLE_EVENT_LIST /begin DEFAULT_EVENT_LIST EVENT 2 /end DEFAULT_EVENT_LIST /end DAQ_EVENT
 /end IF_DATA
/end MEASUREMENT
/begin MEASUREMENT etazwg "Efficiency at basic ignition angle" UBYTE rel_ub_b127p5 1 100 0.00 127.5 FORMAT "%5.1" ECU_ADDRESS 0x40008A2A
 /begin IF_DATA XCPplus 0x0102
  /begin DAQ_EVENT VARIABLE /begin AVAILABLE_EVENT_LIST EVENT 0 EVENT 1 EVENT 2 EVENT 3 /end AVAILABLE_EVENT_LIST /begin DEFAULT_EVENT_LIST EVENT 2 /end DEFAULT_EVENT_LIST /end DAQ_EVENT
 /end IF_DATA
/end MEASUREMENT
/begin MEASUREMENT etazwim "Mean efficiency at actual ignition angle" UBYTE rel_ub_b127p5 1 100 0.00 127.5 FORMAT "%5.1" ECU_ADDRESS 0x40008A2D
 /begin IF_DATA XCPplus 0x0102
  /begin DAQ_EVENT VARIABLE /begin AVAILABLE_EVENT_LIST EVENT 0 EVENT 1 EVENT 2 EVENT 3 /end AVAILABLE_EVENT_LIST /begin DEFAULT_EVENT_LIST EVENT 2 /end DEFAULT_EVENT_LIST /end DAQ_EVENT
 /end IF_DATA
/end MEASUREMENT
/begin MEASUREMENT ExhMgT_rLamSprkSeatLT_I.memory "Spark seat lambda Low pass filter / current lowpass value" UWORD fak_q7P629Em6 1 100 0.00 0.4999924 FORMAT "%9.7" ECU_ADDRESS 0x40009078 /end MEASUREMENT
/begin MEASUREMENT ExhMgT_rLamSprkSeatProtn "Lamda for spark seat temperature reduction" UBYTE fak_q0p0039_op0p5 1 100 0.5000 1.496 FORMAT "%5.3" ECU_ADDRESS 0x40006397
 /begin IF_DATA XCPplus 0x0102
  /begin DAQ_EVENT VARIABLE /begin AVAILABLE_EVENT_LIST EVENT 0 EVENT 1 EVENT 2 EVENT 3 /end AVAILABLE_EVENT_LIST /begin DEFAULT_EVENT_LIST EVENT 2 /end DEFAULT_EVENT_LIST /end DAQ_EVENT
 /end IF_DATA
/end MEASUREMENT
/begin MEASUREMENT ExhMgT_tHysSprkSeat_HDR_I.hysterese "Spark seat Hysterisi for temperature / Current value of the hysteresis" UBYTE B_TRUE 1 100 0.00 1.00000000000 BIT_MASK 0x1 FORMAT "%13.11" ECU_ADDRESS 0x40009076 /end MEASUREMENT
/begin MEASUREMENT ExhMgT_tiSprkSeatTONV_I.outbit "Turn on Delay for spark seat temperature model of main catalyst / return value" UBYTE B_TRUE 1 100 0.00 1.00000000000 BIT_MASK 0x1 FORMAT "%13.11" ECU_ADDRESS 0x40009074 /end MEASUREMENT
/begin MEASUREMENT ExhMgT_tiSprkSeatTONV_I.time "Turn on Delay for spark seat temperature model of main catalyst / expired delay time" UBYTE t_q0p1 1 100 0.00 25.50 FORMAT "%5.2" ECU_ADDRESS 0x40009075 /end MEASUREMENT
/begin MEASUREMENT flbts_w "Factor lambda component protection" UWORD fak_uw_b2 1 100 0.00 1.999969 FORMAT "%8.6" ECU_ADDRESS 0x400086A2
 /begin IF_DATA XCPplus 0x0102
  /begin DAQ_EVENT VARIABLE /begin AVAILABLE_EVENT_LIST EVENT 0 EVENT 1 EVENT 2 EVENT 3 /end AVAILABLE_EVENT_LIST /begin DEFAULT_EVENT_LIST EVENT 2 /end DEFAULT_EVENT_LIST /end DAQ_EVENT
 /end IF_DATA
/end MEASUREMENT
/begin MEASUREMENT FlMA_cntrNrAdpnZon "Counter used to determine every zone adaptation values are reset in case of errors" UBYTE OneToOne 1 100 0.00 255.0 FORMAT "%5.1" ECU_ADDRESS 0x40008F5B
 /begin IF_DATA XCPplus 0x0102
  /begin DAQ_EVENT VARIABLE /begin AVAILABLE_EVENT_LIST EVENT 0 EVENT 1 EVENT 2 EVENT 3 /end AVAILABLE_EVENT_LIST /begin DEFAULT_EVENT_LIST EVENT 3 /end DEFAULT_EVENT_LIST /end DAQ_EVENT
 /end IF_DATA
/end MEASUREMENT
/begin MEASUREMENT FlMA_cntrNrZon "Counter used in Ini Proc to determine every zone adaptation values are reset." UBYTE OneToOne 1 100 0.00 255.0 FORMAT "%5.1" ECU_ADDRESS 0x40008F5A /end MEASUREMENT
/begin MEASUREMENT FlMA_facDeltaMFlowSubLoad "Variable to store the difference in fkmsdk_w." UWORD fak_uw_b4 1 100 0.00 3.999939 FORMAT "%8.6" ECU_ADDRESS 0x40008F58
 /begin IF_DATA XCPplus 0x0102
  /begin DAQ_EVENT VARIABLE /begin AVAILABLE_EVENT_LIST EVENT 0 EVENT 1 EVENT 2 EVENT 3 /end AVAILABLE_EVENT_LIST /begin DEFAULT_EVENT_LIST EVENT 3 /end DEFAULT_EVENT_LIST /end DAQ_EVENT
 /end IF_DATA
/end MEASUREMENT
/begin MEASUREMENT FlMA_facDeltaMFlowSubLoadFild "Filtered value of the difference in fkmsdk_w" UWORD fak_uw_b4 1 100 0.00 3.999939 FORMAT "%8.6" ECU_ADDRESS 0x40008F56
 /begin IF_DATA XCPplus 0x0102
  /begin DAQ_EVENT VARIABLE /begin AVAILABLE_EVENT_LIST EVENT 0 EVENT 1 EVENT 2 EVENT 3 /end AVAILABLE_EVENT_LIST /begin DEFAULT_EVENT_LIST EVENT 3 /end DEFAULT_EVENT_LIST /end DAQ_EVENT
 /end IF_DATA
/end MEASUREMENT
/begin MEASUREMENT FlMA_facEngSpdGrdt "Factor to denote engine speed gradient" UBYTE fak_ub_b2 1 100 0.007812500 1.000000 FORMAT "%8.6" ECU_ADDRESS 0x40008F55
 /begin IF_DATA XCPplus 0x0102
  /begin DAQ_EVENT VARIABLE /begin AVAILABLE_EVENT_LIST EVENT 0 EVENT 1 EVENT 2 EVENT 3 /end AVAILABLE_EVENT_LIST /begin DEFAULT_EVENT_LIST EVENT 3 /end DEFAULT_EVENT_LIST /end DAQ_EVENT
 /end IF_DATA
/end MEASUREMENT
/begin MEASUREMENT FlMA_facEngSpdGrdtInt "Internal variable for the factor to denote engine speed gradient." UBYTE fak_ub_b2 1 100 0.007812500 1.000000 FORMAT "%8.6" ECU_ADDRESS 0x40008F54
 /begin IF_DATA XCPplus 0x0102
  /begin DAQ_EVENT VARIABLE /begin AVAILABLE_EVENT_LIST EVENT 0 EVENT 1 EVENT 2 EVENT 3 /end AVAILABLE_EVENT_LIST /begin DEFAULT_EVENT_LIST EVENT 3 /end DEFAULT_EVENT_LIST /end DAQ_EVENT
 /end IF_DATA
/end MEASUREMENT
/begin MEASUREMENT FlMA_facMFlowSubLoadOld "Variale to store old fkmsdk_w to calculate the difference in fkmsdk_w" UWORD fak_uw_b4 1 100 0.00 3.999939 FORMAT "%8.6" ECU_ADDRESS 0x40008F52
 /begin IF_DATA XCPplus 0x0102
  /begin DAQ_EVENT VARIABLE /begin AVAILABLE_EVENT_LIST EVENT 0 EVENT 1 EVENT 2 EVENT 3 /end AVAILABLE_EVENT_LIST /begin DEFAULT_EVENT_LIST EVENT 3 /end DEFAULT_EVENT_LIST /end DAQ_EVENT
 /end IF_DATA
/end MEASUREMENT
/begin MEASUREMENT FlMA_facMulIninVal "The initialisation value to be considered for the fra integrator." UWORD fak_uw_b2 1 100 0.00 1.999969 FORMAT "%8.6" ECU_ADDRESS 0x40008F50
 /begin IF_DATA XCPplus 0x0102
  /begin DAQ_EVENT VARIABLE /begin AVAILABLE_EVENT_LIST EVENT 0 EVENT 1 EVENT 2 EVENT 3 /end AVAILABLE_EVENT_LIST /begin DEFAULT_EVENT_LIST EVENT 3 /end DEFAULT_EVENT_LIST /end DAQ_EVENT
 /end IF_DATA
/end MEASUREMENT
/begin MEASUREMENT FlMA_facMulMixAdpnAry "Array which stores the multiplicative mixture adaptation values." UWORD fak_uw_b2 1 100 0.00 1.999969 FORMAT "%8.6" ARRAY_SIZE 21 ECU_ADDRESS 0x4000CDAA
 /begin IF_DATA XCPplus 0x0102
  /begin DAQ_EVENT VARIABLE /begin AVAILABLE_EVENT_LIST EVENT 0 EVENT 1 EVENT 2 EVENT 3 /end AVAILABLE_EVENT_LIST /begin DEFAULT_EVENT_LIST EVENT 3 /end DEFAULT_EVENT_LIST /end DAQ_EVENT
 /end IF_DATA
/end MEASUREMENT
/begin MEASUREMENT FlMA_facOffsIninVal "The initialisation value to be considered for the msleak_w integrator." SWORD m_q0p0004 1 100 -13.10720 13.10680 FORMAT "%8.5" ECU_ADDRESS 0x40008F4E
 /begin IF_DATA XCPplus 0x0102
  /begin DAQ_EVENT VARIABLE /begin AVAILABLE_EVENT_LIST EVENT 0 EVENT 1 EVENT 2 EVENT 3 /end AVAILABLE_EVENT_LIST /begin DEFAULT_EVENT_LIST EVENT 3 /end DEFAULT_EVENT_LIST /end DAQ_EVENT
 /end IF_DATA
/end MEASUREMENT
/begin MEASUREMENT FlMA_facOffsMixAdpnAry "Array which stores the msleak_w mixture adaptation values." SWORD m_q0p0004 1 100 -13.10720 13.10680 FORMAT "%8.5" ARRAY_SIZE 21 ECU_ADDRESS 0x4000CD80
 /begin IF_DATA XCPplus 0x0102
  /begin DAQ_EVENT VARIABLE /begin AVAILABLE_EVENT_LIST EVENT 0 EVENT 1 EVENT 2 EVENT 3 /end AVAILABLE_EVENT_LIST /begin DEFAULT_EVENT_LIST EVENT 3 /end DEFAULT_EVENT_LIST /end DAQ_EVENT
 /end IF_DATA
/end MEASUREMENT
/begin MEASUREMENT FlMA_flgEngSpdIdle "Engine is in idle state or within hysteresis Limit" UBYTE B_TRUE 1 100 0.00 1.00000000000 BIT_MASK 0x1 FORMAT "%13.11" ECU_ADDRESS 0x40008F4C
 /begin IF_DATA XCPplus 0x0102
  /begin DAQ_EVENT VARIABLE /begin AVAILABLE_EVENT_LIST EVENT 0 EVENT 1 EVENT 2 EVENT 3 /end AVAILABLE_EVENT_LIST /begin DEFAULT_EVENT_LIST EVENT 3 /end DEFAULT_EVENT_LIST /end DAQ_EVENT
 /end IF_DATA
/end MEASUREMENT
/begin MEASUREMENT FlMA_flgIninAddTstr "Initialisation of ora integrator for testing purpose(when OFLRAMN OFLRAMX are same)" UBYTE B_TRUE 1 100 0.00 1.00000000000 BIT_MASK 0x1 FORMAT "%13.11" ECU_ADDRESS 0x40008F4B
 /begin IF_DATA XCPplus 0x0102
  /begin DAQ_EVENT VARIABLE /begin AVAILABLE_EVENT_LIST EVENT 0 EVENT 1 EVENT 2 EVENT 3 /end AVAILABLE_EVENT_LIST /begin DEFAULT_EVENT_LIST EVENT 3 /end DEFAULT_EVENT_LIST /end DAQ_EVENT
 /end IF_DATA
/end MEASUREMENT
/begin MEASUREMENT FlMA_flgIninMulTstr "Initialisation of fra integrator for testing purpose(when FRAMN FRAMX are same)" UBYTE B_TRUE 1 100 0.00 1.00000000000 BIT_MASK 0x1 FORMAT "%13.11" ECU_ADDRESS 0x40008F4A
 /begin IF_DATA XCPplus 0x0102
  /begin DAQ_EVENT VARIABLE /begin AVAILABLE_EVENT_LIST EVENT 0 EVENT 1 EVENT 2 EVENT 3 /end AVAILABLE_EVENT_LIST /begin DEFAULT_EVENT_LIST EVENT 3 /end DEFAULT_EVENT_LIST /end DAQ_EVENT
 /end IF_DATA
/end MEASUREMENT
/begin MEASUREMENT FlMA_flgMFlowSubLoadCorrnInvld "Correction due to fkmsdk_w is invalid" UBYTE B_TRUE 1 100 0.00 1.00000000000 BIT_MASK 0x1 FORMAT "%13.11" ECU_ADDRESS 0x40008F49
 /begin IF_DATA XCPplus 0x0102
  /begin DAQ_EVENT VARIABLE /begin AVAILABLE_EVENT_LIST EVENT 0 EVENT 1 EVENT 2 EVENT 3 /end AVAILABLE_EVENT_LIST /begin DEFAULT_EVENT_LIST EVENT 3 /end DEFAULT_EVENT_LIST /end DAQ_EVENT
 /end IF_DATA
/end MEASUREMENT
/begin MEASUREMENT FlMA_flgZonChgDetd "Flag to determine if any zone change is detected." UBYTE B_TRUE 1 100 0.00 1.00000000000 BIT_MASK 0x1 FORMAT "%13.11" ECU_ADDRESS 0x40008F48
 /begin IF_DATA XCPplus 0x0102
  /begin DAQ_EVENT VARIABLE /begin AVAILABLE_EVENT_LIST EVENT 0 EVENT 1 EVENT 2 EVENT 3 /end AVAILABLE_EVENT_LIST /begin DEFAULT_EVENT_LIST EVENT 3 /end DEFAULT_EVENT_LIST /end DAQ_EVENT
 /end IF_DATA
/end MEASUREMENT
/begin MEASUREMENT FlMA_nDeltaEng "Variable to store the difference in engine speed." UWORD nmot_uw_q0p25 1 100 0.00 16383.75 FORMAT "%8.2" ECU_ADDRESS 0x40008F46
 /begin IF_DATA XCPplus 0x0102
  /begin DAQ_EVENT VARIABLE /begin AVAILABLE_EVENT_LIST EVENT 0 EVENT 1 EVENT 2 EVENT 3 /end AVAILABLE_EVENT_LIST /begin DEFAULT_EVENT_LIST EVENT 3 /end DEFAULT_EVENT_LIST /end DAQ_EVENT
 /end IF_DATA
/end MEASUREMENT
/begin MEASUREMENT FlMA_nDeltaEngFild "Filtered value of the difference in Engine speed" UWORD nmot_uw_q0p25 1 100 0.00 16383.75 FORMAT "%8.2" ECU_ADDRESS 0x40008F44
 /begin IF_DATA XCPplus 0x0102
  /begin DAQ_EVENT VARIABLE /begin AVAILABLE_EVENT_LIST EVENT 0 EVENT 1 EVENT 2 EVENT 3 /end AVAILABLE_EVENT_LIST /begin DEFAULT_EVENT_LIST EVENT 3 /end DEFAULT_EVENT_LIST /end DAQ_EVENT
 /end IF_DATA
/end MEASUREMENT
/begin MEASUREMENT FlMA_nEngOld "Variale to store old engine speed to calculate the difference of engine speed" UWORD nmot_uw_q0p25 1 100 0.00 16383.75 FORMAT "%8.2" ECU_ADDRESS 0x40008F42
 /begin IF_DATA XCPplus 0x0102
  /begin DAQ_EVENT VARIABLE /begin AVAILABLE_EVENT_LIST EVENT 0 EVENT 1 EVENT 2 EVENT 3 /end AVAILABLE_EVENT_LIST /begin DEFAULT_EVENT_LIST EVENT 3 /end DEFAULT_EVENT_LIST /end DAQ_EVENT
 /end IF_DATA
/end MEASUREMENT
/begin MEASUREMENT FlMA_stZonSelnEngSpdLoad "Variable to signify the current zone." UBYTE OneToOne 1 100 0.00 255.0 FORMAT "%5.1" ECU_ADDRESS 0x40008F41
 /begin IF_DATA XCPplus 0x0102
  /begin DAQ_EVENT VARIABLE /begin AVAILABLE_EVENT_LIST EVENT 0 EVENT 1 EVENT 2 EVENT 3 /end AVAILABLE_EVENT_LIST /begin DEFAULT_EVENT_LIST EVENT 3 /end DEFAULT_EVENT_LIST /end DAQ_EVENT
 /end IF_DATA
/end MEASUREMENT
/begin MEASUREMENT FlMA_stZonSelnEngSpdLoadOld "Variable to hold the old value of the zone" UBYTE OneToOne 1 100 0.00 255.0 FORMAT "%5.1" ECU_ADDRESS 0x40008F40
 /begin IF_DATA XCPplus 0x0102
  /begin DAQ_EVENT VARIABLE /begin AVAILABLE_EVENT_LIST EVENT 0 EVENT 1 EVENT 2 EVENT 3 /end AVAILABLE_EVENT_LIST /begin DEFAULT_EVENT_LIST EVENT 3 /end DEFAULT_EVENT_LIST /end DAQ_EVENT
 /end IF_DATA
/end MEASUREMENT
/begin MEASUREMENT framp "controller amplitude of lambda control upstream catalyst" UBYTE fak_ub_b12p45 1 100 0.00 12.45 FORMAT "%5.2" ECU_ADDRESS 0x40008A3F
 /begin IF_DATA XCPplus 0x0102
  /begin DAQ_EVENT VARIABLE /begin AVAILABLE_EVENT_LIST EVENT 0 EVENT 1 EVENT 2 EVENT 3 /end AVAILABLE_EVENT_LIST /begin DEFAULT_EVENT_LIST EVENT 2 /end DEFAULT_EVENT_LIST /end DAQ_EVENT
 /end IF_DATA
/end MEASUREMENT
/begin MEASUREMENT fra_w "multiplicative correction of the mixture adaptation (word)" UWORD fak_uw_b2 1 100 0.00 1.999969 FORMAT "%8.6" ECU_ADDRESS 0x4000CD7E
 /begin IF_DATA XCPplus 0x0102
  /begin DAQ_EVENT VARIABLE /begin AVAILABLE_EVENT_LIST EVENT 0 EVENT 1 EVENT 2 EVENT 3 /end AVAILABLE_EVENT_LIST /begin DEFAULT_EVENT_LIST EVENT 3 /end DEFAULT_EVENT_LIST /end DAQ_EVENT
 /end IF_DATA
/end MEASUREMENT
/begin MEASUREMENT fri "LR with integrator stop: gradient from KFRI(n,tL) or corresp. to DSLS" UBYTE fak_ub_b77p81 1 100 0.00 77.82 FORMAT "%5.2" ECU_ADDRESS 0x40008A3E
 /begin IF_DATA XCPplus 0x0102
  /begin DAQ_EVENT VARIABLE /begin AVAILABLE_EVENT_LIST EVENT 0 EVENT 1 EVENT 2 EVENT 3 /end AVAILABLE_EVENT_LIST /begin DEFAULT_EVENT_LIST EVENT 2 /end DEFAULT_EVENT_LIST /end DAQ_EVENT
 /end IF_DATA
/end MEASUREMENT
/begin MEASUREMENT frifak_w "product of fri and factor" SWORD fak_sw_b1 1 100 -1.000000 0.9999695 FORMAT "%8.6" ECU_ADDRESS 0x400086B0
 /begin IF_DATA XCPplus 0x0102
  /begin DAQ_EVENT VARIABLE /begin AVAILABLE_EVENT_LIST EVENT 0 EVENT 1 EVENT 2 EVENT 3 /end AVAILABLE_EVENT_LIST /begin DEFAULT_EVENT_LIST EVENT 1 /end DEFAULT_EVENT_LIST /end DAQ_EVENT
 /end IF_DATA
/end MEASUREMENT
/begin MEASUREMENT fripfak_w "Selection between frifak_w and frpfak_w" SWORD fak_sw_b1 1 100 -1.000000 0.9999695 FORMAT "%8.6" ECU_ADDRESS 0x400086B6
 /begin IF_DATA XCPplus 0x0102
  /begin DAQ_EVENT VARIABLE /begin AVAILABLE_EVENT_LIST EVENT 0 EVENT 1 EVENT 2 EVENT 3 /end AVAILABLE_EVENT_LIST /begin DEFAULT_EVENT_LIST EVENT 1 /end DEFAULT_EVENT_LIST /end DAQ_EVENT
 /end IF_DATA
/end MEASUREMENT
/begin MEASUREMENT frm_w "fast mean value of lambda control factor (word)" UWORD fak_uw_b2 1 100 0.00 1.999969 FORMAT "%8.6" ECU_ADDRESS 0x400086AE
 /begin IF_DATA XCPplus 0x0102
  /begin DAQ_EVENT VARIABLE /begin AVAILABLE_EVENT_LIST EVENT 0 EVENT 1 EVENT 2 EVENT 3 /end AVAILABLE_EVENT_LIST /begin DEFAULT_EVENT_LIST EVENT 1 /end DEFAULT_EVENT_LIST /end DAQ_EVENT
 /end IF_DATA
/end MEASUREMENT
/begin MEASUREMENT frp "LR with integrator stop; P-jump from KFRP(n,tL), or DSLS enabled" UBYTE fak_ub_b12p45 1 100 0.00 12.45 FORMAT "%5.2" ECU_ADDRESS 0x40008A3D
 /begin IF_DATA XCPplus 0x0102
  /begin DAQ_EVENT VARIABLE /begin AVAILABLE_EVENT_LIST EVENT 0 EVENT 1 EVENT 2 EVENT 3 /end AVAILABLE_EVENT_LIST /begin DEFAULT_EVENT_LIST EVENT 2 /end DEFAULT_EVENT_LIST /end DAQ_EVENT
 /end IF_DATA
/end MEASUREMENT
/begin MEASUREMENT frpfak_w "product of frp and factor" SWORD fak_sw_b1 1 100 -1.000000 0.9999695 FORMAT "%8.6" ECU_ADDRESS 0x400086B2
 /begin IF_DATA XCPplus 0x0102
  /begin DAQ_EVENT VARIABLE /begin AVAILABLE_EVENT_LIST EVENT 0 EVENT 1 EVENT 2 EVENT 3 /end AVAILABLE_EVENT_LIST /begin DEFAULT_EVENT_LIST EVENT 1 /end DEFAULT_EVENT_LIST /end DAQ_EVENT
 /end IF_DATA
/end MEASUREMENT
/begin MEASUREMENT fr_w "Lambda controller output (word)" UWORD fak_uw_b2 1 100 0.00 1.999969 FORMAT "%8.6" ECU_ADDRESS 0x400086AC
 /begin IF_DATA XCPplus 0x0102
  /begin DAQ_EVENT VARIABLE /begin AVAILABLE_EVENT_LIST EVENT 0 EVENT 1 EVENT 2 EVENT 3 /end AVAILABLE_EVENT_LIST /begin DEFAULT_EVENT_LIST EVENT 1 /end DEFAULT_EVENT_LIST /end DAQ_EVENT
 /end IF_DATA
/end MEASUREMENT
/begin MEASUREMENT fstetakhkt "control factor for desired engine efficiency by catalyst heating in case of cold start" UBYTE fak_ub_b2 1 100 0.00 1.992188 FORMAT "%8.6" ECU_ADDRESS 0x40008A1A
 /begin IF_DATA XCPplus 0x0102
  /begin DAQ_EVENT VARIABLE /begin AVAILABLE_EVENT_LIST EVENT 0 EVENT 1 EVENT 2 EVENT 3 /end AVAILABLE_EVENT_LIST /begin DEFAULT_EVENT_LIST EVENT 2 /end DEFAULT_EVENT_LIST /end DAQ_EVENT
 /end IF_DATA
/end MEASUREMENT
/begin MEASUREMENT fstns_w "Start/ post start injection factor" UWORD fak_uw_b64 1 100 0.00 63.99902 FORMAT "%8.5" ECU_ADDRESS 0x40008644
 /begin IF_DATA XCPplus 0x0102
  /begin DAQ_EVENT VARIABLE /begin AVAILABLE_EVENT_LIST EVENT 0 EVENT 1 EVENT 2 EVENT 3 /end AVAILABLE_EVENT_LIST /begin DEFAULT_EVENT_LIST EVENT 0 /end DEFAULT_EVENT_LIST /end DAQ_EVENT
 /end IF_DATA
/end MEASUREMENT
/begin MEASUREMENT fwfbfltloc "Factor for building up wall film in intake port for drive modes" UWORD fak_uw_b64 1 100 0.00 63.99902 FORMAT "%8.5" ECU_ADDRESS 0x40008670
 /begin IF_DATA XCPplus 0x0102
  /begin DAQ_EVENT VARIABLE /begin AVAILABLE_EVENT_LIST EVENT 0 EVENT 1 EVENT 2 EVENT 3 /end AVAILABLE_EVENT_LIST /begin DEFAULT_EVENT_LIST EVENT 0 /end DEFAULT_EVENT_LIST /end DAQ_EVENT
 /end IF_DATA
/end MEASUREMENT
/begin MEASUREMENT fwfbloc_w "Factor for building up wall film in intake port for drive modes local" UWORD fak_uw_b64 1 100 0.00 63.99902 FORMAT "%8.5" ECU_ADDRESS 0x4000866E
 /begin IF_DATA XCPplus 0x0102
  /begin DAQ_EVENT VARIABLE /begin AVAILABLE_EVENT_LIST EVENT 0 EVENT 1 EVENT 2 EVENT 3 /end AVAILABLE_EVENT_LIST /begin DEFAULT_EVENT_LIST EVENT 0 /end DEFAULT_EVENT_LIST /end DAQ_EVENT
 /end IF_DATA
/end MEASUREMENT
/begin MEASUREMENT fwfb_w "Factor for building up wall film in intake port" UWORD fak_uw_b64 1 100 0.00 63.99902 FORMAT "%8.5" ECU_ADDRESS 0x40008642
 /begin IF_DATA XCPplus 0x0102
  /begin DAQ_EVENT VARIABLE /begin AVAILABLE_EVENT_LIST EVENT 0 EVENT 1 EVENT 2 EVENT 3 /end AVAILABLE_EVENT_LIST /begin DEFAULT_EVENT_LIST EVENT 0 /end DEFAULT_EVENT_LIST /end DAQ_EVENT
 /end IF_DATA
/end MEASUREMENT
/begin MEASUREMENT fwl "Warm up factor" UBYTE fak_ub_b2 1 100 0.00 1.992188 FORMAT "%8.6" ECU_ADDRESS 0x40008A11
 /begin IF_DATA XCPplus 0x0102
  /begin DAQ_EVENT VARIABLE /begin AVAILABLE_EVENT_LIST EVENT 0 EVENT 1 EVENT 2 EVENT 3 /end AVAILABLE_EVENT_LIST /begin DEFAULT_EVENT_LIST EVENT 0 /end DEFAULT_EVENT_LIST /end DAQ_EVENT
 /end IF_DATA
/end MEASUREMENT
/begin MEASUREMENT HEGO_uWoDynSimnS1 "Output voltage of HEGO sensor 1 without dynamics simulation" UWORD spg_q0p005 1 100 0.00 327.6750 FORMAT "%8.4" ECU_ADDRESS 0x40008690
 /begin IF_DATA XCPplus 0x0102
  /begin DAQ_EVENT VARIABLE /begin AVAILABLE_EVENT_LIST EVENT 0 EVENT 1 EVENT 2 EVENT 3 /end AVAILABLE_EVENT_LIST /begin DEFAULT_EVENT_LIST EVENT 1 /end DEFAULT_EVENT_LIST /end DAQ_EVENT
 /end IF_DATA
/end MEASUREMENT
/begin MEASUREMENT HEGO_uWoDynSimnS2 "Output voltage of HEGO sensor 2 without dynamics simulation" UWORD spg_q0p005 1 100 0.00 327.6750 FORMAT "%8.4" ECU_ADDRESS 0x4000868E /end MEASUREMENT
/begin MEASUREMENT imllr_w "integrated air mass flow from start lambda control to maximum value" UWORD m_uw_b7281 1 100 0.00 7281.667 FORMAT "%8.3" ECU_ADDRESS 0x400086CA /end MEASUREMENT
/begin MEASUREMENT iml_w "integrated air mass flow from engine start to maximum value" UWORD m_uw_b23p3 1 100 0.00 23.30133 FORMAT "%8.5" ECU_ADDRESS 0x40008640
 /begin IF_DATA XCPplus 0x0102
  /begin DAQ_EVENT VARIABLE /begin AVAILABLE_EVENT_LIST EVENT 0 EVENT 1 EVENT 2 EVENT 3 /end AVAILABLE_EVENT_LIST /begin DEFAULT_EVENT_LIST EVENT 2 /end DEFAULT_EVENT_LIST /end DAQ_EVENT
 /end IF_DATA
/end MEASUREMENT
/begin MEASUREMENT InjSyG_EngDa_tEngLoc "Engine temperature local" UWORD Temp_Cels 1 100 -273.1400 3003.560 FORMAT "%8.3" ECU_ADDRESS 0x4000866C
 /begin IF_DATA XCPplus 0x0102
  /begin DAQ_EVENT VARIABLE /begin AVAILABLE_EVENT_LIST EVENT 0 EVENT 1 EVENT 2 EVENT 3 /end AVAILABLE_EVENT_LIST /begin DEFAULT_EVENT_LIST EVENT 0 /end DEFAULT_EVENT_LIST /end DAQ_EVENT
 /end IF_DATA
/end MEASUREMENT
/begin MEASUREMENT InjSyG_EngDa_tStrtLoc "Engine starting temperature local" UWORD Temp_Cels 1 100 -273.1400 3003.560 FORMAT "%8.3" ECU_ADDRESS 0x40008668
 /begin IF_DATA XCPplus 0x0102
  /begin DAQ_EVENT VARIABLE /begin AVAILABLE_EVENT_LIST EVENT 0 EVENT 1 EVENT 2 EVENT 3 /end AVAILABLE_EVENT_LIST /begin DEFAULT_EVENT_LIST EVENT 0 /end DEFAULT_EVENT_LIST /end DAQ_EVENT
 /end IF_DATA
/end MEASUREMENT
/begin MEASUREMENT InjSys_dvolFuacc_l "Total Fuel consumtion in current driving cycle(Long)" ULONG volgrd_q5p96Em7 1 100 0.00 2559.99999940 FORMAT "%13.8" ECU_ADDRESS 0x40008EC4
 /begin IF_DATA XCPplus 0x0102
  /begin DAQ_EVENT VARIABLE /begin AVAILABLE_EVENT_LIST EVENT 0 EVENT 1 EVENT 2 EVENT 3 /end AVAILABLE_EVENT_LIST /begin DEFAULT_EVENT_LIST EVENT 3 /end DEFAULT_EVENT_LIST /end DAQ_EVENT
 /end IF_DATA
/end MEASUREMENT
/begin MEASUREMENT InjSys_facCnvnFuMInjTi "calculation relative fuel mass rk into effective injection time te without delta pressure correction factor" UWORD fak_q0p00107_ms_DIV_pc 1 100 0.00 69.90400 FORMAT "%8.5" ECU_ADDRESS 0x40008660
 /begin IF_DATA XCPplus 0x0102
  /begin DAQ_EVENT VARIABLE /begin AVAILABLE_EVENT_LIST EVENT 0 EVENT 1 EVENT 2 EVENT 3 /end AVAILABLE_EVENT_LIST /begin DEFAULT_EVENT_LIST EVENT 2 /end DEFAULT_EVENT_LIST /end DAQ_EVENT
 /end IF_DATA
/end MEASUREMENT
/begin MEASUREMENT InjSys_facCnvnRatFuMGr "factor conversion relative fuel mass to absolute fuel mass in Gram" UWORD m_q1Em7_g_DIV_pc 1 100 0.0000001000000 0.006553500 FORMAT "%11.9" ECU_ADDRESS 0x40008658
 /begin IF_DATA XCPplus 0x0102
  /begin DAQ_EVENT VARIABLE /begin AVAILABLE_EVENT_LIST EVENT 0 EVENT 1 EVENT 2 EVENT 3 /end AVAILABLE_EVENT_LIST /begin DEFAULT_EVENT_LIST EVENT 3 /end DEFAULT_EVENT_LIST /end DAQ_EVENT
 /end IF_DATA
/end MEASUREMENT
/begin MEASUREMENT InjSys_facFuDensCorrn "Factor fuel density correction" UBYTE fak_ub_b2 1 100 0.00 1.992188 FORMAT "%8.6" ECU_ADDRESS 0x40008A13
 /begin IF_DATA XCPplus 0x0102
  /begin DAQ_EVENT VARIABLE /begin AVAILABLE_EVENT_LIST EVENT 0 EVENT 1 EVENT 2 EVENT 3 /end AVAILABLE_EVENT_LIST /begin DEFAULT_EVENT_LIST EVENT 2 /end DEFAULT_EVENT_LIST /end DAQ_EVENT
 /end IF_DATA
/end MEASUREMENT
/begin MEASUREMENT InjSys_mlgPrevDrvgCycAvrg "Avergae of Average Mileage for previous driving cycles" UWORD fak_q0p1 1 100 0.00 6553.500 FORMAT "%8.3" ECU_ADDRESS 0x40008698
 /begin IF_DATA XCPplus 0x0102
  /begin DAQ_EVENT VARIABLE /begin AVAILABLE_EVENT_LIST EVENT 0 EVENT 1 EVENT 2 EVENT 3 /end AVAILABLE_EVENT_LIST /begin DEFAULT_EVENT_LIST EVENT 3 /end DEFAULT_EVENT_LIST /end DAQ_EVENT
 /end IF_DATA
/end MEASUREMENT
/begin MEASUREMENT InjSys_mlgVeh "Instantaneous Vehicle Mileage" UWORD fak_q0p1 1 100 0.00 6553.500 FORMAT "%8.3" ECU_ADDRESS 0x40008696
 /begin IF_DATA XCPplus 0x0102
  /begin DAQ_EVENT VARIABLE /begin AVAILABLE_EVENT_LIST EVENT 0 EVENT 1 EVENT 2 EVENT 3 /end AVAILABLE_EVENT_LIST /begin DEFAULT_EVENT_LIST EVENT 3 /end DEFAULT_EVENT_LIST /end DAQ_EVENT
 /end IF_DATA
/end MEASUREMENT
/begin MEASUREMENT InjSys_mlgVehAvrgDrvgCyc_a "Vehicle Average Mileage for driving cycle" UWORD fak_q0p1 1 100 0.00 6553.500 FORMAT "%8.3" ARRAY_SIZE 10 ECU_ADDRESS 0x4000C6D6
 /begin IF_DATA XCPplus 0x0102
  /begin DAQ_EVENT VARIABLE /begin AVAILABLE_EVENT_LIST EVENT 0 EVENT 1 EVENT 2 EVENT 3 /end AVAILABLE_EVENT_LIST /begin DEFAULT_EVENT_LIST EVENT 3 /end DEFAULT_EVENT_LIST /end DAQ_EVENT
 /end IF_DATA
/end MEASUREMENT
/begin MEASUREMENT InjSys_nrDrvgCycAvrgMilg "Number of driving cycles" UBYTE dez 1 100 0.00 255.0 FORMAT "%5.1" ECU_ADDRESS 0x4000C714
 /begin IF_DATA XCPplus 0x0102
  /begin DAQ_EVENT VARIABLE /begin AVAILABLE_EVENT_LIST EVENT 0 EVENT 1 EVENT 2 EVENT 3 /end AVAILABLE_EVENT_LIST /begin DEFAULT_EVENT_LIST EVENT 3 /end DEFAULT_EVENT_LIST /end DAQ_EVENT
 /end IF_DATA
/end MEASUREMENT
/begin MEASUREMENT InjSys_ratFuMPerSync "Percentage of fuel calculated every synchro" UWORD rel_uw_b3072 1 100 0.00 3071.953 FORMAT "%8.3" ECU_ADDRESS 0x40008650
 /begin IF_DATA XCPplus 0x0102
  /begin DAQ_EVENT VARIABLE /begin AVAILABLE_EVENT_LIST EVENT 0 EVENT 1 EVENT 2 EVENT 3 /end AVAILABLE_EVENT_LIST /begin DEFAULT_EVENT_LIST EVENT 0 /end DEFAULT_EVENT_LIST /end DAQ_EVENT
 /end IF_DATA
/end MEASUREMENT
/begin MEASUREMENT InjSys_tansLoc "Local Intake air temperature" UWORD Temp_Cels 1 100 -273.1400 3003.560 FORMAT "%8.3" ECU_ADDRESS 0x4000865A
 /begin IF_DATA XCPplus 0x0102
  /begin DAQ_EVENT VARIABLE /begin AVAILABLE_EVENT_LIST EVENT 0 EVENT 1 EVENT 2 EVENT 3 /end AVAILABLE_EVENT_LIST /begin DEFAULT_EVENT_LIST EVENT 2 /end DEFAULT_EVENT_LIST /end DAQ_EVENT
 /end IF_DATA
/end MEASUREMENT
/begin MEASUREMENT InjSys_tEngFild "Filtered engine temperature" SWORD Temp_Cels 1 100 -3549.940 3003.560 FORMAT "%8.3" ECU_ADDRESS 0x4000863E
 /begin IF_DATA XCPplus 0x0102
  /begin DAQ_EVENT VARIABLE /begin AVAILABLE_EVENT_LIST EVENT 0 EVENT 1 EVENT 2 EVENT 3 /end AVAILABLE_EVENT_LIST /begin DEFAULT_EVENT_LIST EVENT 2 /end DEFAULT_EVENT_LIST /end DAQ_EVENT
 /end IF_DATA
/end MEASUREMENT
/begin MEASUREMENT InjSys_tiEngoff "Local Engine off time" UWORD t_q1 1 100 0.00 65535.00 FORMAT "%8.2" ECU_ADDRESS 0x40008666
 /begin IF_DATA XCPplus 0x0102
  /begin DAQ_EVENT VARIABLE /begin AVAILABLE_EVENT_LIST EVENT 0 EVENT 1 EVENT 2 EVENT 3 /end AVAILABLE_EVENT_LIST /begin DEFAULT_EVENT_LIST EVENT 0 /end DEFAULT_EVENT_LIST /end DAQ_EVENT
 /end IF_DATA
/end MEASUREMENT
/begin MEASUREMENT InjSys_tMdlFuT "modelled fuel temperature (Unfiltered value)" SWORD Temp_Cels 1 100 -3549.940 3003.560 FORMAT "%8.3" ECU_ADDRESS 0x4000865C
 /begin IF_DATA XCPplus 0x0102
  /begin DAQ_EVENT VARIABLE /begin AVAILABLE_EVENT_LIST EVENT 0 EVENT 1 EVENT 2 EVENT 3 /end AVAILABLE_EVENT_LIST /begin DEFAULT_EVENT_LIST EVENT 2 /end DEFAULT_EVENT_LIST /end DAQ_EVENT
 /end IF_DATA
/end MEASUREMENT
/begin MEASUREMENT InjSys_tMdlFuTFild "modelled fuel temperature (Filtered value)" SWORD Temp_Cels 1 100 -3549.940 3003.560 FORMAT "%8.3" ECU_ADDRESS 0x4000865E
 /begin IF_DATA XCPplus 0x0102
  /begin DAQ_EVENT VARIABLE /begin AVAILABLE_EVENT_LIST EVENT 0 EVENT 1 EVENT 2 EVENT 3 /end AVAILABLE_EVENT_LIST /begin DEFAULT_EVENT_LIST EVENT 2 /end DEFAULT_EVENT_LIST /end DAQ_EVENT
 /end IF_DATA
/end MEASUREMENT
/begin MEASUREMENT InjSys_uBattInj "battery voltage (on board), conversed to standard quantization" UBYTE spg_q0p1 1 100 0.00 25.50 FORMAT "%5.2" ECU_ADDRESS 0x40008A14
 /begin IF_DATA XCPplus 0x0102
  /begin DAQ_EVENT VARIABLE /begin AVAILABLE_EVENT_LIST EVENT 0 EVENT 1 EVENT 2 EVENT 3 /end AVAILABLE_EVENT_LIST /begin DEFAULT_EVENT_LIST EVENT 1 /end DEFAULT_EVENT_LIST /end DAQ_EVENT
 /end IF_DATA
/end MEASUREMENT
/begin MEASUREMENT InjSys_volFuFlowmL "volumetric flow of fuel in ml per s" UWORD volgrd_q5p96Em4 1 100 0.00 39.06190 FORMAT "%8.5" ECU_ADDRESS 0x4000863C
 /begin IF_DATA XCPplus 0x0102
  /begin DAQ_EVENT VARIABLE /begin AVAILABLE_EVENT_LIST EVENT 0 EVENT 1 EVENT 2 EVENT 3 /end AVAILABLE_EVENT_LIST /begin DEFAULT_EVENT_LIST EVENT 3 /end DEFAULT_EVENT_LIST /end DAQ_EVENT
 /end IF_DATA
/end MEASUREMENT
/begin MEASUREMENT InjSys_volFuFlowmLsyn "Volumetric flow of fuel in mL per synchro" UWORD volgrd_q5p96Em4 1 100 0.00 39.06190 FORMAT "%8.5" ECU_ADDRESS 0x40008656
 /begin IF_DATA XCPplus 0x0102
  /begin DAQ_EVENT VARIABLE /begin AVAILABLE_EVENT_LIST EVENT 0 EVENT 1 EVENT 2 EVENT 3 /end AVAILABLE_EVENT_LIST /begin DEFAULT_EVENT_LIST EVENT 0 /end DEFAULT_EVENT_LIST /end DAQ_EVENT
 /end IF_DATA
/end MEASUREMENT
/begin MEASUREMENT KONCW_EepEol_Vss "To read the value configured in varcode2 byte of EEP" UBYTE OneToOne 1 100 0.00 255.0 FORMAT "%5.1" ECU_ADDRESS 0x40007F2E /end MEASUREMENT
/begin MEASUREMENT KONCW_selFlVrnt "Fuel variant selected" UBYTE dez 1 100 0.00 255.0 FORMAT "%5.1" ECU_ADDRESS 0x40007F86 /end MEASUREMENT
/begin MEASUREMENT KONCW_selPrfVrnt "Performance variant selected" UBYTE dez 1 100 0.00 255.0 FORMAT "%5.1" ECU_ADDRESS 0x40007F85 /end MEASUREMENT
/begin MEASUREMENT KONCW_selVehVrnt "Vehicle Variant Code info" UBYTE dez 1 100 0.00 255.0 FORMAT "%5.1" ECU_ADDRESS 0x40007F84 /end MEASUREMENT
/begin MEASUREMENT KONCW_stEepEol "Variant info from EEP" UBYTE OneToOne 1 100 0.00 255.0 FORMAT "%5.1" ECU_ADDRESS 0x40007F2C /end MEASUREMENT
/begin MEASUREMENT KONCW_stEepRd "Status of EEP read for variant selection" UBYTE DEZ 1 100 0.00 255.0 FORMAT "%5.1" ECU_ADDRESS 0x40007F2B /end MEASUREMENT
/begin MEASUREMENT KONCW_stEepRd_Vss "Status of Varcode2 read" UBYTE DEZ 1 100 0.00 255.0 FORMAT "%5.1" ECU_ADDRESS 0x40007F2D /end MEASUREMENT
/begin MEASUREMENT krkte_w "calculation relative fuel mass rk into effective injection time te" UWORD fak_q0p00107_ms_DIV_pc 1 100 0.00 69.90400 FORMAT "%8.5" ECU_ADDRESS 0x40008664
 /begin IF_DATA XCPplus 0x0102
  /begin DAQ_EVENT VARIABLE /begin AVAILABLE_EVENT_LIST EVENT 0 EVENT 1 EVENT 2 EVENT 3 /end AVAILABLE_EVENT_LIST /begin DEFAULT_EVENT_LIST EVENT 0 /end DEFAULT_EVENT_LIST /end DAQ_EVENT
 /end IF_DATA
/end MEASUREMENT
/begin MEASUREMENT lambts "Desired lambda for component protection" UBYTE fak_q0p0039_op0p5 1 100 0.5000 1.496 FORMAT "%5.3" ECU_ADDRESS 0x40008A27
 /begin IF_DATA XCPplus 0x0102
  /begin DAQ_EVENT VARIABLE /begin AVAILABLE_EVENT_LIST EVENT 0 EVENT 1 EVENT 2 EVENT 3 /end AVAILABLE_EVENT_LIST /begin DEFAULT_EVENT_LIST EVENT 2 /end DEFAULT_EVENT_LIST /end DAQ_EVENT
 /end IF_DATA
/end MEASUREMENT
/begin MEASUREMENT LamCtrl_facAddlPropJmpB1 "Additional Proportional jump" UBYTE fak_ub_b12p45 1 100 0.00 4.004 FORMAT "%5.3" ECU_ADDRESS 0x40008A42
 /begin IF_DATA XCPplus 0x0102
  /begin DAQ_EVENT VARIABLE /begin AVAILABLE_EVENT_LIST EVENT 0 EVENT 1 EVENT 2 EVENT 3 /end AVAILABLE_EVENT_LIST /begin DEFAULT_EVENT_LIST EVENT 1 /end DEFAULT_EVENT_LIST /end DAQ_EVENT
 /end IF_DATA
/end MEASUREMENT
/begin MEASUREMENT LamCtrl_facPropJmpB1 "Additional Proportional jump after considering framp" SWORD fak_sw_b1 1 100 -1.000000 0.9999695 FORMAT "%8.6" ECU_ADDRESS 0x400086B4
 /begin IF_DATA XCPplus 0x0102
  /begin DAQ_EVENT VARIABLE /begin AVAILABLE_EVENT_LIST EVENT 0 EVENT 1 EVENT 2 EVENT 3 /end AVAILABLE_EVENT_LIST /begin DEFAULT_EVENT_LIST EVENT 1 /end DEFAULT_EVENT_LIST /end DAQ_EVENT
 /end IF_DATA
/end MEASUREMENT
/begin MEASUREMENT LamCtrl_facStrtSmotngCorrnB1 "Factor start smooth correction for frp Bank1" UWORD fak_q1p5259Em5 1 100 0.00 1.000000 FORMAT "%8.6" ECU_ADDRESS 0x4000C6EA
 /begin IF_DATA XCPplus 0x0102
  /begin DAQ_EVENT VARIABLE /begin AVAILABLE_EVENT_LIST EVENT 0 EVENT 1 EVENT 2 EVENT 3 /end AVAILABLE_EVENT_LIST /begin DEFAULT_EVENT_LIST EVENT 1 /end DEFAULT_EVENT_LIST /end DAQ_EVENT
 /end IF_DATA
/end MEASUREMENT
/begin MEASUREMENT LamCtrl_flgEnaAddlPropJmpB1 "Flag to enable Additional Proportional jump in bank1" UBYTE B_TRUE 1 100 0.00 1.00000000000 BIT_MASK 0x1 FORMAT "%13.11" ECU_ADDRESS 0x40008A45
 /begin IF_DATA XCPplus 0x0102
  /begin DAQ_EVENT VARIABLE /begin AVAILABLE_EVENT_LIST EVENT 0 EVENT 1 EVENT 2 EVENT 3 /end AVAILABLE_EVENT_LIST /begin DEFAULT_EVENT_LIST EVENT 1 /end DEFAULT_EVENT_LIST /end DAQ_EVENT
 /end IF_DATA
/end MEASUREMENT
/begin MEASUREMENT LamCtrl_tEngStrtWpDisp "Working point display for engine start temperature for LamCL MAPS ( KFLANS and KFLANSNG)" UWORD Temp_Cels 1 100 -273.1400 3003.560 FORMAT "%8.3" ECU_ADDRESS 0x400086A8
 /begin IF_DATA XCPplus 0x0102
  /begin DAQ_EVENT VARIABLE /begin AVAILABLE_EVENT_LIST EVENT 0 EVENT 1 EVENT 2 EVENT 3 /end AVAILABLE_EVENT_LIST /begin DEFAULT_EVENT_LIST EVENT 2 /end DEFAULT_EVENT_LIST /end DAQ_EVENT
 /end IF_DATA
/end MEASUREMENT
/begin MEASUREMENT lamhm "fr-synchr.avera.pseudo lambda actual value meas.with Nernst-sen.behind cat" UBYTE fak_q0p000244_op0p97 1 100 0.9690 1.031 FORMAT "%5.3" ECU_ADDRESS 0x40008A57 /end MEASUREMENT
/begin MEASUREMENT lamns "Desired Lambda after start" UBYTE fak_q0p0039_op0p5 1 100 0.5000 1.496 FORMAT "%5.3" ECU_ADDRESS 0x40008A31
 /begin IF_DATA XCPplus 0x0102
  /begin DAQ_EVENT VARIABLE /begin AVAILABLE_EVENT_LIST EVENT 0 EVENT 1 EVENT 2 EVENT 3 /end AVAILABLE_EVENT_LIST /begin DEFAULT_EVENT_LIST EVENT 2 /end DEFAULT_EVENT_LIST /end DAQ_EVENT
 /end IF_DATA
/end MEASUREMENT
/begin MEASUREMENT lamsol "Desired Lambda" UBYTE fak_q0p0039_op0p5 1 100 0.5000 1.496 FORMAT "%5.3" ECU_ADDRESS 0x40008A30
 /begin IF_DATA XCPplus 0x0102
  /begin DAQ_EVENT VARIABLE /begin AVAILABLE_EVENT_LIST EVENT 0 EVENT 1 EVENT 2 EVENT 3 /end AVAILABLE_EVENT_LIST /begin DEFAULT_EVENT_LIST EVENT 2 /end DEFAULT_EVENT_LIST /end DAQ_EVENT
 /end IF_DATA
/end MEASUREMENT
/begin MEASUREMENT lamsolh "pseudo lambda set point behind catalyst" UBYTE fak_q0p000244_op0p97 1 100 0.9690 1.031 FORMAT "%5.3" ECU_ADDRESS 0x40008A50 /end MEASUREMENT
/begin MEASUREMENT lamsolub "Lamda unlimited" UBYTE fak_q0p0039_op0p5 1 100 0.5000 1.496 FORMAT "%5.3" ECU_ADDRESS 0x40008A2F
 /begin IF_DATA XCPplus 0x0102
  /begin DAQ_EVENT VARIABLE /begin AVAILABLE_EVENT_LIST EVENT 0 EVENT 1 EVENT 2 EVENT 3 /end AVAILABLE_EVENT_LIST /begin DEFAULT_EVENT_LIST EVENT 2 /end DEFAULT_EVENT_LIST /end DAQ_EVENT
 /end IF_DATA
/end MEASUREMENT
/begin MEASUREMENT lamsonh "pseudo lambda actual value measured with Nernst-sensor behind cat" UBYTE fak_q0p000244_op0p97 1 100 0.9690 1.031 FORMAT "%5.3" ECU_ADDRESS 0x40008A4F /end MEASUREMENT
/begin MEASUREMENT lbts "lambda for component protection out of stationary map" UBYTE fak_q0p0039_op0p5 1 100 0.5000 1.496 FORMAT "%5.3" ECU_ADDRESS 0x40008A28
 /begin IF_DATA XCPplus 0x0102
  /begin DAQ_EVENT VARIABLE /begin AVAILABLE_EVENT_LIST EVENT 0 EVENT 1 EVENT 2 EVENT 3 /end AVAILABLE_EVENT_LIST /begin DEFAULT_EVENT_LIST EVENT 2 /end DEFAULT_EVENT_LIST /end DAQ_EVENT
 /end IF_DATA
/end MEASUREMENT
/begin MEASUREMENT limax_w "Idle speed control integrator upper limit" SWORD rel_sw_b100 1 100 -100.0000 99.99695 FORMAT "%8.4" ECU_ADDRESS 0x400082FE
 /begin IF_DATA XCPplus 0x0102
  /begin DAQ_EVENT VARIABLE /begin AVAILABLE_EVENT_LIST EVENT 0 EVENT 1 EVENT 2 EVENT 3 /end AVAILABLE_EVENT_LIST /begin DEFAULT_EVENT_LIST EVENT 2 /end DEFAULT_EVENT_LIST /end DAQ_EVENT
 /end IF_DATA
/end MEASUREMENT
/begin MEASUREMENT limin_w "Idle speed control integrator lower limit" SWORD rel_sw_b100 1 100 -100.0000 99.99695 FORMAT "%8.4" ECU_ADDRESS 0x400082FC
 /begin IF_DATA XCPplus 0x0102
  /begin DAQ_EVENT VARIABLE /begin AVAILABLE_EVENT_LIST EVENT 0 EVENT 1 EVENT 2 EVENT 3 /end AVAILABLE_EVENT_LIST /begin DEFAULT_EVENT_LIST EVENT 2 /end DEFAULT_EVENT_LIST /end DAQ_EVENT
 /end IF_DATA
/end MEASUREMENT
/begin MEASUREMENT LLRBB_nEngSpdFuCutin "engine speed for fuel cut in" UBYTE nmot_ub_q40 1 100 0.00 10200. FORMAT "%5.0" ECU_ADDRESS 0x40006396
 /begin IF_DATA XCPplus 0x0102
  /begin DAQ_EVENT VARIABLE /begin AVAILABLE_EVENT_LIST EVENT 0 EVENT 1 EVENT 2 EVENT 3 /end AVAILABLE_EVENT_LIST /begin DEFAULT_EVENT_LIST EVENT 2 /end DEFAULT_EVENT_LIST /end DAQ_EVENT
 /end IF_DATA
/end MEASUREMENT
/begin MEASUREMENT LLRBB_tEng "Engine Temprature" SWORD Temp_Cels 1 100 -3549.940 3003.560 FORMAT "%8.3" ECU_ADDRESS 0x400082F2
 /begin IF_DATA XCPplus 0x0102
  /begin DAQ_EVENT VARIABLE /begin AVAILABLE_EVENT_LIST EVENT 0 EVENT 1 EVENT 2 EVENT 3 /end AVAILABLE_EVENT_LIST /begin DEFAULT_EVENT_LIST EVENT 2 /end DEFAULT_EVENT_LIST /end DAQ_EVENT
 /end IF_DATA
/end MEASUREMENT
/begin MEASUREMENT LLRNSNSOL_tEng "Temprature variable" SWORD Temp_Cels 1 100 -3549.940 3003.560 FORMAT "%8.3" ECU_ADDRESS 0x400082F6
 /begin IF_DATA XCPplus 0x0102
  /begin DAQ_EVENT VARIABLE /begin AVAILABLE_EVENT_LIST EVENT 0 EVENT 1 EVENT 2 EVENT 3 /end AVAILABLE_EVENT_LIST /begin DEFAULT_EVENT_LIST EVENT 2 /end DEFAULT_EVENT_LIST /end DAQ_EVENT
 /end IF_DATA
/end MEASUREMENT
/begin MEASUREMENT LLRNS_flgSpLoRedn "Flag to activate reduction in Stationary reference speed during gear neutral and clutch pressured." UBYTE B_TRUE 1 100 0.00 1.00000000000 BIT_MASK 0x1 FORMAT "%13.11" ECU_ADDRESS 0x40008788
 /begin IF_DATA XCPplus 0x0102
  /begin DAQ_EVENT VARIABLE /begin AVAILABLE_EVENT_LIST EVENT 0 EVENT 1 EVENT 2 EVENT 3 /end AVAILABLE_EVENT_LIST /begin DEFAULT_EVENT_LIST EVENT 2 /end DEFAULT_EVENT_LIST /end DAQ_EVENT
 /end IF_DATA
/end MEASUREMENT
/begin MEASUREMENT LLRNS_nDifIdleSpd "difference of idle speed precontrol(datatype change)" SWORD nmotd_sb_q10 1 100 -1280.000 1270.000 FORMAT "%8.3" ECU_ADDRESS 0x400082FA
 /begin IF_DATA XCPplus 0x0102
  /begin DAQ_EVENT VARIABLE /begin AVAILABLE_EVENT_LIST EVENT 0 EVENT 1 EVENT 2 EVENT 3 /end AVAILABLE_EVENT_LIST /begin DEFAULT_EVENT_LIST EVENT 2 /end DEFAULT_EVENT_LIST /end DAQ_EVENT
 /end IF_DATA
/end MEASUREMENT
/begin MEASUREMENT LLRNS_nRednSpLo "Stationary reference speed based on Engine Temprature" UBYTE nmot_ub_q10 1 100 0.00 2550. FORMAT "%5.0" ECU_ADDRESS 0x40008789
 /begin IF_DATA XCPplus 0x0102
  /begin DAQ_EVENT VARIABLE /begin AVAILABLE_EVENT_LIST EVENT 0 EVENT 1 EVENT 2 EVENT 3 /end AVAILABLE_EVENT_LIST /begin DEFAULT_EVENT_LIST EVENT 2 /end DEFAULT_EVENT_LIST /end DAQ_EVENT
 /end IF_DATA
/end MEASUREMENT
/begin MEASUREMENT LLRNS_nSpLoBatt "local variable to store idle reference speed based on battery voltage" UBYTE nmot_ub_q10 1 100 0.00 2550. FORMAT "%5.0" ECU_ADDRESS 0x40008787
 /begin IF_DATA XCPplus 0x0102
  /begin DAQ_EVENT VARIABLE /begin AVAILABLE_EVENT_LIST EVENT 0 EVENT 1 EVENT 2 EVENT 3 /end AVAILABLE_EVENT_LIST /begin DEFAULT_EVENT_LIST EVENT 2 /end DEFAULT_EVENT_LIST /end DAQ_EVENT
 /end IF_DATA
/end MEASUREMENT
/begin MEASUREMENT LLRNS_tEng "Engine Temprature" SWORD Temp_Cels 1 100 -3549.940 3003.560 FORMAT "%8.3" ECU_ADDRESS 0x400082F8
 /begin IF_DATA XCPplus 0x0102
  /begin DAQ_EVENT VARIABLE /begin AVAILABLE_EVENT_LIST EVENT 0 EVENT 1 EVENT 2 EVENT 3 /end AVAILABLE_EVENT_LIST /begin DEFAULT_EVENT_LIST EVENT 2 /end DEFAULT_EVENT_LIST /end DAQ_EVENT
 /end IF_DATA
/end MEASUREMENT
/begin MEASUREMENT LLRNS_voltBattBefStrt "local variable to store battery voltage" UBYTE sgp_q0p1 1 100 0.00 25.50 FORMAT "%5.2" ECU_ADDRESS 0x40008786
 /begin IF_DATA XCPplus 0x0102
  /begin DAQ_EVENT VARIABLE /begin AVAILABLE_EVENT_LIST EVENT 0 EVENT 1 EVENT 2 EVENT 3 /end AVAILABLE_EVENT_LIST /begin DEFAULT_EVENT_LIST EVENT 2 /end DEFAULT_EVENT_LIST /end DAQ_EVENT
 /end IF_DATA
/end MEASUREMENT
/begin MEASUREMENT LLRRMAIPA_tEng "Engine tempraure" SWORD Temp_Cels 1 100 -3549.940 3003.560 FORMAT "%8.3" ECU_ADDRESS 0x40008308
 /begin IF_DATA XCPplus 0x0102
  /begin DAQ_EVENT VARIABLE /begin AVAILABLE_EVENT_LIST EVENT 0 EVENT 1 EVENT 2 EVENT 3 /end AVAILABLE_EVENT_LIST /begin DEFAULT_EVENT_LIST EVENT 2 /end DEFAULT_EVENT_LIST /end DAQ_EVENT
 /end IF_DATA
/end MEASUREMENT
/begin MEASUREMENT LLRRMIGP_tEng "Engine Temprature" SWORD Temp_Cels 1 100 -3549.940 3003.560 FORMAT "%8.3" ECU_ADDRESS 0x4000830A
 /begin IF_DATA XCPplus 0x0102
  /begin DAQ_EVENT VARIABLE /begin AVAILABLE_EVENT_LIST EVENT 0 EVENT 1 EVENT 2 EVENT 3 /end AVAILABLE_EVENT_LIST /begin DEFAULT_EVENT_LIST EVENT 0 /end DEFAULT_EVENT_LIST /end DAQ_EVENT
 /end IF_DATA
/end MEASUREMENT
/begin MEASUREMENT loco2s "Position of the oxygen sensors" UBYTE dez 1 100 0.00 255.0 FORMAT "%5.1" ECU_ADDRESS 0x40008A32 /end MEASUREMENT
/begin MEASUREMENT longft1_w "long term fuel trim bank1" UWORD fak_uw_b2 1 100 0.00 1.999969 FORMAT "%8.6" ECU_ADDRESS 0x400086BC
 /begin IF_DATA XCPplus 0x0102
  /begin DAQ_EVENT VARIABLE /begin AVAILABLE_EVENT_LIST EVENT 0 EVENT 1 EVENT 2 EVENT 3 /end AVAILABLE_EVENT_LIST /begin DEFAULT_EVENT_LIST EVENT 3 /end DEFAULT_EVENT_LIST /end DAQ_EVENT
 /end IF_DATA
/end MEASUREMENT
/begin MEASUREMENT ltotdist1_l "total distance since first start (in km) when drvmode = 1" ULONG OneToOne 1 100 0.00 4294967295.00 FORMAT "%13.2" ECU_ADDRESS 0x40008E04
 /begin IF_DATA XCPplus 0x0102
  /begin DAQ_EVENT VARIABLE /begin AVAILABLE_EVENT_LIST EVENT 0 EVENT 1 EVENT 2 EVENT 3 /end AVAILABLE_EVENT_LIST /begin DEFAULT_EVENT_LIST EVENT 2 /end DEFAULT_EVENT_LIST /end DAQ_EVENT
 /end IF_DATA
/end MEASUREMENT
/begin MEASUREMENT ltotdist2_l "total distance since first start (in km) when drvmode = 2" ULONG OneToOne 1 100 0.00 4294967295.00 FORMAT "%13.2" ECU_ADDRESS 0x40008E00
 /begin IF_DATA XCPplus 0x0102
  /begin DAQ_EVENT VARIABLE /begin AVAILABLE_EVENT_LIST EVENT 0 EVENT 1 EVENT 2 EVENT 3 /end AVAILABLE_EVENT_LIST /begin DEFAULT_EVENT_LIST EVENT 2 /end DEFAULT_EVENT_LIST /end DAQ_EVENT
 /end IF_DATA
/end MEASUREMENT
/begin MEASUREMENT mdlfs_w "Torque needed by the engine cooling fan" UWORD rel_uw_b100 1 100 0.00 99.99847 FORMAT "%8.5" ECU_ADDRESS 0x400082EC
 /begin IF_DATA XCPplus 0x0102
  /begin DAQ_EVENT VARIABLE /begin AVAILABLE_EVENT_LIST EVENT 0 EVENT 1 EVENT 2 EVENT 3 /end AVAILABLE_EVENT_LIST /begin DEFAULT_EVENT_LIST EVENT 2 /end DEFAULT_EVENT_LIST /end DAQ_EVENT
 /end IF_DATA
/end MEASUREMENT
/begin MEASUREMENT msleakpr_w "Predicted air mass flow to be corrected by LRA ." SWORD m_q0p0004 1 100 -13.10720 13.10680 FORMAT "%8.5" ECU_ADDRESS 0x40008F3E
 /begin IF_DATA XCPplus 0x0102
  /begin DAQ_EVENT VARIABLE /begin AVAILABLE_EVENT_LIST EVENT 0 EVENT 1 EVENT 2 EVENT 3 /end AVAILABLE_EVENT_LIST /begin DEFAULT_EVENT_LIST EVENT 3 /end DEFAULT_EVENT_LIST /end DAQ_EVENT
 /end IF_DATA
/end MEASUREMENT
/begin MEASUREMENT msleak_w "Air mass flow to be corrected by LRA" SWORD m_q0p0004 1 100 -13.10720 13.10680 FORMAT "%8.5" ECU_ADDRESS 0x4000CD7C
 /begin IF_DATA XCPplus 0x0102
  /begin DAQ_EVENT VARIABLE /begin AVAILABLE_EVENT_LIST EVENT 0 EVENT 1 EVENT 2 EVENT 3 /end AVAILABLE_EVENT_LIST /begin DEFAULT_EVENT_LIST EVENT 3 /end DEFAULT_EVENT_LIST /end DAQ_EVENT
 /end IF_DATA
/end MEASUREMENT
/begin MEASUREMENT nsol_w "idle reference speed ,word" UWORD nmot_uw_q0p25 1 100 0.00 16383.75 FORMAT "%8.2" ECU_ADDRESS 0x400082F4
 /begin IF_DATA XCPplus 0x0102
  /begin DAQ_EVENT VARIABLE /begin AVAILABLE_EVENT_LIST EVENT 0 EVENT 1 EVENT 2 EVENT 3 /end AVAILABLE_EVENT_LIST /begin DEFAULT_EVENT_LIST EVENT 2 /end DEFAULT_EVENT_LIST /end DAQ_EVENT
 /end IF_DATA
/end MEASUREMENT
/begin MEASUREMENT nstat "Stationary reference speed" UBYTE nmot_ub_q10 1 100 0.00 2550. FORMAT "%5.0" ECU_ADDRESS 0x40008784
 /begin IF_DATA XCPplus 0x0102
  /begin DAQ_EVENT VARIABLE /begin AVAILABLE_EVENT_LIST EVENT 0 EVENT 1 EVENT 2 EVENT 3 /end AVAILABLE_EVENT_LIST /begin DEFAULT_EVENT_LIST EVENT 2 /end DEFAULT_EVENT_LIST /end DAQ_EVENT
 /end IF_DATA
/end MEASUREMENT
/begin MEASUREMENT rka_w "additive adaptive correction of the relative fuel amount" SWORD rel_sw_b1536 1 100 -1536.000 1535.953 FORMAT "%8.3" ECU_ADDRESS 0x40008F3C
 /begin IF_DATA XCPplus 0x0102
  /begin DAQ_EVENT VARIABLE /begin AVAILABLE_EVENT_LIST EVENT 0 EVENT 1 EVENT 2 EVENT 3 /end AVAILABLE_EVENT_LIST /begin DEFAULT_EVENT_LIST EVENT 3 /end DEFAULT_EVENT_LIST /end DAQ_EVENT
 /end IF_DATA
/end MEASUREMENT
/begin MEASUREMENT rkoak_w "Relative fuel mass without additive corrections" UWORD rel_uw_b3072 1 100 0.00 3071.953 FORMAT "%8.3" ECU_ADDRESS 0x4000863A
 /begin IF_DATA XCPplus 0x0102
  /begin DAQ_EVENT VARIABLE /begin AVAILABLE_EVENT_LIST EVENT 0 EVENT 1 EVENT 2 EVENT 3 /end AVAILABLE_EVENT_LIST /begin DEFAULT_EVENT_LIST EVENT 0 /end DEFAULT_EVENT_LIST /end DAQ_EVENT
 /end IF_DATA
/end MEASUREMENT
/begin MEASUREMENT rk_w "Relative fuel mass" UWORD rel_uw_b3072 1 100 0.00 3071.953 FORMAT "%8.3" ECU_ADDRESS 0x40008638
 /begin IF_DATA XCPplus 0x0102
  /begin DAQ_EVENT VARIABLE /begin AVAILABLE_EVENT_LIST EVENT 0 EVENT 1 EVENT 2 EVENT 3 /end AVAILABLE_EVENT_LIST /begin DEFAULT_EVENT_LIST EVENT 0 /end DEFAULT_EVENT_LIST /end DAQ_EVENT
 /end IF_DATA
/end MEASUREMENT
/begin MEASUREMENT rlhp "high pass filter output of relative air charge" SWORD rel_q0p75 1 100 -24576.00 24575.25 FORMAT "%8.2" ECU_ADDRESS 0x400086C0 /end MEASUREMENT
/begin MEASUREMENT sdlamh_w "Sum lambda deviations downstream catalyst for average" SWORD fak_q0p000244 1 100 -8.000000 7.999756 FORMAT "%8.6" ECU_ADDRESS 0x400086C2 /end MEASUREMENT
/begin MEASUREMENT taikrm_TONV.outbit "Turn on delay for Exhaust gas temperature at manifold out of model / return value" UBYTE B_TRUE 1 100 0.00 1.00000000000 BIT_MASK 0x1 FORMAT "%13.11" ECU_ADDRESS 0x40009065 /end MEASUREMENT
/begin MEASUREMENT taikrm_TONV.time "Turn on delay for Exhaust gas temperature at manifold out of model / expired delay time" UBYTE t_q0p1 1 100 0.00 25.50 FORMAT "%5.2" ECU_ADDRESS 0x40009066 /end MEASUREMENT
/begin MEASUREMENT tdlfsar_w "remaining engine fan after run time" UWORD t_q0p1 1 100 0.00 6553.500 FORMAT "%8.3" ECU_ADDRESS 0x4000C6B0
 /begin IF_DATA XCPplus 0x0102
  /begin DAQ_EVENT VARIABLE /begin AVAILABLE_EVENT_LIST EVENT 0 EVENT 1 EVENT 2 EVENT 3 /end AVAILABLE_EVENT_LIST /begin DEFAULT_EVENT_LIST EVENT 2 /end DEFAULT_EVENT_LIST /end DAQ_EVENT
 /end IF_DATA
/end MEASUREMENT
/begin MEASUREMENT tfuelfl_w "flight time of fuel between injection valve and intake valve" UWORD t_q0p0064_ms 1 100 0.00 419.4240 FORMAT "%8.4" ECU_ADDRESS 0x40008636
 /begin IF_DATA XCPplus 0x0102
  /begin DAQ_EVENT VARIABLE /begin AVAILABLE_EVENT_LIST EVENT 0 EVENT 1 EVENT 2 EVENT 3 /end AVAILABLE_EVENT_LIST /begin DEFAULT_EVENT_LIST EVENT 0 /end DEFAULT_EVENT_LIST /end DAQ_EVENT
 /end IF_DATA
/end MEASUREMENT
/begin MEASUREMENT tieffloc_w "Effective injection time(local)" UWORD t_q0p0064_ms 1 100 0.00 419.4240 FORMAT "%8.4" ECU_ADDRESS 0x40008674
 /begin IF_DATA XCPplus 0x0102
  /begin DAQ_EVENT VARIABLE /begin AVAILABLE_EVENT_LIST EVENT 0 EVENT 1 EVENT 2 EVENT 3 /end AVAILABLE_EVENT_LIST /begin DEFAULT_EVENT_LIST EVENT 0 /end DEFAULT_EVENT_LIST /end DAQ_EVENT
 /end IF_DATA
/end MEASUREMENT
/begin MEASUREMENT tieffrloc_w "effective injection time local" UWORD t_q0p0064_ms 1 100 0.00 419.4240 FORMAT "%8.4" ECU_ADDRESS 0x40008672
 /begin IF_DATA XCPplus 0x0102
  /begin DAQ_EVENT VARIABLE /begin AVAILABLE_EVENT_LIST EVENT 0 EVENT 1 EVENT 2 EVENT 3 /end AVAILABLE_EVENT_LIST /begin DEFAULT_EVENT_LIST EVENT 0 /end DEFAULT_EVENT_LIST /end DAQ_EVENT
 /end IF_DATA
/end MEASUREMENT
/begin MEASUREMENT tieffr_w "effective injection time 16Bit original value" UWORD t_q0p0064_ms 1 100 0.00 419.4240 FORMAT "%8.4" ECU_ADDRESS 0x40008634
 /begin IF_DATA XCPplus 0x0102
  /begin DAQ_EVENT VARIABLE /begin AVAILABLE_EVENT_LIST EVENT 0 EVENT 1 EVENT 2 EVENT 3 /end AVAILABLE_EVENT_LIST /begin DEFAULT_EVENT_LIST EVENT 0 /end DEFAULT_EVENT_LIST /end DAQ_EVENT
 /end IF_DATA
/end MEASUREMENT
/begin MEASUREMENT tieff_w "effective gasoline injection time 16Bit" UWORD t_q0p0064_ms 1 100 0.00 419.4240 FORMAT "%8.4" ECU_ADDRESS 0x40008632
 /begin IF_DATA XCPplus 0x0102
  /begin DAQ_EVENT VARIABLE /begin AVAILABLE_EVENT_LIST EVENT 0 EVENT 1 EVENT 2 EVENT 3 /end AVAILABLE_EVENT_LIST /begin DEFAULT_EVENT_LIST EVENT 0 /end DEFAULT_EVENT_LIST /end DAQ_EVENT
 /end IF_DATA
/end MEASUREMENT
/begin MEASUREMENT tkihkm_TONV.outbit "Turn on Delayfor Bed temperature of main catalyst, modelled / return value" UBYTE B_TRUE 1 100 0.00 1.00000000000 BIT_MASK 0x1 FORMAT "%13.11" ECU_ADDRESS 0x40009068 /end MEASUREMENT
/begin MEASUREMENT tkihkm_TONV.time "Turn on Delayfor Bed temperature of main catalyst, modelled / expired delay time" UBYTE t_q0p1 1 100 0.00 25.50 FORMAT "%5.2" ECU_ADDRESS 0x40009069 /end MEASUREMENT
/begin MEASUREMENT tlrs "Time delay for lambda-control model" UBYTE t10msxs_ub_b2p55 1 100 0.00 2.550 FORMAT "%5.3" ECU_ADDRESS 0x40008A3C
 /begin IF_DATA XCPplus 0x0102
  /begin DAQ_EVENT VARIABLE /begin AVAILABLE_EVENT_LIST EVENT 0 EVENT 1 EVENT 2 EVENT 3 /end AVAILABLE_EVENT_LIST /begin DEFAULT_EVENT_LIST EVENT 2 /end DEFAULT_EVENT_LIST /end DAQ_EVENT
 /end IF_DATA
/end MEASUREMENT
/begin MEASUREMENT tlrs_TONV.outbit "Turn on delay variable for no fuel cutoff / return value" UBYTE B_TRUE 1 100 0.00 1.00000000000 BIT_MASK 0x1 FORMAT "%13.11" ECU_ADDRESS 0x40008DE4 /end MEASUREMENT
/begin MEASUREMENT tlrs_TONV.time "Turn on delay variable for no fuel cutoff / expired delay time" UBYTE t_q0p02 1 100 0.00 5.100 FORMAT "%5.3" ECU_ADDRESS 0x40008DE5 /end MEASUREMENT
/begin MEASUREMENT tnse_w "time counter at end of start (16 bit)" UWORD t100msxs_uw_b6553p5 1 100 0.00 6553.500 FORMAT "%8.3" ECU_ADDRESS 0x40008630
 /begin IF_DATA XCPplus 0x0102
  /begin DAQ_EVENT VARIABLE /begin AVAILABLE_EVENT_LIST EVENT 0 EVENT 1 EVENT 2 EVENT 3 /end AVAILABLE_EVENT_LIST /begin DEFAULT_EVENT_LIST EVENT 2 /end DEFAULT_EVENT_LIST /end DAQ_EVENT
 /end IF_DATA
/end MEASUREMENT
/begin MEASUREMENT tramp "Ramp duration of lambda controller" UBYTE t10msxs_ub_q0p01 1 100 0.00 2.550 FORMAT "%5.3" ECU_ADDRESS 0x40008A3B
 /begin IF_DATA XCPplus 0x0102
  /begin DAQ_EVENT VARIABLE /begin AVAILABLE_EVENT_LIST EVENT 0 EVENT 1 EVENT 2 EVENT 3 /end AVAILABLE_EVENT_LIST /begin DEFAULT_EVENT_LIST EVENT 2 /end DEFAULT_EVENT_LIST /end DAQ_EVENT
 /end IF_DATA
/end MEASUREMENT
/begin MEASUREMENT trampkorr "Corrected ramp duration of lambda controller" UBYTE t10msxs_ub_b2p55 1 100 0.00 2.550 FORMAT "%5.3" ECU_ADDRESS 0x40008A48
 /begin IF_DATA XCPplus 0x0102
  /begin DAQ_EVENT VARIABLE /begin AVAILABLE_EVENT_LIST EVENT 0 EVENT 1 EVENT 2 EVENT 3 /end AVAILABLE_EVENT_LIST /begin DEFAULT_EVENT_LIST EVENT 2 /end DEFAULT_EVENT_LIST /end DAQ_EVENT
 /end IF_DATA
/end MEASUREMENT
/begin MEASUREMENT tsperr "Stop time for lambda close loop system" UBYTE t10msxs_ub_b2p55 1 100 0.00 2.550 FORMAT "%5.3" ECU_ADDRESS 0x40008A43
 /begin IF_DATA XCPplus 0x0102
  /begin DAQ_EVENT VARIABLE /begin AVAILABLE_EVENT_LIST EVENT 0 EVENT 1 EVENT 2 EVENT 3 /end AVAILABLE_EVENT_LIST /begin DEFAULT_EVENT_LIST EVENT 2 /end DEFAULT_EVENT_LIST /end DAQ_EVENT
 /end IF_DATA
/end MEASUREMENT
/begin MEASUREMENT tvevub_w "delay time injector battery voltage depending" UWORD t_q0p0064_ms 1 100 0.00 419.4240 FORMAT "%8.4" ECU_ADDRESS 0x4000862E
 /begin IF_DATA XCPplus 0x0102
  /begin DAQ_EVENT VARIABLE /begin AVAILABLE_EVENT_LIST EVENT 0 EVENT 1 EVENT 2 EVENT 3 /end AVAILABLE_EVENT_LIST /begin DEFAULT_EVENT_LIST EVENT 1 /end DEFAULT_EVENT_LIST /end DAQ_EVENT
 /end IF_DATA
/end MEASUREMENT
/begin MEASUREMENT tvlr "LR: total value for delayed controller switch tv" SBYTE t10msxs_sb_q0p01 1 100 -1.280 1.270 FORMAT "%5.3" ECU_ADDRESS 0x40008A3A
 /begin IF_DATA XCPplus 0x0102
  /begin DAQ_EVENT VARIABLE /begin AVAILABLE_EVENT_LIST EVENT 0 EVENT 1 EVENT 2 EVENT 3 /end AVAILABLE_EVENT_LIST /begin DEFAULT_EVENT_LIST EVENT 2 /end DEFAULT_EVENT_LIST /end DAQ_EVENT
 /end IF_DATA
/end MEASUREMENT
/begin MEASUREMENT tvomdkat "LR: delayed controller switch tv symmetric for DKAT = f(osctvdkt_w)" UBYTE t10msxs_ub_q0p01 1 100 0.00 2.550 FORMAT "%5.3" ECU_ADDRESS 0x40008A39
 /begin IF_DATA XCPplus 0x0102
  /begin DAQ_EVENT VARIABLE /begin AVAILABLE_EVENT_LIST EVENT 0 EVENT 1 EVENT 2 EVENT 3 /end AVAILABLE_EVENT_LIST /begin DEFAULT_EVENT_LIST EVENT 2 /end DEFAULT_EVENT_LIST /end DAQ_EVENT
 /end IF_DATA
/end MEASUREMENT
/begin MEASUREMENT TWC_facSnsrAmpDs "amplitude sensor signal behind catalyst" UBYTE fak_ub_b1 1 100 0.00 0.9961 ECU_ADDRESS 0x40008A5C /end MEASUREMENT
/begin MEASUREMENT TWC_fildRelAirChrg "Filtered output of relative air charge" UBYTE rel_ub_q0p75 1 100 0.00 191.3 FORMAT "%5.1" ECU_ADDRESS 0x40008A59 /end MEASUREMENT
/begin MEASUREMENT tzlrkorr "Corrected exhaust pipe volume for dead time model" UWORD dez 1 100 0.00 65535.00 FORMAT "%8.2" ECU_ADDRESS 0x400086BA
 /begin IF_DATA XCPplus 0x0102
  /begin DAQ_EVENT VARIABLE /begin AVAILABLE_EVENT_LIST EVENT 0 EVENT 1 EVENT 2 EVENT 3 /end AVAILABLE_EVENT_LIST /begin DEFAULT_EVENT_LIST EVENT 2 /end DEFAULT_EVENT_LIST /end DAQ_EVENT
 /end IF_DATA
/end MEASUREMENT
/begin MEASUREMENT t_engoff_w "time of engine off" UWORD t_q1 1 100 0.00 65535.00 FORMAT "%8.2" ECU_ADDRESS 0x4000C6D2
 /begin IF_DATA XCPplus 0x0102
  /begin DAQ_EVENT VARIABLE /begin AVAILABLE_EVENT_LIST EVENT 0 EVENT 1 EVENT 2 EVENT 3 /end AVAILABLE_EVENT_LIST /begin DEFAULT_EVENT_LIST EVENT 3 /end DEFAULT_EVENT_LIST /end DAQ_EVENT
 /end IF_DATA
/end MEASUREMENT
/begin MEASUREMENT uproml_w "constant for transformation from % into ml" UWORD ASCET_tmp4 1 100 0.00 0.01017237 FORMAT "%10.8" ECU_ADDRESS 0x40008652
 /begin IF_DATA XCPplus 0x0102
  /begin DAQ_EVENT VARIABLE /begin AVAILABLE_EVENT_LIST EVENT 0 EVENT 1 EVENT 2 EVENT 3 /end AVAILABLE_EVENT_LIST /begin DEFAULT_EVENT_LIST EVENT 3 /end DEFAULT_EVENT_LIST /end DAQ_EVENT
 /end IF_DATA
/end MEASUREMENT
/begin MEASUREMENT ushdktpr "output voltage oxygen sensor downstream catatalyst, low pass filtered, for controller" UBYTE spg_q0p005 1 100 0.00 1.275 FORMAT "%5.3" ECU_ADDRESS 0x40008A4D /end MEASUREMENT
/begin MEASUREMENT ushkl "Sensor voltage after catalyst for lambda control" UBYTE spg_q0p005 1 100 0.00 1.275 FORMAT "%5.3" ECU_ADDRESS 0x40008A1F /end MEASUREMENT
/begin MEASUREMENT ushkl_w "Sensor voltage after catalyst for lambda control" UWORD spg_q0p005 1 100 0.00 327.6750 FORMAT "%8.4" ECU_ADDRESS 0x4000868C /end MEASUREMENT
/begin MEASUREMENT ushkpr_w "Sensor voltage after cat with pullup for calculation of Ri" UWORD spg_q0p005 1 100 0.00 327.6750 FORMAT "%8.4" ECU_ADDRESS 0x4000868A /end MEASUREMENT
/begin MEASUREMENT ushkun_w "unloaded sensor voltage after cat for Ri after pullup (LSF with Pumped Reference)" UWORD spg_q0p005 1 100 0.00 327.6750 FORMAT "%8.4" ECU_ADDRESS 0x40008688 /end MEASUREMENT
/begin MEASUREMENT ushkuv_w "Unloaded sensor voltage after cat for Ri before pullup (LSF with Pumped Reference)" UWORD spg_q0p005 1 100 0.00 327.6750 FORMAT "%8.4" ECU_ADDRESS 0x40008686 /end MEASUREMENT
/begin MEASUREMENT usrhk "momentary control threshold for downstream lambda control" UBYTE spg_q0p005 1 100 0.00 1.275 FORMAT "%5.3" ECU_ADDRESS 0x40008A4C /end MEASUREMENT
/begin MEASUREMENT usvkl "Sensor voltage before catalyst for lambda control" UBYTE spg_q0p005 1 100 0.00 1.275 FORMAT "%5.3" ECU_ADDRESS 0x40008A1E
 /begin IF_DATA XCPplus 0x0102
  /begin DAQ_EVENT VARIABLE /begin AVAILABLE_EVENT_LIST EVENT 0 EVENT 1 EVENT 2 EVENT 3 /end AVAILABLE_EVENT_LIST /begin DEFAULT_EVENT_LIST EVENT 1 /end DEFAULT_EVENT_LIST /end DAQ_EVENT
 /end IF_DATA
/end MEASUREMENT
/begin MEASUREMENT usvkl_w "Sensor voltage before catalyst for lambda control" UWORD spg_q0p005 1 100 0.00 327.6750 FORMAT "%8.4" ECU_ADDRESS 0x40008684
 /begin IF_DATA XCPplus 0x0102
  /begin DAQ_EVENT VARIABLE /begin AVAILABLE_EVENT_LIST EVENT 0 EVENT 1 EVENT 2 EVENT 3 /end AVAILABLE_EVENT_LIST /begin DEFAULT_EVENT_LIST EVENT 1 /end DEFAULT_EVENT_LIST /end DAQ_EVENT
 /end IF_DATA
/end MEASUREMENT
/begin MEASUREMENT usvkpr_w "Sensor voltage before cat with pullup for calculation of Ri" UWORD spg_q0p005 1 100 0.00 327.6750 FORMAT "%8.4" ECU_ADDRESS 0x40008682
 /begin IF_DATA XCPplus 0x0102
  /begin DAQ_EVENT VARIABLE /begin AVAILABLE_EVENT_LIST EVENT 0 EVENT 1 EVENT 2 EVENT 3 /end AVAILABLE_EVENT_LIST /begin DEFAULT_EVENT_LIST EVENT 1 /end DEFAULT_EVENT_LIST /end DAQ_EVENT
 /end IF_DATA
/end MEASUREMENT
/begin MEASUREMENT usvkun_w "Unloaded sensor voltage before cat for Ri after pullup" UWORD spg_q0p005 1 100 0.00 327.6750 FORMAT "%8.4" ECU_ADDRESS 0x40008680
 /begin IF_DATA XCPplus 0x0102
  /begin DAQ_EVENT VARIABLE /begin AVAILABLE_EVENT_LIST EVENT 0 EVENT 1 EVENT 2 EVENT 3 /end AVAILABLE_EVENT_LIST /begin DEFAULT_EVENT_LIST EVENT 1 /end DEFAULT_EVENT_LIST /end DAQ_EVENT
 /end IF_DATA
/end MEASUREMENT
/begin MEASUREMENT usvkuv_w "Unloaded sensor voltage before cat for Ri before pullup" UWORD spg_q0p005 1 100 0.00 327.6750 FORMAT "%8.4" ECU_ADDRESS 0x4000867E
 /begin IF_DATA XCPplus 0x0102
  /begin DAQ_EVENT VARIABLE /begin AVAILABLE_EVENT_LIST EVENT 0 EVENT 1 EVENT 2 EVENT 3 /end AVAILABLE_EVENT_LIST /begin DEFAULT_EVENT_LIST EVENT 1 /end DEFAULT_EVENT_LIST /end DAQ_EVENT
 /end IF_DATA
/end MEASUREMENT
/begin MEASUREMENT vskssyn_w "Volumetric flow of fuel in L/Synchro" UWORD RBPtCel_vf_1p90em8_1 1 100 0.00 0.001249981 FORMAT "%11.9" ECU_ADDRESS 0x40008654
 /begin IF_DATA XCPplus 0x0102
  /begin DAQ_EVENT VARIABLE /begin AVAILABLE_EVENT_LIST EVENT 0 EVENT 1 EVENT 2 EVENT 3 /end AVAILABLE_EVENT_LIST /begin DEFAULT_EVENT_LIST EVENT 0 /end DEFAULT_EVENT_LIST /end DAQ_EVENT
 /end IF_DATA
/end MEASUREMENT
/begin MEASUREMENT vsks_w "Volumetric flow of fuel in L/s" UWORD volgrd_q5p96Em7 1 100 0.00 0.03906190 FORMAT "%10.8" ECU_ADDRESS 0x4000862C
 /begin IF_DATA XCPplus 0x0102
  /begin DAQ_EVENT VARIABLE /begin AVAILABLE_EVENT_LIST EVENT 0 EVENT 1 EVENT 2 EVENT 3 /end AVAILABLE_EVENT_LIST /begin DEFAULT_EVENT_LIST EVENT 3 /end DEFAULT_EVENT_LIST /end DAQ_EVENT
 /end IF_DATA
/end MEASUREMENT
/begin MEASUREMENT weeofl "angle for end of injection without consideration of flight time" UBYTE zw_ub_q6 1 100 0.00 1530. FORMAT "%5.0" ECU_ADDRESS 0x40008A10
 /begin IF_DATA XCPplus 0x0102
  /begin DAQ_EVENT VARIABLE /begin AVAILABLE_EVENT_LIST EVENT 0 EVENT 1 EVENT 2 EVENT 3 /end AVAILABLE_EVENT_LIST /begin DEFAULT_EVENT_LIST EVENT 0 /end DEFAULT_EVENT_LIST /end DAQ_EVENT
 /end IF_DATA
/end MEASUREMENT
/begin MEASUREMENT weestsim "Offset angle injection end for simultaneous injections at start" UBYTE zw_ub_q6 1 100 0.00 1530. FORMAT "%5.0" ECU_ADDRESS 0x40008A0F
 /begin IF_DATA XCPplus 0x0102
  /begin DAQ_EVENT VARIABLE /begin AVAILABLE_EVENT_LIST EVENT 0 EVENT 1 EVENT 2 EVENT 3 /end AVAILABLE_EVENT_LIST /begin DEFAULT_EVENT_LIST EVENT 0 /end DEFAULT_EVENT_LIST /end DAQ_EVENT
 /end IF_DATA
/end MEASUREMENT
/begin MEASUREMENT wes "angle mark, inlet, closes relative to ignition TDC cylinder 1" UBYTE zw_ub_q6 1 100 0.00 1530. FORMAT "%5.0" ECU_ADDRESS 0x40008A0E /end MEASUREMENT
/begin MEASUREMENT zlrh_w "momentary integration time constant for lambda controller downstream catalyst" UWORD t_q0p1 1 100 0.00 6553.500 FORMAT "%8.3" ECU_ADDRESS 0x400086BE /end MEASUREMENT
/begin FUNCTION InjSyG_FuInjPah "9001.33.0_386.0.0Fuel Injection Path - For MSE projects"
 /begin DEF_CHARACTERISTIC ANZESWNS ANZTIMXST ANZTIMXWST CWFIP2W DTEMN FKKVS FSTNSHO FSTNSHST InjSys_facCorFuCons_M InjSys_facCorrnFuTCalcn_M InjSys_facInjrFlowCorrn_T InjSys_mfStatInjrFlowRate_C InjSys_ratStoic_C InjSys_rhoFuDens_T InjSys_tiDlyInjTiCorrn_C InjSys_tiMdlFuTCalcnFastFil_C InjSys_tiMdlFuTCalcn_C InjSys_tiStrtEndFuDensCorrn_T InjSys_tStatInjrFlowRateCalcn_C InjSys_volCyl_C KFDWEEST KFFSTNS KFFWL KFWEEOF KFWLIML KFWLRL KRKTE KWANZWST NSTNM TAHST TEMIN TKRFVW TMOTHST TNLWST TVUB WDKCLFLD WEESTSM WESSOT /end DEF_CHARACTERISTIC
 /begin IN_MEASUREMENT anztib_w B_edk B_kl15 B_llrein B_nmot B_poweron B_syn Com_tiRstrt drldkrohdyn_w EngDa_tEng EngDa_tStrt evz_austot fho fra_w frkapp fr_w GGUB_uBattFild lamsol ml_w msdkrohq_w nmotfihy_w nmot_w ps_w pu_w rka_w rkte_w rkukg_w rl rlp_w SyC_stSub tans ubsq wdkfawu_w zzyl /end IN_MEASUREMENT
 /begin OUT_MEASUREMENT anzesw_w anztistr_w B_gktiposv B_hst B_nmotst B_st B_stclfld B_stend B_stendes B_stendz B_temin B_wst dpus_w drk_w dtemnkt_w dtiefftr_w dweest fstns_w fwfb_w fwl iml_w InjSys_tEngFild InjSys_volFuFlowmL rkoak_w rk_w tfuelfl_w tieffr_w tieff_w tnse_w tvevub_w t_engoff_w vsks_w weeofl weestsim wes /end OUT_MEASUREMENT
 /begin LOC_MEASUREMENT anzeswst B_endelold B_endely EngDa_tEngLoc10ms fwfbfltloc fwfbloc_w InjSyG_EngDa_tEngLoc InjSyG_EngDa_tStrtLoc InjSys_facCnvnFuMInjTi InjSys_facCnvnRatFuMGr InjSys_facFuDensCorrn InjSys_ratFuMPerSync InjSys_tansLoc InjSys_tiEngoff InjSys_tMdlFuT InjSys_tMdlFuTFild InjSys_uBattInj InjSys_volFuFlowmLsyn krkte_w tieffloc_w tieffrloc_w uproml_w vskssyn_w /end LOC_MEASUREMENT
 FUNCTION_VERSION "9001.33.0_386.0.0" /end FUNCTION
/begin FUNCTION KHMD "9000.8.0  Calculation of torque reserve for heating catalytic converter"
 /begin DEF_CHARACTERISTIC DDMRKHMN DDMRKHMX ExhMgT_iaDesDeltaIgCatHeatg_M ExhMgT_stTqResvCatHeatg_C FAKMIFAKH KFZWKHZ KLDETAKH KLFSTKTFHO KLFSTKTMST KLFSTKTTNS /end DEF_CHARACTERISTIC
 /begin REF_CHARACTERISTIC ETADZW /end REF_CHARACTERISTIC
 /begin IN_MEASUREMENT B_kh B_llrein EngDa_tStrt etazwbm etazwmn fho_w fkhab furlmi_w mdvernsol_w mifal_w nmotfihy_w rlfawu_w SyC_stSub tnse_w zwopt /end IN_MEASUREMENT
 /begin OUT_MEASUREMENT dmkh_w dmrkh_w etakh /end OUT_MEASUREMENT
 /begin LOC_MEASUREMENT dmrkhr_w dmrkhuf_w dzw etakhkt fstetakhkt /end LOC_MEASUREMENT
 FUNCTION_VERSION "9000.8.0" /end FUNCTION
/begin FUNCTION KONCW "386.0.0   Configuration via code words"
 /begin OUT_MEASUREMENT KONCW_selFlVrnt KONCW_selPrfVrnt KONCW_selVehVrnt KONCW_stEepEol KONCW_stEepRd /end OUT_MEASUREMENT
 /begin LOC_MEASUREMENT KONCW_EepEol_Vss KONCW_stEepRd_Vss /end LOC_MEASUREMENT
 FUNCTION_VERSION "386.0.0" /end FUNCTION
/begin FUNCTION KTGGLS "9100.13.0 Component driver for GGLSV and GGLSH" /begin REF_CHARACTERISTIC HEGO_flgDynSimnS1_C HEGO_flgDynSimnS2_C /end REF_CHARACTERISTIC
 /begin IN_MEASUREMENT B_ushren B_usvren HEGO_uWithDynSimnS1 HEGO_uWithDynSimnS2 PrjCon_stLamSensRrCat_b SyC_stSub /end IN_MEASUREMENT
 /begin OUT_MEASUREMENT B_usrih B_usriv ctr_2S HEGO_uWoDynSimnS1 HEGO_uWoDynSimnS2 ushkl ushkl_w ushkpr_w ushkun_w ushkuv_w usvkl usvkl_w usvkpr_w usvkun_w usvkuv_w /end OUT_MEASUREMENT
 FUNCTION_VERSION "9100.13.0" /end FUNCTION
/begin FUNCTION KVA "9001.2.0  Output signal: display of fuel consumption"
 /begin DEF_CHARACTERISTIC InjSys_mlgSpFco_T InjSys_nrAvrgMlgDrvgCyc_C InjSys_tiVehMilg_C /end DEF_CHARACTERISTIC
 /begin IN_MEASUREMENT B_kl15 B_nmot Eep_EnvRamHist Eep_EnvRamInvld ltotdist_l SyC_stSub VehV_vAvrg vsks_w /end IN_MEASUREMENT
 /begin OUT_MEASUREMENT InjSys_mlgPrevDrvgCycAvrg InjSys_mlgVeh InjSys_mlgVehAvrgDrvgCyc_a /end OUT_MEASUREMENT
 /begin LOC_MEASUREMENT InjSys_dvolFuacc_l InjSys_nrDrvgCycAvrgMilg /end LOC_MEASUREMENT
 FUNCTION_VERSION "9001.2.0" /end FUNCTION
/begin FUNCTION LAMBTS "9000.10.0 Lambda component protection"
 /begin DEF_CHARACTERISTIC DTBTS ExhMgT_rLamSprkSeatProtn_M ExhMgT_tCatAllwdFuCutOff_C ExhMgT_tDeltaCatAllwdFuCutOff_C ExhMgT_tDeltaSprkSeatProtn_C ExhMgT_tiEnaLamSprkSeatProtn_C ExhMgT_tiLamSprkSeatFil_C ExhMgT_tSprkSeatProtn_C KFDZWLONE KFFDLBTS KFLBTS KLDLBTS KLZLBTS SNM16BTSUW SRL12BTSUW TABGBTS TIKATBTS TVTABLBTS TVTIKLBTS ZDLBTS /end DEF_CHARACTERISTIC
 /begin REF_CHARACTERISTIC ETADZW /end REF_CHARACTERISTIC
 /begin IN_MEASUREMENT etazwist ml_w nmot_w rl_w SprkSeatT_tMdl SyC_stSub taikrm tkihkm zwgru zwopt /end IN_MEASUREMENT
 /begin OUT_MEASUREMENT B_tabgbts B_tatmbts B_tatmsa B_tikatbts ExhMgT_rLamSprkSeatProtn lambts /end OUT_MEASUREMENT
 /begin LOC_MEASUREMENT detazwbs dlambts dzwg etazwg etazwim ExhMgT_rLamSprkSeatLT_I.memory ExhMgT_tHysSprkSeat_HDR_I.hysterese ExhMgT_tiSprkSeatTONV_I.outbit ExhMgT_tiSprkSeatTONV_I.time flbts_w lbts taikrm_TONV.outbit taikrm_TONV.time tkihkm_TONV.outbit tkihkm_TONV.time /end LOC_MEASUREMENT
 FUNCTION_VERSION "9000.10.0" /end FUNCTION
/begin FUNCTION LAMKO "9000.6.0  Lambda coordination" /begin DEF_CHARACTERISTIC KFLANS LABRG LASOAB /end DEF_CHARACTERISTIC
 /begin IN_MEASUREMENT anztib_w B_bevab B_lamsoap B_stendes ExhMgT_rLamSprkSeatProtn lambts lamdiag lamka lamsolap NMAXMD_flgCdnTogActv PrjCon_stLamSensRrCat_b SyC_stSub tmst /end IN_MEASUREMENT
 /begin OUT_MEASUREMENT lamns lamsol lamsolub /end OUT_MEASUREMENT
 /begin LOC_MEASUREMENT LamCtrl_tEngStrtWpDisp /end LOC_MEASUREMENT
 FUNCTION_VERSION "9000.6.0" /end FUNCTION
/begin FUNCTION LFS "9000.5.0  Engine cooling fan control"
 /begin DEF_CHARACTERISTIC CWLFS CWPSLUES1E DFC_CtlMsk2.DFC_LFS1Max_C DFC_CtlMsk2.DFC_LFS1Min_C DFC_CtlMsk2.DFC_LFS1Sig_C DFC_DisblMsk2.DFC_LFS1Max_C DFC_DisblMsk2.DFC_LFS1Min_C DFC_DisblMsk2.DFC_LFS1Sig_C DISTLFSTHR1 DISTLFSTHR2 KLDISTLFS1OFF KLTDLFSAR MDLF1 NLFS1HI TDLFSHION TDLFSLOHI TDLFSLOOF TDLFSLOON TDSTENDLFS TMLFS1DISTHI TMLFS1HI TMLFS1HI_N TMLFSARHI TMLFSARLO UBLFSAR ZKMD1LF /end DEF_CHARACTERISTIC
 /begin REF_CHARACTERISTIC TVP /end REF_CHARACTERISTIC
 /begin IN_MEASUREMENT B_desee B_kl15 B_nmot B_stendes EngDa_tEng ltotdist_l nmot SyC_stSub ubsq /end IN_MEASUREMENT
 /begin OUT_MEASUREMENT B_lf1s B_lotmp B_nlmls mdlfs_w /end OUT_MEASUREMENT
 /begin LOC_MEASUREMENT B_lfsar B_lfslodrv B_lfslow B_lfsrng B_lfsstd B_lotemc distlfson ltotdist1_l ltotdist2_l tdlfsar_w /end LOC_MEASUREMENT
 FUNCTION_VERSION "9000.5.0" /end FUNCTION
/begin FUNCTION LLRBB "9001.11.0 Operating conditions of idle speed control"
 /begin DEF_CHARACTERISTIC CWLLRBB DNSLLREIN LLRBB_nEngSpdFuOffs_C NSLLREINHY OLLSBGHY TLLRETM TLLSBGMX TVKUPPL VLLR /end DEF_CHARACTERISTIC
 /begin IN_MEASUREMENT B_atmtpa B_dash B_kuppl B_ll B_neutgear B_nmot B_nmotst B_sabte B_savmd dn_w EngDa_tEng gangi nmot_w nstat nwe ollsms_w olls_w SyC_stSub tnse_w VehV_v /end IN_MEASUREMENT
 /begin OUT_MEASUREMENT B_llr B_llrein B_llri B_llrpd B_vllr LLRBB_nEngSpdFuCutin /end OUT_MEASUREMENT
 /begin LOC_MEASUREMENT LLRBB_tEng /end LOC_MEASUREMENT
 FUNCTION_VERSION "9001.11.0" /end FUNCTION
/begin FUNCTION LLRMR "9000.5.0  Torque reserve for idle speed control" /begin DEF_CHARACTERISTIC CWLLRMR KFMRES KFMRESK KFMRESNL LLRMR_tiTakeOff_C VANF /end DEF_CHARACTERISTIC /begin REF_CHARACTERISTIC SMI04LLUB SNM06LLUB /end REF_CHARACTERISTIC /begin IN_MEASUREMENT B_kuppl B_ll B_neutgear mifa_w nmot_w SyC_stSub vfzg /end IN_MEASUREMENT /begin OUT_MEASUREMENT dmrllr_w /end OUT_MEASUREMENT FUNCTION_VERSION "9000.5.0" /end FUNCTION
/begin FUNCTION LLRNS "9000.7.0_1.9.0Idle control; Nominal engine speed for idle speed control"
 /begin DEF_CHARACTERISTIC KFNLLVG KFTFNSOL KNSNF LLRNS_flgSpLoRednNeutCond_C LLRNS_nRednSpLo_T LLRNS_nSpLoBatt_T LLRNS_nStatyRstRef_C LLRNS_nTakeOff_C LLRNS_tiSpLoRednMaxEnad_C LLRNS_voltBattDiffThd_C LLRNS_vThdTakeOff_C NLLTM NSTATNOT TFNSTAT /end DEF_CHARACTERISTIC
 /begin IN_MEASUREMENT B_kuppl B_llrein B_neutgear B_nldg B_nmot EngDa_tEng gangi LLRBB_nEngSpdFuCutin nllkh nmot_w SyC_stSub ubsq vfzg_w /end IN_MEASUREMENT
 /begin OUT_MEASUREMENT dns LLRNSNSOL_tEng nsol_w nstat /end OUT_MEASUREMENT
 /begin LOC_MEASUREMENT LLRNS_flgSpLoRedn LLRNS_nDifIdleSpd LLRNS_nRednSpLo LLRNS_nSpLoBatt LLRNS_tEng LLRNS_voltBattBefStrt /end LOC_MEASUREMENT
 FUNCTION_VERSION "9000.7.0_1.9.0" /end FUNCTION
/begin FUNCTION LLRRM "9000.9.0  Idle speed control: torque controller"
 /begin DEF_CHARACTERISTIC CWLLRRM DMLLRLMNN DMLLRLMXN DMLLRMNN DMLLRMXN DNLLRIST DNMNI IVDN IVDNV KLFKTLT KLFKTZT LIMN LIMXDNS LLRRM_tiLwrLimIntgr_C PVDN PVDNV PVLDN PVLDNV SDN06LLSB SMI04LLUB SNM06LLUB ZLIBG /end DEF_CHARACTERISTIC
 /begin IN_MEASUREMENT B_llr B_llrein B_llri B_llrpd B_vllr dns EngDa_tEng mifa_w nmot_w nsol_w SyC_stSub /end IN_MEASUREMENT
 /begin OUT_MEASUREMENT dmllri_w dmllrl_w dmllr_w dn dn_w limax_w limin_w /end OUT_MEASUREMENT
 /begin LOC_MEASUREMENT LLRRMAIPA_tEng LLRRMIGP_tEng /end LOC_MEASUREMENT
 FUNCTION_VERSION "9000.9.0" /end FUNCTION
/begin FUNCTION LOCOS2SV "9000.0.0  Interface Oxygen Sensors Location for OBD2 Service $01/$02" /begin OUT_MEASUREMENT loco2s /end OUT_MEASUREMENT FUNCTION_VERSION "9000.0.0" /end FUNCTION
/begin FUNCTION LR "9001.20.0 Lambda closed loop control"
 /begin DEF_CHARACTERISTIC FTLRSFRM KFDLAV KFRAP KFRP KLDTPSVK KLKTZLR KTZLR LamCtrl_facAddlPropJmpLeanB1_MAP LamCtrl_facAddlPropJmpRichB1_MAP LamCtrl_facStrtSmotngInin_C LamCtrl_SNM05LRUW LamCtrl_SRL05LRUB LamCtrl_tiFuDlyB1_T LamCtrl_tiStrtSmotngEngT_T LamCtrl_uLamSwtThd_C SNM05LRUW SRL05LRUB /end DEF_CHARACTERISTIC
 /begin IN_MEASUREMENT B_dktlp B_lr B_poweron dtpsvkmf falrdkt ml_w nmot_w osctvdkt_w rl SyC_stSub taikrm tmst usvkl_w /end IN_MEASUREMENT
 /begin OUT_MEASUREMENT B_frmax B_frmin B_frsp B_leandb B_leanvk B_lrtv dlasum dlavk framp fri frm_w frp fr_w tlrs tramp tvlr tvomdkat /end OUT_MEASUREMENT
 /begin LOC_MEASUREMENT B_restvop dtpsvkor frifak_w fripfak_w frpfak_w LamCtrl_facAddlPropJmpB1 LamCtrl_facPropJmpB1 LamCtrl_facStrtSmotngCorrnB1 LamCtrl_flgEnaAddlPropJmpB1 trampkorr tsperr tzlrkorr /end LOC_MEASUREMENT
 FUNCTION_VERSION "9001.20.0" /end FUNCTION
/begin FUNCTION LRA "9001.5.0  Lambda closed loop control; Adaptive pilot control"
 /begin DEF_CHARACTERISTIC DMLLRA FlMA_cntrNrZon_C FlMA_facEngSpdGrdtCnvr_T FlMA_facMFlowSubLoadCorrnThd FlMA_nARbdDeltaLimDeltaEngSpd FlMA_nARbdLimDeltaEngSpd FlMA_nDecelRbdDeltaLimDeltaEngSpd FlMA_nDecelRbdLimDeltaEngSpd FlMA_stCfgDftZonSelnStrt_C FlMA_stCfgDurgInin_C FlMA_stCfgLRA_C FlMA_stDftZonSelnStrt FlMA_stLowrThdRelAirChrg_C FlMA_stZonSelnEngSpdLoad_M FlMA_tiDeltaEngSpdFildTn_C FlMA_tiDeltaMFlowSubLoadFildTn_C FlMA_tiDlyIdleSpd FlMA_tiZonChgfraTn_C FlMA_tiZonChgoraTn_C FlMA_tLowrThdEngT_C FlMA_tLowrThdIntkAirT_C FlMA_tUpprThdEngT_C FlMA_tUpprThdIntkAirT_C FRAMN FRAMX MLLRA NLRA OFLRAMN OFLRAMX RLLRA TKFRA TKORA TVLRA /end DEF_CHARACTERISTIC
 /begin IN_MEASUREMENT B_ll B_lr B_lraofap B_lrarsap B_pwf B_stendes EngDa_tEng fkmsdk_w frm_w ml_w nmot_w rl SyC_stSub tans tateout_w umsrln_w /end IN_MEASUREMENT
 /begin OUT_MEASUREMENT B_lra B_lrafra B_lrafraf B_lraini B_lraora B_lraoraf fra_w msleakpr_w msleak_w rka_w /end OUT_MEASUREMENT
 /begin LOC_MEASUREMENT B_flgZonStyfra B_flgZonStyora FlMA_cntrNrAdpnZon FlMA_cntrNrZon FlMA_facDeltaMFlowSubLoad FlMA_facDeltaMFlowSubLoadFild FlMA_facEngSpdGrdt FlMA_facEngSpdGrdtInt FlMA_facMFlowSubLoadOld FlMA_facMulIninVal FlMA_facMulMixAdpnAry FlMA_facOffsIninVal FlMA_facOffsMixAdpnAry FlMA_flgEngSpdIdle FlMA_flgIninAddTstr FlMA_flgIninMulTstr FlMA_flgMFlowSubLoadCorrnInvld FlMA_flgZonChgDetd FlMA_nDeltaEng FlMA_nDeltaEngFild FlMA_nEngOld FlMA_stZonSelnEngSpdLoad FlMA_stZonSelnEngSpdLoadOld /end LOC_MEASUREMENT
 FUNCTION_VERSION "9001.5.0" /end FUNCTION
/begin FUNCTION LRA2SV "9000.1.0  Connection %LRA to OBD Service" /begin IN_MEASUREMENT fra_w rka_w rlp_w SyC_stSub /end IN_MEASUREMENT /begin OUT_MEASUREMENT longft1_w /end OUT_MEASUREMENT FUNCTION_VERSION "9000.1.0" /end FUNCTION
/begin FUNCTION LREB "9000.14.0 Activation conditions for lambda closed loop control"
 /begin IN_MEASUREMENT B_bevab B_lroffap B_mdkat B_nmot B_sbbvk B_temin B_ukg lamsol SyC_stSub tlrs /end IN_MEASUREMENT
 /begin OUT_MEASUREMENT B_eobdlr B_lr /end OUT_MEASUREMENT
 /begin LOC_MEASUREMENT tlrs_TONV.outbit tlrs_TONV.time /end LOC_MEASUREMENT
 FUNCTION_VERSION "9000.14.0" /end FUNCTION
/begin FUNCTION LRHK "9000.0.1  Lambda closed loop control downstream catalyst (OBDII)"
 /begin DEF_CHARACTERISTIC DRLLRHU FZDKADR FZDKAFR IMLLRMN KDLASHKI KDLASHKP KFUSHK KPLRHML LALIUSH LRHIMN LRHIMX MLLRHU NLRHO NLRHU PLRHAK RLLRHO SML06LHUW SNM05LHUB TKATMLRH TWC_flgIntglMfChkLoadChg_C TWC_flgSelMaxSnsrAmpDs_C TWC_mfLoadChgMin_C TWC_ratLoadChgDet_C TWC_tiDetLoadChg_C ZLRHML /end DEF_CHARACTERISTIC
 /begin REF_CHARACTERISTIC SRL05LRUB /end REF_CHARACTERISTIC
 /begin IN_MEASUREMENT ahkat B_frmax B_frmin B_leandb B_lr B_nmot B_pwf B_sbbhk B_tehb ml_w nmot nmot_w PrjCon_stLamSensRrCat_b rl rlmin_w SyC_stSub tkihkm tramp ushkl /end IN_MEASUREMENT
 /begin OUT_MEASUREMENT ahkatnr B_imllr B_lrhkgi B_lrhki B_lrhkp dlahc dlahi dlahp esst_sml06lhuw esst_snm05lhub lamsolh lamsonh ushdktpr usrhk zlrh_w /end OUT_MEASUREMENT
 /begin LOC_MEASUREMENT anzlrzy B_leandbs B_lrhkgne dlahil_l dlashki dlashkm dlashkp imllr_w lamhm rlhp sdlamh_w TWC_facSnsrAmpDs TWC_fildRelAirChrg /end LOC_MEASUREMENT
 FUNCTION_VERSION "9000.0.1" /end FUNCTION
/begin COMPU_METHOD ASCET_tmp4 "" RAT_FUNC "%9.8" "" COEFFS 0 65536 0 0 0 0.01017253 /end COMPU_METHOD
/begin COMPU_METHOD B_TRUE "" TAB_VERB "%6.3" "" COMPU_TAB_REF B_TRUE /end COMPU_METHOD
/begin COMPU_VTAB B_TRUE "" TAB_VERB 2 0 "FALSE" 1 "TRUE" /end COMPU_VTAB
/begin COMPU_METHOD DEZ "" RAT_FUNC "%6.2" "" COEFFS 0 1 0 0 0 1 /end COMPU_METHOD
/begin COMPU_METHOD dez "" RAT_FUNC "%6.2" "" COEFFS 0 1 0 0 0 1 /end COMPU_METHOD
/begin COMPU_METHOD DFES_OneToOne "" RAT_FUNC "%6.2" "-" COEFFS 0 1 0 0 0 1 /end COMPU_METHOD
/begin COMPU_METHOD fak_q0p000244 "" RAT_FUNC "%6.5" "-" COEFFS 0 65536 0 0 0 16 /end COMPU_METHOD
/begin COMPU_METHOD fak_q0p000244_op0p97 "" RAT_FUNC "%6.3" "-" COEFFS 0 4098 -3971 0 0 1 /end COMPU_METHOD
/begin COMPU_METHOD fak_q0p00039 "" RAT_FUNC "%6.5" "-" COEFFS 0 65536 0 0 0 25.6 /end COMPU_METHOD
/begin COMPU_METHOD fak_q0p000488 "" RAT_FUNC "%6.5" "-" COEFFS 0 65536 0 0 0 32 /end COMPU_METHOD
/begin COMPU_METHOD fak_q0p00107_ms_DIV_pc "" RAT_FUNC "%6.4" "ms/%" COEFFS 0 1875 0 0 0 2 /end COMPU_METHOD
/begin COMPU_METHOD fak_q0p0039_op0p5 "" RAT_FUNC "%6.3" "" COEFFS 0 256 -128 0 0 1 /end COMPU_METHOD
/begin COMPU_METHOD fak_q0p00781 "" RAT_FUNC "%6.4" "-" COEFFS 0 128 0 0 0 1 /end COMPU_METHOD
/begin COMPU_METHOD fak_q0p01 "" RAT_FUNC "%6.4" "" COEFFS 0 100 0 0 0 1 /end COMPU_METHOD
/begin COMPU_METHOD fak_q0p1 "" RAT_FUNC "%6.3" "-" COEFFS 0 1 0 0 0 0.1 /end COMPU_METHOD
/begin COMPU_METHOD fak_q1p5259Em5 "" RAT_FUNC "%7.6" "-" COEFFS 0 65535 0 0 0 1 /end COMPU_METHOD
/begin COMPU_METHOD fak_q7P629Em6 "" RAT_FUNC "%8.7" "-" COEFFS 0 655360 0 0 0 5 /end COMPU_METHOD
/begin COMPU_METHOD fak_sb_b0p5 "" RAT_FUNC "%10.6" "" COEFFS 0 256 0 0 0 1 /end COMPU_METHOD
/begin COMPU_METHOD fak_sw_b1 "" RAT_FUNC "%7.6" "-" COEFFS 0 65536 0 0 0 2 /end COMPU_METHOD
/begin COMPU_METHOD fak_ub_b1 "" RAT_FUNC "%6.4" "-" COEFFS 0 256 0 0 0 1 /end COMPU_METHOD
/begin COMPU_METHOD fak_ub_b12p45 "" RAT_FUNC "%6.4" "%" COEFFS 0 2048 0 0 0 100 /end COMPU_METHOD
/begin COMPU_METHOD fak_ub_b2 "" RAT_FUNC "%8.5" "-" COEFFS 0 256 0 0 0 2 /end COMPU_METHOD
/begin COMPU_METHOD fak_ub_b4 "" RAT_FUNC "%6.4" "-" COEFFS 0 256 0 0 0 4 /end COMPU_METHOD
/begin COMPU_METHOD fak_ub_b77p81 "" RAT_FUNC "%6.3" "%/s" COEFFS 0 327.68 0 0 0 100 /end COMPU_METHOD
/begin COMPU_METHOD fak_ub_q0p0019_o0p75 "" RAT_FUNC "%6.3" "" COEFFS 0 512 -384 0 0 1 /end COMPU_METHOD
/begin COMPU_METHOD fak_uw_b2 "" RAT_FUNC "%7.6" "-" COEFFS 0 65536 0 0 0 2 /end COMPU_METHOD
/begin COMPU_METHOD fak_uw_b4 "" RAT_FUNC "%7.6" "-" COEFFS 0 65536 0 0 0 4 /end COMPU_METHOD
/begin COMPU_METHOD fak_uw_b64 "" RAT_FUNC "%6.5" "-" COEFFS 0 65536 0 0 0 64 /end COMPU_METHOD
/begin COMPU_METHOD fak_uw_q0p01 "" RAT_FUNC "%6.4" "-" COEFFS 0 1 0 0 0 0.01 /end COMPU_METHOD
/begin COMPU_METHOD KLINE_SY_Compu "" TAB_VERB "%6.3" "" COMPU_TAB_REF KLINE_SY_Compu /end COMPU_METHOD
/begin COMPU_VTAB KLINE_SY_Compu "" TAB_VERB 2 0 "False" 1 "True" /end COMPU_VTAB
/begin COMPU_METHOD Kp "" RAT_FUNC "%7.6" "1/1" COEFFS 0 32768 0 0 0 1 /end COMPU_METHOD
/begin COMPU_METHOD Kp_1 "" RAT_FUNC "%6.4" "1/1" COEFFS 0 64 0 0 0 1 /end COMPU_METHOD
/begin COMPU_METHOD Kp_LmbdRec2InjMass_1 "" RAT_FUNC "%6.4" "mg/stroke" COEFFS 0 81.92 0 0 0 1 /end COMPU_METHOD
/begin COMPU_METHOD Kp_pRail2Q_1 "" RAT_FUNC "%7.6" "mm^3/s/hPa" COEFFS 0 81920 0 0 0 1 /end COMPU_METHOD
/begin COMPU_METHOD L9779_SC_Compu "" TAB_VERB "%6.3" "" COMPU_TAB_REF L9779_SC_Compu /end COMPU_METHOD
/begin COMPU_VTAB L9779_SC_Compu "" TAB_VERB 2 0 "False" 1 "True" /end COMPU_VTAB
/begin COMPU_METHOD L9959_SC_Compu "" RAT_FUNC "%6.2" "" COEFFS 0 1 0 0 0 1 /end COMPU_METHOD
/begin COMPU_METHOD L9966_SC_Compu "" RAT_FUNC "%6.2" "" COEFFS 0 1 0 0 0 1 /end COMPU_METHOD
/begin COMPU_METHOD lambda "" RAT_FUNC "%6.5" "-" COEFFS 0 1000 0 0 0 1 /end COMPU_METHOD
/begin COMPU_METHOD lambdaRec "" RAT_FUNC "%7.6" "-" COEFFS 0 10000 0 0 0 1 /end COMPU_METHOD
/begin COMPU_METHOD lambdaRecVal "" RAT_FUNC "%6.5" "-" COEFFS 0 1000 0 0 0 1 /end COMPU_METHOD
/begin COMPU_METHOD Lambda_DiffQuot "" RAT_FUNC "%6.4" "1/s" COEFFS 0 20 0 0 0 1 /end COMPU_METHOD
/begin COMPU_METHOD LAMCL_VAR_SY_Compu "" TAB_VERB "%6.3" "" COMPU_TAB_REF LAMCL_VAR_SY_Compu /end COMPU_METHOD
/begin COMPU_VTAB LAMCL_VAR_SY_Compu "" TAB_VERB 47 1 "DAI" 3 "VWW" 4 "POR" 5 "AUD" 6 "OPE" 9 "FIA" 11 "BMW" 14 "PSA" 15 "REN" 17 "ALF" 18 "SAB" 19 "VOL" 20 "NIS" 21 "GMU" 22 "FOR" 26 "IMJ" 51 "SEA" 53 "CHR" 54 "JAG" 55 "ROL" 69 "FER" 72 "TOY" 123 "MIT" 147 "HYU" 159 "HON" 160 "MAZ" 183 "CU" 190 "LRG" 204 "VVW" 214 "AVT" 242 "Iveco" 243 "DMC" 248 "SUZ" 267 "SSANGYONG" 270 "KEF" 289 "AMG" 308 "TAT" 319 "MVM" 330 "TVS" 385 "UAES" 386 "Bajaj Auto Indien" 425 "Polaris" 590 "Scania" 828 "RBCD" 999 "ALL" 2887 "Nonox" 9454 "Fuso" /end COMPU_VTAB
/begin COMPU_METHOD LAMCTRLADDLPROPJMP_SC_Compu "" TAB_VERB "%6.3" "" COMPU_TAB_REF LAMCTRLADDLPROPJMP_SC_Compu /end COMPU_METHOD
/begin COMPU_VTAB LAMCTRLADDLPROPJMP_SC_Compu "" TAB_VERB 2 0 "False" 1 "True" /end COMPU_VTAB
/begin COMPU_METHOD LAMCTRLCONF_SC_Compu "" TAB_VERB "%6.3" "" COMPU_TAB_REF LAMCTRLCONF_SC_Compu /end COMPU_METHOD
/begin COMPU_VTAB LAMCTRLCONF_SC_Compu "" TAB_VERB 3 0 "Disabled" 1 "Without_mix_adpn" 2 "With_mix_adpn" /end COMPU_VTAB
/begin COMPU_METHOD LengthFine "" RAT_FUNC "%6.5" "m" COEFFS 0 1000 0 0 0 1 /end COMPU_METHOD
/begin COMPU_METHOD LengthKm "" RAT_FUNC "%6.1" "Km" COEFFS 0 0.05 0 0 0 1 /end COMPU_METHOD
/begin COMPU_METHOD LengthKm1 "" RAT_FUNC "%6.2" "Km" COEFFS 0 1 0 0 0 1 /end COMPU_METHOD
/begin COMPU_METHOD Length_fine "" RAT_FUNC "%6.5" "m" COEFFS 0 1000 0 0 0 1 /end COMPU_METHOD
/begin COMPU_METHOD Length_km "" RAT_FUNC "%6.2" "km" COEFFS 0 1 0 0 0 1 /end COMPU_METHOD
/begin COMPU_METHOD Len_Km_q0p00001_COMPU "" RAT_FUNC "%8.7" "Km" COEFFS 0 100000 0 0 0 1 /end COMPU_METHOD
/begin COMPU_METHOD len_q0p0007629_m "" RAT_FUNC "%6.5" "m" COEFFS 0 65536 0 0 0 50 /end COMPU_METHOD
/begin COMPU_METHOD LINNM_SC_Compu "" TAB_VERB "%6.3" "" COMPU_TAB_REF LINNM_SC_Compu /end COMPU_METHOD
/begin COMPU_VTAB LINNM_SC_Compu "" TAB_VERB 2 0 "False" 1 "True" /end COMPU_VTAB
/begin COMPU_METHOD LIN_SY_Compu "" TAB_VERB "%6.3" "" COMPU_TAB_REF LIN_SY_Compu /end COMPU_METHOD
/begin COMPU_VTAB LIN_SY_Compu "" TAB_VERB 2 0 "False" 1 "True" /end COMPU_VTAB
/begin COMPU_METHOD LSFX4_SY_Compu "" TAB_VERB "%6.3" "" COMPU_TAB_REF LSFX4_SY_Compu /end COMPU_METHOD
/begin COMPU_VTAB LSFX4_SY_Compu "" TAB_VERB 2 0 "False" 1 "True" /end COMPU_VTAB
/begin COMPU_METHOD LSM_SY_Compu "" TAB_VERB "%6.3" "" COMPU_TAB_REF LSM_SY_Compu /end COMPU_METHOD
/begin COMPU_VTAB LSM_SY_Compu "" TAB_VERB 2 0 "0" 1 "1" /end COMPU_VTAB
/begin COMPU_METHOD LSU_CT_SENSORS_TWFLW_SYS_Compu "" TAB_VERB "%6.3" "" COMPU_TAB_REF LSU_CT_SENSORS_TWFLW_SYS_Compu /end COMPU_METHOD
/begin COMPU_VTAB LSU_CT_SENSORS_TWFLW_SYS_Compu "" TAB_VERB 3 0 "0" 1 "1" 2 "2" /end COMPU_VTAB
/begin COMPU_METHOD Mass "" RAT_FUNC "%6.2" "-" COEFFS 0 1 0 0 0 1 /end COMPU_METHOD
/begin COMPU_METHOD Mass2Temp_q0p000003 "" RAT_FUNC "%8.7" "Kg/K" COEFFS 0 333333.333333333 0 0 0 1 /end COMPU_METHOD
/begin COMPU_METHOD MassPerTimeq0p00001 "" RAT_FUNC "%8.7" "g/s" COEFFS 0 100000 0 0 0 1 /end COMPU_METHOD
/begin COMPU_METHOD MassPerTimeq0p001 "" RAT_FUNC "%6.5" "g/s" COEFFS 0 1000 0 0 0 1 /end COMPU_METHOD
/begin COMPU_METHOD Mass_q1 "" RAT_FUNC "%6.2" "g" COEFFS 0 1 0 0 0 1 /end COMPU_METHOD
/begin COMPU_METHOD MDG1BSWBASELINE_SC_Compu "" TAB_VERB "%6.3" "" COMPU_TAB_REF MDG1BSWBASELINE_SC_Compu /end COMPU_METHOD
/begin COMPU_VTAB MDG1BSWBASELINE_SC_Compu "" TAB_VERB 18 10 "BSW_13_05" 11 "BSW_13_05A" 12 "BSW_13_05B" 13 "BSW_13_05C" 20 "BSW_13_09" 30 "BSW_13_11" 40 "BSW_14_03" 41 "BSW_14_03A" 42 "BSW_14_03B" 43 "BSW_14_03C" 44 "BSW_14_03D" 50 "BSW_14_06" 60 "BSW_14_09" 70 "BSW_14_12" 80 "BSW_15_03" 90 "BSW_15_06" 100 "BSW_15_09" 110 "BSW_15_12" /end COMPU_VTAB
/begin COMPU_METHOD MDG1CPUDEVICE_SC_Compu "" TAB_VERB "%6.3" "" COMPU_TAB_REF MDG1CPUDEVICE_SC_Compu /end COMPU_METHOD
/begin COMPU_VTAB MDG1CPUDEVICE_SC_Compu "" TAB_VERB 6 0 "None" 1 "1" 2 "2" 3 "3" 4 "4" 5 "5" /end COMPU_VTAB
/begin COMPU_METHOD MDG1CPUHOUSING_SC_Compu "" TAB_VERB "%6.3" "" COMPU_TAB_REF MDG1CPUHOUSING_SC_Compu /end COMPU_METHOD
/begin COMPU_VTAB MDG1CPUHOUSING_SC_Compu "" TAB_VERB 10 0 "None" 1 "PRE" 2 "LQFP" 3 "LQFP80" 4 "LQFP100" 5 "LQFP144" 6 "LQFP176" 7 "BAG292" 8 "BAG416" 9 "BAG516" /end COMPU_VTAB
/begin COMPU_METHOD MDG1CPUSTEP_SC_Compu "" TAB_VERB "%6.3" "" COMPU_TAB_REF MDG1CPUSTEP_SC_Compu /end COMPU_METHOD
/begin COMPU_VTAB MDG1CPUSTEP_SC_Compu "" TAB_VERB 5 0 "None" 1 "1" 2 "2" 110 "110" 120 "120" /end COMPU_VTAB
/begin COMPU_METHOD MDG1CPUVENDOR_SC_Compu "" TAB_VERB "%6.3" "" COMPU_TAB_REF MDG1CPUVENDOR_SC_Compu /end COMPU_METHOD
/begin COMPU_VTAB MDG1CPUVENDOR_SC_Compu "" TAB_VERB 3 0 "None" 1 "IFX" 2 "JDP" /end COMPU_VTAB
/begin COMPU_METHOD MDG1MSGCNCPT_SC_Compu "" TAB_VERB "%6.3" "" COMPU_TAB_REF MDG1MSGCNCPT_SC_Compu /end COMPU_METHOD
/begin COMPU_VTAB MDG1MSGCNCPT_SC_Compu "" TAB_VERB 2 0 "MSGCNCPT_DISABLED" 1 "MSGCNCPT_ENABLED" /end COMPU_VTAB
/begin COMPU_METHOD MEM_CENDIAGACTVD_SC_Compu "" TAB_VERB "%6.3" "" COMPU_TAB_REF MEM_CENDIAGACTVD_SC_Compu /end COMPU_METHOD
/begin COMPU_VTAB MEM_CENDIAGACTVD_SC_Compu "" TAB_VERB 2 0 "False" 1 "True" /end COMPU_VTAB
/begin COMPU_METHOD MEM_DIAGACTVDEXTD_SC_Compu "" TAB_VERB "%6.3" "" COMPU_TAB_REF MEM_DIAGACTVDEXTD_SC_Compu /end COMPU_METHOD
/begin COMPU_VTAB MEM_DIAGACTVDEXTD_SC_Compu "" TAB_VERB 2 0 "False" 1 "True" /end COMPU_VTAB
/begin COMPU_METHOD MgPerHubSec "" RAT_FUNC "%6.3" "mg/(Hub*sec)" COEFFS 0 10 0 0 0 1 /end COMPU_METHOD
/begin COMPU_METHOD mgrad_q1p526Em6_kg_DIV_h "" RAT_FUNC "%8.7" "kg/h" COEFFS 0 65536 0 0 0 0.1 /end COMPU_METHOD
/begin COMPU_METHOD MILLMP_2HZBLINK_SC_Compu "" TAB_VERB "%6.3" "" COMPU_TAB_REF MILLMP_2HZBLINK_SC_Compu /end COMPU_METHOD
/begin COMPU_VTAB MILLMP_2HZBLINK_SC_Compu "" TAB_VERB 2 0 "False" 1 "True" /end COMPU_VTAB
/begin COMPU_METHOD MILLMP_ENGSTRTWITH2SECCDN_SC_Compu "" TAB_VERB "%6.3" "" COMPU_TAB_REF MILLMP_ENGSTRTWITH2SECCDN_SC_Compu /end COMPU_METHOD
/begin COMPU_VTAB MILLMP_ENGSTRTWITH2SECCDN_SC_Compu "" TAB_VERB 2 0 "False" 1 "True" /end COMPU_VTAB
/begin COMPU_METHOD MILLMP_PWRSTG_SY_Compu "" TAB_VERB "%6.3" "" COMPU_TAB_REF MILLMP_PWRSTG_SY_Compu /end COMPU_METHOD
/begin COMPU_VTAB MILLMP_PWRSTG_SY_Compu "" TAB_VERB 2 0 "False" 1 "True" /end COMPU_VTAB
/begin COMPU_METHOD MILLMP_SUPRT_ATS_SY_Compu "" TAB_VERB "%6.3" "" COMPU_TAB_REF MILLMP_SUPRT_ATS_SY_Compu /end COMPU_METHOD
/begin COMPU_VTAB MILLMP_SUPRT_ATS_SY_Compu "" TAB_VERB 2 0 "False" 1 "True" /end COMPU_VTAB
/begin COMPU_METHOD MISFDETD_AVL_SY_Compu "" TAB_VERB "%6.3" "" COMPU_TAB_REF MISFDETD_AVL_SY_Compu /end COMPU_METHOD
/begin COMPU_VTAB MISFDETD_AVL_SY_Compu "" TAB_VERB 2 0 "False" 1 "True" /end COMPU_VTAB
/begin COMPU_METHOD MISFDET_ACTVTESTSUSPCMISFCNTR_SC_Compu "" TAB_VERB "%6.3" "" COMPU_TAB_REF MISFDET_ACTVTESTSUSPCMISFCNTR_SC_Compu /end COMPU_METHOD
/begin COMPU_VTAB MISFDET_ACTVTESTSUSPCMISFCNTR_SC_Compu "" TAB_VERB 2 0 "no_cntr" 1 "wi_cntr" /end COMPU_VTAB
/begin COMPU_METHOD MISFDET_ACTVTEST_SC_Compu "" TAB_VERB "%6.3" "" COMPU_TAB_REF MISFDET_ACTVTEST_SC_Compu /end COMPU_METHOD
/begin COMPU_VTAB MISFDET_ACTVTEST_SC_Compu "" TAB_VERB 2 0 "actvTest_notUsed" 1 "actvTest_used" /end COMPU_VTAB
/begin COMPU_METHOD MISFDET_ADPNDATAEEP_SC_Compu "" TAB_VERB "%6.3" "" COMPU_TAB_REF MISFDET_ADPNDATAEEP_SC_Compu /end COMPU_METHOD
/begin COMPU_VTAB MISFDET_ADPNDATAEEP_SC_Compu "" TAB_VERB 2 0 "data_in_NVRAM" 1 "data_in_EEP" /end COMPU_VTAB
/begin COMPU_METHOD MISFDET_BNKIMBAL_SC_Compu "" TAB_VERB "%6.3" "" COMPU_TAB_REF MISFDET_BNKIMBAL_SC_Compu /end COMPU_METHOD
/begin COMPU_VTAB MISFDET_BNKIMBAL_SC_Compu "" TAB_VERB 2 0 "noBnkImbalDetn" 1 "wiBankImbalDetn" /end COMPU_VTAB
/begin COMPU_METHOD MISFDET_DMFDSTBC_SC_Compu "" TAB_VERB "%6.3" "" COMPU_TAB_REF MISFDET_DMFDSTBC_SC_Compu /end COMPU_METHOD
/begin COMPU_VTAB MISFDET_DMFDSTBC_SC_Compu "" TAB_VERB 2 0 "Deactive" 1 "Active" /end COMPU_VTAB
/begin COMPU_METHOD MISFDET_DNADPNNRRNGNENG_SC_Compu "" RAT_FUNC "%6.2" "" COEFFS 0 1 0 0 0 1 /end COMPU_METHOD
/begin COMPU_METHOD MISFDET_DNADPNNRRNGTQ_SC_Compu "" RAT_FUNC "%6.2" "" COEFFS 0 1 0 0 0 1 /end COMPU_METHOD
/begin COMPU_METHOD MISFDET_DNADPN_SC_Compu "" TAB_VERB "%6.3" "" COMPU_TAB_REF MISFDET_DNADPN_SC_Compu /end COMPU_METHOD
/begin COMPU_VTAB MISFDET_DNADPN_SC_Compu "" TAB_VERB 3 0 "no_adpn" 1 "adpn_pos_tq" 2 "adpn_pos_tq_fco" /end COMPU_VTAB
/begin COMPU_METHOD MISFDET_DNCALCNTQBAL_SC_Compu "" TAB_VERB "%6.3" "" COMPU_TAB_REF MISFDET_DNCALCNTQBAL_SC_Compu /end COMPU_METHOD
/begin COMPU_VTAB MISFDET_DNCALCNTQBAL_SC_Compu "" TAB_VERB 3 0 "no_dncalcntqbal" 1 "wi_dncalcntqbal" 2 "wi_dncalcntqbalsegadpn" /end COMPU_VTAB
/begin COMPU_METHOD MISFDET_DNDIFSIG_SC_Compu "" TAB_VERB "%6.3" "" COMPU_TAB_REF MISFDET_DNDIFSIG_SC_Compu /end COMPU_METHOD
/begin COMPU_VTAB MISFDET_DNDIFSIG_SC_Compu "" TAB_VERB 2 0 "False" 1 "True" /end COMPU_VTAB
/begin COMPU_METHOD m_q0p0004 "" RAT_FUNC "%6.5" "" COEFFS 0 1 0 0 0 0.0004 /end COMPU_METHOD
/begin COMPU_METHOD m_q0p1_g_DIV_L "" RAT_FUNC "%6.3" "g/l" COEFFS 0 10 0 0 0 1 /end COMPU_METHOD
/begin COMPU_METHOD m_q0p1_g_DIV_min "" RAT_FUNC "%6.3" "g/min" COEFFS 0 10 0 0 0 1 /end COMPU_METHOD
/begin COMPU_METHOD m_q1Em7_g_DIV_pc "" RAT_FUNC "%10.9" "g/%" COEFFS 0 10000000 0 0 0 1 /end COMPU_METHOD
/begin COMPU_METHOD m_uw_b23p3 "" RAT_FUNC "%6.5" "kg" COEFFS 0 2812.5 0 0 0 1 /end COMPU_METHOD
/begin COMPU_METHOD m_uw_b6553p5 "" RAT_FUNC "%6.3" "kg/h" COEFFS 0 1 0 0 0 0.1 /end COMPU_METHOD
/begin COMPU_METHOD m_uw_b655p35 "" RAT_FUNC "%6.4" "kg/h" COEFFS 0 100 0 0 0 1 /end COMPU_METHOD
/begin COMPU_METHOD m_uw_b7281 "" RAT_FUNC "%6.3" "g" COEFFS 0 9 0 0 0 1 /end COMPU_METHOD
/begin COMPU_METHOD nmotd_sb_q10 "" RAT_FUNC "%6.1" "1/min" COEFFS 0 1 0 0 0 10 /end COMPU_METHOD
/begin COMPU_METHOD nmot_sw_q0p25 "" RAT_FUNC "%6.3" "1/min" COEFFS 0 1 0 0 0 0.25 /end COMPU_METHOD
/begin COMPU_METHOD nmot_ub_q10 "" RAT_FUNC "%6.1" "1/min" COEFFS 0 1 0 0 0 10 /end COMPU_METHOD
/begin COMPU_METHOD nmot_ub_q40 "" RAT_FUNC "%6.1" "1/min" COEFFS 0 1 0 0 0 40 /end COMPU_METHOD
/begin COMPU_METHOD nmot_uw_q0p25 "" RAT_FUNC "%6.3" "1/min" COEFFS 0 1 0 0 0 0.25 /end COMPU_METHOD
/begin COMPU_METHOD OneToOne "" RAT_FUNC "%6.2" "-" COEFFS 0 1 0 0 0 1 /end COMPU_METHOD
/begin COMPU_METHOD p_sw_q0p078 "" RAT_FUNC "%6.4" "hPa" COEFFS 0 65536 0 0 0 5120 /end COMPU_METHOD
/begin COMPU_METHOD RBPtCel_vf_1p90em8_1 "" RAT_FUNC "%10.9" "L/s" COEFFS 0 104857600 0 0 0 2 /end COMPU_METHOD
/begin COMPU_METHOD relDK_uw_b100 "" RAT_FUNC "%6.4" "%DK" COEFFS 0 65535 0 0 0 100 /end COMPU_METHOD
/begin COMPU_METHOD rel_q0p000488 "" RAT_FUNC "%6.5" "%" COEFFS 0 2048 0 0 0 1 /end COMPU_METHOD
/begin COMPU_METHOD rel_q0p1953 "" RAT_FUNC "%6.3" "%" COEFFS 0 256 0 0 0 50 /end COMPU_METHOD
/begin COMPU_METHOD rel_q0p5 "" RAT_FUNC "%6.3" "%" COEFFS 0 1 0 0 0 0.5 /end COMPU_METHOD
/begin COMPU_METHOD rel_q0p75 "" RAT_FUNC "%6.3" "%" COEFFS 0 4 0 0 0 3 /end COMPU_METHOD
/begin COMPU_METHOD rel_sw_b100 "" RAT_FUNC "%6.4" "%" COEFFS 0 32768 0 0 0 100 /end COMPU_METHOD
/begin COMPU_METHOD rel_sw_b1536 "" RAT_FUNC "%6.4" "%" COEFFS 0 65536 0 0 0 3072 /end COMPU_METHOD
/begin COMPU_METHOD rel_ub_b127p5 "" RAT_FUNC "%6.3" "%" COEFFS 0 2 0 0 0 1 /end COMPU_METHOD
/begin COMPU_METHOD rel_ub_b25 "" RAT_FUNC "%6.3" "%" COEFFS 0 256 0 0 0 25 /end COMPU_METHOD
/begin COMPU_METHOD rel_ub_q0p75 "" RAT_FUNC "%6.3" "%" COEFFS 0 1 0 0 0 0.75 /end COMPU_METHOD
/begin COMPU_METHOD rel_uw_b100 "" RAT_FUNC "%6.4" "%" COEFFS 0 65536 0 0 0 100 /end COMPU_METHOD
/begin COMPU_METHOD rel_uw_b3072 "" RAT_FUNC "%6.4" "%" COEFFS 0 65536 0 0 0 3072 /end COMPU_METHOD
/begin COMPU_METHOD rel_uw_q0p0234 "" RAT_FUNC "%6.4" "%" COEFFS 0 32 0 0 0 0.75 /end COMPU_METHOD
/begin COMPU_METHOD sgp_q0p1 "" RAT_FUNC "%6.3" "V" COEFFS 0 10 0 0 0 1 /end COMPU_METHOD
/begin COMPU_METHOD spg_q0p005 "" RAT_FUNC "%6.4" "V" COEFFS 0 1 0 0 0 0.005 /end COMPU_METHOD
/begin COMPU_METHOD spg_q0p1 "" RAT_FUNC "%6.3" "V" COEFFS 0 1 0 0 0 0.1 /end COMPU_METHOD
/begin COMPU_METHOD t100msxs_uw_b6553p5 "" RAT_FUNC "%6.3" "s" COEFFS 0 1 0 0 0 0.1 /end COMPU_METHOD
/begin COMPU_METHOD t10msxs_sb_q0p01 "" RAT_FUNC "%6.4" "s" COEFFS 0 1 0 0 0 0.01 /end COMPU_METHOD
/begin COMPU_METHOD t10msxs_ub_b2p55 "" RAT_FUNC "%6.4" "s" COEFFS 0 1 0 0 0 0.01 /end COMPU_METHOD
/begin COMPU_METHOD t10msxs_ub_q0p01 "" RAT_FUNC "%6.4" "s" COEFFS 0 1 0 0 0 0.01 /end COMPU_METHOD
/begin COMPU_METHOD t1p0usxms "" RAT_FUNC "%6.5" "ms" COEFFS 0 1000 0 0 0 1 /end COMPU_METHOD
/begin COMPU_METHOD t20msxs_ub_b5p1 "" RAT_FUNC "%6.4" "s" COEFFS 0 1 0 0 0 0.02 /end COMPU_METHOD
/begin COMPU_METHOD Temp_Cels "" RAT_FUNC "%6.1" "deg C" COEFFS 0 10 2731.4 0 0 1 /end COMPU_METHOD
/begin COMPU_METHOD temp_q0p1 "" RAT_FUNC "%6.3" "Grad C" COEFFS 0 10 0 0 0 1 /end COMPU_METHOD
/begin COMPU_METHOD temp_ub_q5 "" RAT_FUNC "%6.2" "Grad C" COEFFS 0 1 0 0 0 5 /end COMPU_METHOD
/begin COMPU_METHOD temp_ub_q5_o50 "" RAT_FUNC "%6.2" "Grad C" COEFFS 0 1 50 0 0 5 /end COMPU_METHOD
/begin COMPU_METHOD t_q0p0064_ms "" RAT_FUNC "%6.4" "ms" COEFFS 0 625 0 0 0 4 /end COMPU_METHOD
/begin COMPU_METHOD t_q0p01 "" RAT_FUNC "%6.4" "s" COEFFS 0 100 0 0 0 1 /end COMPU_METHOD
/begin COMPU_METHOD t_q0p02 "" RAT_FUNC "%6.4" "s" COEFFS 0 100 0 0 0 2 /end COMPU_METHOD
/begin COMPU_METHOD t_q0p1 "" RAT_FUNC "%6.3" "s" COEFFS 0 10 0 0 0 1 /end COMPU_METHOD
/begin COMPU_METHOD t_q0p2 "" RAT_FUNC "%6.3" "s" COEFFS 0 10 0 0 0 2 /end COMPU_METHOD
/begin COMPU_METHOD t_q1 "" RAT_FUNC "%6.2" "s" COEFFS 0 1 0 0 0 1 /end COMPU_METHOD
/begin COMPU_METHOD undefined "" RAT_FUNC "%6.2" "" COEFFS 0 1 0 0 0 1 /end COMPU_METHOD
/begin COMPU_METHOD vel "" RAT_FUNC "%6.4" "km/h" COEFFS 0 100 0 0 0 1 /end COMPU_METHOD
/begin COMPU_METHOD vel_q0p01 "" RAT_FUNC "%6.4" "km/h" COEFFS 0 100 0 0 0 1 /end COMPU_METHOD
/begin COMPU_METHOD vfzg_ub_q1p25 "" RAT_FUNC "%6.2" "km/h" COEFFS 0 1 0 0 0 1.25 /end COMPU_METHOD
/begin COMPU_METHOD vfzg_uw_b512 "" RAT_FUNC "%6.4" "km/h" COEFFS 0 65536 0 0 0 512 /end COMPU_METHOD
/begin COMPU_METHOD volgrd_q5p96Em4 "" RAT_FUNC "%6.5" "ml/s" COEFFS 0 65536 0 0 0 39.0625 /end COMPU_METHOD
/begin COMPU_METHOD volgrd_q5p96Em7 "" RAT_FUNC "%9.8" "l/s" COEFFS 0 65536 0 0 0 0.0390625 /end COMPU_METHOD
/begin COMPU_METHOD vol_q5p0Em5_l "" RAT_FUNC "%7.6" "L" COEFFS 0 20000 0 0 0 1 /end COMPU_METHOD
/begin COMPU_METHOD zk100msxs_uw_b6553 "" RAT_FUNC "%6.1" "s" COEFFS 0 0 65536 0 10 0 /end COMPU_METHOD
/begin COMPU_METHOD zk10msxs_uw_b655 "" RAT_FUNC "%6.2" "s" COEFFS 0 0 65536 0 100 0 /end COMPU_METHOD
/begin COMPU_METHOD zk200msxs_uw_b13107p2 "" RAT_FUNC "%6.0" "s" COEFFS 0 0 65536 0 5 0 /end COMPU_METHOD
/begin COMPU_METHOD zk20msxs_uw_b1310p72 "" RAT_FUNC "%6.1" "s" COEFFS 0 0 65536 0 50 0 /end COMPU_METHOD
/begin COMPU_METHOD zw_sb_q0p75 "" RAT_FUNC "%6.3" "Grad KW" COEFFS 0 255 0 0 0 191.25 /end COMPU_METHOD
/begin COMPU_METHOD zw_sb_q6 "" RAT_FUNC "%6.2" "Grad KW" COEFFS 0 1 0 0 0 6 /end COMPU_METHOD
/begin COMPU_METHOD zw_ub_q0p75 "" RAT_FUNC "%6.3" "Grad KW" COEFFS 0 255 0 0 0 191.25 /end COMPU_METHOD
/begin COMPU_METHOD zw_ub_q6 "" RAT_FUNC "%6.2" "Grad KW" COEFFS 0 255 0 0 0 1530 /end COMPU_METHOD
/begin RECORD_LAYOUT GkfWS8 FNC_VALUES 1 SBYTE COLUMN_DIR DIRECT /end RECORD_LAYOUT
/begin RECORD_LAYOUT GkfWU16 FNC_VALUES 1 UWORD COLUMN_DIR DIRECT /end RECORD_LAYOUT
/begin RECORD_LAYOUT GkfWU8 FNC_VALUES 1 UBYTE COLUMN_DIR DIRECT /end RECORD_LAYOUT
/begin RECORD_LAYOUT GkfWUb FNC_VALUES 1 UBYTE COLUMN_DIR DIRECT /end RECORD_LAYOUT
/begin RECORD_LAYOUT GklWS8 FNC_VALUES 1 SBYTE COLUMN_DIR DIRECT /end RECORD_LAYOUT
/begin RECORD_LAYOUT GklWU8 FNC_VALUES 1 UBYTE COLUMN_DIR DIRECT /end RECORD_LAYOUT
/begin RECORD_LAYOUT GklWUb FNC_VALUES 1 UBYTE COLUMN_DIR DIRECT /end RECORD_LAYOUT
/begin RECORD_LAYOUT GklWUw FNC_VALUES 1 UWORD COLUMN_DIR DIRECT /end RECORD_LAYOUT
/begin RECORD_LAYOUT KfAxU8AyU8SstxS16SstyS16WS16 NO_AXIS_PTS_X 1 SWORD NO_AXIS_PTS_Y 2 SWORD AXIS_PTS_X 3 SWORD INDEX_INCR DIRECT AXIS_PTS_Y 4 SWORD INDEX_INCR DIRECT FNC_VALUES 5 SWORD COLUMN_DIR DIRECT /end RECORD_LAYOUT
/begin RECORD_LAYOUT KfAxU8AyU8SstxS16SstyU16WU16 NO_AXIS_PTS_X 1 UBYTE NO_AXIS_PTS_Y 2 UBYTE AXIS_PTS_X 3 SWORD INDEX_INCR DIRECT AXIS_PTS_Y 4 UWORD INDEX_INCR DIRECT FNC_VALUES 5 UWORD COLUMN_DIR DIRECT /end RECORD_LAYOUT
/begin RECORD_LAYOUT KfAxU8AyU8SstxU16SstyU16WS16 NO_AXIS_PTS_X 1 UWORD NO_AXIS_PTS_Y 2 UWORD AXIS_PTS_X 3 UWORD INDEX_INCR DIRECT AXIS_PTS_Y 4 UWORD INDEX_INCR DIRECT FNC_VALUES 5 SWORD COLUMN_DIR DIRECT /end RECORD_LAYOUT
/begin RECORD_LAYOUT KfAxU8AyU8SstxU16SstyU16WU16 NO_AXIS_PTS_X 1 UWORD NO_AXIS_PTS_Y 2 UWORD AXIS_PTS_X 3 UWORD INDEX_INCR DIRECT AXIS_PTS_Y 4 UWORD INDEX_INCR DIRECT FNC_VALUES 5 UWORD COLUMN_DIR DIRECT /end RECORD_LAYOUT
/begin RECORD_LAYOUT KfAxU8AyU8SstxU16SstyU8WU8 NO_AXIS_PTS_X 1 UBYTE NO_AXIS_PTS_Y 2 UBYTE AXIS_PTS_X 3 UWORD INDEX_INCR DIRECT AXIS_PTS_Y 4 UBYTE INDEX_INCR DIRECT FNC_VALUES 5 UBYTE COLUMN_DIR DIRECT /end RECORD_LAYOUT
/begin RECORD_LAYOUT KfAxU8AyU8SstxU8SstyU16WU8 NO_AXIS_PTS_X 1 UBYTE NO_AXIS_PTS_Y 2 UBYTE AXIS_PTS_X 3 UBYTE INDEX_INCR DIRECT AXIS_PTS_Y 4 UWORD INDEX_INCR DIRECT FNC_VALUES 5 UBYTE COLUMN_DIR DIRECT /end RECORD_LAYOUT
/begin RECORD_LAYOUT KlAUbSstUbWUb NO_AXIS_PTS_X 1 UBYTE AXIS_PTS_X 2 UBYTE INDEX_INCR DIRECT FNC_VALUES 3 UBYTE COLUMN_DIR DIRECT /end RECORD_LAYOUT
/begin RECORD_LAYOUT KlAxU8SstxS16WS16 NO_AXIS_PTS_X 1 SWORD AXIS_PTS_X 2 SWORD INDEX_INCR DIRECT FNC_VALUES 3 SWORD COLUMN_DIR DIRECT /end RECORD_LAYOUT
/begin RECORD_LAYOUT KlAxU8SstxS16WU16_Static NO_AXIS_PTS_X 1 UWORD AXIS_PTS_X 2 SWORD INDEX_INCR DIRECT FNC_VALUES 3 UWORD COLUMN_DIR DIRECT STATIC_RECORD_LAYOUT /end RECORD_LAYOUT
/begin RECORD_LAYOUT KlAxU8SstxS8WS8 NO_AXIS_PTS_X 1 SBYTE AXIS_PTS_X 2 SBYTE INDEX_INCR DIRECT FNC_VALUES 3 SBYTE COLUMN_DIR DIRECT /end RECORD_LAYOUT
/begin RECORD_LAYOUT KlAxU8SstxS8WU8_Static NO_AXIS_PTS_X 1 UBYTE AXIS_PTS_X 2 SBYTE INDEX_INCR DIRECT FNC_VALUES 3 UBYTE COLUMN_DIR DIRECT STATIC_RECORD_LAYOUT /end RECORD_LAYOUT
/begin RECORD_LAYOUT KlAxU8SstxU16WS16_Static NO_AXIS_PTS_X 1 UWORD AXIS_PTS_X 2 UWORD INDEX_INCR DIRECT FNC_VALUES 3 SWORD COLUMN_DIR DIRECT STATIC_RECORD_LAYOUT /end RECORD_LAYOUT
/begin RECORD_LAYOUT KlAxU8SstxU16WU16 NO_AXIS_PTS_X 1 UWORD AXIS_PTS_X 2 UWORD INDEX_INCR DIRECT FNC_VALUES 3 UWORD COLUMN_DIR DIRECT /end RECORD_LAYOUT
/begin RECORD_LAYOUT KlAxU8SstxU16WU8_Static NO_AXIS_PTS_X 1 UWORD AXIS_PTS_X 2 UWORD INDEX_INCR DIRECT FNC_VALUES 3 UBYTE COLUMN_DIR DIRECT STATIC_RECORD_LAYOUT /end RECORD_LAYOUT
/begin RECORD_LAYOUT KlAxU8SstxU8WU16_Static NO_AXIS_PTS_X 1 UBYTE AXIS_PTS_X 2 UBYTE INDEX_INCR DIRECT FNC_VALUES 3 UWORD COLUMN_DIR DIRECT STATIC_RECORD_LAYOUT /end RECORD_LAYOUT
/begin RECORD_LAYOUT KlAxU8SstxU8WU8 NO_AXIS_PTS_X 1 UBYTE AXIS_PTS_X 2 UBYTE INDEX_INCR DIRECT FNC_VALUES 3 UBYTE COLUMN_DIR DIRECT /end RECORD_LAYOUT
/begin RECORD_LAYOUT KwSb FNC_VALUES 1 SBYTE COLUMN_DIR DIRECT /end RECORD_LAYOUT
/begin RECORD_LAYOUT KwSw FNC_VALUES 1 SWORD COLUMN_DIR DIRECT /end RECORD_LAYOUT
/begin RECORD_LAYOUT KwUb FNC_VALUES 1 UBYTE COLUMN_DIR DIRECT /end RECORD_LAYOUT
/begin RECORD_LAYOUT KwUw FNC_VALUES 1 UWORD COLUMN_DIR DIRECT /end RECORD_LAYOUT
/begin RECORD_LAYOUT KwWS16 FNC_VALUES 1 SWORD COLUMN_DIR DIRECT /end RECORD_LAYOUT
/begin RECORD_LAYOUT KwWS8 FNC_VALUES 1 SBYTE COLUMN_DIR DIRECT /end RECORD_LAYOUT
/begin RECORD_LAYOUT KwWU16 FNC_VALUES 1 UWORD COLUMN_DIR DIRECT /end RECORD_LAYOUT
/begin RECORD_LAYOUT KwWU8 FNC_VALUES 1 UBYTE COLUMN_DIR DIRECT /end RECORD_LAYOUT
/begin RECORD_LAYOUT RB_Curve_U16_U8_Static NO_AXIS_PTS_X 1 UWORD AXIS_PTS_X 2 UWORD INDEX_INCR DIRECT FNC_VALUES 3 UBYTE COLUMN_DIR DIRECT STATIC_RECORD_LAYOUT /end RECORD_LAYOUT
/begin RECORD_LAYOUT RB_Map_U16U16_U16 NO_AXIS_PTS_X 1 UWORD NO_AXIS_PTS_Y 2 UWORD AXIS_PTS_X 3 UWORD INDEX_INCR DIRECT AXIS_PTS_Y 4 UWORD INDEX_INCR DIRECT FNC_VALUES 5 UWORD COLUMN_DIR DIRECT /end RECORD_LAYOUT
/begin RECORD_LAYOUT RB_Val_Ws16 FNC_VALUES 1 SWORD COLUMN_DIR DIRECT /end RECORD_LAYOUT
/begin RECORD_LAYOUT RB_Val_Wu16 FNC_VALUES 1 UWORD COLUMN_DIR DIRECT /end RECORD_LAYOUT
/begin RECORD_LAYOUT RB_Val_Wu8 FNC_VALUES 1 UBYTE COLUMN_DIR DIRECT /end RECORD_LAYOUT
/begin RECORD_LAYOUT SstAU8SstS8 NO_AXIS_PTS_X 1 SBYTE AXIS_PTS_X 2 SBYTE INDEX_INCR DIRECT /end RECORD_LAYOUT
/begin RECORD_LAYOUT SstAU8SstU16 NO_AXIS_PTS_X 1 UWORD AXIS_PTS_X 2 UWORD INDEX_INCR DIRECT /end RECORD_LAYOUT
/begin RECORD_LAYOUT SstAU8SstU8 NO_AXIS_PTS_X 1 UBYTE AXIS_PTS_X 2 UBYTE INDEX_INCR DIRECT /end RECORD_LAYOUT
/begin RECORD_LAYOUT SstAUwSstUw NO_AXIS_PTS_X 1 UWORD AXIS_PTS_X 2 UWORD INDEX_INCR DIRECT /end RECORD_LAYOUT
/begin RECORD_LAYOUT Val_Wu8 FNC_VALUES 1 UBYTE COLUMN_DIR DIRECT /end RECORD_LAYOUT
/end MODULE
/end PROJECT
