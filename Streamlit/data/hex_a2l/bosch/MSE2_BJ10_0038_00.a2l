ASAP2_VERSION 1 60
/begin PROJECT MSE2_BJ10_0038_00 "MDG1"
/begin HEADER "" VERSION "MSE2_BJ10_0038_00" PROJECT_NO MSE2_BJ10_0038_00 /end HEADER
/begin MODULE DIM ""
/begin MOD_COMMON "" BYTE_ORDER MSB_FIRST ALIGNMENT_BYTE 1 ALIGNMENT_WORD 2 ALIGNMENT_LONG 4 ALIGNMENT_INT64 4 ALIGNMENT_FLOAT32_IEEE 4 ALIGNMENT_FLOAT64_IEEE 4 /end MOD_COMMON
/begin CHARACTERISTIC DDRC_DurDeb.DevLib_tiBattUHiDebOk_C "debouncing parameter / Duration of healing debouncing for check DFC_DevLibBattUHi" VALUE 0x9080354 Val_Wu16 655350.0 DDRCTime_ms 0.00 655350.0 FORMAT "%8.1" /end CHARACTERISTIC
/begin CHARACTERISTIC DDRC_DurDeb.DevLib_tiBattUHiDebDef_C "debouncing parameter / Duration of defect debouncing for check DFC_DevLibBattUHi" VALUE 0x9080356 Val_Wu16 655350.0 DDRCTime_ms 0.00 655350.0 FORMAT "%8.1" /end CHARACTERISTIC
/begin CHARACTERISTIC DDRC_DurDeb.DevLib_tiBattULoDebOk_C "debouncing parameter / Duration of healing debouncing for check DFC_DevLibBattULo" VALUE 0x9080358 Val_Wu16 655350.0 DDRCTime_ms 0.00 655350.0 FORMAT "%8.1" /end CHARACTERISTIC
/begin CHARACTERISTIC DDRC_DurDeb.DevLib_tiBattULoDebDef_C "debouncing parameter / Duration of defect debouncing for check DFC_DevLibBattULo" VALUE 0x908035A Val_Wu16 655350.0 DDRCTime_ms 0.00 655350.0 FORMAT "%8.1" /end CHARACTERISTIC
/begin CHARACTERISTIC DDRC_RatDeb.DevLib_tiBattUHiUDRat_C "Ratioof up-down debouncing / Defect / Heal Ratio for check DFC_DevLibBattUHi" VALUE 0x9080D5B Val_Wu8 3.00000000000 DDRC_Ratio 1.00000000000 4.00000000000 FORMAT "%13.11" /end CHARACTERISTIC
/begin CHARACTERISTIC DDRC_RatDeb.DevLib_tiBattULoUDRat_C "Ratioof up-down debouncing / Defect / Heal Ratio for check DFC_DevLibBattULo" VALUE 0x9080D5C Val_Wu8 3.00000000000 DDRC_Ratio 1.00000000000 4.00000000000 FORMAT "%13.11" /end CHARACTERISTIC
/begin CHARACTERISTIC DevLib_DigOutDbgSig_C "Calibration parameter to select the Digital out signal for which the debugging information is to be updated into the measuring points" VALUE 0x9089F38 Val_Wu16 65535.00 OneToOne 0.00 65535.00 FORMAT "%8.2" /end CHARACTERISTIC
/begin CHARACTERISTIC Devlib_PsDisbl.facLowHysLo_C "Structure containing hysterisis limits for battery voltage correction factor / Lower hysterisis limit for battery correction factor LOW." VALUE 0x9089F3C Kw_Ws16 1.000000 Fact 0.00 1.000000 FORMAT "%8.6" EXTENDED_LIMITS -4.000000 3.999878 /end CHARACTERISTIC
/begin CHARACTERISTIC Devlib_PsDisbl.facLowHysHi_C "Structure containing hysterisis limits for battery voltage correction factor / Higher hysterisis limit for battery correction factor LOW." VALUE 0x9089F3E Kw_Ws16 1.000000 Fact 0.00 1.000000 FORMAT "%8.6" EXTENDED_LIMITS -4.000000 3.999878 /end CHARACTERISTIC
/begin CHARACTERISTIC Devlib_PsDisbl.facHighHysLo_C "Structure containing hysterisis limits for battery voltage correction factor / Lower hysterisis limit for battery correction factor HIGH." VALUE 0x9089F40 Kw_Ws16 2.000000 Fact 1.000000 3.000000 FORMAT "%8.6" EXTENDED_LIMITS -4.000000 3.999878 /end CHARACTERISTIC
/begin CHARACTERISTIC Devlib_PsDisbl.facHighHysHi_C "Structure containing hysterisis limits for battery voltage correction factor / Higher hysterisis limit for battery correction factor HIGH." VALUE 0x9089F42 Kw_Ws16 2.000000 Fact 1.000000 3.000000 FORMAT "%8.6" EXTENDED_LIMITS -4.000000 3.999878 /end CHARACTERISTIC
/begin CHARACTERISTIC DevLib_PWMOutDbgSig_C "Calibration parameter to select the PWM out signal for which the debugging information is to be updated into the measuring points" VALUE 0x9089F3A Val_Wu16 65535.00 OneToOne 0.00 65535.00 FORMAT "%8.2" /end CHARACTERISTIC
/begin CHARACTERISTIC Devlib_PwrStg.BattLoHysLo_C "Structure containing hysterisis check for battery voltage LOW/HIGH / Lower limit for battery voltage LOW hysterisis check." VALUE 0x9089F44 Kw_Ws16 9000.000 Volt_Batt 3000.000 12000.00 FORMAT "%8.2" EXTENDED_LIMITS -655360.0 655340.0 /end CHARACTERISTIC
/begin CHARACTERISTIC Devlib_PwrStg.BattLoHysHi_C "Structure containing hysterisis check for battery voltage LOW/HIGH / Higher limit for battery voltage LOW hysterisis check" VALUE 0x9089F46 Kw_Ws16 9000.000 Volt_Batt 3000.000 12000.00 FORMAT "%8.2" EXTENDED_LIMITS -655360.0 655340.0 /end CHARACTERISTIC
/begin CHARACTERISTIC Devlib_PwrStg.BattHiHysLo_C "Structure containing hysterisis check for battery voltage LOW/HIGH / Lower limit for battery voltage HIGH hysterisis check" VALUE 0x9089F48 Kw_Ws16 24000.00 Volt_Batt 12000.00 36000.00 FORMAT "%8.2" EXTENDED_LIMITS -655360.0 655340.0 /end CHARACTERISTIC
/begin CHARACTERISTIC Devlib_PwrStg.BattHiHysHi_C "Structure containing hysterisis check for battery voltage LOW/HIGH / Upper limit for battery voltage HIGH hysterisis check" VALUE 0x9089F4A Kw_Ws16 24000.00 Volt_Batt 12000.00 36000.00 FORMAT "%8.2" EXTENDED_LIMITS -655360.0 655340.0 /end CHARACTERISTIC
/begin CHARACTERISTIC DFC_CtlMsk2.DFC_Unused_C "Behaviour control mask / " VALUE 0x9080398 Val_Wu8 255.0 DFES_OneToOne 0.00 255.0 FORMAT "%5.1" READ_ONLY /end CHARACTERISTIC
/begin CHARACTERISTIC DFC_CtlMsk2.DFC_DevLibBattUHi_C "Behaviour control mask / Behaviour control masks of check DFC_DevLibBattUHi" VALUE 0x908039D Val_Wu8 255.0 DFES_OneToOne 0.00 255.0 FORMAT "%5.1" /end CHARACTERISTIC
/begin CHARACTERISTIC DFC_CtlMsk2.DFC_DevLibBattULo_C "Behaviour control mask / Behaviour control masks of check DFC_DevLibBattULo" VALUE 0x908039E Val_Wu8 255.0 DFES_OneToOne 0.00 255.0 FORMAT "%5.1" /end CHARACTERISTIC
/begin CHARACTERISTIC DFC_CtlMsk2.DFC_CANIF_E_CTRL_STOPPED_ERROR_VALUE_C "Behaviour control mask / Behaviour control masks of check DFC_CANIF_E_CTRL_STOPPED_ERROR_VALUE" VALUE 0x90803BA Val_Wu8 255.0 DFES_OneToOne 0.00 255.0 FORMAT "%5.1" /end CHARACTERISTIC
/begin CHARACTERISTIC DFC_CtlMsk2.DFC_CANIF_E_INVALID_DLC_ERROR_C "Behaviour control mask / Behaviour control masks of check DFC_CANIF_E_INVALID_DLC_ERROR" VALUE 0x90803BB Val_Wu8 255.0 DFES_OneToOne 0.00 255.0 FORMAT "%5.1" /end CHARACTERISTIC
/begin CHARACTERISTIC DFC_CtlMsk2.DFC_CANNM_E_CANIF_TRANSMIT_ERROR_C "Behaviour control mask / Behaviour control masks of check DFC_CANNM_E_CANIF_TRANSMIT_ERROR" VALUE 0x90803BC Val_Wu8 255.0 DFES_OneToOne 0.00 255.0 FORMAT "%5.1" /end CHARACTERISTIC
/begin CHARACTERISTIC DFC_CtlMsk2.DFC_CANNM_E_INIT_FAILED_C "Behaviour control mask / Behaviour control masks of check DFC_CANNM_E_INIT_FAILED" VALUE 0x90803BD Val_Wu8 255.0 DFES_OneToOne 0.00 255.0 FORMAT "%5.1" /end CHARACTERISTIC
/begin CHARACTERISTIC DFC_CtlMsk2.DFC_CANNM_E_NETWORK_TIMEOUT_C "Behaviour control mask / Behaviour control masks of check DFC_CANNM_E_NETWORK_TIMEOUT" VALUE 0x90803BE Val_Wu8 255.0 DFES_OneToOne 0.00 255.0 FORMAT "%5.1" /end CHARACTERISTIC
/begin CHARACTERISTIC DFC_CtlMsk2.DFC_COMM_E_NET_START_IND_CHANNEL_0_C "Behaviour control mask / Behaviour control masks of check DFC_COMM_E_NET_START_IND_CHANNEL_0" VALUE 0x90803C0 Val_Wu8 255.0 DFES_OneToOne 0.00 255.0 FORMAT "%5.1" /end CHARACTERISTIC
/begin CHARACTERISTIC DFC_CtlMsk2.DFC_COMM_E_NET_START_IND_CHANNEL_1_C "Behaviour control mask / Behaviour control masks of check DFC_COMM_E_NET_START_IND_CHANNEL_1" VALUE 0x90803C1 Val_Wu8 255.0 DFES_OneToOne 0.00 255.0 FORMAT "%5.1" /end CHARACTERISTIC
/begin CHARACTERISTIC DFC_CtlMsk2.DFC_COMM_E_NET_START_IND_CHANNEL_2_C "Behaviour control mask / Behaviour control masks of check DFC_COMM_E_NET_START_IND_CHANNEL_2" VALUE 0x90803C2 Val_Wu8 255.0 DFES_OneToOne 0.00 255.0 FORMAT "%5.1" /end CHARACTERISTIC
/begin CHARACTERISTIC DFC_CtlMsk2.DFC_COMM_E_NET_START_IND_CHANNEL_3_C "Behaviour control mask / Behaviour control masks of check DFC_COMM_E_NET_START_IND_CHANNEL_3" VALUE 0x90803C3 Val_Wu8 255.0 DFES_OneToOne 0.00 255.0 FORMAT "%5.1" /end CHARACTERISTIC
/begin CHARACTERISTIC DFC_CtlMsk2.DFC_COMM_E_NET_START_IND_CHANNEL_4_C "Behaviour control mask / Behaviour control masks of check DFC_COMM_E_NET_START_IND_CHANNEL_4" VALUE 0x90803C4 Val_Wu8 255.0 DFES_OneToOne 0.00 255.0 FORMAT "%5.1" /end CHARACTERISTIC
/begin CHARACTERISTIC DFC_CtlMsk2.DFC_COMM_E_NET_START_IND_CHANNEL_5_C "Behaviour control mask / Behaviour control masks of check DFC_COMM_E_NET_START_IND_CHANNEL_5" VALUE 0x90803C5 Val_Wu8 255.0 DFES_OneToOne 0.00 255.0 FORMAT "%5.1" /end CHARACTERISTIC
/begin CHARACTERISTIC DFC_CtlMsk2.DFC_PDUR_E_INIT_FAILED_C "Behaviour control mask / Behaviour control masks of check DFC_PDUR_E_INIT_FAILED" VALUE 0x90803C6 Val_Wu8 255.0 DFES_OneToOne 0.00 255.0 FORMAT "%5.1" /end CHARACTERISTIC
/begin CHARACTERISTIC DFC_CtlMsk2.DFC_PDUR_E_PDU_INSTANCE_LOST_C "Behaviour control mask / Behaviour control masks of check DFC_PDUR_E_PDU_INSTANCE_LOST" VALUE 0x90803C7 Val_Wu8 255.0 DFES_OneToOne 0.00 255.0 FORMAT "%5.1" /end CHARACTERISTIC
/begin CHARACTERISTIC DFC_DisblMsk2.DFC_Unused_C "disable mask / " VALUE 0x9080D68 Val_Wu8 255.0 DFES_OneToOne 0.00 255.0 FORMAT "%5.1" READ_ONLY /end CHARACTERISTIC
/begin CHARACTERISTIC DFC_DisblMsk2.DFC_DevLibBattUHi_C "disable mask / Disable masks of check DFC_DevLibBattUHi" VALUE 0x9080D6D Val_Wu8 255.0 DFES_OneToOne 0.00 255.0 FORMAT "%5.1" /end CHARACTERISTIC
/begin CHARACTERISTIC DFC_DisblMsk2.DFC_DevLibBattULo_C "disable mask / Disable masks of check DFC_DevLibBattULo" VALUE 0x9080D6E Val_Wu8 255.0 DFES_OneToOne 0.00 255.0 FORMAT "%5.1" /end CHARACTERISTIC
/begin CHARACTERISTIC DFC_DisblMsk2.DFC_CANIF_E_CTRL_STOPPED_ERROR_VALUE_C "disable mask / Disable masks of check DFC_CANIF_E_CTRL_STOPPED_ERROR_VALUE" VALUE 0x9080D8A Val_Wu8 255.0 DFES_OneToOne 0.00 255.0 FORMAT "%5.1" /end CHARACTERISTIC
/begin CHARACTERISTIC DFC_DisblMsk2.DFC_CANIF_E_INVALID_DLC_ERROR_C "disable mask / Disable masks of check DFC_CANIF_E_INVALID_DLC_ERROR" VALUE 0x9080D8B Val_Wu8 255.0 DFES_OneToOne 0.00 255.0 FORMAT "%5.1" /end CHARACTERISTIC
/begin CHARACTERISTIC DFC_DisblMsk2.DFC_CANNM_E_CANIF_TRANSMIT_ERROR_C "disable mask / Disable masks of check DFC_CANNM_E_CANIF_TRANSMIT_ERROR" VALUE 0x9080D8C Val_Wu8 255.0 DFES_OneToOne 0.00 255.0 FORMAT "%5.1" /end CHARACTERISTIC
/begin CHARACTERISTIC DFC_DisblMsk2.DFC_CANNM_E_INIT_FAILED_C "disable mask / Disable masks of check DFC_CANNM_E_INIT_FAILED" VALUE 0x9080D8D Val_Wu8 255.0 DFES_OneToOne 0.00 255.0 FORMAT "%5.1" /end CHARACTERISTIC
/begin CHARACTERISTIC DFC_DisblMsk2.DFC_CANNM_E_NETWORK_TIMEOUT_C "disable mask / Disable masks of check DFC_CANNM_E_NETWORK_TIMEOUT" VALUE 0x9080D8E Val_Wu8 255.0 DFES_OneToOne 0.00 255.0 FORMAT "%5.1" /end CHARACTERISTIC
/begin CHARACTERISTIC DFC_DisblMsk2.DFC_COMM_E_NET_START_IND_CHANNEL_0_C "disable mask / Disable masks of check DFC_COMM_E_NET_START_IND_CHANNEL_0" VALUE 0x9080D90 Val_Wu8 255.0 DFES_OneToOne 0.00 255.0 FORMAT "%5.1" /end CHARACTERISTIC
/begin CHARACTERISTIC DFC_DisblMsk2.DFC_COMM_E_NET_START_IND_CHANNEL_1_C "disable mask / Disable masks of check DFC_COMM_E_NET_START_IND_CHANNEL_1" VALUE 0x9080D91 Val_Wu8 255.0 DFES_OneToOne 0.00 255.0 FORMAT "%5.1" /end CHARACTERISTIC
/begin CHARACTERISTIC DFC_DisblMsk2.DFC_COMM_E_NET_START_IND_CHANNEL_2_C "disable mask / Disable masks of check DFC_COMM_E_NET_START_IND_CHANNEL_2" VALUE 0x9080D92 Val_Wu8 255.0 DFES_OneToOne 0.00 255.0 FORMAT "%5.1" /end CHARACTERISTIC
/begin CHARACTERISTIC DFC_DisblMsk2.DFC_COMM_E_NET_START_IND_CHANNEL_3_C "disable mask / Disable masks of check DFC_COMM_E_NET_START_IND_CHANNEL_3" VALUE 0x9080D93 Val_Wu8 255.0 DFES_OneToOne 0.00 255.0 FORMAT "%5.1" /end CHARACTERISTIC
/begin CHARACTERISTIC DFC_DisblMsk2.DFC_COMM_E_NET_START_IND_CHANNEL_4_C "disable mask / Disable masks of check DFC_COMM_E_NET_START_IND_CHANNEL_4" VALUE 0x9080D94 Val_Wu8 255.0 DFES_OneToOne 0.00 255.0 FORMAT "%5.1" /end CHARACTERISTIC
/begin CHARACTERISTIC DFC_DisblMsk2.DFC_COMM_E_NET_START_IND_CHANNEL_5_C "disable mask / Disable masks of check DFC_COMM_E_NET_START_IND_CHANNEL_5" VALUE 0x9080D95 Val_Wu8 255.0 DFES_OneToOne 0.00 255.0 FORMAT "%5.1" /end CHARACTERISTIC
/begin CHARACTERISTIC DFC_DisblMsk2.DFC_PDUR_E_INIT_FAILED_C "disable mask / Disable masks of check DFC_PDUR_E_INIT_FAILED" VALUE 0x9080D96 Val_Wu8 255.0 DFES_OneToOne 0.00 255.0 FORMAT "%5.1" /end CHARACTERISTIC
/begin CHARACTERISTIC DFC_DisblMsk2.DFC_PDUR_E_PDU_INSTANCE_LOST_C "disable mask / Disable masks of check DFC_PDUR_E_PDU_INSTANCE_LOST" VALUE 0x9080D97 Val_Wu8 255.0 DFES_OneToOne 0.00 255.0 FORMAT "%5.1" /end CHARACTERISTIC
/begin CHARACTERISTIC DFC_DtcFuncUnit_C "AUTOSAR: Functional unit of DTC of all events" VALUE 0x9080439 Val_Wu8 255.0 OneToOne 0.00 255.0 FORMAT "%5.1" /end CHARACTERISTIC
/begin CHARACTERISTIC DFC_DtcGroup_C "AUTOSAR: Matching DTC group of all events" VALUE 0x908043A Val_Wu8 16.0000000000 Dem_DTCGroup_Verb 0.00 16.0000000000 FORMAT "%13.10" /end CHARACTERISTIC
/begin CHARACTERISTIC DFC_DtcSeverity_C "AUTOSAR: DTC severity class of all events" VALUE 0x908043B Val_Wu8 128.000000000 Dem_DTCSeverity_Verb 0.00 128.000000000 FORMAT "%13.9" /end CHARACTERISTIC
/begin MEASUREMENT DevLib_stDigOutErr_mp "Measuring point that contains the error information received from HWE for the digital out signal selected by DevLib_DigOutDbgSig_C" ULONG OneToOne 1 100 0.00 4294967295.00 FORMAT "%13.2" ECU_ADDRESS 0x40009D6C /end MEASUREMENT
/begin MEASUREMENT DevLib_stPWMOutErr_mp "Measuring point that contains the error information received from HWE for the PWM out signal selected by DevLib_PWMOutDbgSig_C" ULONG OneToOne 1 100 0.00 4294967295.00 FORMAT "%13.2" ECU_ADDRESS 0x40009D68 /end MEASUREMENT
/begin MEASUREMENT DevLib_stPwrStgEnaCond "Device Library - state of powerstage enabling conditions" UWORD OneToOne 1 100 0.00 65535.00 FORMAT "%8.2" ECU_ADDRESS 0x40005D8C
 /begin IF_DATA XCPplus 0x0102
  /begin DAQ_EVENT VARIABLE /begin AVAILABLE_EVENT_LIST EVENT 0 EVENT 1 EVENT 2 EVENT 3 /end AVAILABLE_EVENT_LIST /begin DEFAULT_EVENT_LIST EVENT 2 /end DEFAULT_EVENT_LIST /end DAQ_EVENT
 /end IF_DATA
/end MEASUREMENT
/begin MEASUREMENT DFC_b.TST_BusDiagOpenLoad_Can0 "Bit encoding / Tested bit for check DFC_BusDiagOpenLoad_Can0" UBYTE DFC_OneToOne 1 100 0.00 1.000 BIT_MASK 0x8 FORMAT "%5.3" ECU_ADDRESS 0x4000CB9D /end MEASUREMENT
/begin MEASUREMENT DFC_b.TST_Com_ABSInfo_DLC "Bit encoding / Tested bit for check DFC_Com_ABSInfo_DLC" UBYTE DFC_OneToOne 1 100 0.00 1.000 BIT_MASK 0x8 FORMAT "%5.3" ECU_ADDRESS 0x4000CB9E /end MEASUREMENT
/begin MEASUREMENT DFC_b.TST_Com_ABSInfo_TO "Bit encoding / Tested bit for check DFC_Com_ABSInfo_TO" UBYTE DFC_OneToOne 1 100 0.00 1.000 BIT_MASK 0x8 FORMAT "%5.3" ECU_ADDRESS 0x4000CB9F /end MEASUREMENT
/begin MEASUREMENT DFC_b.TST_BusDiagBusOff_Can0 "Bit encoding / Tested bit for check DFC_BusDiagBusOff_Can0" UBYTE DFC_OneToOne 1 100 0.00 1.000 BIT_MASK 0x8 FORMAT "%5.3" ECU_ADDRESS 0x4000CBA0 /end MEASUREMENT
/begin MEASUREMENT DFC_b.TST_DevLibBattUHi "Bit encoding / Tested bit for check DFC_DevLibBattUHi" UBYTE DFC_OneToOne 1 100 0.00 1.000 BIT_MASK 0x8 FORMAT "%5.3" ECU_ADDRESS 0x4000CBA1 /end MEASUREMENT
/begin MEASUREMENT DFC_b.TST_DevLibBattULo "Bit encoding / Tested bit for check DFC_DevLibBattULo" UBYTE DFC_OneToOne 1 100 0.00 1.000 BIT_MASK 0x8 FORMAT "%5.3" ECU_ADDRESS 0x4000CBA2 /end MEASUREMENT
/begin MEASUREMENT DFC_b.TST_StrtOL "Bit encoding / Tested bit for check DFC_StrtOL" UBYTE DFC_OneToOne 1 100 0.00 1.000 BIT_MASK 0x8 FORMAT "%5.3" ECU_ADDRESS 0x4000CBA3 /end MEASUREMENT
/begin MEASUREMENT DFC_b.TST_StrtOvrTemp "Bit encoding / Tested bit for check DFC_StrtOvrTemp" UBYTE DFC_OneToOne 1 100 0.00 1.000 BIT_MASK 0x8 FORMAT "%5.3" ECU_ADDRESS 0x4000CBA4 /end MEASUREMENT
/begin MEASUREMENT DFC_b.TST_StrtSCB "Bit encoding / Tested bit for check DFC_StrtSCB" UBYTE DFC_OneToOne 1 100 0.00 1.000 BIT_MASK 0x8 FORMAT "%5.3" ECU_ADDRESS 0x4000CBA5 /end MEASUREMENT
/begin MEASUREMENT DFC_b.TST_StrtSCG "Bit encoding / Tested bit for check DFC_StrtSCG" UBYTE DFC_OneToOne 1 100 0.00 1.000 BIT_MASK 0x8 FORMAT "%5.3" ECU_ADDRESS 0x4000CBA6 /end MEASUREMENT
/begin MEASUREMENT DFC_b.TST_MILLmpOL "Bit encoding / Tested bit for check DFC_MILLmpOL" UBYTE DFC_OneToOne 1 100 0.00 1.000 BIT_MASK 0x8 FORMAT "%5.3" ECU_ADDRESS 0x4000CBA7 /end MEASUREMENT
/begin MEASUREMENT DFC_b.TST_MILLmpOT "Bit encoding / Tested bit for check DFC_MILLmpOT" UBYTE DFC_OneToOne 1 100 0.00 1.000 BIT_MASK 0x8 FORMAT "%5.3" ECU_ADDRESS 0x4000CBA8 /end MEASUREMENT
/begin MEASUREMENT DFC_b.TST_MILLmpSCB "Bit encoding / Tested bit for check DFC_MILLmpSCB" UBYTE DFC_OneToOne 1 100 0.00 1.000 BIT_MASK 0x8 FORMAT "%5.3" ECU_ADDRESS 0x4000CBA9 /end MEASUREMENT
/begin MEASUREMENT DFC_b.TST_MILLmpSCG "Bit encoding / Tested bit for check DFC_MILLmpSCG" UBYTE DFC_OneToOne 1 100 0.00 1.000 BIT_MASK 0x8 FORMAT "%5.3" ECU_ADDRESS 0x4000CBAA /end MEASUREMENT
/begin MEASUREMENT DFC_b.TST_EV1max "Bit encoding / Tested bit for check DFC_EV1max" UBYTE DFC_OneToOne 1 100 0.00 1.000 BIT_MASK 0x8 FORMAT "%5.3" ECU_ADDRESS 0x4000CBAB /end MEASUREMENT
/begin MEASUREMENT DFC_b.TST_EV1min "Bit encoding / Tested bit for check DFC_EV1min" UBYTE DFC_OneToOne 1 100 0.00 1.000 BIT_MASK 0x8 FORMAT "%5.3" ECU_ADDRESS 0x4000CBAC /end MEASUREMENT
/begin MEASUREMENT DFC_b.TST_EV1sig "Bit encoding / Tested bit for check DFC_EV1sig" UBYTE DFC_OneToOne 1 100 0.00 1.000 BIT_MASK 0x8 FORMAT "%5.3" ECU_ADDRESS 0x4000CBAD /end MEASUREMENT
/begin MEASUREMENT DFC_b.TST_CEngDsTPlausSTC "Bit encoding / Tested bit for check DFC_CEngDsTPlausSTC" UBYTE DFC_OneToOne 1 100 0.00 1.000 BIT_MASK 0x8 FORMAT "%5.3" ECU_ADDRESS 0x4000CBAE /end MEASUREMENT
/begin MEASUREMENT DFC_b.TST_ClthStkOpn "Bit encoding / Tested bit for check DFC_ClthStkOpn" UBYTE DFC_OneToOne 1 100 0.00 1.000 BIT_MASK 0x8 FORMAT "%5.3" ECU_ADDRESS 0x4000CBAF /end MEASUREMENT
/begin MEASUREMENT DFC_b.TST_EVX "Bit encoding / Tested bit for check DFC_EVX" UBYTE DFC_OneToOne 1 100 0.00 1.000 BIT_MASK 0x8 FORMAT "%5.3" ECU_ADDRESS 0x4000CBB0 /end MEASUREMENT
/begin MEASUREMENT DFC_b.TST_IntkAirTAirFltDsSTC "Bit encoding / Tested bit for check DFC_IntkAirTAirFltDsSTC" UBYTE DFC_OneToOne 1 100 0.00 1.000 BIT_MASK 0x8 FORMAT "%5.3" ECU_ADDRESS 0x4000CBB1 /end MEASUREMENT
/begin MEASUREMENT DFC_b.TST_RoughRoad "Bit encoding / Tested bit for check DFC_RoughRoad" UBYTE DFC_OneToOne 1 100 0.00 1.000 BIT_MASK 0x8 FORMAT "%5.3" ECU_ADDRESS 0x4000CBB2 /end MEASUREMENT
/begin MEASUREMENT DFC_b.TST_SSpMon1 "Bit encoding / Tested bit for check DFC_SSpMon1" UBYTE DFC_OneToOne 1 100 0.00 1.000 BIT_MASK 0x8 FORMAT "%5.3" ECU_ADDRESS 0x4000CBB3 /end MEASUREMENT
/begin MEASUREMENT DFC_b.TST_SSpMon1OT "Bit encoding / Tested bit for check DFC_SSpMon1OT" UBYTE DFC_OneToOne 1 100 0.00 1.000 BIT_MASK 0x8 FORMAT "%5.3" ECU_ADDRESS 0x4000CBB4 /end MEASUREMENT
/begin MEASUREMENT DFC_b.TST_SSpMon1OV "Bit encoding / Tested bit for check DFC_SSpMon1OV" UBYTE DFC_OneToOne 1 100 0.00 1.000 BIT_MASK 0x8 FORMAT "%5.3" ECU_ADDRESS 0x4000CBB5 /end MEASUREMENT
/begin MEASUREMENT DFC_b.TST_SSpMon1SCG "Bit encoding / Tested bit for check DFC_SSpMon1SCG" UBYTE DFC_OneToOne 1 100 0.00 1.000 BIT_MASK 0x8 FORMAT "%5.3" ECU_ADDRESS 0x4000CBB6 /end MEASUREMENT
/begin MEASUREMENT DFC_b.TST_SSpMon1UV "Bit encoding / Tested bit for check DFC_SSpMon1UV" UBYTE DFC_OneToOne 1 100 0.00 1.000 BIT_MASK 0x8 FORMAT "%5.3" ECU_ADDRESS 0x4000CBB7 /end MEASUREMENT
/begin MEASUREMENT DFC_b.TST_SSpMon2 "Bit encoding / Tested bit for check DFC_SSpMon2" UBYTE DFC_OneToOne 1 100 0.00 1.000 BIT_MASK 0x8 FORMAT "%5.3" ECU_ADDRESS 0x4000CBB8 /end MEASUREMENT
/begin MEASUREMENT DFC_b.TST_SSpMon2OT "Bit encoding / Tested bit for check DFC_SSpMon2OT" UBYTE DFC_OneToOne 1 100 0.00 1.000 BIT_MASK 0x8 FORMAT "%5.3" ECU_ADDRESS 0x4000CBB9 /end MEASUREMENT
/begin MEASUREMENT DFC_b.TST_SSpMon2OV "Bit encoding / Tested bit for check DFC_SSpMon2OV" UBYTE DFC_OneToOne 1 100 0.00 1.000 BIT_MASK 0x8 FORMAT "%5.3" ECU_ADDRESS 0x4000CBBA /end MEASUREMENT
/begin MEASUREMENT DFC_b.TST_SSpMon2SCG "Bit encoding / Tested bit for check DFC_SSpMon2SCG" UBYTE DFC_OneToOne 1 100 0.00 1.000 BIT_MASK 0x8 FORMAT "%5.3" ECU_ADDRESS 0x4000CBBB /end MEASUREMENT
/begin MEASUREMENT DFC_b.TST_SSpMon2UV "Bit encoding / Tested bit for check DFC_SSpMon2UV" UBYTE DFC_OneToOne 1 100 0.00 1.000 BIT_MASK 0x8 FORMAT "%5.3" ECU_ADDRESS 0x4000CBBC /end MEASUREMENT
/begin MEASUREMENT DFC_b.TST_CANIF_E_CTRL_NOT_SLEEP_ERROR_VALUE "Bit encoding / Tested bit for check DFC_CANIF_E_CTRL_NOT_SLEEP_ERROR_VALUE" UBYTE DFC_OneToOne 1 100 0.00 1.000 BIT_MASK 0x8 FORMAT "%5.3" ECU_ADDRESS 0x4000CBBD /end MEASUREMENT
/begin MEASUREMENT DFC_b.TST_CANIF_E_CTRL_STOPPED_ERROR_VALUE "Bit encoding / Tested bit for check DFC_CANIF_E_CTRL_STOPPED_ERROR_VALUE" UBYTE DFC_OneToOne 1 100 0.00 1.000 BIT_MASK 0x8 FORMAT "%5.3" ECU_ADDRESS 0x4000CBBE /end MEASUREMENT
/begin MEASUREMENT DFC_b.TST_CANIF_E_INVALID_DLC_ERROR "Bit encoding / Tested bit for check DFC_CANIF_E_INVALID_DLC_ERROR" UBYTE DFC_OneToOne 1 100 0.00 1.000 BIT_MASK 0x8 FORMAT "%5.3" ECU_ADDRESS 0x4000CBBF /end MEASUREMENT
/begin MEASUREMENT DFC_b.TST_CANNM_E_CANIF_TRANSMIT_ERROR "Bit encoding / Tested bit for check DFC_CANNM_E_CANIF_TRANSMIT_ERROR" UBYTE DFC_OneToOne 1 100 0.00 1.000 BIT_MASK 0x8 FORMAT "%5.3" ECU_ADDRESS 0x4000CBC0 /end MEASUREMENT
/begin MEASUREMENT DFC_b.TST_CANNM_E_INIT_FAILED "Bit encoding / Tested bit for check DFC_CANNM_E_INIT_FAILED" UBYTE DFC_OneToOne 1 100 0.00 1.000 BIT_MASK 0x8 FORMAT "%5.3" ECU_ADDRESS 0x4000CBC1 /end MEASUREMENT
/begin MEASUREMENT DFC_b.TST_CANNM_E_NETWORK_TIMEOUT "Bit encoding / Tested bit for check DFC_CANNM_E_NETWORK_TIMEOUT" UBYTE DFC_OneToOne 1 100 0.00 1.000 BIT_MASK 0x8 FORMAT "%5.3" ECU_ADDRESS 0x4000CBC2 /end MEASUREMENT
/begin MEASUREMENT DFC_b.TST_CAN_E_TIMEOUT "Bit encoding / Tested bit for check DFC_CAN_E_TIMEOUT" UBYTE DFC_OneToOne 1 100 0.00 1.000 BIT_MASK 0x8 FORMAT "%5.3" ECU_ADDRESS 0x4000CBC3 /end MEASUREMENT
/begin MEASUREMENT DFC_b.TST_COMM_E_NET_START_IND_CHANNEL_0 "Bit encoding / Tested bit for check DFC_COMM_E_NET_START_IND_CHANNEL_0" UBYTE DFC_OneToOne 1 100 0.00 1.000 BIT_MASK 0x8 FORMAT "%5.3" ECU_ADDRESS 0x4000CBC4 /end MEASUREMENT
/begin MEASUREMENT DFC_b.TST_COMM_E_NET_START_IND_CHANNEL_1 "Bit encoding / Tested bit for check DFC_COMM_E_NET_START_IND_CHANNEL_1" UBYTE DFC_OneToOne 1 100 0.00 1.000 BIT_MASK 0x8 FORMAT "%5.3" ECU_ADDRESS 0x4000CBC5 /end MEASUREMENT
/begin MEASUREMENT DFC_b.TST_COMM_E_NET_START_IND_CHANNEL_2 "Bit encoding / Tested bit for check DFC_COMM_E_NET_START_IND_CHANNEL_2" UBYTE DFC_OneToOne 1 100 0.00 1.000 BIT_MASK 0x8 FORMAT "%5.3" ECU_ADDRESS 0x4000CBC6 /end MEASUREMENT
/begin MEASUREMENT DFC_b.TST_COMM_E_NET_START_IND_CHANNEL_3 "Bit encoding / Tested bit for check DFC_COMM_E_NET_START_IND_CHANNEL_3" UBYTE DFC_OneToOne 1 100 0.00 1.000 BIT_MASK 0x8 FORMAT "%5.3" ECU_ADDRESS 0x4000CBC7 /end MEASUREMENT
/begin MEASUREMENT DFC_b.TST_COMM_E_NET_START_IND_CHANNEL_4 "Bit encoding / Tested bit for check DFC_COMM_E_NET_START_IND_CHANNEL_4" UBYTE DFC_OneToOne 1 100 0.00 1.000 BIT_MASK 0x8 FORMAT "%5.3" ECU_ADDRESS 0x4000CBC8 /end MEASUREMENT
/begin MEASUREMENT DFC_b.TST_COMM_E_NET_START_IND_CHANNEL_5 "Bit encoding / Tested bit for check DFC_COMM_E_NET_START_IND_CHANNEL_5" UBYTE DFC_OneToOne 1 100 0.00 1.000 BIT_MASK 0x8 FORMAT "%5.3" ECU_ADDRESS 0x4000CBC9 /end MEASUREMENT
/begin MEASUREMENT DFC_b.TST_PDUR_E_INIT_FAILED "Bit encoding / Tested bit for check DFC_PDUR_E_INIT_FAILED" UBYTE DFC_OneToOne 1 100 0.00 1.000 BIT_MASK 0x8 FORMAT "%5.3" ECU_ADDRESS 0x4000CBCA /end MEASUREMENT
/begin MEASUREMENT DFC_b.TST_PDUR_E_PDU_INSTANCE_LOST "Bit encoding / Tested bit for check DFC_PDUR_E_PDU_INSTANCE_LOST" UBYTE DFC_OneToOne 1 100 0.00 1.000 BIT_MASK 0x8 FORMAT "%5.3" ECU_ADDRESS 0x4000CBCB /end MEASUREMENT
/begin MEASUREMENT DFC_b.TST_RBA_IOEXTLIB_KEEPALIVE_DRV "Bit encoding / Tested bit for check DFC_RBA_IOEXTLIB_KEEPALIVE_DRV" UBYTE DFC_OneToOne 1 100 0.00 1.000 BIT_MASK 0x8 FORMAT "%5.3" ECU_ADDRESS 0x4000CBCC /end MEASUREMENT
/begin MEASUREMENT DFC_b.TST_RBA_IOEXTLIB_KEEPALIVE_INI "Bit encoding / Tested bit for check DFC_RBA_IOEXTLIB_KEEPALIVE_INI" UBYTE DFC_OneToOne 1 100 0.00 1.000 BIT_MASK 0x8 FORMAT "%5.3" ECU_ADDRESS 0x4000CBCD /end MEASUREMENT
/begin MEASUREMENT DFC_b.TST_rba_IoSigRtc_StopCounter "Bit encoding / Tested bit for check DFC_rba_IoSigRtc_StopCounter" UBYTE DFC_OneToOne 1 100 0.00 1.000 BIT_MASK 0x8 FORMAT "%5.3" ECU_ADDRESS 0x4000CBCE /end MEASUREMENT
/begin MEASUREMENT DFC_b.TST_rba_MultiStackTrace_Threshold "Bit encoding / Tested bit for check DFC_rba_MultiStackTrace_Threshold" UBYTE DFC_OneToOne 1 100 0.00 1.000 BIT_MASK 0x8 FORMAT "%5.3" ECU_ADDRESS 0x4000CBCF /end MEASUREMENT
/begin MEASUREMENT DFC_b.TST_rba_MRly_Diag_Stk_Event "Bit encoding / Tested bit for check DFC_rba_MRly_Diag_Stk_Event" UBYTE DFC_OneToOne 1 100 0.00 1.000 BIT_MASK 0x8 FORMAT "%5.3" ECU_ADDRESS 0x4000CBD0 /end MEASUREMENT
/begin MEASUREMENT DFC_b.TST_rba_SyC_IrrSwOffTrigEngRun_Event "Bit encoding / Tested bit for check DFC_rba_SyC_IrrSwOffTrigEngRun_Event" UBYTE DFC_OneToOne 1 100 0.00 1.000 BIT_MASK 0x8 FORMAT "%5.3" ECU_ADDRESS 0x4000CBD1 /end MEASUREMENT
/begin MEASUREMENT DFC_b.TST_rba_T15_Diag_ComInVld_Event "Bit encoding / Tested bit for check DFC_rba_T15_Diag_ComInVld_Event" UBYTE DFC_OneToOne 1 100 0.00 1.000 BIT_MASK 0x8 FORMAT "%5.3" ECU_ADDRESS 0x4000CBD2 /end MEASUREMENT
/begin MEASUREMENT DFC_b.TST_rba_T15_Diag_ComOff_HwOn_Event "Bit encoding / Tested bit for check DFC_rba_T15_Diag_ComOff_HwOn_Event" UBYTE DFC_OneToOne 1 100 0.00 1.000 BIT_MASK 0x8 FORMAT "%5.3" ECU_ADDRESS 0x4000CBD3 /end MEASUREMENT
/begin MEASUREMENT DFC_b.TST_rba_T15_Diag_ComOn_HwOff_Event "Bit encoding / Tested bit for check DFC_rba_T15_Diag_ComOn_HwOff_Event" UBYTE DFC_OneToOne 1 100 0.00 1.000 BIT_MASK 0x8 FORMAT "%5.3" ECU_ADDRESS 0x4000CBD4 /end MEASUREMENT
/begin MEASUREMENT DFC_b.TST_BypAirActrOcCoil1 "Bit encoding / Tested bit for check DFC_BypAirActrOcCoil1" UBYTE DFC_OneToOne 1 100 0.00 1.000 BIT_MASK 0x8 FORMAT "%5.3" ECU_ADDRESS 0x4000CBD5 /end MEASUREMENT
/begin MEASUREMENT DFC_b.TST_BypAirActrOcCoil2 "Bit encoding / Tested bit for check DFC_BypAirActrOcCoil2" UBYTE DFC_OneToOne 1 100 0.00 1.000 BIT_MASK 0x8 FORMAT "%5.3" ECU_ADDRESS 0x4000CBD6 /end MEASUREMENT
/begin MEASUREMENT DFC_b.TST_BypAirActrOlCoil1 "Bit encoding / Tested bit for check DFC_BypAirActrOlCoil1" UBYTE DFC_OneToOne 1 100 0.00 1.000 BIT_MASK 0x8 FORMAT "%5.3" ECU_ADDRESS 0x4000CBD7 /end MEASUREMENT
/begin MEASUREMENT DFC_b.TST_BypAirActrOlCoil2 "Bit encoding / Tested bit for check DFC_BypAirActrOlCoil2" UBYTE DFC_OneToOne 1 100 0.00 1.000 BIT_MASK 0x8 FORMAT "%5.3" ECU_ADDRESS 0x4000CBD8 /end MEASUREMENT
/begin MEASUREMENT DFC_b.TST_BypAirActrOt "Bit encoding / Tested bit for check DFC_BypAirActrOt" UBYTE DFC_OneToOne 1 100 0.00 1.000 BIT_MASK 0x8 FORMAT "%5.3" ECU_ADDRESS 0x4000CBD9 /end MEASUREMENT
/begin MEASUREMENT DFC_b.TST_BypAirActrScbCoil1 "Bit encoding / Tested bit for check DFC_BypAirActrScbCoil1" UBYTE DFC_OneToOne 1 100 0.00 1.000 BIT_MASK 0x8 FORMAT "%5.3" ECU_ADDRESS 0x4000CBDA /end MEASUREMENT
/begin MEASUREMENT DFC_b.TST_BypAirActrScbCoil2 "Bit encoding / Tested bit for check DFC_BypAirActrScbCoil2" UBYTE DFC_OneToOne 1 100 0.00 1.000 BIT_MASK 0x8 FORMAT "%5.3" ECU_ADDRESS 0x4000CBDB /end MEASUREMENT
/begin MEASUREMENT DFC_b.TST_BypAirActrScgCoil1 "Bit encoding / Tested bit for check DFC_BypAirActrScgCoil1" UBYTE DFC_OneToOne 1 100 0.00 1.000 BIT_MASK 0x8 FORMAT "%5.3" ECU_ADDRESS 0x4000CBDC /end MEASUREMENT
/begin MEASUREMENT DFC_b.TST_BypAirActrScgCoil2 "Bit encoding / Tested bit for check DFC_BypAirActrScgCoil2" UBYTE DFC_OneToOne 1 100 0.00 1.000 BIT_MASK 0x8 FORMAT "%5.3" ECU_ADDRESS 0x4000CBDD /end MEASUREMENT
/begin MEASUREMENT DFC_b.TST_CEngDsTPhysRngHi "Bit encoding / Tested bit for check DFC_CEngDsTPhysRngHi" UBYTE DFC_OneToOne 1 100 0.00 1.000 BIT_MASK 0x8 FORMAT "%5.3" ECU_ADDRESS 0x4000CBDE /end MEASUREMENT
/begin MEASUREMENT DFC_b.TST_CEngDsTPhysRngLo "Bit encoding / Tested bit for check DFC_CEngDsTPhysRngLo" UBYTE DFC_OneToOne 1 100 0.00 1.000 BIT_MASK 0x8 FORMAT "%5.3" ECU_ADDRESS 0x4000CBDF /end MEASUREMENT
/begin MEASUREMENT DFC_b.TST_CEngDsTSRCMax "Bit encoding / Tested bit for check DFC_CEngDsTSRCMax" UBYTE DFC_OneToOne 1 100 0.00 1.000 BIT_MASK 0x8 FORMAT "%5.3" ECU_ADDRESS 0x4000CBE0 /end MEASUREMENT
/begin MEASUREMENT DFC_b.TST_CEngDsTSRCMin "Bit encoding / Tested bit for check DFC_CEngDsTSRCMin" UBYTE DFC_OneToOne 1 100 0.00 1.000 BIT_MASK 0x8 FORMAT "%5.3" ECU_ADDRESS 0x4000CBE1 /end MEASUREMENT
/begin MEASUREMENT DFC_b.TST_DKmax "Bit encoding / Tested bit for check DFC_DKmax" UBYTE DFC_OneToOne 1 100 0.00 1.000 BIT_MASK 0x8 FORMAT "%5.3" ECU_ADDRESS 0x4000CBE2 /end MEASUREMENT
/begin MEASUREMENT DFC_b.TST_DKmin "Bit encoding / Tested bit for check DFC_DKmin" UBYTE DFC_OneToOne 1 100 0.00 1.000 BIT_MASK 0x8 FORMAT "%5.3" ECU_ADDRESS 0x4000CBE3 /end MEASUREMENT
/begin MEASUREMENT DFC_b.TST_DLLRmax "Bit encoding / Tested bit for check DFC_DLLRmax" UBYTE DFC_OneToOne 1 100 0.00 1.000 BIT_MASK 0x8 FORMAT "%5.3" ECU_ADDRESS 0x4000CBE4 /end MEASUREMENT
/begin MEASUREMENT DFC_b.TST_DLLRmin "Bit encoding / Tested bit for check DFC_DLLRmin" UBYTE DFC_OneToOne 1 100 0.00 1.000 BIT_MASK 0x8 FORMAT "%5.3" ECU_ADDRESS 0x4000CBE5 /end MEASUREMENT
/begin MEASUREMENT DFC_b.TST_DLLRnpl "Bit encoding / Tested bit for check DFC_DLLRnpl" UBYTE DFC_OneToOne 1 100 0.00 1.000 BIT_MASK 0x8 FORMAT "%5.3" ECU_ADDRESS 0x4000CBE6 /end MEASUREMENT
/begin MEASUREMENT DFC_b.TST_DSSRngMax "Bit encoding / Tested bit for check DFC_DSSRngMax" UBYTE DFC_OneToOne 1 100 0.00 1.000 BIT_MASK 0x8 FORMAT "%5.3" ECU_ADDRESS 0x4000CBE7 /end MEASUREMENT
/begin MEASUREMENT DFC_b.TST_DSSRngMin "Bit encoding / Tested bit for check DFC_DSSRngMin" UBYTE DFC_OneToOne 1 100 0.00 1.000 BIT_MASK 0x8 FORMAT "%5.3" ECU_ADDRESS 0x4000CBE8 /end MEASUREMENT
/begin MEASUREMENT DFC_b.TST_DSSmax "Bit encoding / Tested bit for check DFC_DSSmax" UBYTE DFC_OneToOne 1 100 0.00 1.000 BIT_MASK 0x8 FORMAT "%5.3" ECU_ADDRESS 0x4000CBE9 /end MEASUREMENT
/begin MEASUREMENT DFC_b.TST_DSSmin "Bit encoding / Tested bit for check DFC_DSSmin" UBYTE DFC_OneToOne 1 100 0.00 1.000 BIT_MASK 0x8 FORMAT "%5.3" ECU_ADDRESS 0x4000CBEA /end MEASUREMENT
/begin MEASUREMENT DFC_b.TST_DSSnpl "Bit encoding / Tested bit for check DFC_DSSnpl" UBYTE DFC_OneToOne 1 100 0.00 1.000 BIT_MASK 0x8 FORMAT "%5.3" ECU_ADDRESS 0x4000CBEB /end MEASUREMENT
/begin MEASUREMENT DFC_b.TST_DSSnplMax "Bit encoding / Tested bit for check DFC_DSSnplMax" UBYTE DFC_OneToOne 1 100 0.00 1.000 BIT_MASK 0x8 FORMAT "%5.3" ECU_ADDRESS 0x4000CBEC /end MEASUREMENT
/begin MEASUREMENT DFC_b.TST_DSSnplMin "Bit encoding / Tested bit for check DFC_DSSnplMin" UBYTE DFC_OneToOne 1 100 0.00 1.000 BIT_MASK 0x8 FORMAT "%5.3" ECU_ADDRESS 0x4000CBED /end MEASUREMENT
/begin MEASUREMENT DFC_b.TST_DSSsig "Bit encoding / Tested bit for check DFC_DSSsig" UBYTE DFC_OneToOne 1 100 0.00 1.000 BIT_MASK 0x8 FORMAT "%5.3" ECU_ADDRESS 0x4000CBEE /end MEASUREMENT
/begin MEASUREMENT DFC_b.TST_EpmCrSErrSig "Bit encoding / Tested bit for check DFC_EpmCrSErrSig" UBYTE DFC_OneToOne 1 100 0.00 1.000 BIT_MASK 0x8 FORMAT "%5.3" ECU_ADDRESS 0x4000CBEF /end MEASUREMENT
/begin MEASUREMENT DFC_b.TST_EpmCrSNoSig "Bit encoding / Tested bit for check DFC_EpmCrSNoSig" UBYTE DFC_OneToOne 1 100 0.00 1.000 BIT_MASK 0x8 FORMAT "%5.3" ECU_ADDRESS 0x4000CBF0 /end MEASUREMENT
/begin MEASUREMENT DFC_b.TST_HEGOS1B1ElecNpl "Bit encoding / Tested bit for check DFC_HEGOS1B1ElecNpl" UBYTE DFC_OneToOne 1 100 0.00 1.000 BIT_MASK 0x8 FORMAT "%5.3" ECU_ADDRESS 0x4000CBF1 /end MEASUREMENT
/begin MEASUREMENT DFC_b.TST_HSH "Bit encoding / Tested bit for check DFC_HSH" UBYTE DFC_OneToOne 1 100 0.00 1.000 BIT_MASK 0x8 FORMAT "%5.3" ECU_ADDRESS 0x4000CBF2 /end MEASUREMENT
/begin MEASUREMENT DFC_b.TST_HSHEmax "Bit encoding / Tested bit for check DFC_HSHEmax" UBYTE DFC_OneToOne 1 100 0.00 1.000 BIT_MASK 0x8 FORMAT "%5.3" ECU_ADDRESS 0x4000CBF3 /end MEASUREMENT
/begin MEASUREMENT DFC_b.TST_HSHEmin "Bit encoding / Tested bit for check DFC_HSHEmin" UBYTE DFC_OneToOne 1 100 0.00 1.000 BIT_MASK 0x8 FORMAT "%5.3" ECU_ADDRESS 0x4000CBF4 /end MEASUREMENT
/begin MEASUREMENT DFC_b.TST_HSHEsig "Bit encoding / Tested bit for check DFC_HSHEsig" UBYTE DFC_OneToOne 1 100 0.00 1.000 BIT_MASK 0x8 FORMAT "%5.3" ECU_ADDRESS 0x4000CBF5 /end MEASUREMENT
/begin MEASUREMENT DFC_b.TST_HSV "Bit encoding / Tested bit for check DFC_HSV" UBYTE DFC_OneToOne 1 100 0.00 1.000 BIT_MASK 0x8 FORMAT "%5.3" ECU_ADDRESS 0x4000CBF6 /end MEASUREMENT
/begin MEASUREMENT DFC_b.TST_HSVEmax "Bit encoding / Tested bit for check DFC_HSVEmax" UBYTE DFC_OneToOne 1 100 0.00 1.000 BIT_MASK 0x8 FORMAT "%5.3" ECU_ADDRESS 0x4000CBF7 /end MEASUREMENT
/begin MEASUREMENT DFC_b.TST_HSVEmin "Bit encoding / Tested bit for check DFC_HSVEmin" UBYTE DFC_OneToOne 1 100 0.00 1.000 BIT_MASK 0x8 FORMAT "%5.3" ECU_ADDRESS 0x4000CBF8 /end MEASUREMENT
/begin MEASUREMENT DFC_b.TST_HSVEsig "Bit encoding / Tested bit for check DFC_HSVEsig" UBYTE DFC_OneToOne 1 100 0.00 1.000 BIT_MASK 0x8 FORMAT "%5.3" ECU_ADDRESS 0x4000CBF9 /end MEASUREMENT
/begin MEASUREMENT DFC_b.TST_HdLampMax "Bit encoding / Tested bit for check DFC_HdLampMax" UBYTE DFC_OneToOne 1 100 0.00 1.000 BIT_MASK 0x8 FORMAT "%5.3" ECU_ADDRESS 0x4000CBFA /end MEASUREMENT
/begin MEASUREMENT DFC_b.TST_HdLampMin "Bit encoding / Tested bit for check DFC_HdLampMin" UBYTE DFC_OneToOne 1 100 0.00 1.000 BIT_MASK 0x8 FORMAT "%5.3" ECU_ADDRESS 0x4000CBFB /end MEASUREMENT
/begin MEASUREMENT DFC_b.TST_HdLampSig "Bit encoding / Tested bit for check DFC_HdLampSig" UBYTE DFC_OneToOne 1 100 0.00 1.000 BIT_MASK 0x8 FORMAT "%5.3" ECU_ADDRESS 0x4000CBFC /end MEASUREMENT
/begin MEASUREMENT DFC_b.TST_IgnCoil1Err "Bit encoding / Tested bit for check DFC_IgnCoil1Err" UBYTE DFC_OneToOne 1 100 0.00 1.000 BIT_MASK 0x8 FORMAT "%5.3" ECU_ADDRESS 0x4000CBFD /end MEASUREMENT
/begin MEASUREMENT DFC_b.TST_IgnCoil2Err "Bit encoding / Tested bit for check DFC_IgnCoil2Err" UBYTE DFC_OneToOne 1 100 0.00 1.000 BIT_MASK 0x8 FORMAT "%5.3" ECU_ADDRESS 0x4000CBFE /end MEASUREMENT
/begin MEASUREMENT DFC_b.TST_IgnIgbtDiagSCG_0 "Bit encoding / Tested bit for check DFC_IgnIgbtDiagSCG_0" UBYTE DFC_OneToOne 1 100 0.00 1.000 BIT_MASK 0x8 FORMAT "%5.3" ECU_ADDRESS 0x4000CBFF /end MEASUREMENT
/begin MEASUREMENT DFC_b.TST_IgnIgbtDiagSCG_1 "Bit encoding / Tested bit for check DFC_IgnIgbtDiagSCG_1" UBYTE DFC_OneToOne 1 100 0.00 1.000 BIT_MASK 0x8 FORMAT "%5.3" ECU_ADDRESS 0x4000CC00 /end MEASUREMENT
/begin MEASUREMENT DFC_b.TST_IntkAirTAirFltDsPRCMax "Bit encoding / Tested bit for check DFC_IntkAirTAirFltDsPRCMax" UBYTE DFC_OneToOne 1 100 0.00 1.000 BIT_MASK 0x8 FORMAT "%5.3" ECU_ADDRESS 0x4000CC01 /end MEASUREMENT
/begin MEASUREMENT DFC_b.TST_IntkAirTAirFltDsPRCMin "Bit encoding / Tested bit for check DFC_IntkAirTAirFltDsPRCMin" UBYTE DFC_OneToOne 1 100 0.00 1.000 BIT_MASK 0x8 FORMAT "%5.3" ECU_ADDRESS 0x4000CC02 /end MEASUREMENT
/begin MEASUREMENT DFC_b.TST_IntkAirTAirFltDsSRCMax "Bit encoding / Tested bit for check DFC_IntkAirTAirFltDsSRCMax" UBYTE DFC_OneToOne 1 100 0.00 1.000 BIT_MASK 0x8 FORMAT "%5.3" ECU_ADDRESS 0x4000CC03 /end MEASUREMENT
/begin MEASUREMENT DFC_b.TST_IntkAirTAirFltDsSRCMin "Bit encoding / Tested bit for check DFC_IntkAirTAirFltDsSRCMin" UBYTE DFC_OneToOne 1 100 0.00 1.000 BIT_MASK 0x8 FORMAT "%5.3" ECU_ADDRESS 0x4000CC04 /end MEASUREMENT
/begin MEASUREMENT DFC_b.TST_IntkMnfldPNoSyn "Bit encoding / Tested bit for check DFC_IntkMnfldPNoSyn" UBYTE DFC_OneToOne 1 100 0.00 1.000 BIT_MASK 0x8 FORMAT "%5.3" ECU_ADDRESS 0x4000CC05 /end MEASUREMENT
/begin MEASUREMENT DFC_b.TST_KAT "Bit encoding / Tested bit for check DFC_KAT" UBYTE DFC_OneToOne 1 100 0.00 1.000 BIT_MASK 0x8 FORMAT "%5.3" ECU_ADDRESS 0x4000CC06 /end MEASUREMENT
/begin MEASUREMENT DFC_b.TST_KPEmax "Bit encoding / Tested bit for check DFC_KPEmax" UBYTE DFC_OneToOne 1 100 0.00 1.000 BIT_MASK 0x8 FORMAT "%5.3" ECU_ADDRESS 0x4000CC07 /end MEASUREMENT
/begin MEASUREMENT DFC_b.TST_KPEmin "Bit encoding / Tested bit for check DFC_KPEmin" UBYTE DFC_OneToOne 1 100 0.00 1.000 BIT_MASK 0x8 FORMAT "%5.3" ECU_ADDRESS 0x4000CC08 /end MEASUREMENT
/begin MEASUREMENT DFC_b.TST_KPEsig "Bit encoding / Tested bit for check DFC_KPEsig" UBYTE DFC_OneToOne 1 100 0.00 1.000 BIT_MASK 0x8 FORMAT "%5.3" ECU_ADDRESS 0x4000CC09 /end MEASUREMENT
/begin MEASUREMENT DFC_b.TST_KVSFmax "Bit encoding / Tested bit for check DFC_KVSFmax" UBYTE DFC_OneToOne 1 100 0.00 1.000 BIT_MASK 0x8 FORMAT "%5.3" ECU_ADDRESS 0x4000CC0A /end MEASUREMENT
/begin MEASUREMENT DFC_b.TST_KVSFmin "Bit encoding / Tested bit for check DFC_KVSFmin" UBYTE DFC_OneToOne 1 100 0.00 1.000 BIT_MASK 0x8 FORMAT "%5.3" ECU_ADDRESS 0x4000CC0B /end MEASUREMENT
/begin MEASUREMENT DFC_b.TST_KVSOmax "Bit encoding / Tested bit for check DFC_KVSOmax" UBYTE DFC_OneToOne 1 100 0.00 1.000 BIT_MASK 0x8 FORMAT "%5.3" ECU_ADDRESS 0x4000CC0C /end MEASUREMENT
/begin MEASUREMENT DFC_b.TST_KVSOmin "Bit encoding / Tested bit for check DFC_KVSOmin" UBYTE DFC_OneToOne 1 100 0.00 1.000 BIT_MASK 0x8 FORMAT "%5.3" ECU_ADDRESS 0x4000CC0D /end MEASUREMENT
/begin MEASUREMENT DFC_b.TST_LASHmn "Bit encoding / Tested bit for check DFC_LASHmn" UBYTE DFC_OneToOne 1 100 0.00 1.000 BIT_MASK 0x8 FORMAT "%5.3" ECU_ADDRESS 0x4000CC0E /end MEASUREMENT
/begin MEASUREMENT DFC_b.TST_LASHmx "Bit encoding / Tested bit for check DFC_LASHmx" UBYTE DFC_OneToOne 1 100 0.00 1.000 BIT_MASK 0x8 FORMAT "%5.3" ECU_ADDRESS 0x4000CC0F /end MEASUREMENT
/begin MEASUREMENT DFC_b.TST_LATP "Bit encoding / Tested bit for check DFC_LATP" UBYTE DFC_OneToOne 1 100 0.00 1.000 BIT_MASK 0x8 FORMAT "%5.3" ECU_ADDRESS 0x4000CC10 /end MEASUREMENT
/begin MEASUREMENT DFC_b.TST_LDLAHI "Bit encoding / Tested bit for check DFC_LDLAHI" UBYTE DFC_OneToOne 1 100 0.00 1.000 BIT_MASK 0x8 FORMAT "%5.3" ECU_ADDRESS 0x4000CC11 /end MEASUREMENT
/begin MEASUREMENT DFC_b.TST_LFS1Max "Bit encoding / Tested bit for check DFC_LFS1Max" UBYTE DFC_OneToOne 1 100 0.00 1.000 BIT_MASK 0x8 FORMAT "%5.3" ECU_ADDRESS 0x4000CC12 /end MEASUREMENT
/begin MEASUREMENT DFC_b.TST_LFS1Min "Bit encoding / Tested bit for check DFC_LFS1Min" UBYTE DFC_OneToOne 1 100 0.00 1.000 BIT_MASK 0x8 FORMAT "%5.3" ECU_ADDRESS 0x4000CC13 /end MEASUREMENT
/begin MEASUREMENT DFC_b.TST_LFS1Sig "Bit encoding / Tested bit for check DFC_LFS1Sig" UBYTE DFC_OneToOne 1 100 0.00 1.000 BIT_MASK 0x8 FORMAT "%5.3" ECU_ADDRESS 0x4000CC14 /end MEASUREMENT
/begin MEASUREMENT DFC_b.TST_LSHmax "Bit encoding / Tested bit for check DFC_LSHmax" UBYTE DFC_OneToOne 1 100 0.00 1.000 BIT_MASK 0x8 FORMAT "%5.3" ECU_ADDRESS 0x4000CC15 /end MEASUREMENT
/begin MEASUREMENT DFC_b.TST_LSHmin "Bit encoding / Tested bit for check DFC_LSHmin" UBYTE DFC_OneToOne 1 100 0.00 1.000 BIT_MASK 0x8 FORMAT "%5.3" ECU_ADDRESS 0x4000CC16 /end MEASUREMENT
/begin MEASUREMENT DFC_b.TST_LSHnpl "Bit encoding / Tested bit for check DFC_LSHnpl" UBYTE DFC_OneToOne 1 100 0.00 1.000 BIT_MASK 0x8 FORMAT "%5.3" ECU_ADDRESS 0x4000CC17 /end MEASUREMENT
/begin MEASUREMENT DFC_b.TST_LSHsig "Bit encoding / Tested bit for check DFC_LSHsig" UBYTE DFC_OneToOne 1 100 0.00 1.000 BIT_MASK 0x8 FORMAT "%5.3" ECU_ADDRESS 0x4000CC18 /end MEASUREMENT
/begin MEASUREMENT DFC_b.TST_LSVmax "Bit encoding / Tested bit for check DFC_LSVmax" UBYTE DFC_OneToOne 1 100 0.00 1.000 BIT_MASK 0x8 FORMAT "%5.3" ECU_ADDRESS 0x4000CC19 /end MEASUREMENT
/begin MEASUREMENT DFC_b.TST_LSVmin "Bit encoding / Tested bit for check DFC_LSVmin" UBYTE DFC_OneToOne 1 100 0.00 1.000 BIT_MASK 0x8 FORMAT "%5.3" ECU_ADDRESS 0x4000CC1A /end MEASUREMENT
/begin MEASUREMENT DFC_b.TST_LSVnpl "Bit encoding / Tested bit for check DFC_LSVnpl" UBYTE DFC_OneToOne 1 100 0.00 1.000 BIT_MASK 0x8 FORMAT "%5.3" ECU_ADDRESS 0x4000CC1B /end MEASUREMENT
/begin MEASUREMENT DFC_b.TST_LSVsig "Bit encoding / Tested bit for check DFC_LSVsig" UBYTE DFC_OneToOne 1 100 0.00 1.000 BIT_MASK 0x8 FORMAT "%5.3" ECU_ADDRESS 0x4000CC1C /end MEASUREMENT
/begin MEASUREMENT DFC_b.TST_MDCat "Bit encoding / Tested bit for check DFC_MDCat" UBYTE DFC_OneToOne 1 100 0.00 1.000 BIT_MASK 0x8 FORMAT "%5.3" ECU_ADDRESS 0x4000CC1D /end MEASUREMENT
/begin MEASUREMENT DFC_b.TST_MDCatCurr "Bit encoding / Tested bit for check DFC_MDCatCurr" UBYTE DFC_OneToOne 1 100 0.00 1.000 BIT_MASK 0x8 FORMAT "%5.3" ECU_ADDRESS 0x4000CC1E /end MEASUREMENT
/begin MEASUREMENT DFC_b.TST_MDCyl "Bit encoding / Tested bit for check DFC_MDCyl" UBYTE DFC_OneToOne 1 100 0.00 1.000 BIT_MASK 0x8 FORMAT "%5.3" ECU_ADDRESS 0x4000CC1F /end MEASUREMENT
/begin MEASUREMENT DFC_b.TST_MDEmi "Bit encoding / Tested bit for check DFC_MDEmi" UBYTE DFC_OneToOne 1 100 0.00 1.000 BIT_MASK 0x8 FORMAT "%5.3" ECU_ADDRESS 0x4000CC20 /end MEASUREMENT
/begin MEASUREMENT DFC_b.TST_MDEmiStrt "Bit encoding / Tested bit for check DFC_MDEmiStrt" UBYTE DFC_OneToOne 1 100 0.00 1.000 BIT_MASK 0x8 FORMAT "%5.3" ECU_ADDRESS 0x4000CC21 /end MEASUREMENT
/begin MEASUREMENT DFC_b.TST_MDMpl "Bit encoding / Tested bit for check DFC_MDMpl" UBYTE DFC_OneToOne 1 100 0.00 1.000 BIT_MASK 0x8 FORMAT "%5.3" ECU_ADDRESS 0x4000CC22 /end MEASUREMENT
/begin MEASUREMENT DFC_b.TST_MoCADCNTP "Bit encoding / Tested bit for check DFC_MoCADCNTP" UBYTE DFC_OneToOne 1 100 0.00 1.000 BIT_MASK 0x8 FORMAT "%5.3" ECU_ADDRESS 0x4000CC23 /end MEASUREMENT
/begin MEASUREMENT DFC_b.TST_MoCADCTst "Bit encoding / Tested bit for check DFC_MoCADCTst" UBYTE DFC_OneToOne 1 100 0.00 1.000 BIT_MASK 0x8 FORMAT "%5.3" ECU_ADDRESS 0x4000CC24 /end MEASUREMENT
/begin MEASUREMENT DFC_b.TST_MoFSidst "Bit encoding / Tested bit for check DFC_MoFSidst" UBYTE DFC_OneToOne 1 100 0.00 1.000 BIT_MASK 0x8 FORMAT "%5.3" ECU_ADDRESS 0x4000CC25 /end MEASUREMENT
/begin MEASUREMENT DFC_b.TST_OCWDACom "Bit encoding / Tested bit for check DFC_OCWDACom" UBYTE DFC_OneToOne 1 100 0.00 1.000 BIT_MASK 0x8 FORMAT "%5.3" ECU_ADDRESS 0x4000CC26 /end MEASUREMENT
/begin MEASUREMENT DFC_b.TST_OilPPSSwtMax "Bit encoding / Tested bit for check DFC_OilPPSSwtMax" UBYTE DFC_OneToOne 1 100 0.00 1.000 BIT_MASK 0x8 FORMAT "%5.3" ECU_ADDRESS 0x4000CC27 /end MEASUREMENT
/begin MEASUREMENT DFC_b.TST_OilPPSSwtMin "Bit encoding / Tested bit for check DFC_OilPPSSwtMin" UBYTE DFC_OneToOne 1 100 0.00 1.000 BIT_MASK 0x8 FORMAT "%5.3" ECU_ADDRESS 0x4000CC28 /end MEASUREMENT
/begin MEASUREMENT DFC_b.TST_OilPPSSwtSig "Bit encoding / Tested bit for check DFC_OilPPSSwtSig" UBYTE DFC_OneToOne 1 100 0.00 1.000 BIT_MASK 0x8 FORMAT "%5.3" ECU_ADDRESS 0x4000CC29 /end MEASUREMENT
/begin MEASUREMENT DFC_b.TST_OvHEngSpdLimr "Bit encoding / Tested bit for check DFC_OvHEngSpdLimr" UBYTE DFC_OneToOne 1 100 0.00 1.000 BIT_MASK 0x8 FORMAT "%5.3" ECU_ADDRESS 0x4000CC2A /end MEASUREMENT
/begin MEASUREMENT DFC_b.TST_RoVComVld "Bit encoding / Tested bit for check DFC_RoVComVld" UBYTE DFC_OneToOne 1 100 0.00 1.000 BIT_MASK 0x8 FORMAT "%5.3" ECU_ADDRESS 0x4000CC2B /end MEASUREMENT
/begin MEASUREMENT DFC_b.TST_RoVSNpl "Bit encoding / Tested bit for check DFC_RoVSNpl" UBYTE DFC_OneToOne 1 100 0.00 1.000 BIT_MASK 0x8 FORMAT "%5.3" ECU_ADDRESS 0x4000CC2C /end MEASUREMENT
/begin MEASUREMENT DFC_b.TST_RoVSOL "Bit encoding / Tested bit for check DFC_RoVSOL" UBYTE DFC_OneToOne 1 100 0.00 1.000 BIT_MASK 0x8 FORMAT "%5.3" ECU_ADDRESS 0x4000CC2D /end MEASUREMENT
/begin MEASUREMENT DFC_b.TST_RoVSSCB "Bit encoding / Tested bit for check DFC_RoVSSCB" UBYTE DFC_OneToOne 1 100 0.00 1.000 BIT_MASK 0x8 FORMAT "%5.3" ECU_ADDRESS 0x4000CC2E /end MEASUREMENT
/begin MEASUREMENT DFC_b.TST_RoVSSCG "Bit encoding / Tested bit for check DFC_RoVSSCG" UBYTE DFC_OneToOne 1 100 0.00 1.000 BIT_MASK 0x8 FORMAT "%5.3" ECU_ADDRESS 0x4000CC2F /end MEASUREMENT
/begin MEASUREMENT DFC_b.TST_SdSTNpl "Bit encoding / Tested bit for check DFC_SdSTNpl" UBYTE DFC_OneToOne 1 100 0.00 1.000 BIT_MASK 0x8 FORMAT "%5.3" ECU_ADDRESS 0x4000CC30 /end MEASUREMENT
/begin MEASUREMENT DFC_b.TST_SdSTSCB "Bit encoding / Tested bit for check DFC_SdSTSCB" UBYTE DFC_OneToOne 1 100 0.00 1.000 BIT_MASK 0x8 FORMAT "%5.3" ECU_ADDRESS 0x4000CC31 /end MEASUREMENT
/begin MEASUREMENT DFC_b.TST_SdSTSCG "Bit encoding / Tested bit for check DFC_SdSTSCG" UBYTE DFC_OneToOne 1 100 0.00 1.000 BIT_MASK 0x8 FORMAT "%5.3" ECU_ADDRESS 0x4000CC32 /end MEASUREMENT
/begin MEASUREMENT DFC_b.TST_SdSTSOL "Bit encoding / Tested bit for check DFC_SdSTSOL" UBYTE DFC_OneToOne 1 100 0.00 1.000 BIT_MASK 0x8 FORMAT "%5.3" ECU_ADDRESS 0x4000CC33 /end MEASUREMENT
/begin MEASUREMENT DFC_b.TST_TEVEmax "Bit encoding / Tested bit for check DFC_TEVEmax" UBYTE DFC_OneToOne 1 100 0.00 1.000 BIT_MASK 0x8 FORMAT "%5.3" ECU_ADDRESS 0x4000CC34 /end MEASUREMENT
/begin MEASUREMENT DFC_b.TST_TEVEmin "Bit encoding / Tested bit for check DFC_TEVEmin" UBYTE DFC_OneToOne 1 100 0.00 1.000 BIT_MASK 0x8 FORMAT "%5.3" ECU_ADDRESS 0x4000CC35 /end MEASUREMENT
/begin MEASUREMENT DFC_b.TST_TEVEsig "Bit encoding / Tested bit for check DFC_TEVEsig" UBYTE DFC_OneToOne 1 100 0.00 1.000 BIT_MASK 0x8 FORMAT "%5.3" ECU_ADDRESS 0x4000CC36 /end MEASUREMENT
/begin MEASUREMENT DFC_b.TST_TMnpl "Bit encoding / Tested bit for check DFC_TMnpl" UBYTE DFC_OneToOne 1 100 0.00 1.000 BIT_MASK 0x8 FORMAT "%5.3" ECU_ADDRESS 0x4000CC37 /end MEASUREMENT
/begin MEASUREMENT DFC_b.TST_UBmax "Bit encoding / Tested bit for check DFC_UBmax" UBYTE DFC_OneToOne 1 100 0.00 1.000 BIT_MASK 0x8 FORMAT "%5.3" ECU_ADDRESS 0x4000CC38 /end MEASUREMENT
/begin MEASUREMENT DFC_b.TST_UBmin "Bit encoding / Tested bit for check DFC_UBmin" UBYTE DFC_OneToOne 1 100 0.00 1.000 BIT_MASK 0x8 FORMAT "%5.3" ECU_ADDRESS 0x4000CC39 /end MEASUREMENT
/begin MEASUREMENT DFC_b.TST_UBnpl "Bit encoding / Tested bit for check DFC_UBnpl" UBYTE DFC_OneToOne 1 100 0.00 1.000 BIT_MASK 0x8 FORMAT "%5.3" ECU_ADDRESS 0x4000CC3A /end MEASUREMENT
/begin MEASUREMENT DFC_b.TST_VFZsig "Bit encoding / Tested bit for check DFC_VFZsig" UBYTE DFC_OneToOne 1 100 0.00 1.000 BIT_MASK 0x8 FORMAT "%5.3" ECU_ADDRESS 0x4000CC3B /end MEASUREMENT
/begin MEASUREMENT DFC_b.TST_VFZsig2 "Bit encoding / Tested bit for check DFC_VFZsig2" UBYTE DFC_OneToOne 1 100 0.00 1.000 BIT_MASK 0x8 FORMAT "%5.3" ECU_ADDRESS 0x4000CC3C /end MEASUREMENT
/begin MEASUREMENT DFC_b.LDF_BusDiagOpenLoad_Can0 "Bit encoding / Last debounced flag bit for check DFC_BusDiagOpenLoad_Can0" UBYTE DFC_OneToOne 1 100 0.00 1.000 BIT_MASK 0x10 FORMAT "%5.3" ECU_ADDRESS 0x4000CB9D /end MEASUREMENT
/begin MEASUREMENT DFC_b.LDF_Com_ABSInfo_DLC "Bit encoding / Last debounced flag bit for check DFC_Com_ABSInfo_DLC" UBYTE DFC_OneToOne 1 100 0.00 1.000 BIT_MASK 0x10 FORMAT "%5.3" ECU_ADDRESS 0x4000CB9E /end MEASUREMENT
/begin MEASUREMENT DFC_b.LDF_Com_ABSInfo_TO "Bit encoding / Last debounced flag bit for check DFC_Com_ABSInfo_TO" UBYTE DFC_OneToOne 1 100 0.00 1.000 BIT_MASK 0x10 FORMAT "%5.3" ECU_ADDRESS 0x4000CB9F /end MEASUREMENT
/begin MEASUREMENT DFC_b.LDF_BusDiagBusOff_Can0 "Bit encoding / Last debounced flag bit for check DFC_BusDiagBusOff_Can0" UBYTE DFC_OneToOne 1 100 0.00 1.000 BIT_MASK 0x10 FORMAT "%5.3" ECU_ADDRESS 0x4000CBA0 /end MEASUREMENT
/begin MEASUREMENT DFC_b.LDF_DevLibBattUHi "Bit encoding / Last debounced flag bit for check DFC_DevLibBattUHi" UBYTE DFC_OneToOne 1 100 0.00 1.000 BIT_MASK 0x10 FORMAT "%5.3" ECU_ADDRESS 0x4000CBA1 /end MEASUREMENT
/begin MEASUREMENT DFC_b.LDF_DevLibBattULo "Bit encoding / Last debounced flag bit for check DFC_DevLibBattULo" UBYTE DFC_OneToOne 1 100 0.00 1.000 BIT_MASK 0x10 FORMAT "%5.3" ECU_ADDRESS 0x4000CBA2 /end MEASUREMENT
/begin MEASUREMENT DFC_b.LDF_StrtOL "Bit encoding / Last debounced flag bit for check DFC_StrtOL" UBYTE DFC_OneToOne 1 100 0.00 1.000 BIT_MASK 0x10 FORMAT "%5.3" ECU_ADDRESS 0x4000CBA3 /end MEASUREMENT
/begin MEASUREMENT DFC_b.LDF_StrtOvrTemp "Bit encoding / Last debounced flag bit for check DFC_StrtOvrTemp" UBYTE DFC_OneToOne 1 100 0.00 1.000 BIT_MASK 0x10 FORMAT "%5.3" ECU_ADDRESS 0x4000CBA4 /end MEASUREMENT
/begin MEASUREMENT DFC_b.LDF_StrtSCB "Bit encoding / Last debounced flag bit for check DFC_StrtSCB" UBYTE DFC_OneToOne 1 100 0.00 1.000 BIT_MASK 0x10 FORMAT "%5.3" ECU_ADDRESS 0x4000CBA5 /end MEASUREMENT
/begin MEASUREMENT DFC_b.LDF_StrtSCG "Bit encoding / Last debounced flag bit for check DFC_StrtSCG" UBYTE DFC_OneToOne 1 100 0.00 1.000 BIT_MASK 0x10 FORMAT "%5.3" ECU_ADDRESS 0x4000CBA6 /end MEASUREMENT
/begin MEASUREMENT DFC_b.LDF_MILLmpOL "Bit encoding / Last debounced flag bit for check DFC_MILLmpOL" UBYTE DFC_OneToOne 1 100 0.00 1.000 BIT_MASK 0x10 FORMAT "%5.3" ECU_ADDRESS 0x4000CBA7 /end MEASUREMENT
/begin MEASUREMENT DFC_b.LDF_MILLmpOT "Bit encoding / Last debounced flag bit for check DFC_MILLmpOT" UBYTE DFC_OneToOne 1 100 0.00 1.000 BIT_MASK 0x10 FORMAT "%5.3" ECU_ADDRESS 0x4000CBA8 /end MEASUREMENT
/begin MEASUREMENT DFC_b.LDF_MILLmpSCB "Bit encoding / Last debounced flag bit for check DFC_MILLmpSCB" UBYTE DFC_OneToOne 1 100 0.00 1.000 BIT_MASK 0x10 FORMAT "%5.3" ECU_ADDRESS 0x4000CBA9 /end MEASUREMENT
/begin MEASUREMENT DFC_b.LDF_MILLmpSCG "Bit encoding / Last debounced flag bit for check DFC_MILLmpSCG" UBYTE DFC_OneToOne 1 100 0.00 1.000 BIT_MASK 0x10 FORMAT "%5.3" ECU_ADDRESS 0x4000CBAA /end MEASUREMENT
/begin MEASUREMENT DFC_b.LDF_EV1max "Bit encoding / Last debounced flag bit for check DFC_EV1max" UBYTE DFC_OneToOne 1 100 0.00 1.000 BIT_MASK 0x10 FORMAT "%5.3" ECU_ADDRESS 0x4000CBAB /end MEASUREMENT
/begin MEASUREMENT DFC_b.LDF_EV1min "Bit encoding / Last debounced flag bit for check DFC_EV1min" UBYTE DFC_OneToOne 1 100 0.00 1.000 BIT_MASK 0x10 FORMAT "%5.3" ECU_ADDRESS 0x4000CBAC /end MEASUREMENT
/begin MEASUREMENT DFC_b.LDF_EV1sig "Bit encoding / Last debounced flag bit for check DFC_EV1sig" UBYTE DFC_OneToOne 1 100 0.00 1.000 BIT_MASK 0x10 FORMAT "%5.3" ECU_ADDRESS 0x4000CBAD /end MEASUREMENT
/begin MEASUREMENT DFC_b.LDF_CEngDsTPlausSTC "Bit encoding / Last debounced flag bit for check DFC_CEngDsTPlausSTC" UBYTE DFC_OneToOne 1 100 0.00 1.000 BIT_MASK 0x10 FORMAT "%5.3" ECU_ADDRESS 0x4000CBAE /end MEASUREMENT
/begin MEASUREMENT DFC_b.LDF_ClthStkOpn "Bit encoding / Last debounced flag bit for check DFC_ClthStkOpn" UBYTE DFC_OneToOne 1 100 0.00 1.000 BIT_MASK 0x10 FORMAT "%5.3" ECU_ADDRESS 0x4000CBAF /end MEASUREMENT
/begin MEASUREMENT DFC_b.LDF_EVX "Bit encoding / Last debounced flag bit for check DFC_EVX" UBYTE DFC_OneToOne 1 100 0.00 1.000 BIT_MASK 0x10 FORMAT "%5.3" ECU_ADDRESS 0x4000CBB0 /end MEASUREMENT
/begin MEASUREMENT DFC_b.LDF_IntkAirTAirFltDsSTC "Bit encoding / Last debounced flag bit for check DFC_IntkAirTAirFltDsSTC" UBYTE DFC_OneToOne 1 100 0.00 1.000 BIT_MASK 0x10 FORMAT "%5.3" ECU_ADDRESS 0x4000CBB1 /end MEASUREMENT
/begin MEASUREMENT DFC_b.LDF_RoughRoad "Bit encoding / Last debounced flag bit for check DFC_RoughRoad" UBYTE DFC_OneToOne 1 100 0.00 1.000 BIT_MASK 0x10 FORMAT "%5.3" ECU_ADDRESS 0x4000CBB2 /end MEASUREMENT
/begin MEASUREMENT DFC_b.LDF_SSpMon1 "Bit encoding / Last debounced flag bit for check DFC_SSpMon1" UBYTE DFC_OneToOne 1 100 0.00 1.000 BIT_MASK 0x10 FORMAT "%5.3" ECU_ADDRESS 0x4000CBB3 /end MEASUREMENT
/begin MEASUREMENT DFC_b.LDF_SSpMon1OT "Bit encoding / Last debounced flag bit for check DFC_SSpMon1OT" UBYTE DFC_OneToOne 1 100 0.00 1.000 BIT_MASK 0x10 FORMAT "%5.3" ECU_ADDRESS 0x4000CBB4 /end MEASUREMENT
/begin MEASUREMENT DFC_b.LDF_SSpMon1OV "Bit encoding / Last debounced flag bit for check DFC_SSpMon1OV" UBYTE DFC_OneToOne 1 100 0.00 1.000 BIT_MASK 0x10 FORMAT "%5.3" ECU_ADDRESS 0x4000CBB5 /end MEASUREMENT
/begin MEASUREMENT DFC_b.LDF_SSpMon1SCG "Bit encoding / Last debounced flag bit for check DFC_SSpMon1SCG" UBYTE DFC_OneToOne 1 100 0.00 1.000 BIT_MASK 0x10 FORMAT "%5.3" ECU_ADDRESS 0x4000CBB6 /end MEASUREMENT
/begin MEASUREMENT DFC_b.LDF_SSpMon1UV "Bit encoding / Last debounced flag bit for check DFC_SSpMon1UV" UBYTE DFC_OneToOne 1 100 0.00 1.000 BIT_MASK 0x10 FORMAT "%5.3" ECU_ADDRESS 0x4000CBB7 /end MEASUREMENT
/begin MEASUREMENT DFC_b.LDF_SSpMon2 "Bit encoding / Last debounced flag bit for check DFC_SSpMon2" UBYTE DFC_OneToOne 1 100 0.00 1.000 BIT_MASK 0x10 FORMAT "%5.3" ECU_ADDRESS 0x4000CBB8 /end MEASUREMENT
/begin MEASUREMENT DFC_b.LDF_SSpMon2OT "Bit encoding / Last debounced flag bit for check DFC_SSpMon2OT" UBYTE DFC_OneToOne 1 100 0.00 1.000 BIT_MASK 0x10 FORMAT "%5.3" ECU_ADDRESS 0x4000CBB9 /end MEASUREMENT
/begin MEASUREMENT DFC_b.LDF_SSpMon2OV "Bit encoding / Last debounced flag bit for check DFC_SSpMon2OV" UBYTE DFC_OneToOne 1 100 0.00 1.000 BIT_MASK 0x10 FORMAT "%5.3" ECU_ADDRESS 0x4000CBBA /end MEASUREMENT
/begin MEASUREMENT DFC_b.LDF_SSpMon2SCG "Bit encoding / Last debounced flag bit for check DFC_SSpMon2SCG" UBYTE DFC_OneToOne 1 100 0.00 1.000 BIT_MASK 0x10 FORMAT "%5.3" ECU_ADDRESS 0x4000CBBB /end MEASUREMENT
/begin MEASUREMENT DFC_b.LDF_SSpMon2UV "Bit encoding / Last debounced flag bit for check DFC_SSpMon2UV" UBYTE DFC_OneToOne 1 100 0.00 1.000 BIT_MASK 0x10 FORMAT "%5.3" ECU_ADDRESS 0x4000CBBC /end MEASUREMENT
/begin MEASUREMENT DFC_b.LDF_CANIF_E_CTRL_NOT_SLEEP_ERROR_VALUE "Bit encoding / Last debounced flag bit for check DFC_CANIF_E_CTRL_NOT_SLEEP_ERROR_VALUE" UBYTE DFC_OneToOne 1 100 0.00 1.000 BIT_MASK 0x10 FORMAT "%5.3" ECU_ADDRESS 0x4000CBBD /end MEASUREMENT
/begin MEASUREMENT DFC_b.LDF_CANIF_E_CTRL_STOPPED_ERROR_VALUE "Bit encoding / Last debounced flag bit for check DFC_CANIF_E_CTRL_STOPPED_ERROR_VALUE" UBYTE DFC_OneToOne 1 100 0.00 1.000 BIT_MASK 0x10 FORMAT "%5.3" ECU_ADDRESS 0x4000CBBE /end MEASUREMENT
/begin MEASUREMENT DFC_b.LDF_CANIF_E_INVALID_DLC_ERROR "Bit encoding / Last debounced flag bit for check DFC_CANIF_E_INVALID_DLC_ERROR" UBYTE DFC_OneToOne 1 100 0.00 1.000 BIT_MASK 0x10 FORMAT "%5.3" ECU_ADDRESS 0x4000CBBF /end MEASUREMENT
/begin MEASUREMENT DFC_b.LDF_CANNM_E_CANIF_TRANSMIT_ERROR "Bit encoding / Last debounced flag bit for check DFC_CANNM_E_CANIF_TRANSMIT_ERROR" UBYTE DFC_OneToOne 1 100 0.00 1.000 BIT_MASK 0x10 FORMAT "%5.3" ECU_ADDRESS 0x4000CBC0 /end MEASUREMENT
/begin MEASUREMENT DFC_b.LDF_CANNM_E_INIT_FAILED "Bit encoding / Last debounced flag bit for check DFC_CANNM_E_INIT_FAILED" UBYTE DFC_OneToOne 1 100 0.00 1.000 BIT_MASK 0x10 FORMAT "%5.3" ECU_ADDRESS 0x4000CBC1 /end MEASUREMENT
/begin MEASUREMENT DFC_b.LDF_CANNM_E_NETWORK_TIMEOUT "Bit encoding / Last debounced flag bit for check DFC_CANNM_E_NETWORK_TIMEOUT" UBYTE DFC_OneToOne 1 100 0.00 1.000 BIT_MASK 0x10 FORMAT "%5.3" ECU_ADDRESS 0x4000CBC2 /end MEASUREMENT
/begin MEASUREMENT DFC_b.LDF_CAN_E_TIMEOUT "Bit encoding / Last debounced flag bit for check DFC_CAN_E_TIMEOUT" UBYTE DFC_OneToOne 1 100 0.00 1.000 BIT_MASK 0x10 FORMAT "%5.3" ECU_ADDRESS 0x4000CBC3 /end MEASUREMENT
/begin MEASUREMENT DFC_b.LDF_COMM_E_NET_START_IND_CHANNEL_0 "Bit encoding / Last debounced flag bit for check DFC_COMM_E_NET_START_IND_CHANNEL_0" UBYTE DFC_OneToOne 1 100 0.00 1.000 BIT_MASK 0x10 FORMAT "%5.3" ECU_ADDRESS 0x4000CBC4 /end MEASUREMENT
/begin MEASUREMENT DFC_b.LDF_COMM_E_NET_START_IND_CHANNEL_1 "Bit encoding / Last debounced flag bit for check DFC_COMM_E_NET_START_IND_CHANNEL_1" UBYTE DFC_OneToOne 1 100 0.00 1.000 BIT_MASK 0x10 FORMAT "%5.3" ECU_ADDRESS 0x4000CBC5 /end MEASUREMENT
/begin MEASUREMENT DFC_b.LDF_COMM_E_NET_START_IND_CHANNEL_2 "Bit encoding / Last debounced flag bit for check DFC_COMM_E_NET_START_IND_CHANNEL_2" UBYTE DFC_OneToOne 1 100 0.00 1.000 BIT_MASK 0x10 FORMAT "%5.3" ECU_ADDRESS 0x4000CBC6 /end MEASUREMENT
/begin MEASUREMENT DFC_b.LDF_COMM_E_NET_START_IND_CHANNEL_3 "Bit encoding / Last debounced flag bit for check DFC_COMM_E_NET_START_IND_CHANNEL_3" UBYTE DFC_OneToOne 1 100 0.00 1.000 BIT_MASK 0x10 FORMAT "%5.3" ECU_ADDRESS 0x4000CBC7 /end MEASUREMENT
/begin MEASUREMENT DFC_b.LDF_COMM_E_NET_START_IND_CHANNEL_4 "Bit encoding / Last debounced flag bit for check DFC_COMM_E_NET_START_IND_CHANNEL_4" UBYTE DFC_OneToOne 1 100 0.00 1.000 BIT_MASK 0x10 FORMAT "%5.3" ECU_ADDRESS 0x4000CBC8 /end MEASUREMENT
/begin MEASUREMENT DFC_b.LDF_COMM_E_NET_START_IND_CHANNEL_5 "Bit encoding / Last debounced flag bit for check DFC_COMM_E_NET_START_IND_CHANNEL_5" UBYTE DFC_OneToOne 1 100 0.00 1.000 BIT_MASK 0x10 FORMAT "%5.3" ECU_ADDRESS 0x4000CBC9 /end MEASUREMENT
/begin MEASUREMENT DFC_b.LDF_PDUR_E_INIT_FAILED "Bit encoding / Last debounced flag bit for check DFC_PDUR_E_INIT_FAILED" UBYTE DFC_OneToOne 1 100 0.00 1.000 BIT_MASK 0x10 FORMAT "%5.3" ECU_ADDRESS 0x4000CBCA /end MEASUREMENT
/begin MEASUREMENT DFC_b.LDF_PDUR_E_PDU_INSTANCE_LOST "Bit encoding / Last debounced flag bit for check DFC_PDUR_E_PDU_INSTANCE_LOST" UBYTE DFC_OneToOne 1 100 0.00 1.000 BIT_MASK 0x10 FORMAT "%5.3" ECU_ADDRESS 0x4000CBCB /end MEASUREMENT
/begin MEASUREMENT DFC_b.LDF_RBA_IOEXTLIB_KEEPALIVE_DRV "Bit encoding / Last debounced flag bit for check DFC_RBA_IOEXTLIB_KEEPALIVE_DRV" UBYTE DFC_OneToOne 1 100 0.00 1.000 BIT_MASK 0x10 FORMAT "%5.3" ECU_ADDRESS 0x4000CBCC /end MEASUREMENT
/begin MEASUREMENT DFC_b.LDF_RBA_IOEXTLIB_KEEPALIVE_INI "Bit encoding / Last debounced flag bit for check DFC_RBA_IOEXTLIB_KEEPALIVE_INI" UBYTE DFC_OneToOne 1 100 0.00 1.000 BIT_MASK 0x10 FORMAT "%5.3" ECU_ADDRESS 0x4000CBCD /end MEASUREMENT
/begin MEASUREMENT DFC_b.LDF_rba_IoSigRtc_StopCounter "Bit encoding / Last debounced flag bit for check DFC_rba_IoSigRtc_StopCounter" UBYTE DFC_OneToOne 1 100 0.00 1.000 BIT_MASK 0x10 FORMAT "%5.3" ECU_ADDRESS 0x4000CBCE /end MEASUREMENT
/begin MEASUREMENT DFC_b.LDF_rba_MultiStackTrace_Threshold "Bit encoding / Last debounced flag bit for check DFC_rba_MultiStackTrace_Threshold" UBYTE DFC_OneToOne 1 100 0.00 1.000 BIT_MASK 0x10 FORMAT "%5.3" ECU_ADDRESS 0x4000CBCF /end MEASUREMENT
/begin MEASUREMENT DFC_b.LDF_rba_MRly_Diag_Stk_Event "Bit encoding / Last debounced flag bit for check DFC_rba_MRly_Diag_Stk_Event" UBYTE DFC_OneToOne 1 100 0.00 1.000 BIT_MASK 0x10 FORMAT "%5.3" ECU_ADDRESS 0x4000CBD0 /end MEASUREMENT
/begin MEASUREMENT DFC_b.LDF_rba_SyC_IrrSwOffTrigEngRun_Event "Bit encoding / Last debounced flag bit for check DFC_rba_SyC_IrrSwOffTrigEngRun_Event" UBYTE DFC_OneToOne 1 100 0.00 1.000 BIT_MASK 0x10 FORMAT "%5.3" ECU_ADDRESS 0x4000CBD1 /end MEASUREMENT
/begin MEASUREMENT DFC_b.LDF_rba_T15_Diag_ComInVld_Event "Bit encoding / Last debounced flag bit for check DFC_rba_T15_Diag_ComInVld_Event" UBYTE DFC_OneToOne 1 100 0.00 1.000 BIT_MASK 0x10 FORMAT "%5.3" ECU_ADDRESS 0x4000CBD2 /end MEASUREMENT
/begin MEASUREMENT DFC_b.LDF_rba_T15_Diag_ComOff_HwOn_Event "Bit encoding / Last debounced flag bit for check DFC_rba_T15_Diag_ComOff_HwOn_Event" UBYTE DFC_OneToOne 1 100 0.00 1.000 BIT_MASK 0x10 FORMAT "%5.3" ECU_ADDRESS 0x4000CBD3 /end MEASUREMENT
/begin MEASUREMENT DFC_b.LDF_rba_T15_Diag_ComOn_HwOff_Event "Bit encoding / Last debounced flag bit for check DFC_rba_T15_Diag_ComOn_HwOff_Event" UBYTE DFC_OneToOne 1 100 0.00 1.000 BIT_MASK 0x10 FORMAT "%5.3" ECU_ADDRESS 0x4000CBD4 /end MEASUREMENT
/begin MEASUREMENT DFC_b.LDF_BypAirActrOcCoil1 "Bit encoding / Last debounced flag bit for check DFC_BypAirActrOcCoil1" UBYTE DFC_OneToOne 1 100 0.00 1.000 BIT_MASK 0x10 FORMAT "%5.3" ECU_ADDRESS 0x4000CBD5 /end MEASUREMENT
/begin MEASUREMENT DFC_b.LDF_BypAirActrOcCoil2 "Bit encoding / Last debounced flag bit for check DFC_BypAirActrOcCoil2" UBYTE DFC_OneToOne 1 100 0.00 1.000 BIT_MASK 0x10 FORMAT "%5.3" ECU_ADDRESS 0x4000CBD6 /end MEASUREMENT
/begin MEASUREMENT DFC_b.LDF_BypAirActrOlCoil1 "Bit encoding / Last debounced flag bit for check DFC_BypAirActrOlCoil1" UBYTE DFC_OneToOne 1 100 0.00 1.000 BIT_MASK 0x10 FORMAT "%5.3" ECU_ADDRESS 0x4000CBD7 /end MEASUREMENT
/begin MEASUREMENT DFC_b.LDF_BypAirActrOlCoil2 "Bit encoding / Last debounced flag bit for check DFC_BypAirActrOlCoil2" UBYTE DFC_OneToOne 1 100 0.00 1.000 BIT_MASK 0x10 FORMAT "%5.3" ECU_ADDRESS 0x4000CBD8 /end MEASUREMENT
/begin MEASUREMENT DFC_b.LDF_BypAirActrOt "Bit encoding / Last debounced flag bit for check DFC_BypAirActrOt" UBYTE DFC_OneToOne 1 100 0.00 1.000 BIT_MASK 0x10 FORMAT "%5.3" ECU_ADDRESS 0x4000CBD9 /end MEASUREMENT
/begin MEASUREMENT DFC_b.LDF_BypAirActrScbCoil1 "Bit encoding / Last debounced flag bit for check DFC_BypAirActrScbCoil1" UBYTE DFC_OneToOne 1 100 0.00 1.000 BIT_MASK 0x10 FORMAT "%5.3" ECU_ADDRESS 0x4000CBDA /end MEASUREMENT
/begin MEASUREMENT DFC_b.LDF_BypAirActrScbCoil2 "Bit encoding / Last debounced flag bit for check DFC_BypAirActrScbCoil2" UBYTE DFC_OneToOne 1 100 0.00 1.000 BIT_MASK 0x10 FORMAT "%5.3" ECU_ADDRESS 0x4000CBDB /end MEASUREMENT
/begin MEASUREMENT DFC_b.LDF_BypAirActrScgCoil1 "Bit encoding / Last debounced flag bit for check DFC_BypAirActrScgCoil1" UBYTE DFC_OneToOne 1 100 0.00 1.000 BIT_MASK 0x10 FORMAT "%5.3" ECU_ADDRESS 0x4000CBDC /end MEASUREMENT
/begin MEASUREMENT DFC_b.LDF_BypAirActrScgCoil2 "Bit encoding / Last debounced flag bit for check DFC_BypAirActrScgCoil2" UBYTE DFC_OneToOne 1 100 0.00 1.000 BIT_MASK 0x10 FORMAT "%5.3" ECU_ADDRESS 0x4000CBDD /end MEASUREMENT
/begin MEASUREMENT DFC_b.LDF_CEngDsTPhysRngHi "Bit encoding / Last debounced flag bit for check DFC_CEngDsTPhysRngHi" UBYTE DFC_OneToOne 1 100 0.00 1.000 BIT_MASK 0x10 FORMAT "%5.3" ECU_ADDRESS 0x4000CBDE /end MEASUREMENT
/begin MEASUREMENT DFC_b.LDF_CEngDsTPhysRngLo "Bit encoding / Last debounced flag bit for check DFC_CEngDsTPhysRngLo" UBYTE DFC_OneToOne 1 100 0.00 1.000 BIT_MASK 0x10 FORMAT "%5.3" ECU_ADDRESS 0x4000CBDF /end MEASUREMENT
/begin MEASUREMENT DFC_b.LDF_CEngDsTSRCMax "Bit encoding / Last debounced flag bit for check DFC_CEngDsTSRCMax" UBYTE DFC_OneToOne 1 100 0.00 1.000 BIT_MASK 0x10 FORMAT "%5.3" ECU_ADDRESS 0x4000CBE0 /end MEASUREMENT
/begin MEASUREMENT DFC_b.LDF_CEngDsTSRCMin "Bit encoding / Last debounced flag bit for check DFC_CEngDsTSRCMin" UBYTE DFC_OneToOne 1 100 0.00 1.000 BIT_MASK 0x10 FORMAT "%5.3" ECU_ADDRESS 0x4000CBE1 /end MEASUREMENT
/begin MEASUREMENT DFC_b.LDF_DKmax "Bit encoding / Last debounced flag bit for check DFC_DKmax" UBYTE DFC_OneToOne 1 100 0.00 1.000 BIT_MASK 0x10 FORMAT "%5.3" ECU_ADDRESS 0x4000CBE2 /end MEASUREMENT
/begin MEASUREMENT DFC_b.LDF_DKmin "Bit encoding / Last debounced flag bit for check DFC_DKmin" UBYTE DFC_OneToOne 1 100 0.00 1.000 BIT_MASK 0x10 FORMAT "%5.3" ECU_ADDRESS 0x4000CBE3 /end MEASUREMENT
/begin MEASUREMENT DFC_b.LDF_DLLRmax "Bit encoding / Last debounced flag bit for check DFC_DLLRmax" UBYTE DFC_OneToOne 1 100 0.00 1.000 BIT_MASK 0x10 FORMAT "%5.3" ECU_ADDRESS 0x4000CBE4 /end MEASUREMENT
/begin MEASUREMENT DFC_b.LDF_DLLRmin "Bit encoding / Last debounced flag bit for check DFC_DLLRmin" UBYTE DFC_OneToOne 1 100 0.00 1.000 BIT_MASK 0x10 FORMAT "%5.3" ECU_ADDRESS 0x4000CBE5 /end MEASUREMENT
/begin MEASUREMENT DFC_b.LDF_DLLRnpl "Bit encoding / Last debounced flag bit for check DFC_DLLRnpl" UBYTE DFC_OneToOne 1 100 0.00 1.000 BIT_MASK 0x10 FORMAT "%5.3" ECU_ADDRESS 0x4000CBE6 /end MEASUREMENT
/begin MEASUREMENT DFC_b.LDF_DSSRngMax "Bit encoding / Last debounced flag bit for check DFC_DSSRngMax" UBYTE DFC_OneToOne 1 100 0.00 1.000 BIT_MASK 0x10 FORMAT "%5.3" ECU_ADDRESS 0x4000CBE7 /end MEASUREMENT
/begin MEASUREMENT DFC_b.LDF_DSSRngMin "Bit encoding / Last debounced flag bit for check DFC_DSSRngMin" UBYTE DFC_OneToOne 1 100 0.00 1.000 BIT_MASK 0x10 FORMAT "%5.3" ECU_ADDRESS 0x4000CBE8 /end MEASUREMENT
/begin MEASUREMENT DFC_b.LDF_DSSmax "Bit encoding / Last debounced flag bit for check DFC_DSSmax" UBYTE DFC_OneToOne 1 100 0.00 1.000 BIT_MASK 0x10 FORMAT "%5.3" ECU_ADDRESS 0x4000CBE9 /end MEASUREMENT
/begin MEASUREMENT DFC_b.LDF_DSSmin "Bit encoding / Last debounced flag bit for check DFC_DSSmin" UBYTE DFC_OneToOne 1 100 0.00 1.000 BIT_MASK 0x10 FORMAT "%5.3" ECU_ADDRESS 0x4000CBEA /end MEASUREMENT
/begin MEASUREMENT DFC_b.LDF_DSSnpl "Bit encoding / Last debounced flag bit for check DFC_DSSnpl" UBYTE DFC_OneToOne 1 100 0.00 1.000 BIT_MASK 0x10 FORMAT "%5.3" ECU_ADDRESS 0x4000CBEB /end MEASUREMENT
/begin MEASUREMENT DFC_b.LDF_DSSnplMax "Bit encoding / Last debounced flag bit for check DFC_DSSnplMax" UBYTE DFC_OneToOne 1 100 0.00 1.000 BIT_MASK 0x10 FORMAT "%5.3" ECU_ADDRESS 0x4000CBEC /end MEASUREMENT
/begin MEASUREMENT DFC_b.LDF_DSSnplMin "Bit encoding / Last debounced flag bit for check DFC_DSSnplMin" UBYTE DFC_OneToOne 1 100 0.00 1.000 BIT_MASK 0x10 FORMAT "%5.3" ECU_ADDRESS 0x4000CBED /end MEASUREMENT
/begin MEASUREMENT DFC_b.LDF_DSSsig "Bit encoding / Last debounced flag bit for check DFC_DSSsig" UBYTE DFC_OneToOne 1 100 0.00 1.000 BIT_MASK 0x10 FORMAT "%5.3" ECU_ADDRESS 0x4000CBEE /end MEASUREMENT
/begin MEASUREMENT DFC_b.LDF_EpmCrSErrSig "Bit encoding / Last debounced flag bit for check DFC_EpmCrSErrSig" UBYTE DFC_OneToOne 1 100 0.00 1.000 BIT_MASK 0x10 FORMAT "%5.3" ECU_ADDRESS 0x4000CBEF /end MEASUREMENT
/begin MEASUREMENT DFC_b.LDF_EpmCrSNoSig "Bit encoding / Last debounced flag bit for check DFC_EpmCrSNoSig" UBYTE DFC_OneToOne 1 100 0.00 1.000 BIT_MASK 0x10 FORMAT "%5.3" ECU_ADDRESS 0x4000CBF0 /end MEASUREMENT
/begin MEASUREMENT DFC_b.LDF_HEGOS1B1ElecNpl "Bit encoding / Last debounced flag bit for check DFC_HEGOS1B1ElecNpl" UBYTE DFC_OneToOne 1 100 0.00 1.000 BIT_MASK 0x10 FORMAT "%5.3" ECU_ADDRESS 0x4000CBF1 /end MEASUREMENT
/begin MEASUREMENT DFC_b.LDF_HSH "Bit encoding / Last debounced flag bit for check DFC_HSH" UBYTE DFC_OneToOne 1 100 0.00 1.000 BIT_MASK 0x10 FORMAT "%5.3" ECU_ADDRESS 0x4000CBF2 /end MEASUREMENT
/begin MEASUREMENT DFC_b.LDF_HSHEmax "Bit encoding / Last debounced flag bit for check DFC_HSHEmax" UBYTE DFC_OneToOne 1 100 0.00 1.000 BIT_MASK 0x10 FORMAT "%5.3" ECU_ADDRESS 0x4000CBF3 /end MEASUREMENT
/begin MEASUREMENT DFC_b.LDF_HSHEmin "Bit encoding / Last debounced flag bit for check DFC_HSHEmin" UBYTE DFC_OneToOne 1 100 0.00 1.000 BIT_MASK 0x10 FORMAT "%5.3" ECU_ADDRESS 0x4000CBF4 /end MEASUREMENT
/begin MEASUREMENT DFC_b.LDF_HSHEsig "Bit encoding / Last debounced flag bit for check DFC_HSHEsig" UBYTE DFC_OneToOne 1 100 0.00 1.000 BIT_MASK 0x10 FORMAT "%5.3" ECU_ADDRESS 0x4000CBF5 /end MEASUREMENT
/begin MEASUREMENT DFC_b.LDF_HSV "Bit encoding / Last debounced flag bit for check DFC_HSV" UBYTE DFC_OneToOne 1 100 0.00 1.000 BIT_MASK 0x10 FORMAT "%5.3" ECU_ADDRESS 0x4000CBF6 /end MEASUREMENT
/begin MEASUREMENT DFC_b.LDF_HSVEmax "Bit encoding / Last debounced flag bit for check DFC_HSVEmax" UBYTE DFC_OneToOne 1 100 0.00 1.000 BIT_MASK 0x10 FORMAT "%5.3" ECU_ADDRESS 0x4000CBF7 /end MEASUREMENT
/begin MEASUREMENT DFC_b.LDF_HSVEmin "Bit encoding / Last debounced flag bit for check DFC_HSVEmin" UBYTE DFC_OneToOne 1 100 0.00 1.000 BIT_MASK 0x10 FORMAT "%5.3" ECU_ADDRESS 0x4000CBF8 /end MEASUREMENT
/begin MEASUREMENT DFC_b.LDF_HSVEsig "Bit encoding / Last debounced flag bit for check DFC_HSVEsig" UBYTE DFC_OneToOne 1 100 0.00 1.000 BIT_MASK 0x10 FORMAT "%5.3" ECU_ADDRESS 0x4000CBF9 /end MEASUREMENT
/begin MEASUREMENT DFC_b.LDF_HdLampMax "Bit encoding / Last debounced flag bit for check DFC_HdLampMax" UBYTE DFC_OneToOne 1 100 0.00 1.000 BIT_MASK 0x10 FORMAT "%5.3" ECU_ADDRESS 0x4000CBFA /end MEASUREMENT
/begin MEASUREMENT DFC_b.LDF_HdLampMin "Bit encoding / Last debounced flag bit for check DFC_HdLampMin" UBYTE DFC_OneToOne 1 100 0.00 1.000 BIT_MASK 0x10 FORMAT "%5.3" ECU_ADDRESS 0x4000CBFB /end MEASUREMENT
/begin MEASUREMENT DFC_b.LDF_HdLampSig "Bit encoding / Last debounced flag bit for check DFC_HdLampSig" UBYTE DFC_OneToOne 1 100 0.00 1.000 BIT_MASK 0x10 FORMAT "%5.3" ECU_ADDRESS 0x4000CBFC /end MEASUREMENT
/begin MEASUREMENT DFC_b.LDF_IgnCoil1Err "Bit encoding / Last debounced flag bit for check DFC_IgnCoil1Err" UBYTE DFC_OneToOne 1 100 0.00 1.000 BIT_MASK 0x10 FORMAT "%5.3" ECU_ADDRESS 0x4000CBFD /end MEASUREMENT
/begin MEASUREMENT DFC_b.LDF_IgnCoil2Err "Bit encoding / Last debounced flag bit for check DFC_IgnCoil2Err" UBYTE DFC_OneToOne 1 100 0.00 1.000 BIT_MASK 0x10 FORMAT "%5.3" ECU_ADDRESS 0x4000CBFE /end MEASUREMENT
/begin MEASUREMENT DFC_b.LDF_IgnIgbtDiagSCG_0 "Bit encoding / Last debounced flag bit for check DFC_IgnIgbtDiagSCG_0" UBYTE DFC_OneToOne 1 100 0.00 1.000 BIT_MASK 0x10 FORMAT "%5.3" ECU_ADDRESS 0x4000CBFF /end MEASUREMENT
/begin MEASUREMENT DFC_b.LDF_IgnIgbtDiagSCG_1 "Bit encoding / Last debounced flag bit for check DFC_IgnIgbtDiagSCG_1" UBYTE DFC_OneToOne 1 100 0.00 1.000 BIT_MASK 0x10 FORMAT "%5.3" ECU_ADDRESS 0x4000CC00 /end MEASUREMENT
/begin MEASUREMENT DFC_b.LDF_IntkAirTAirFltDsPRCMax "Bit encoding / Last debounced flag bit for check DFC_IntkAirTAirFltDsPRCMax" UBYTE DFC_OneToOne 1 100 0.00 1.000 BIT_MASK 0x10 FORMAT "%5.3" ECU_ADDRESS 0x4000CC01 /end MEASUREMENT
/begin MEASUREMENT DFC_b.LDF_IntkAirTAirFltDsPRCMin "Bit encoding / Last debounced flag bit for check DFC_IntkAirTAirFltDsPRCMin" UBYTE DFC_OneToOne 1 100 0.00 1.000 BIT_MASK 0x10 FORMAT "%5.3" ECU_ADDRESS 0x4000CC02 /end MEASUREMENT
/begin MEASUREMENT DFC_b.LDF_IntkAirTAirFltDsSRCMax "Bit encoding / Last debounced flag bit for check DFC_IntkAirTAirFltDsSRCMax" UBYTE DFC_OneToOne 1 100 0.00 1.000 BIT_MASK 0x10 FORMAT "%5.3" ECU_ADDRESS 0x4000CC03 /end MEASUREMENT
/begin MEASUREMENT DFC_b.LDF_IntkAirTAirFltDsSRCMin "Bit encoding / Last debounced flag bit for check DFC_IntkAirTAirFltDsSRCMin" UBYTE DFC_OneToOne 1 100 0.00 1.000 BIT_MASK 0x10 FORMAT "%5.3" ECU_ADDRESS 0x4000CC04 /end MEASUREMENT
/begin MEASUREMENT DFC_b.LDF_IntkMnfldPNoSyn "Bit encoding / Last debounced flag bit for check DFC_IntkMnfldPNoSyn" UBYTE DFC_OneToOne 1 100 0.00 1.000 BIT_MASK 0x10 FORMAT "%5.3" ECU_ADDRESS 0x4000CC05 /end MEASUREMENT
/begin MEASUREMENT DFC_b.LDF_KAT "Bit encoding / Last debounced flag bit for check DFC_KAT" UBYTE DFC_OneToOne 1 100 0.00 1.000 BIT_MASK 0x10 FORMAT "%5.3" ECU_ADDRESS 0x4000CC06 /end MEASUREMENT
/begin MEASUREMENT DFC_b.LDF_KPEmax "Bit encoding / Last debounced flag bit for check DFC_KPEmax" UBYTE DFC_OneToOne 1 100 0.00 1.000 BIT_MASK 0x10 FORMAT "%5.3" ECU_ADDRESS 0x4000CC07 /end MEASUREMENT
/begin MEASUREMENT DFC_b.LDF_KPEmin "Bit encoding / Last debounced flag bit for check DFC_KPEmin" UBYTE DFC_OneToOne 1 100 0.00 1.000 BIT_MASK 0x10 FORMAT "%5.3" ECU_ADDRESS 0x4000CC08 /end MEASUREMENT
/begin MEASUREMENT DFC_b.LDF_KPEsig "Bit encoding / Last debounced flag bit for check DFC_KPEsig" UBYTE DFC_OneToOne 1 100 0.00 1.000 BIT_MASK 0x10 FORMAT "%5.3" ECU_ADDRESS 0x4000CC09 /end MEASUREMENT
/begin MEASUREMENT DFC_b.LDF_KVSFmax "Bit encoding / Last debounced flag bit for check DFC_KVSFmax" UBYTE DFC_OneToOne 1 100 0.00 1.000 BIT_MASK 0x10 FORMAT "%5.3" ECU_ADDRESS 0x4000CC0A /end MEASUREMENT
/begin MEASUREMENT DFC_b.LDF_KVSFmin "Bit encoding / Last debounced flag bit for check DFC_KVSFmin" UBYTE DFC_OneToOne 1 100 0.00 1.000 BIT_MASK 0x10 FORMAT "%5.3" ECU_ADDRESS 0x4000CC0B /end MEASUREMENT
/begin MEASUREMENT DFC_b.LDF_KVSOmax "Bit encoding / Last debounced flag bit for check DFC_KVSOmax" UBYTE DFC_OneToOne 1 100 0.00 1.000 BIT_MASK 0x10 FORMAT "%5.3" ECU_ADDRESS 0x4000CC0C /end MEASUREMENT
/begin MEASUREMENT DFC_b.LDF_KVSOmin "Bit encoding / Last debounced flag bit for check DFC_KVSOmin" UBYTE DFC_OneToOne 1 100 0.00 1.000 BIT_MASK 0x10 FORMAT "%5.3" ECU_ADDRESS 0x4000CC0D /end MEASUREMENT
/begin MEASUREMENT DFC_b.LDF_LASHmn "Bit encoding / Last debounced flag bit for check DFC_LASHmn" UBYTE DFC_OneToOne 1 100 0.00 1.000 BIT_MASK 0x10 FORMAT "%5.3" ECU_ADDRESS 0x4000CC0E /end MEASUREMENT
/begin MEASUREMENT DFC_b.LDF_LASHmx "Bit encoding / Last debounced flag bit for check DFC_LASHmx" UBYTE DFC_OneToOne 1 100 0.00 1.000 BIT_MASK 0x10 FORMAT "%5.3" ECU_ADDRESS 0x4000CC0F /end MEASUREMENT
/begin MEASUREMENT DFC_b.LDF_LATP "Bit encoding / Last debounced flag bit for check DFC_LATP" UBYTE DFC_OneToOne 1 100 0.00 1.000 BIT_MASK 0x10 FORMAT "%5.3" ECU_ADDRESS 0x4000CC10 /end MEASUREMENT
/begin MEASUREMENT DFC_b.LDF_LDLAHI "Bit encoding / Last debounced flag bit for check DFC_LDLAHI" UBYTE DFC_OneToOne 1 100 0.00 1.000 BIT_MASK 0x10 FORMAT "%5.3" ECU_ADDRESS 0x4000CC11 /end MEASUREMENT
/begin MEASUREMENT DFC_b.LDF_LFS1Max "Bit encoding / Last debounced flag bit for check DFC_LFS1Max" UBYTE DFC_OneToOne 1 100 0.00 1.000 BIT_MASK 0x10 FORMAT "%5.3" ECU_ADDRESS 0x4000CC12 /end MEASUREMENT
/begin MEASUREMENT DFC_b.LDF_LFS1Min "Bit encoding / Last debounced flag bit for check DFC_LFS1Min" UBYTE DFC_OneToOne 1 100 0.00 1.000 BIT_MASK 0x10 FORMAT "%5.3" ECU_ADDRESS 0x4000CC13 /end MEASUREMENT
/begin MEASUREMENT DFC_b.LDF_LFS1Sig "Bit encoding / Last debounced flag bit for check DFC_LFS1Sig" UBYTE DFC_OneToOne 1 100 0.00 1.000 BIT_MASK 0x10 FORMAT "%5.3" ECU_ADDRESS 0x4000CC14 /end MEASUREMENT
/begin MEASUREMENT DFC_b.LDF_LSHmax "Bit encoding / Last debounced flag bit for check DFC_LSHmax" UBYTE DFC_OneToOne 1 100 0.00 1.000 BIT_MASK 0x10 FORMAT "%5.3" ECU_ADDRESS 0x4000CC15 /end MEASUREMENT
/begin MEASUREMENT DFC_b.LDF_LSHmin "Bit encoding / Last debounced flag bit for check DFC_LSHmin" UBYTE DFC_OneToOne 1 100 0.00 1.000 BIT_MASK 0x10 FORMAT "%5.3" ECU_ADDRESS 0x4000CC16 /end MEASUREMENT
/begin MEASUREMENT DFC_b.LDF_LSHnpl "Bit encoding / Last debounced flag bit for check DFC_LSHnpl" UBYTE DFC_OneToOne 1 100 0.00 1.000 BIT_MASK 0x10 FORMAT "%5.3" ECU_ADDRESS 0x4000CC17 /end MEASUREMENT
/begin MEASUREMENT DFC_b.LDF_LSHsig "Bit encoding / Last debounced flag bit for check DFC_LSHsig" UBYTE DFC_OneToOne 1 100 0.00 1.000 BIT_MASK 0x10 FORMAT "%5.3" ECU_ADDRESS 0x4000CC18 /end MEASUREMENT
/begin MEASUREMENT DFC_b.LDF_LSVmax "Bit encoding / Last debounced flag bit for check DFC_LSVmax" UBYTE DFC_OneToOne 1 100 0.00 1.000 BIT_MASK 0x10 FORMAT "%5.3" ECU_ADDRESS 0x4000CC19 /end MEASUREMENT
/begin MEASUREMENT DFC_b.LDF_LSVmin "Bit encoding / Last debounced flag bit for check DFC_LSVmin" UBYTE DFC_OneToOne 1 100 0.00 1.000 BIT_MASK 0x10 FORMAT "%5.3" ECU_ADDRESS 0x4000CC1A /end MEASUREMENT
/begin MEASUREMENT DFC_b.LDF_LSVnpl "Bit encoding / Last debounced flag bit for check DFC_LSVnpl" UBYTE DFC_OneToOne 1 100 0.00 1.000 BIT_MASK 0x10 FORMAT "%5.3" ECU_ADDRESS 0x4000CC1B /end MEASUREMENT
/begin MEASUREMENT DFC_b.LDF_LSVsig "Bit encoding / Last debounced flag bit for check DFC_LSVsig" UBYTE DFC_OneToOne 1 100 0.00 1.000 BIT_MASK 0x10 FORMAT "%5.3" ECU_ADDRESS 0x4000CC1C /end MEASUREMENT
/begin MEASUREMENT DFC_b.LDF_MDCat "Bit encoding / Last debounced flag bit for check DFC_MDCat" UBYTE DFC_OneToOne 1 100 0.00 1.000 BIT_MASK 0x10 FORMAT "%5.3" ECU_ADDRESS 0x4000CC1D /end MEASUREMENT
/begin MEASUREMENT DFC_b.LDF_MDCatCurr "Bit encoding / Last debounced flag bit for check DFC_MDCatCurr" UBYTE DFC_OneToOne 1 100 0.00 1.000 BIT_MASK 0x10 FORMAT "%5.3" ECU_ADDRESS 0x4000CC1E /end MEASUREMENT
/begin MEASUREMENT DFC_b.LDF_MDCyl "Bit encoding / Last debounced flag bit for check DFC_MDCyl" UBYTE DFC_OneToOne 1 100 0.00 1.000 BIT_MASK 0x10 FORMAT "%5.3" ECU_ADDRESS 0x4000CC1F /end MEASUREMENT
/begin MEASUREMENT DFC_b.LDF_MDEmi "Bit encoding / Last debounced flag bit for check DFC_MDEmi" UBYTE DFC_OneToOne 1 100 0.00 1.000 BIT_MASK 0x10 FORMAT "%5.3" ECU_ADDRESS 0x4000CC20 /end MEASUREMENT
/begin MEASUREMENT DFC_b.LDF_MDEmiStrt "Bit encoding / Last debounced flag bit for check DFC_MDEmiStrt" UBYTE DFC_OneToOne 1 100 0.00 1.000 BIT_MASK 0x10 FORMAT "%5.3" ECU_ADDRESS 0x4000CC21 /end MEASUREMENT
/begin MEASUREMENT DFC_b.LDF_MDMpl "Bit encoding / Last debounced flag bit for check DFC_MDMpl" UBYTE DFC_OneToOne 1 100 0.00 1.000 BIT_MASK 0x10 FORMAT "%5.3" ECU_ADDRESS 0x4000CC22 /end MEASUREMENT
/begin MEASUREMENT DFC_b.LDF_MoCADCNTP "Bit encoding / Last debounced flag bit for check DFC_MoCADCNTP" UBYTE DFC_OneToOne 1 100 0.00 1.000 BIT_MASK 0x10 FORMAT "%5.3" ECU_ADDRESS 0x4000CC23 /end MEASUREMENT
/begin MEASUREMENT DFC_b.LDF_MoCADCTst "Bit encoding / Last debounced flag bit for check DFC_MoCADCTst" UBYTE DFC_OneToOne 1 100 0.00 1.000 BIT_MASK 0x10 FORMAT "%5.3" ECU_ADDRESS 0x4000CC24 /end MEASUREMENT
/begin MEASUREMENT DFC_b.LDF_MoFSidst "Bit encoding / Last debounced flag bit for check DFC_MoFSidst" UBYTE DFC_OneToOne 1 100 0.00 1.000 BIT_MASK 0x10 FORMAT "%5.3" ECU_ADDRESS 0x4000CC25 /end MEASUREMENT
/begin MEASUREMENT DFC_b.LDF_OCWDACom "Bit encoding / Last debounced flag bit for check DFC_OCWDACom" UBYTE DFC_OneToOne 1 100 0.00 1.000 BIT_MASK 0x10 FORMAT "%5.3" ECU_ADDRESS 0x4000CC26 /end MEASUREMENT
/begin MEASUREMENT DFC_b.LDF_OilPPSSwtMax "Bit encoding / Last debounced flag bit for check DFC_OilPPSSwtMax" UBYTE DFC_OneToOne 1 100 0.00 1.000 BIT_MASK 0x10 FORMAT "%5.3" ECU_ADDRESS 0x4000CC27 /end MEASUREMENT
/begin MEASUREMENT DFC_b.LDF_OilPPSSwtMin "Bit encoding / Last debounced flag bit for check DFC_OilPPSSwtMin" UBYTE DFC_OneToOne 1 100 0.00 1.000 BIT_MASK 0x10 FORMAT "%5.3" ECU_ADDRESS 0x4000CC28 /end MEASUREMENT
/begin MEASUREMENT DFC_b.LDF_OilPPSSwtSig "Bit encoding / Last debounced flag bit for check DFC_OilPPSSwtSig" UBYTE DFC_OneToOne 1 100 0.00 1.000 BIT_MASK 0x10 FORMAT "%5.3" ECU_ADDRESS 0x4000CC29 /end MEASUREMENT
/begin MEASUREMENT DFC_b.LDF_OvHEngSpdLimr "Bit encoding / Last debounced flag bit for check DFC_OvHEngSpdLimr" UBYTE DFC_OneToOne 1 100 0.00 1.000 BIT_MASK 0x10 FORMAT "%5.3" ECU_ADDRESS 0x4000CC2A /end MEASUREMENT
/begin MEASUREMENT DFC_b.LDF_RoVComVld "Bit encoding / Last debounced flag bit for check DFC_RoVComVld" UBYTE DFC_OneToOne 1 100 0.00 1.000 BIT_MASK 0x10 FORMAT "%5.3" ECU_ADDRESS 0x4000CC2B /end MEASUREMENT
/begin MEASUREMENT DFC_b.LDF_RoVSNpl "Bit encoding / Last debounced flag bit for check DFC_RoVSNpl" UBYTE DFC_OneToOne 1 100 0.00 1.000 BIT_MASK 0x10 FORMAT "%5.3" ECU_ADDRESS 0x4000CC2C /end MEASUREMENT
/begin MEASUREMENT DFC_b.LDF_RoVSOL "Bit encoding / Last debounced flag bit for check DFC_RoVSOL" UBYTE DFC_OneToOne 1 100 0.00 1.000 BIT_MASK 0x10 FORMAT "%5.3" ECU_ADDRESS 0x4000CC2D /end MEASUREMENT
/begin MEASUREMENT DFC_b.LDF_RoVSSCB "Bit encoding / Last debounced flag bit for check DFC_RoVSSCB" UBYTE DFC_OneToOne 1 100 0.00 1.000 BIT_MASK 0x10 FORMAT "%5.3" ECU_ADDRESS 0x4000CC2E /end MEASUREMENT
/begin MEASUREMENT DFC_b.LDF_RoVSSCG "Bit encoding / Last debounced flag bit for check DFC_RoVSSCG" UBYTE DFC_OneToOne 1 100 0.00 1.000 BIT_MASK 0x10 FORMAT "%5.3" ECU_ADDRESS 0x4000CC2F /end MEASUREMENT
/begin MEASUREMENT DFC_b.LDF_SdSTNpl "Bit encoding / Last debounced flag bit for check DFC_SdSTNpl" UBYTE DFC_OneToOne 1 100 0.00 1.000 BIT_MASK 0x10 FORMAT "%5.3" ECU_ADDRESS 0x4000CC30 /end MEASUREMENT
/begin MEASUREMENT DFC_b.LDF_SdSTSCB "Bit encoding / Last debounced flag bit for check DFC_SdSTSCB" UBYTE DFC_OneToOne 1 100 0.00 1.000 BIT_MASK 0x10 FORMAT "%5.3" ECU_ADDRESS 0x4000CC31 /end MEASUREMENT
/begin MEASUREMENT DFC_b.LDF_SdSTSCG "Bit encoding / Last debounced flag bit for check DFC_SdSTSCG" UBYTE DFC_OneToOne 1 100 0.00 1.000 BIT_MASK 0x10 FORMAT "%5.3" ECU_ADDRESS 0x4000CC32 /end MEASUREMENT
/begin MEASUREMENT DFC_b.LDF_SdSTSOL "Bit encoding / Last debounced flag bit for check DFC_SdSTSOL" UBYTE DFC_OneToOne 1 100 0.00 1.000 BIT_MASK 0x10 FORMAT "%5.3" ECU_ADDRESS 0x4000CC33 /end MEASUREMENT
/begin MEASUREMENT DFC_b.LDF_TEVEmax "Bit encoding / Last debounced flag bit for check DFC_TEVEmax" UBYTE DFC_OneToOne 1 100 0.00 1.000 BIT_MASK 0x10 FORMAT "%5.3" ECU_ADDRESS 0x4000CC34 /end MEASUREMENT
/begin MEASUREMENT DFC_b.LDF_TEVEmin "Bit encoding / Last debounced flag bit for check DFC_TEVEmin" UBYTE DFC_OneToOne 1 100 0.00 1.000 BIT_MASK 0x10 FORMAT "%5.3" ECU_ADDRESS 0x4000CC35 /end MEASUREMENT
/begin MEASUREMENT DFC_b.LDF_TEVEsig "Bit encoding / Last debounced flag bit for check DFC_TEVEsig" UBYTE DFC_OneToOne 1 100 0.00 1.000 BIT_MASK 0x10 FORMAT "%5.3" ECU_ADDRESS 0x4000CC36 /end MEASUREMENT
/begin MEASUREMENT DFC_b.LDF_TMnpl "Bit encoding / Last debounced flag bit for check DFC_TMnpl" UBYTE DFC_OneToOne 1 100 0.00 1.000 BIT_MASK 0x10 FORMAT "%5.3" ECU_ADDRESS 0x4000CC37 /end MEASUREMENT
/begin MEASUREMENT DFC_b.LDF_UBmax "Bit encoding / Last debounced flag bit for check DFC_UBmax" UBYTE DFC_OneToOne 1 100 0.00 1.000 BIT_MASK 0x10 FORMAT "%5.3" ECU_ADDRESS 0x4000CC38 /end MEASUREMENT
/begin MEASUREMENT DFC_b.LDF_UBmin "Bit encoding / Last debounced flag bit for check DFC_UBmin" UBYTE DFC_OneToOne 1 100 0.00 1.000 BIT_MASK 0x10 FORMAT "%5.3" ECU_ADDRESS 0x4000CC39 /end MEASUREMENT
/begin MEASUREMENT DFC_b.LDF_UBnpl "Bit encoding / Last debounced flag bit for check DFC_UBnpl" UBYTE DFC_OneToOne 1 100 0.00 1.000 BIT_MASK 0x10 FORMAT "%5.3" ECU_ADDRESS 0x4000CC3A /end MEASUREMENT
/begin MEASUREMENT DFC_b.LDF_VFZsig "Bit encoding / Last debounced flag bit for check DFC_VFZsig" UBYTE DFC_OneToOne 1 100 0.00 1.000 BIT_MASK 0x10 FORMAT "%5.3" ECU_ADDRESS 0x4000CC3B /end MEASUREMENT
/begin MEASUREMENT DFC_b.LDF_VFZsig2 "Bit encoding / Last debounced flag bit for check DFC_VFZsig2" UBYTE DFC_OneToOne 1 100 0.00 1.000 BIT_MASK 0x10 FORMAT "%5.3" ECU_ADDRESS 0x4000CC3C /end MEASUREMENT
/begin MEASUREMENT DFC_b.TSC_BusDiagOpenLoad_Can0 "Bit encoding / Ok-Tested Since Clear bit for check DFC_BusDiagOpenLoad_Can0" UBYTE DFC_OneToOne 1 100 0.00 1.000 BIT_MASK 0x20 FORMAT "%5.3" ECU_ADDRESS 0x4000CB9D /end MEASUREMENT
/begin MEASUREMENT DFC_b.TSC_Com_ABSInfo_DLC "Bit encoding / Ok-Tested Since Clear bit for check DFC_Com_ABSInfo_DLC" UBYTE DFC_OneToOne 1 100 0.00 1.000 BIT_MASK 0x20 FORMAT "%5.3" ECU_ADDRESS 0x4000CB9E /end MEASUREMENT
/begin MEASUREMENT DFC_b.TSC_Com_ABSInfo_TO "Bit encoding / Ok-Tested Since Clear bit for check DFC_Com_ABSInfo_TO" UBYTE DFC_OneToOne 1 100 0.00 1.000 BIT_MASK 0x20 FORMAT "%5.3" ECU_ADDRESS 0x4000CB9F /end MEASUREMENT
/begin MEASUREMENT DFC_b.TSC_BusDiagBusOff_Can0 "Bit encoding / Ok-Tested Since Clear bit for check DFC_BusDiagBusOff_Can0" UBYTE DFC_OneToOne 1 100 0.00 1.000 BIT_MASK 0x20 FORMAT "%5.3" ECU_ADDRESS 0x4000CBA0 /end MEASUREMENT
/begin MEASUREMENT DFC_b.TSC_DevLibBattUHi "Bit encoding / Ok-Tested Since Clear bit for check DFC_DevLibBattUHi" UBYTE DFC_OneToOne 1 100 0.00 1.000 BIT_MASK 0x20 FORMAT "%5.3" ECU_ADDRESS 0x4000CBA1 /end MEASUREMENT
/begin MEASUREMENT DFC_b.TSC_DevLibBattULo "Bit encoding / Ok-Tested Since Clear bit for check DFC_DevLibBattULo" UBYTE DFC_OneToOne 1 100 0.00 1.000 BIT_MASK 0x20 FORMAT "%5.3" ECU_ADDRESS 0x4000CBA2 /end MEASUREMENT
/begin MEASUREMENT DFC_b.TSC_StrtOL "Bit encoding / Ok-Tested Since Clear bit for check DFC_StrtOL" UBYTE DFC_OneToOne 1 100 0.00 1.000 BIT_MASK 0x20 FORMAT "%5.3" ECU_ADDRESS 0x4000CBA3 /end MEASUREMENT
/begin MEASUREMENT DFC_b.TSC_StrtOvrTemp "Bit encoding / Ok-Tested Since Clear bit for check DFC_StrtOvrTemp" UBYTE DFC_OneToOne 1 100 0.00 1.000 BIT_MASK 0x20 FORMAT "%5.3" ECU_ADDRESS 0x4000CBA4 /end MEASUREMENT
/begin MEASUREMENT DFC_b.TSC_StrtSCB "Bit encoding / Ok-Tested Since Clear bit for check DFC_StrtSCB" UBYTE DFC_OneToOne 1 100 0.00 1.000 BIT_MASK 0x20 FORMAT "%5.3" ECU_ADDRESS 0x4000CBA5 /end MEASUREMENT
/begin MEASUREMENT DFC_b.TSC_StrtSCG "Bit encoding / Ok-Tested Since Clear bit for check DFC_StrtSCG" UBYTE DFC_OneToOne 1 100 0.00 1.000 BIT_MASK 0x20 FORMAT "%5.3" ECU_ADDRESS 0x4000CBA6 /end MEASUREMENT
/begin MEASUREMENT DFC_b.TSC_MILLmpOL "Bit encoding / Ok-Tested Since Clear bit for check DFC_MILLmpOL" UBYTE DFC_OneToOne 1 100 0.00 1.000 BIT_MASK 0x20 FORMAT "%5.3" ECU_ADDRESS 0x4000CBA7 /end MEASUREMENT
/begin MEASUREMENT DFC_b.TSC_MILLmpOT "Bit encoding / Ok-Tested Since Clear bit for check DFC_MILLmpOT" UBYTE DFC_OneToOne 1 100 0.00 1.000 BIT_MASK 0x20 FORMAT "%5.3" ECU_ADDRESS 0x4000CBA8 /end MEASUREMENT
/begin MEASUREMENT DFC_b.TSC_MILLmpSCB "Bit encoding / Ok-Tested Since Clear bit for check DFC_MILLmpSCB" UBYTE DFC_OneToOne 1 100 0.00 1.000 BIT_MASK 0x20 FORMAT "%5.3" ECU_ADDRESS 0x4000CBA9 /end MEASUREMENT
/begin MEASUREMENT DFC_b.TSC_MILLmpSCG "Bit encoding / Ok-Tested Since Clear bit for check DFC_MILLmpSCG" UBYTE DFC_OneToOne 1 100 0.00 1.000 BIT_MASK 0x20 FORMAT "%5.3" ECU_ADDRESS 0x4000CBAA /end MEASUREMENT
/begin MEASUREMENT DFC_b.TSC_EV1max "Bit encoding / Ok-Tested Since Clear bit for check DFC_EV1max" UBYTE DFC_OneToOne 1 100 0.00 1.000 BIT_MASK 0x20 FORMAT "%5.3" ECU_ADDRESS 0x4000CBAB /end MEASUREMENT
/begin MEASUREMENT DFC_b.TSC_EV1min "Bit encoding / Ok-Tested Since Clear bit for check DFC_EV1min" UBYTE DFC_OneToOne 1 100 0.00 1.000 BIT_MASK 0x20 FORMAT "%5.3" ECU_ADDRESS 0x4000CBAC /end MEASUREMENT
/begin MEASUREMENT DFC_b.TSC_EV1sig "Bit encoding / Ok-Tested Since Clear bit for check DFC_EV1sig" UBYTE DFC_OneToOne 1 100 0.00 1.000 BIT_MASK 0x20 FORMAT "%5.3" ECU_ADDRESS 0x4000CBAD /end MEASUREMENT
/begin MEASUREMENT DFC_b.TSC_CEngDsTPlausSTC "Bit encoding / Ok-Tested Since Clear bit for check DFC_CEngDsTPlausSTC" UBYTE DFC_OneToOne 1 100 0.00 1.000 BIT_MASK 0x20 FORMAT "%5.3" ECU_ADDRESS 0x4000CBAE /end MEASUREMENT
/begin MEASUREMENT DFC_b.TSC_ClthStkOpn "Bit encoding / Ok-Tested Since Clear bit for check DFC_ClthStkOpn" UBYTE DFC_OneToOne 1 100 0.00 1.000 BIT_MASK 0x20 FORMAT "%5.3" ECU_ADDRESS 0x4000CBAF /end MEASUREMENT
/begin MEASUREMENT DFC_b.TSC_EVX "Bit encoding / Ok-Tested Since Clear bit for check DFC_EVX" UBYTE DFC_OneToOne 1 100 0.00 1.000 BIT_MASK 0x20 FORMAT "%5.3" ECU_ADDRESS 0x4000CBB0 /end MEASUREMENT
/begin MEASUREMENT DFC_b.TSC_IntkAirTAirFltDsSTC "Bit encoding / Ok-Tested Since Clear bit for check DFC_IntkAirTAirFltDsSTC" UBYTE DFC_OneToOne 1 100 0.00 1.000 BIT_MASK 0x20 FORMAT "%5.3" ECU_ADDRESS 0x4000CBB1 /end MEASUREMENT
/begin MEASUREMENT DFC_b.TSC_RoughRoad "Bit encoding / Ok-Tested Since Clear bit for check DFC_RoughRoad" UBYTE DFC_OneToOne 1 100 0.00 1.000 BIT_MASK 0x20 FORMAT "%5.3" ECU_ADDRESS 0x4000CBB2 /end MEASUREMENT
/begin MEASUREMENT DFC_b.TSC_SSpMon1 "Bit encoding / Ok-Tested Since Clear bit for check DFC_SSpMon1" UBYTE DFC_OneToOne 1 100 0.00 1.000 BIT_MASK 0x20 FORMAT "%5.3" ECU_ADDRESS 0x4000CBB3 /end MEASUREMENT
/begin MEASUREMENT DFC_b.TSC_SSpMon1OT "Bit encoding / Ok-Tested Since Clear bit for check DFC_SSpMon1OT" UBYTE DFC_OneToOne 1 100 0.00 1.000 BIT_MASK 0x20 FORMAT "%5.3" ECU_ADDRESS 0x4000CBB4 /end MEASUREMENT
/begin MEASUREMENT DFC_b.TSC_SSpMon1OV "Bit encoding / Ok-Tested Since Clear bit for check DFC_SSpMon1OV" UBYTE DFC_OneToOne 1 100 0.00 1.000 BIT_MASK 0x20 FORMAT "%5.3" ECU_ADDRESS 0x4000CBB5 /end MEASUREMENT
/begin MEASUREMENT DFC_b.TSC_SSpMon1SCG "Bit encoding / Ok-Tested Since Clear bit for check DFC_SSpMon1SCG" UBYTE DFC_OneToOne 1 100 0.00 1.000 BIT_MASK 0x20 FORMAT "%5.3" ECU_ADDRESS 0x4000CBB6 /end MEASUREMENT
/begin MEASUREMENT DFC_b.TSC_SSpMon1UV "Bit encoding / Ok-Tested Since Clear bit for check DFC_SSpMon1UV" UBYTE DFC_OneToOne 1 100 0.00 1.000 BIT_MASK 0x20 FORMAT "%5.3" ECU_ADDRESS 0x4000CBB7 /end MEASUREMENT
/begin MEASUREMENT DFC_b.TSC_SSpMon2 "Bit encoding / Ok-Tested Since Clear bit for check DFC_SSpMon2" UBYTE DFC_OneToOne 1 100 0.00 1.000 BIT_MASK 0x20 FORMAT "%5.3" ECU_ADDRESS 0x4000CBB8 /end MEASUREMENT
/begin MEASUREMENT DFC_b.TSC_SSpMon2OT "Bit encoding / Ok-Tested Since Clear bit for check DFC_SSpMon2OT" UBYTE DFC_OneToOne 1 100 0.00 1.000 BIT_MASK 0x20 FORMAT "%5.3" ECU_ADDRESS 0x4000CBB9 /end MEASUREMENT
/begin MEASUREMENT DFC_b.TSC_SSpMon2OV "Bit encoding / Ok-Tested Since Clear bit for check DFC_SSpMon2OV" UBYTE DFC_OneToOne 1 100 0.00 1.000 BIT_MASK 0x20 FORMAT "%5.3" ECU_ADDRESS 0x4000CBBA /end MEASUREMENT
/begin MEASUREMENT DFC_b.TSC_SSpMon2SCG "Bit encoding / Ok-Tested Since Clear bit for check DFC_SSpMon2SCG" UBYTE DFC_OneToOne 1 100 0.00 1.000 BIT_MASK 0x20 FORMAT "%5.3" ECU_ADDRESS 0x4000CBBB /end MEASUREMENT
/begin MEASUREMENT DFC_b.TSC_SSpMon2UV "Bit encoding / Ok-Tested Since Clear bit for check DFC_SSpMon2UV" UBYTE DFC_OneToOne 1 100 0.00 1.000 BIT_MASK 0x20 FORMAT "%5.3" ECU_ADDRESS 0x4000CBBC /end MEASUREMENT
/begin MEASUREMENT DFC_b.TSC_CANIF_E_CTRL_NOT_SLEEP_ERROR_VALUE "Bit encoding / Ok-Tested Since Clear bit for check DFC_CANIF_E_CTRL_NOT_SLEEP_ERROR_VALUE" UBYTE DFC_OneToOne 1 100 0.00 1.000 BIT_MASK 0x20 FORMAT "%5.3" ECU_ADDRESS 0x4000CBBD /end MEASUREMENT
/begin MEASUREMENT DFC_b.TSC_CANIF_E_CTRL_STOPPED_ERROR_VALUE "Bit encoding / Ok-Tested Since Clear bit for check DFC_CANIF_E_CTRL_STOPPED_ERROR_VALUE" UBYTE DFC_OneToOne 1 100 0.00 1.000 BIT_MASK 0x20 FORMAT "%5.3" ECU_ADDRESS 0x4000CBBE /end MEASUREMENT
/begin MEASUREMENT DFC_b.TSC_CANIF_E_INVALID_DLC_ERROR "Bit encoding / Ok-Tested Since Clear bit for check DFC_CANIF_E_INVALID_DLC_ERROR" UBYTE DFC_OneToOne 1 100 0.00 1.000 BIT_MASK 0x20 FORMAT "%5.3" ECU_ADDRESS 0x4000CBBF /end MEASUREMENT
/begin MEASUREMENT DFC_b.TSC_CANNM_E_CANIF_TRANSMIT_ERROR "Bit encoding / Ok-Tested Since Clear bit for check DFC_CANNM_E_CANIF_TRANSMIT_ERROR" UBYTE DFC_OneToOne 1 100 0.00 1.000 BIT_MASK 0x20 FORMAT "%5.3" ECU_ADDRESS 0x4000CBC0 /end MEASUREMENT
/begin MEASUREMENT DFC_b.TSC_CANNM_E_INIT_FAILED "Bit encoding / Ok-Tested Since Clear bit for check DFC_CANNM_E_INIT_FAILED" UBYTE DFC_OneToOne 1 100 0.00 1.000 BIT_MASK 0x20 FORMAT "%5.3" ECU_ADDRESS 0x4000CBC1 /end MEASUREMENT
/begin MEASUREMENT DFC_b.TSC_CANNM_E_NETWORK_TIMEOUT "Bit encoding / Ok-Tested Since Clear bit for check DFC_CANNM_E_NETWORK_TIMEOUT" UBYTE DFC_OneToOne 1 100 0.00 1.000 BIT_MASK 0x20 FORMAT "%5.3" ECU_ADDRESS 0x4000CBC2 /end MEASUREMENT
/begin MEASUREMENT DFC_b.TSC_CAN_E_TIMEOUT "Bit encoding / Ok-Tested Since Clear bit for check DFC_CAN_E_TIMEOUT" UBYTE DFC_OneToOne 1 100 0.00 1.000 BIT_MASK 0x20 FORMAT "%5.3" ECU_ADDRESS 0x4000CBC3 /end MEASUREMENT
/begin MEASUREMENT DFC_b.TSC_COMM_E_NET_START_IND_CHANNEL_0 "Bit encoding / Ok-Tested Since Clear bit for check DFC_COMM_E_NET_START_IND_CHANNEL_0" UBYTE DFC_OneToOne 1 100 0.00 1.000 BIT_MASK 0x20 FORMAT "%5.3" ECU_ADDRESS 0x4000CBC4 /end MEASUREMENT
/begin MEASUREMENT DFC_b.TSC_COMM_E_NET_START_IND_CHANNEL_1 "Bit encoding / Ok-Tested Since Clear bit for check DFC_COMM_E_NET_START_IND_CHANNEL_1" UBYTE DFC_OneToOne 1 100 0.00 1.000 BIT_MASK 0x20 FORMAT "%5.3" ECU_ADDRESS 0x4000CBC5 /end MEASUREMENT
/begin MEASUREMENT DFC_b.TSC_COMM_E_NET_START_IND_CHANNEL_2 "Bit encoding / Ok-Tested Since Clear bit for check DFC_COMM_E_NET_START_IND_CHANNEL_2" UBYTE DFC_OneToOne 1 100 0.00 1.000 BIT_MASK 0x20 FORMAT "%5.3" ECU_ADDRESS 0x4000CBC6 /end MEASUREMENT
/begin MEASUREMENT DFC_b.TSC_COMM_E_NET_START_IND_CHANNEL_3 "Bit encoding / Ok-Tested Since Clear bit for check DFC_COMM_E_NET_START_IND_CHANNEL_3" UBYTE DFC_OneToOne 1 100 0.00 1.000 BIT_MASK 0x20 FORMAT "%5.3" ECU_ADDRESS 0x4000CBC7 /end MEASUREMENT
/begin MEASUREMENT DFC_b.TSC_COMM_E_NET_START_IND_CHANNEL_4 "Bit encoding / Ok-Tested Since Clear bit for check DFC_COMM_E_NET_START_IND_CHANNEL_4" UBYTE DFC_OneToOne 1 100 0.00 1.000 BIT_MASK 0x20 FORMAT "%5.3" ECU_ADDRESS 0x4000CBC8 /end MEASUREMENT
/begin MEASUREMENT DFC_b.TSC_COMM_E_NET_START_IND_CHANNEL_5 "Bit encoding / Ok-Tested Since Clear bit for check DFC_COMM_E_NET_START_IND_CHANNEL_5" UBYTE DFC_OneToOne 1 100 0.00 1.000 BIT_MASK 0x20 FORMAT "%5.3" ECU_ADDRESS 0x4000CBC9 /end MEASUREMENT
/begin MEASUREMENT DFC_b.TSC_PDUR_E_INIT_FAILED "Bit encoding / Ok-Tested Since Clear bit for check DFC_PDUR_E_INIT_FAILED" UBYTE DFC_OneToOne 1 100 0.00 1.000 BIT_MASK 0x20 FORMAT "%5.3" ECU_ADDRESS 0x4000CBCA /end MEASUREMENT
/begin MEASUREMENT DFC_b.TSC_PDUR_E_PDU_INSTANCE_LOST "Bit encoding / Ok-Tested Since Clear bit for check DFC_PDUR_E_PDU_INSTANCE_LOST" UBYTE DFC_OneToOne 1 100 0.00 1.000 BIT_MASK 0x20 FORMAT "%5.3" ECU_ADDRESS 0x4000CBCB /end MEASUREMENT
/begin MEASUREMENT DFC_b.TSC_RBA_IOEXTLIB_KEEPALIVE_DRV "Bit encoding / Ok-Tested Since Clear bit for check DFC_RBA_IOEXTLIB_KEEPALIVE_DRV" UBYTE DFC_OneToOne 1 100 0.00 1.000 BIT_MASK 0x20 FORMAT "%5.3" ECU_ADDRESS 0x4000CBCC /end MEASUREMENT
/begin MEASUREMENT DFC_b.TSC_RBA_IOEXTLIB_KEEPALIVE_INI "Bit encoding / Ok-Tested Since Clear bit for check DFC_RBA_IOEXTLIB_KEEPALIVE_INI" UBYTE DFC_OneToOne 1 100 0.00 1.000 BIT_MASK 0x20 FORMAT "%5.3" ECU_ADDRESS 0x4000CBCD /end MEASUREMENT
/begin MEASUREMENT DFC_b.TSC_rba_IoSigRtc_StopCounter "Bit encoding / Ok-Tested Since Clear bit for check DFC_rba_IoSigRtc_StopCounter" UBYTE DFC_OneToOne 1 100 0.00 1.000 BIT_MASK 0x20 FORMAT "%5.3" ECU_ADDRESS 0x4000CBCE /end MEASUREMENT
/begin MEASUREMENT DFC_b.TSC_rba_MultiStackTrace_Threshold "Bit encoding / Ok-Tested Since Clear bit for check DFC_rba_MultiStackTrace_Threshold" UBYTE DFC_OneToOne 1 100 0.00 1.000 BIT_MASK 0x20 FORMAT "%5.3" ECU_ADDRESS 0x4000CBCF /end MEASUREMENT
/begin MEASUREMENT DFC_b.TSC_rba_MRly_Diag_Stk_Event "Bit encoding / Ok-Tested Since Clear bit for check DFC_rba_MRly_Diag_Stk_Event" UBYTE DFC_OneToOne 1 100 0.00 1.000 BIT_MASK 0x20 FORMAT "%5.3" ECU_ADDRESS 0x4000CBD0 /end MEASUREMENT
/begin MEASUREMENT DFC_b.TSC_rba_SyC_IrrSwOffTrigEngRun_Event "Bit encoding / Ok-Tested Since Clear bit for check DFC_rba_SyC_IrrSwOffTrigEngRun_Event" UBYTE DFC_OneToOne 1 100 0.00 1.000 BIT_MASK 0x20 FORMAT "%5.3" ECU_ADDRESS 0x4000CBD1 /end MEASUREMENT
/begin MEASUREMENT DFC_b.TSC_rba_T15_Diag_ComInVld_Event "Bit encoding / Ok-Tested Since Clear bit for check DFC_rba_T15_Diag_ComInVld_Event" UBYTE DFC_OneToOne 1 100 0.00 1.000 BIT_MASK 0x20 FORMAT "%5.3" ECU_ADDRESS 0x4000CBD2 /end MEASUREMENT
/begin MEASUREMENT DFC_b.TSC_rba_T15_Diag_ComOff_HwOn_Event "Bit encoding / Ok-Tested Since Clear bit for check DFC_rba_T15_Diag_ComOff_HwOn_Event" UBYTE DFC_OneToOne 1 100 0.00 1.000 BIT_MASK 0x20 FORMAT "%5.3" ECU_ADDRESS 0x4000CBD3 /end MEASUREMENT
/begin MEASUREMENT DFC_b.TSC_rba_T15_Diag_ComOn_HwOff_Event "Bit encoding / Ok-Tested Since Clear bit for check DFC_rba_T15_Diag_ComOn_HwOff_Event" UBYTE DFC_OneToOne 1 100 0.00 1.000 BIT_MASK 0x20 FORMAT "%5.3" ECU_ADDRESS 0x4000CBD4 /end MEASUREMENT
/begin MEASUREMENT DFC_b.TSC_BypAirActrOcCoil1 "Bit encoding / Ok-Tested Since Clear bit for check DFC_BypAirActrOcCoil1" UBYTE DFC_OneToOne 1 100 0.00 1.000 BIT_MASK 0x20 FORMAT "%5.3" ECU_ADDRESS 0x4000CBD5 /end MEASUREMENT
/begin MEASUREMENT DFC_b.TSC_BypAirActrOcCoil2 "Bit encoding / Ok-Tested Since Clear bit for check DFC_BypAirActrOcCoil2" UBYTE DFC_OneToOne 1 100 0.00 1.000 BIT_MASK 0x20 FORMAT "%5.3" ECU_ADDRESS 0x4000CBD6 /end MEASUREMENT
/begin MEASUREMENT DFC_b.TSC_BypAirActrOlCoil1 "Bit encoding / Ok-Tested Since Clear bit for check DFC_BypAirActrOlCoil1" UBYTE DFC_OneToOne 1 100 0.00 1.000 BIT_MASK 0x20 FORMAT "%5.3" ECU_ADDRESS 0x4000CBD7 /end MEASUREMENT
/begin MEASUREMENT DFC_b.TSC_BypAirActrOlCoil2 "Bit encoding / Ok-Tested Since Clear bit for check DFC_BypAirActrOlCoil2" UBYTE DFC_OneToOne 1 100 0.00 1.000 BIT_MASK 0x20 FORMAT "%5.3" ECU_ADDRESS 0x4000CBD8 /end MEASUREMENT
/begin MEASUREMENT DFC_b.TSC_BypAirActrOt "Bit encoding / Ok-Tested Since Clear bit for check DFC_BypAirActrOt" UBYTE DFC_OneToOne 1 100 0.00 1.000 BIT_MASK 0x20 FORMAT "%5.3" ECU_ADDRESS 0x4000CBD9 /end MEASUREMENT
/begin MEASUREMENT DFC_b.TSC_BypAirActrScbCoil1 "Bit encoding / Ok-Tested Since Clear bit for check DFC_BypAirActrScbCoil1" UBYTE DFC_OneToOne 1 100 0.00 1.000 BIT_MASK 0x20 FORMAT "%5.3" ECU_ADDRESS 0x4000CBDA /end MEASUREMENT
/begin MEASUREMENT DFC_b.TSC_BypAirActrScbCoil2 "Bit encoding / Ok-Tested Since Clear bit for check DFC_BypAirActrScbCoil2" UBYTE DFC_OneToOne 1 100 0.00 1.000 BIT_MASK 0x20 FORMAT "%5.3" ECU_ADDRESS 0x4000CBDB /end MEASUREMENT
/begin MEASUREMENT DFC_b.TSC_BypAirActrScgCoil1 "Bit encoding / Ok-Tested Since Clear bit for check DFC_BypAirActrScgCoil1" UBYTE DFC_OneToOne 1 100 0.00 1.000 BIT_MASK 0x20 FORMAT "%5.3" ECU_ADDRESS 0x4000CBDC /end MEASUREMENT
/begin MEASUREMENT DFC_b.TSC_BypAirActrScgCoil2 "Bit encoding / Ok-Tested Since Clear bit for check DFC_BypAirActrScgCoil2" UBYTE DFC_OneToOne 1 100 0.00 1.000 BIT_MASK 0x20 FORMAT "%5.3" ECU_ADDRESS 0x4000CBDD /end MEASUREMENT
/begin MEASUREMENT DFC_b.TSC_CEngDsTPhysRngHi "Bit encoding / Ok-Tested Since Clear bit for check DFC_CEngDsTPhysRngHi" UBYTE DFC_OneToOne 1 100 0.00 1.000 BIT_MASK 0x20 FORMAT "%5.3" ECU_ADDRESS 0x4000CBDE /end MEASUREMENT
/begin MEASUREMENT DFC_b.TSC_CEngDsTPhysRngLo "Bit encoding / Ok-Tested Since Clear bit for check DFC_CEngDsTPhysRngLo" UBYTE DFC_OneToOne 1 100 0.00 1.000 BIT_MASK 0x20 FORMAT "%5.3" ECU_ADDRESS 0x4000CBDF /end MEASUREMENT
/begin MEASUREMENT DFC_b.TSC_CEngDsTSRCMax "Bit encoding / Ok-Tested Since Clear bit for check DFC_CEngDsTSRCMax" UBYTE DFC_OneToOne 1 100 0.00 1.000 BIT_MASK 0x20 FORMAT "%5.3" ECU_ADDRESS 0x4000CBE0 /end MEASUREMENT
/begin MEASUREMENT DFC_b.TSC_CEngDsTSRCMin "Bit encoding / Ok-Tested Since Clear bit for check DFC_CEngDsTSRCMin" UBYTE DFC_OneToOne 1 100 0.00 1.000 BIT_MASK 0x20 FORMAT "%5.3" ECU_ADDRESS 0x4000CBE1 /end MEASUREMENT
/begin MEASUREMENT DFC_b.TSC_DKmax "Bit encoding / Ok-Tested Since Clear bit for check DFC_DKmax" UBYTE DFC_OneToOne 1 100 0.00 1.000 BIT_MASK 0x20 FORMAT "%5.3" ECU_ADDRESS 0x4000CBE2 /end MEASUREMENT
/begin MEASUREMENT DFC_b.TSC_DKmin "Bit encoding / Ok-Tested Since Clear bit for check DFC_DKmin" UBYTE DFC_OneToOne 1 100 0.00 1.000 BIT_MASK 0x20 FORMAT "%5.3" ECU_ADDRESS 0x4000CBE3 /end MEASUREMENT
/begin MEASUREMENT DFC_b.TSC_DLLRmax "Bit encoding / Ok-Tested Since Clear bit for check DFC_DLLRmax" UBYTE DFC_OneToOne 1 100 0.00 1.000 BIT_MASK 0x20 FORMAT "%5.3" ECU_ADDRESS 0x4000CBE4 /end MEASUREMENT
/begin MEASUREMENT DFC_b.TSC_DLLRmin "Bit encoding / Ok-Tested Since Clear bit for check DFC_DLLRmin" UBYTE DFC_OneToOne 1 100 0.00 1.000 BIT_MASK 0x20 FORMAT "%5.3" ECU_ADDRESS 0x4000CBE5 /end MEASUREMENT
/begin MEASUREMENT DFC_b.TSC_DLLRnpl "Bit encoding / Ok-Tested Since Clear bit for check DFC_DLLRnpl" UBYTE DFC_OneToOne 1 100 0.00 1.000 BIT_MASK 0x20 FORMAT "%5.3" ECU_ADDRESS 0x4000CBE6 /end MEASUREMENT
/begin MEASUREMENT DFC_b.TSC_DSSRngMax "Bit encoding / Ok-Tested Since Clear bit for check DFC_DSSRngMax" UBYTE DFC_OneToOne 1 100 0.00 1.000 BIT_MASK 0x20 FORMAT "%5.3" ECU_ADDRESS 0x4000CBE7 /end MEASUREMENT
/begin MEASUREMENT DFC_b.TSC_DSSRngMin "Bit encoding / Ok-Tested Since Clear bit for check DFC_DSSRngMin" UBYTE DFC_OneToOne 1 100 0.00 1.000 BIT_MASK 0x20 FORMAT "%5.3" ECU_ADDRESS 0x4000CBE8 /end MEASUREMENT
/begin MEASUREMENT DFC_b.TSC_DSSmax "Bit encoding / Ok-Tested Since Clear bit for check DFC_DSSmax" UBYTE DFC_OneToOne 1 100 0.00 1.000 BIT_MASK 0x20 FORMAT "%5.3" ECU_ADDRESS 0x4000CBE9 /end MEASUREMENT
/begin MEASUREMENT DFC_b.TSC_DSSmin "Bit encoding / Ok-Tested Since Clear bit for check DFC_DSSmin" UBYTE DFC_OneToOne 1 100 0.00 1.000 BIT_MASK 0x20 FORMAT "%5.3" ECU_ADDRESS 0x4000CBEA /end MEASUREMENT
/begin MEASUREMENT DFC_b.TSC_DSSnpl "Bit encoding / Ok-Tested Since Clear bit for check DFC_DSSnpl" UBYTE DFC_OneToOne 1 100 0.00 1.000 BIT_MASK 0x20 FORMAT "%5.3" ECU_ADDRESS 0x4000CBEB /end MEASUREMENT
/begin MEASUREMENT DFC_b.TSC_DSSnplMax "Bit encoding / Ok-Tested Since Clear bit for check DFC_DSSnplMax" UBYTE DFC_OneToOne 1 100 0.00 1.000 BIT_MASK 0x20 FORMAT "%5.3" ECU_ADDRESS 0x4000CBEC /end MEASUREMENT
/begin MEASUREMENT DFC_b.TSC_DSSnplMin "Bit encoding / Ok-Tested Since Clear bit for check DFC_DSSnplMin" UBYTE DFC_OneToOne 1 100 0.00 1.000 BIT_MASK 0x20 FORMAT "%5.3" ECU_ADDRESS 0x4000CBED /end MEASUREMENT
/begin MEASUREMENT DFC_b.TSC_DSSsig "Bit encoding / Ok-Tested Since Clear bit for check DFC_DSSsig" UBYTE DFC_OneToOne 1 100 0.00 1.000 BIT_MASK 0x20 FORMAT "%5.3" ECU_ADDRESS 0x4000CBEE /end MEASUREMENT
/begin MEASUREMENT DFC_b.TSC_EpmCrSErrSig "Bit encoding / Ok-Tested Since Clear bit for check DFC_EpmCrSErrSig" UBYTE DFC_OneToOne 1 100 0.00 1.000 BIT_MASK 0x20 FORMAT "%5.3" ECU_ADDRESS 0x4000CBEF /end MEASUREMENT
/begin MEASUREMENT DFC_b.TSC_EpmCrSNoSig "Bit encoding / Ok-Tested Since Clear bit for check DFC_EpmCrSNoSig" UBYTE DFC_OneToOne 1 100 0.00 1.000 BIT_MASK 0x20 FORMAT "%5.3" ECU_ADDRESS 0x4000CBF0 /end MEASUREMENT
/begin MEASUREMENT DFC_b.TSC_HEGOS1B1ElecNpl "Bit encoding / Ok-Tested Since Clear bit for check DFC_HEGOS1B1ElecNpl" UBYTE DFC_OneToOne 1 100 0.00 1.000 BIT_MASK 0x20 FORMAT "%5.3" ECU_ADDRESS 0x4000CBF1 /end MEASUREMENT
/begin MEASUREMENT DFC_b.TSC_HSH "Bit encoding / Ok-Tested Since Clear bit for check DFC_HSH" UBYTE DFC_OneToOne 1 100 0.00 1.000 BIT_MASK 0x20 FORMAT "%5.3" ECU_ADDRESS 0x4000CBF2 /end MEASUREMENT
/begin MEASUREMENT DFC_b.TSC_HSHEmax "Bit encoding / Ok-Tested Since Clear bit for check DFC_HSHEmax" UBYTE DFC_OneToOne 1 100 0.00 1.000 BIT_MASK 0x20 FORMAT "%5.3" ECU_ADDRESS 0x4000CBF3 /end MEASUREMENT
/begin MEASUREMENT DFC_b.TSC_HSHEmin "Bit encoding / Ok-Tested Since Clear bit for check DFC_HSHEmin" UBYTE DFC_OneToOne 1 100 0.00 1.000 BIT_MASK 0x20 FORMAT "%5.3" ECU_ADDRESS 0x4000CBF4 /end MEASUREMENT
/begin MEASUREMENT DFC_b.TSC_HSHEsig "Bit encoding / Ok-Tested Since Clear bit for check DFC_HSHEsig" UBYTE DFC_OneToOne 1 100 0.00 1.000 BIT_MASK 0x20 FORMAT "%5.3" ECU_ADDRESS 0x4000CBF5 /end MEASUREMENT
/begin MEASUREMENT DFC_b.TSC_HSV "Bit encoding / Ok-Tested Since Clear bit for check DFC_HSV" UBYTE DFC_OneToOne 1 100 0.00 1.000 BIT_MASK 0x20 FORMAT "%5.3" ECU_ADDRESS 0x4000CBF6 /end MEASUREMENT
/begin MEASUREMENT DFC_b.TSC_HSVEmax "Bit encoding / Ok-Tested Since Clear bit for check DFC_HSVEmax" UBYTE DFC_OneToOne 1 100 0.00 1.000 BIT_MASK 0x20 FORMAT "%5.3" ECU_ADDRESS 0x4000CBF7 /end MEASUREMENT
/begin MEASUREMENT DFC_b.TSC_HSVEmin "Bit encoding / Ok-Tested Since Clear bit for check DFC_HSVEmin" UBYTE DFC_OneToOne 1 100 0.00 1.000 BIT_MASK 0x20 FORMAT "%5.3" ECU_ADDRESS 0x4000CBF8 /end MEASUREMENT
/begin MEASUREMENT DFC_b.TSC_HSVEsig "Bit encoding / Ok-Tested Since Clear bit for check DFC_HSVEsig" UBYTE DFC_OneToOne 1 100 0.00 1.000 BIT_MASK 0x20 FORMAT "%5.3" ECU_ADDRESS 0x4000CBF9 /end MEASUREMENT
/begin MEASUREMENT DFC_b.TSC_HdLampMax "Bit encoding / Ok-Tested Since Clear bit for check DFC_HdLampMax" UBYTE DFC_OneToOne 1 100 0.00 1.000 BIT_MASK 0x20 FORMAT "%5.3" ECU_ADDRESS 0x4000CBFA /end MEASUREMENT
/begin MEASUREMENT DFC_b.TSC_HdLampMin "Bit encoding / Ok-Tested Since Clear bit for check DFC_HdLampMin" UBYTE DFC_OneToOne 1 100 0.00 1.000 BIT_MASK 0x20 FORMAT "%5.3" ECU_ADDRESS 0x4000CBFB /end MEASUREMENT
/begin MEASUREMENT DFC_b.TSC_HdLampSig "Bit encoding / Ok-Tested Since Clear bit for check DFC_HdLampSig" UBYTE DFC_OneToOne 1 100 0.00 1.000 BIT_MASK 0x20 FORMAT "%5.3" ECU_ADDRESS 0x4000CBFC /end MEASUREMENT
/begin MEASUREMENT DFC_b.TSC_IgnCoil1Err "Bit encoding / Ok-Tested Since Clear bit for check DFC_IgnCoil1Err" UBYTE DFC_OneToOne 1 100 0.00 1.000 BIT_MASK 0x20 FORMAT "%5.3" ECU_ADDRESS 0x4000CBFD /end MEASUREMENT
/begin MEASUREMENT DFC_b.TSC_IgnCoil2Err "Bit encoding / Ok-Tested Since Clear bit for check DFC_IgnCoil2Err" UBYTE DFC_OneToOne 1 100 0.00 1.000 BIT_MASK 0x20 FORMAT "%5.3" ECU_ADDRESS 0x4000CBFE /end MEASUREMENT
/begin MEASUREMENT DFC_b.TSC_IgnIgbtDiagSCG_0 "Bit encoding / Ok-Tested Since Clear bit for check DFC_IgnIgbtDiagSCG_0" UBYTE DFC_OneToOne 1 100 0.00 1.000 BIT_MASK 0x20 FORMAT "%5.3" ECU_ADDRESS 0x4000CBFF /end MEASUREMENT
/begin MEASUREMENT DFC_b.TSC_IgnIgbtDiagSCG_1 "Bit encoding / Ok-Tested Since Clear bit for check DFC_IgnIgbtDiagSCG_1" UBYTE DFC_OneToOne 1 100 0.00 1.000 BIT_MASK 0x20 FORMAT "%5.3" ECU_ADDRESS 0x4000CC00 /end MEASUREMENT
/begin MEASUREMENT DFC_b.TSC_IntkAirTAirFltDsPRCMax "Bit encoding / Ok-Tested Since Clear bit for check DFC_IntkAirTAirFltDsPRCMax" UBYTE DFC_OneToOne 1 100 0.00 1.000 BIT_MASK 0x20 FORMAT "%5.3" ECU_ADDRESS 0x4000CC01 /end MEASUREMENT
/begin MEASUREMENT DFC_b.TSC_IntkAirTAirFltDsPRCMin "Bit encoding / Ok-Tested Since Clear bit for check DFC_IntkAirTAirFltDsPRCMin" UBYTE DFC_OneToOne 1 100 0.00 1.000 BIT_MASK 0x20 FORMAT "%5.3" ECU_ADDRESS 0x4000CC02 /end MEASUREMENT
/begin MEASUREMENT DFC_b.TSC_IntkAirTAirFltDsSRCMax "Bit encoding / Ok-Tested Since Clear bit for check DFC_IntkAirTAirFltDsSRCMax" UBYTE DFC_OneToOne 1 100 0.00 1.000 BIT_MASK 0x20 FORMAT "%5.3" ECU_ADDRESS 0x4000CC03 /end MEASUREMENT
/begin MEASUREMENT DFC_b.TSC_IntkAirTAirFltDsSRCMin "Bit encoding / Ok-Tested Since Clear bit for check DFC_IntkAirTAirFltDsSRCMin" UBYTE DFC_OneToOne 1 100 0.00 1.000 BIT_MASK 0x20 FORMAT "%5.3" ECU_ADDRESS 0x4000CC04 /end MEASUREMENT
/begin MEASUREMENT DFC_b.TSC_IntkMnfldPNoSyn "Bit encoding / Ok-Tested Since Clear bit for check DFC_IntkMnfldPNoSyn" UBYTE DFC_OneToOne 1 100 0.00 1.000 BIT_MASK 0x20 FORMAT "%5.3" ECU_ADDRESS 0x4000CC05 /end MEASUREMENT
/begin MEASUREMENT DFC_b.TSC_KAT "Bit encoding / Ok-Tested Since Clear bit for check DFC_KAT" UBYTE DFC_OneToOne 1 100 0.00 1.000 BIT_MASK 0x20 FORMAT "%5.3" ECU_ADDRESS 0x4000CC06 /end MEASUREMENT
/begin MEASUREMENT DFC_b.TSC_KPEmax "Bit encoding / Ok-Tested Since Clear bit for check DFC_KPEmax" UBYTE DFC_OneToOne 1 100 0.00 1.000 BIT_MASK 0x20 FORMAT "%5.3" ECU_ADDRESS 0x4000CC07 /end MEASUREMENT
/begin MEASUREMENT DFC_b.TSC_KPEmin "Bit encoding / Ok-Tested Since Clear bit for check DFC_KPEmin" UBYTE DFC_OneToOne 1 100 0.00 1.000 BIT_MASK 0x20 FORMAT "%5.3" ECU_ADDRESS 0x4000CC08 /end MEASUREMENT
/begin MEASUREMENT DFC_b.TSC_KPEsig "Bit encoding / Ok-Tested Since Clear bit for check DFC_KPEsig" UBYTE DFC_OneToOne 1 100 0.00 1.000 BIT_MASK 0x20 FORMAT "%5.3" ECU_ADDRESS 0x4000CC09 /end MEASUREMENT
/begin MEASUREMENT DFC_b.TSC_KVSFmax "Bit encoding / Ok-Tested Since Clear bit for check DFC_KVSFmax" UBYTE DFC_OneToOne 1 100 0.00 1.000 BIT_MASK 0x20 FORMAT "%5.3" ECU_ADDRESS 0x4000CC0A /end MEASUREMENT
/begin MEASUREMENT DFC_b.TSC_KVSFmin "Bit encoding / Ok-Tested Since Clear bit for check DFC_KVSFmin" UBYTE DFC_OneToOne 1 100 0.00 1.000 BIT_MASK 0x20 FORMAT "%5.3" ECU_ADDRESS 0x4000CC0B /end MEASUREMENT
/begin MEASUREMENT DFC_b.TSC_KVSOmax "Bit encoding / Ok-Tested Since Clear bit for check DFC_KVSOmax" UBYTE DFC_OneToOne 1 100 0.00 1.000 BIT_MASK 0x20 FORMAT "%5.3" ECU_ADDRESS 0x4000CC0C /end MEASUREMENT
/begin MEASUREMENT DFC_b.TSC_KVSOmin "Bit encoding / Ok-Tested Since Clear bit for check DFC_KVSOmin" UBYTE DFC_OneToOne 1 100 0.00 1.000 BIT_MASK 0x20 FORMAT "%5.3" ECU_ADDRESS 0x4000CC0D /end MEASUREMENT
/begin MEASUREMENT DFC_b.TSC_LASHmn "Bit encoding / Ok-Tested Since Clear bit for check DFC_LASHmn" UBYTE DFC_OneToOne 1 100 0.00 1.000 BIT_MASK 0x20 FORMAT "%5.3" ECU_ADDRESS 0x4000CC0E /end MEASUREMENT
/begin MEASUREMENT DFC_b.TSC_LASHmx "Bit encoding / Ok-Tested Since Clear bit for check DFC_LASHmx" UBYTE DFC_OneToOne 1 100 0.00 1.000 BIT_MASK 0x20 FORMAT "%5.3" ECU_ADDRESS 0x4000CC0F /end MEASUREMENT
/begin MEASUREMENT DFC_b.TSC_LATP "Bit encoding / Ok-Tested Since Clear bit for check DFC_LATP" UBYTE DFC_OneToOne 1 100 0.00 1.000 BIT_MASK 0x20 FORMAT "%5.3" ECU_ADDRESS 0x4000CC10 /end MEASUREMENT
/begin MEASUREMENT DFC_b.TSC_LDLAHI "Bit encoding / Ok-Tested Since Clear bit for check DFC_LDLAHI" UBYTE DFC_OneToOne 1 100 0.00 1.000 BIT_MASK 0x20 FORMAT "%5.3" ECU_ADDRESS 0x4000CC11 /end MEASUREMENT
/begin MEASUREMENT DFC_b.TSC_LFS1Max "Bit encoding / Ok-Tested Since Clear bit for check DFC_LFS1Max" UBYTE DFC_OneToOne 1 100 0.00 1.000 BIT_MASK 0x20 FORMAT "%5.3" ECU_ADDRESS 0x4000CC12 /end MEASUREMENT
/begin MEASUREMENT DFC_b.TSC_LFS1Min "Bit encoding / Ok-Tested Since Clear bit for check DFC_LFS1Min" UBYTE DFC_OneToOne 1 100 0.00 1.000 BIT_MASK 0x20 FORMAT "%5.3" ECU_ADDRESS 0x4000CC13 /end MEASUREMENT
/begin MEASUREMENT DFC_b.TSC_LFS1Sig "Bit encoding / Ok-Tested Since Clear bit for check DFC_LFS1Sig" UBYTE DFC_OneToOne 1 100 0.00 1.000 BIT_MASK 0x20 FORMAT "%5.3" ECU_ADDRESS 0x4000CC14 /end MEASUREMENT
/begin MEASUREMENT DFC_b.TSC_LSHmax "Bit encoding / Ok-Tested Since Clear bit for check DFC_LSHmax" UBYTE DFC_OneToOne 1 100 0.00 1.000 BIT_MASK 0x20 FORMAT "%5.3" ECU_ADDRESS 0x4000CC15 /end MEASUREMENT
/begin MEASUREMENT DFC_b.TSC_LSHmin "Bit encoding / Ok-Tested Since Clear bit for check DFC_LSHmin" UBYTE DFC_OneToOne 1 100 0.00 1.000 BIT_MASK 0x20 FORMAT "%5.3" ECU_ADDRESS 0x4000CC16 /end MEASUREMENT
/begin MEASUREMENT DFC_b.TSC_LSHnpl "Bit encoding / Ok-Tested Since Clear bit for check DFC_LSHnpl" UBYTE DFC_OneToOne 1 100 0.00 1.000 BIT_MASK 0x20 FORMAT "%5.3" ECU_ADDRESS 0x4000CC17 /end MEASUREMENT
/begin MEASUREMENT DFC_b.TSC_LSHsig "Bit encoding / Ok-Tested Since Clear bit for check DFC_LSHsig" UBYTE DFC_OneToOne 1 100 0.00 1.000 BIT_MASK 0x20 FORMAT "%5.3" ECU_ADDRESS 0x4000CC18 /end MEASUREMENT
/begin MEASUREMENT DFC_b.TSC_LSVmax "Bit encoding / Ok-Tested Since Clear bit for check DFC_LSVmax" UBYTE DFC_OneToOne 1 100 0.00 1.000 BIT_MASK 0x20 FORMAT "%5.3" ECU_ADDRESS 0x4000CC19 /end MEASUREMENT
/begin MEASUREMENT DFC_b.TSC_LSVmin "Bit encoding / Ok-Tested Since Clear bit for check DFC_LSVmin" UBYTE DFC_OneToOne 1 100 0.00 1.000 BIT_MASK 0x20 FORMAT "%5.3" ECU_ADDRESS 0x4000CC1A /end MEASUREMENT
/begin MEASUREMENT DFC_b.TSC_LSVnpl "Bit encoding / Ok-Tested Since Clear bit for check DFC_LSVnpl" UBYTE DFC_OneToOne 1 100 0.00 1.000 BIT_MASK 0x20 FORMAT "%5.3" ECU_ADDRESS 0x4000CC1B /end MEASUREMENT
/begin MEASUREMENT DFC_b.TSC_LSVsig "Bit encoding / Ok-Tested Since Clear bit for check DFC_LSVsig" UBYTE DFC_OneToOne 1 100 0.00 1.000 BIT_MASK 0x20 FORMAT "%5.3" ECU_ADDRESS 0x4000CC1C /end MEASUREMENT
/begin MEASUREMENT DFC_b.TSC_MDCat "Bit encoding / Ok-Tested Since Clear bit for check DFC_MDCat" UBYTE DFC_OneToOne 1 100 0.00 1.000 BIT_MASK 0x20 FORMAT "%5.3" ECU_ADDRESS 0x4000CC1D /end MEASUREMENT
/begin MEASUREMENT DFC_b.TSC_MDCatCurr "Bit encoding / Ok-Tested Since Clear bit for check DFC_MDCatCurr" UBYTE DFC_OneToOne 1 100 0.00 1.000 BIT_MASK 0x20 FORMAT "%5.3" ECU_ADDRESS 0x4000CC1E /end MEASUREMENT
/begin MEASUREMENT DFC_b.TSC_MDCyl "Bit encoding / Ok-Tested Since Clear bit for check DFC_MDCyl" UBYTE DFC_OneToOne 1 100 0.00 1.000 BIT_MASK 0x20 FORMAT "%5.3" ECU_ADDRESS 0x4000CC1F /end MEASUREMENT
/begin MEASUREMENT DFC_b.TSC_MDEmi "Bit encoding / Ok-Tested Since Clear bit for check DFC_MDEmi" UBYTE DFC_OneToOne 1 100 0.00 1.000 BIT_MASK 0x20 FORMAT "%5.3" ECU_ADDRESS 0x4000CC20 /end MEASUREMENT
/begin MEASUREMENT DFC_b.TSC_MDEmiStrt "Bit encoding / Ok-Tested Since Clear bit for check DFC_MDEmiStrt" UBYTE DFC_OneToOne 1 100 0.00 1.000 BIT_MASK 0x20 FORMAT "%5.3" ECU_ADDRESS 0x4000CC21 /end MEASUREMENT
/begin MEASUREMENT DFC_b.TSC_MDMpl "Bit encoding / Ok-Tested Since Clear bit for check DFC_MDMpl" UBYTE DFC_OneToOne 1 100 0.00 1.000 BIT_MASK 0x20 FORMAT "%5.3" ECU_ADDRESS 0x4000CC22 /end MEASUREMENT
/begin MEASUREMENT DFC_b.TSC_MoCADCNTP "Bit encoding / Ok-Tested Since Clear bit for check DFC_MoCADCNTP" UBYTE DFC_OneToOne 1 100 0.00 1.000 BIT_MASK 0x20 FORMAT "%5.3" ECU_ADDRESS 0x4000CC23 /end MEASUREMENT
/begin MEASUREMENT DFC_b.TSC_MoCADCTst "Bit encoding / Ok-Tested Since Clear bit for check DFC_MoCADCTst" UBYTE DFC_OneToOne 1 100 0.00 1.000 BIT_MASK 0x20 FORMAT "%5.3" ECU_ADDRESS 0x4000CC24 /end MEASUREMENT
/begin MEASUREMENT DFC_b.TSC_MoFSidst "Bit encoding / Ok-Tested Since Clear bit for check DFC_MoFSidst" UBYTE DFC_OneToOne 1 100 0.00 1.000 BIT_MASK 0x20 FORMAT "%5.3" ECU_ADDRESS 0x4000CC25 /end MEASUREMENT
/begin MEASUREMENT DFC_b.TSC_OCWDACom "Bit encoding / Ok-Tested Since Clear bit for check DFC_OCWDACom" UBYTE DFC_OneToOne 1 100 0.00 1.000 BIT_MASK 0x20 FORMAT "%5.3" ECU_ADDRESS 0x4000CC26 /end MEASUREMENT
/begin MEASUREMENT DFC_b.TSC_OilPPSSwtMax "Bit encoding / Ok-Tested Since Clear bit for check DFC_OilPPSSwtMax" UBYTE DFC_OneToOne 1 100 0.00 1.000 BIT_MASK 0x20 FORMAT "%5.3" ECU_ADDRESS 0x4000CC27 /end MEASUREMENT
/begin MEASUREMENT DFC_b.TSC_OilPPSSwtMin "Bit encoding / Ok-Tested Since Clear bit for check DFC_OilPPSSwtMin" UBYTE DFC_OneToOne 1 100 0.00 1.000 BIT_MASK 0x20 FORMAT "%5.3" ECU_ADDRESS 0x4000CC28 /end MEASUREMENT
/begin MEASUREMENT DFC_b.TSC_OilPPSSwtSig "Bit encoding / Ok-Tested Since Clear bit for check DFC_OilPPSSwtSig" UBYTE DFC_OneToOne 1 100 0.00 1.000 BIT_MASK 0x20 FORMAT "%5.3" ECU_ADDRESS 0x4000CC29 /end MEASUREMENT
/begin MEASUREMENT DFC_b.TSC_OvHEngSpdLimr "Bit encoding / Ok-Tested Since Clear bit for check DFC_OvHEngSpdLimr" UBYTE DFC_OneToOne 1 100 0.00 1.000 BIT_MASK 0x20 FORMAT "%5.3" ECU_ADDRESS 0x4000CC2A /end MEASUREMENT
/begin MEASUREMENT DFC_b.TSC_RoVComVld "Bit encoding / Ok-Tested Since Clear bit for check DFC_RoVComVld" UBYTE DFC_OneToOne 1 100 0.00 1.000 BIT_MASK 0x20 FORMAT "%5.3" ECU_ADDRESS 0x4000CC2B /end MEASUREMENT
/begin MEASUREMENT DFC_b.TSC_RoVSNpl "Bit encoding / Ok-Tested Since Clear bit for check DFC_RoVSNpl" UBYTE DFC_OneToOne 1 100 0.00 1.000 BIT_MASK 0x20 FORMAT "%5.3" ECU_ADDRESS 0x4000CC2C /end MEASUREMENT
/begin MEASUREMENT DFC_b.TSC_RoVSOL "Bit encoding / Ok-Tested Since Clear bit for check DFC_RoVSOL" UBYTE DFC_OneToOne 1 100 0.00 1.000 BIT_MASK 0x20 FORMAT "%5.3" ECU_ADDRESS 0x4000CC2D /end MEASUREMENT
/begin MEASUREMENT DFC_b.TSC_RoVSSCB "Bit encoding / Ok-Tested Since Clear bit for check DFC_RoVSSCB" UBYTE DFC_OneToOne 1 100 0.00 1.000 BIT_MASK 0x20 FORMAT "%5.3" ECU_ADDRESS 0x4000CC2E /end MEASUREMENT
/begin MEASUREMENT DFC_b.TSC_RoVSSCG "Bit encoding / Ok-Tested Since Clear bit for check DFC_RoVSSCG" UBYTE DFC_OneToOne 1 100 0.00 1.000 BIT_MASK 0x20 FORMAT "%5.3" ECU_ADDRESS 0x4000CC2F /end MEASUREMENT
/begin MEASUREMENT DFC_b.TSC_SdSTNpl "Bit encoding / Ok-Tested Since Clear bit for check DFC_SdSTNpl" UBYTE DFC_OneToOne 1 100 0.00 1.000 BIT_MASK 0x20 FORMAT "%5.3" ECU_ADDRESS 0x4000CC30 /end MEASUREMENT
/begin MEASUREMENT DFC_b.TSC_SdSTSCB "Bit encoding / Ok-Tested Since Clear bit for check DFC_SdSTSCB" UBYTE DFC_OneToOne 1 100 0.00 1.000 BIT_MASK 0x20 FORMAT "%5.3" ECU_ADDRESS 0x4000CC31 /end MEASUREMENT
/begin MEASUREMENT DFC_b.TSC_SdSTSCG "Bit encoding / Ok-Tested Since Clear bit for check DFC_SdSTSCG" UBYTE DFC_OneToOne 1 100 0.00 1.000 BIT_MASK 0x20 FORMAT "%5.3" ECU_ADDRESS 0x4000CC32 /end MEASUREMENT
/begin MEASUREMENT DFC_b.TSC_SdSTSOL "Bit encoding / Ok-Tested Since Clear bit for check DFC_SdSTSOL" UBYTE DFC_OneToOne 1 100 0.00 1.000 BIT_MASK 0x20 FORMAT "%5.3" ECU_ADDRESS 0x4000CC33 /end MEASUREMENT
/begin MEASUREMENT DFC_b.TSC_TEVEmax "Bit encoding / Ok-Tested Since Clear bit for check DFC_TEVEmax" UBYTE DFC_OneToOne 1 100 0.00 1.000 BIT_MASK 0x20 FORMAT "%5.3" ECU_ADDRESS 0x4000CC34 /end MEASUREMENT
/begin MEASUREMENT DFC_b.TSC_TEVEmin "Bit encoding / Ok-Tested Since Clear bit for check DFC_TEVEmin" UBYTE DFC_OneToOne 1 100 0.00 1.000 BIT_MASK 0x20 FORMAT "%5.3" ECU_ADDRESS 0x4000CC35 /end MEASUREMENT
/begin MEASUREMENT DFC_b.TSC_TEVEsig "Bit encoding / Ok-Tested Since Clear bit for check DFC_TEVEsig" UBYTE DFC_OneToOne 1 100 0.00 1.000 BIT_MASK 0x20 FORMAT "%5.3" ECU_ADDRESS 0x4000CC36 /end MEASUREMENT
/begin MEASUREMENT DFC_b.TSC_TMnpl "Bit encoding / Ok-Tested Since Clear bit for check DFC_TMnpl" UBYTE DFC_OneToOne 1 100 0.00 1.000 BIT_MASK 0x20 FORMAT "%5.3" ECU_ADDRESS 0x4000CC37 /end MEASUREMENT
/begin MEASUREMENT DFC_b.TSC_UBmax "Bit encoding / Ok-Tested Since Clear bit for check DFC_UBmax" UBYTE DFC_OneToOne 1 100 0.00 1.000 BIT_MASK 0x20 FORMAT "%5.3" ECU_ADDRESS 0x4000CC38 /end MEASUREMENT
/begin MEASUREMENT DFC_b.TSC_UBmin "Bit encoding / Ok-Tested Since Clear bit for check DFC_UBmin" UBYTE DFC_OneToOne 1 100 0.00 1.000 BIT_MASK 0x20 FORMAT "%5.3" ECU_ADDRESS 0x4000CC39 /end MEASUREMENT
/begin MEASUREMENT DFC_b.TSC_UBnpl "Bit encoding / Ok-Tested Since Clear bit for check DFC_UBnpl" UBYTE DFC_OneToOne 1 100 0.00 1.000 BIT_MASK 0x20 FORMAT "%5.3" ECU_ADDRESS 0x4000CC3A /end MEASUREMENT
/begin MEASUREMENT DFC_b.TSC_VFZsig "Bit encoding / Ok-Tested Since Clear bit for check DFC_VFZsig" UBYTE DFC_OneToOne 1 100 0.00 1.000 BIT_MASK 0x20 FORMAT "%5.3" ECU_ADDRESS 0x4000CC3B /end MEASUREMENT
/begin MEASUREMENT DFC_b.TSC_VFZsig2 "Bit encoding / Ok-Tested Since Clear bit for check DFC_VFZsig2" UBYTE DFC_OneToOne 1 100 0.00 1.000 BIT_MASK 0x20 FORMAT "%5.3" ECU_ADDRESS 0x4000CC3C /end MEASUREMENT
/begin MEASUREMENT DFC_lenMaxCllsn "Measurement longest DFC Kollision" ULONG OneToOne 1 100 0.00 4294967295.00 FORMAT "%13.2" ECU_ADDRESS 0x4000CDDC /end MEASUREMENT
/begin MEASUREMENT DFC_nrCllsnClear "Number of DFC collisions at fcmclear" ULONG OneToOne 1 100 0.00 4294967295.00 FORMAT "%13.2" ECU_ADDRESS 0x40007F38 /end MEASUREMENT
/begin MEASUREMENT DFC_nrCllsnReInit "Number of DFC collisions at reInit" ULONG OneToOne 1 100 0.00 4294967295.00 FORMAT "%13.2" ECU_ADDRESS 0x40007F34 /end MEASUREMENT
/begin MEASUREMENT DFC_nrCllsnReport "Number of DFC collisions at report" ULONG OneToOne 1 100 0.00 4294967295.00 FORMAT "%13.2" ECU_ADDRESS 0x40007F30 /end MEASUREMENT
/begin MEASUREMENT DFC_numDfcMaxCllsn "DFC which encountered the longest collision" UWORD DFCDFP_Verb 1 100 0.00 186. FORMAT "%2.0" ECU_ADDRESS 0x4000CDDA /end MEASUREMENT
/begin MEASUREMENT DFC_st.DFC_Unused "Status of DFC / " UBYTE DFC_OneToOne 1 100 0.00 255.0 FORMAT "%5.1" ECU_ADDRESS 0x4000CB9C /end MEASUREMENT
/begin MEASUREMENT DFC_st.DFC_BusDiagOpenLoad_Can0 "Status of DFC / Status of diagnostic fault check DFC_BusDiagOpenLoad_Can0" UBYTE DFC_OneToOne 1 100 0.00 255.0 FORMAT "%5.1" ECU_ADDRESS 0x4000CB9D /end MEASUREMENT
/begin MEASUREMENT DFC_st.DFC_Com_ABSInfo_DLC "Status of DFC / Status of diagnostic fault check DFC_Com_ABSInfo_DLC" UBYTE DFC_OneToOne 1 100 0.00 255.0 FORMAT "%5.1" ECU_ADDRESS 0x4000CB9E /end MEASUREMENT
/begin MEASUREMENT DFC_st.DFC_Com_ABSInfo_TO "Status of DFC / Status of diagnostic fault check DFC_Com_ABSInfo_TO" UBYTE DFC_OneToOne 1 100 0.00 255.0 FORMAT "%5.1" ECU_ADDRESS 0x4000CB9F /end MEASUREMENT
/begin MEASUREMENT DFC_st.DFC_BusDiagBusOff_Can0 "Status of DFC / Status of diagnostic fault check DFC_BusDiagBusOff_Can0" UBYTE DFC_OneToOne 1 100 0.00 255.0 FORMAT "%5.1" ECU_ADDRESS 0x4000CBA0 /end MEASUREMENT
/begin MEASUREMENT DFC_st.DFC_DevLibBattUHi "Status of DFC / Status of diagnostic fault check DFC_DevLibBattUHi" UBYTE DFC_OneToOne 1 100 0.00 255.0 FORMAT "%5.1" ECU_ADDRESS 0x4000CBA1 /end MEASUREMENT
/begin MEASUREMENT DFC_st.DFC_DevLibBattULo "Status of DFC / Status of diagnostic fault check DFC_DevLibBattULo" UBYTE DFC_OneToOne 1 100 0.00 255.0 FORMAT "%5.1" ECU_ADDRESS 0x4000CBA2 /end MEASUREMENT
/begin MEASUREMENT DFC_st.DFC_StrtOL "Status of DFC / Status of diagnostic fault check DFC_StrtOL" UBYTE DFC_OneToOne 1 100 0.00 255.0 FORMAT "%5.1" ECU_ADDRESS 0x4000CBA3 /end MEASUREMENT
/begin MEASUREMENT DFC_st.DFC_StrtOvrTemp "Status of DFC / Status of diagnostic fault check DFC_StrtOvrTemp" UBYTE DFC_OneToOne 1 100 0.00 255.0 FORMAT "%5.1" ECU_ADDRESS 0x4000CBA4 /end MEASUREMENT
/begin MEASUREMENT DFC_st.DFC_StrtSCB "Status of DFC / Status of diagnostic fault check DFC_StrtSCB" UBYTE DFC_OneToOne 1 100 0.00 255.0 FORMAT "%5.1" ECU_ADDRESS 0x4000CBA5 /end MEASUREMENT
/begin MEASUREMENT DFC_st.DFC_StrtSCG "Status of DFC / Status of diagnostic fault check DFC_StrtSCG" UBYTE DFC_OneToOne 1 100 0.00 255.0 FORMAT "%5.1" ECU_ADDRESS 0x4000CBA6 /end MEASUREMENT
/begin MEASUREMENT DFC_st.DFC_MILLmpOL "Status of DFC / Status of diagnostic fault check DFC_MILLmpOL" UBYTE DFC_OneToOne 1 100 0.00 255.0 FORMAT "%5.1" ECU_ADDRESS 0x4000CBA7 /end MEASUREMENT
/begin MEASUREMENT DFC_st.DFC_MILLmpOT "Status of DFC / Status of diagnostic fault check DFC_MILLmpOT" UBYTE DFC_OneToOne 1 100 0.00 255.0 FORMAT "%5.1" ECU_ADDRESS 0x4000CBA8 /end MEASUREMENT
/begin MEASUREMENT DFC_st.DFC_MILLmpSCB "Status of DFC / Status of diagnostic fault check DFC_MILLmpSCB" UBYTE DFC_OneToOne 1 100 0.00 255.0 FORMAT "%5.1" ECU_ADDRESS 0x4000CBA9 /end MEASUREMENT
/begin MEASUREMENT DFC_st.DFC_MILLmpSCG "Status of DFC / Status of diagnostic fault check DFC_MILLmpSCG" UBYTE DFC_OneToOne 1 100 0.00 255.0 FORMAT "%5.1" ECU_ADDRESS 0x4000CBAA /end MEASUREMENT
/begin MEASUREMENT DFC_st.DFC_EV1max "Status of DFC / Status of diagnostic fault check DFC_EV1max" UBYTE DFC_OneToOne 1 100 0.00 255.0 FORMAT "%5.1" ECU_ADDRESS 0x4000CBAB /end MEASUREMENT
/begin MEASUREMENT DFC_st.DFC_EV1min "Status of DFC / Status of diagnostic fault check DFC_EV1min" UBYTE DFC_OneToOne 1 100 0.00 255.0 FORMAT "%5.1" ECU_ADDRESS 0x4000CBAC /end MEASUREMENT
/begin MEASUREMENT DFC_st.DFC_EV1sig "Status of DFC / Status of diagnostic fault check DFC_EV1sig" UBYTE DFC_OneToOne 1 100 0.00 255.0 FORMAT "%5.1" ECU_ADDRESS 0x4000CBAD /end MEASUREMENT
/begin MEASUREMENT DFC_st.DFC_CEngDsTPlausSTC "Status of DFC / Status of diagnostic fault check DFC_CEngDsTPlausSTC" UBYTE DFC_OneToOne 1 100 0.00 255.0 FORMAT "%5.1" ECU_ADDRESS 0x4000CBAE /end MEASUREMENT
/begin MEASUREMENT DFC_st.DFC_ClthStkOpn "Status of DFC / Status of diagnostic fault check DFC_ClthStkOpn" UBYTE DFC_OneToOne 1 100 0.00 255.0 FORMAT "%5.1" ECU_ADDRESS 0x4000CBAF /end MEASUREMENT
/begin MEASUREMENT DFC_st.DFC_EVX "Status of DFC / Status of diagnostic fault check DFC_EVX" UBYTE DFC_OneToOne 1 100 0.00 255.0 FORMAT "%5.1" ECU_ADDRESS 0x4000CBB0 /end MEASUREMENT
/begin MEASUREMENT DFC_st.DFC_IntkAirTAirFltDsSTC "Status of DFC / Status of diagnostic fault check DFC_IntkAirTAirFltDsSTC" UBYTE DFC_OneToOne 1 100 0.00 255.0 FORMAT "%5.1" ECU_ADDRESS 0x4000CBB1 /end MEASUREMENT
/begin MEASUREMENT DFC_st.DFC_RoughRoad "Status of DFC / Status of diagnostic fault check DFC_RoughRoad" UBYTE DFC_OneToOne 1 100 0.00 255.0 FORMAT "%5.1" ECU_ADDRESS 0x4000CBB2 /end MEASUREMENT
/begin MEASUREMENT DFC_st.DFC_SSpMon1 "Status of DFC / Status of diagnostic fault check DFC_SSpMon1" UBYTE DFC_OneToOne 1 100 0.00 255.0 FORMAT "%5.1" ECU_ADDRESS 0x4000CBB3 /end MEASUREMENT
/begin MEASUREMENT DFC_st.DFC_SSpMon1OT "Status of DFC / Status of diagnostic fault check DFC_SSpMon1OT" UBYTE DFC_OneToOne 1 100 0.00 255.0 FORMAT "%5.1" ECU_ADDRESS 0x4000CBB4 /end MEASUREMENT
/begin MEASUREMENT DFC_st.DFC_SSpMon1OV "Status of DFC / Status of diagnostic fault check DFC_SSpMon1OV" UBYTE DFC_OneToOne 1 100 0.00 255.0 FORMAT "%5.1" ECU_ADDRESS 0x4000CBB5 /end MEASUREMENT
/begin MEASUREMENT DFC_st.DFC_SSpMon1SCG "Status of DFC / Status of diagnostic fault check DFC_SSpMon1SCG" UBYTE DFC_OneToOne 1 100 0.00 255.0 FORMAT "%5.1" ECU_ADDRESS 0x4000CBB6 /end MEASUREMENT
/begin MEASUREMENT DFC_st.DFC_SSpMon1UV "Status of DFC / Status of diagnostic fault check DFC_SSpMon1UV" UBYTE DFC_OneToOne 1 100 0.00 255.0 FORMAT "%5.1" ECU_ADDRESS 0x4000CBB7 /end MEASUREMENT
/begin MEASUREMENT DFC_st.DFC_SSpMon2 "Status of DFC / Status of diagnostic fault check DFC_SSpMon2" UBYTE DFC_OneToOne 1 100 0.00 255.0 FORMAT "%5.1" ECU_ADDRESS 0x4000CBB8 /end MEASUREMENT
/begin MEASUREMENT DFC_st.DFC_SSpMon2OT "Status of DFC / Status of diagnostic fault check DFC_SSpMon2OT" UBYTE DFC_OneToOne 1 100 0.00 255.0 FORMAT "%5.1" ECU_ADDRESS 0x4000CBB9 /end MEASUREMENT
/begin MEASUREMENT DFC_st.DFC_SSpMon2OV "Status of DFC / Status of diagnostic fault check DFC_SSpMon2OV" UBYTE DFC_OneToOne 1 100 0.00 255.0 FORMAT "%5.1" ECU_ADDRESS 0x4000CBBA /end MEASUREMENT
/begin MEASUREMENT DFC_st.DFC_SSpMon2SCG "Status of DFC / Status of diagnostic fault check DFC_SSpMon2SCG" UBYTE DFC_OneToOne 1 100 0.00 255.0 FORMAT "%5.1" ECU_ADDRESS 0x4000CBBB /end MEASUREMENT
/begin MEASUREMENT DFC_st.DFC_SSpMon2UV "Status of DFC / Status of diagnostic fault check DFC_SSpMon2UV" UBYTE DFC_OneToOne 1 100 0.00 255.0 FORMAT "%5.1" ECU_ADDRESS 0x4000CBBC /end MEASUREMENT
/begin MEASUREMENT DFC_st.DFC_CANIF_E_CTRL_NOT_SLEEP_ERROR_VALUE "Status of DFC / Status of diagnostic fault check DFC_CANIF_E_CTRL_NOT_SLEEP_ERROR_VALUE" UBYTE DFC_OneToOne 1 100 0.00 255.0 FORMAT "%5.1" ECU_ADDRESS 0x4000CBBD /end MEASUREMENT
/begin MEASUREMENT DFC_st.DFC_CANIF_E_CTRL_STOPPED_ERROR_VALUE "Status of DFC / Status of diagnostic fault check DFC_CANIF_E_CTRL_STOPPED_ERROR_VALUE" UBYTE DFC_OneToOne 1 100 0.00 255.0 FORMAT "%5.1" ECU_ADDRESS 0x4000CBBE /end MEASUREMENT
/begin MEASUREMENT DFC_st.DFC_CANIF_E_INVALID_DLC_ERROR "Status of DFC / Status of diagnostic fault check DFC_CANIF_E_INVALID_DLC_ERROR" UBYTE DFC_OneToOne 1 100 0.00 255.0 FORMAT "%5.1" ECU_ADDRESS 0x4000CBBF /end MEASUREMENT
/begin MEASUREMENT DFC_st.DFC_CANNM_E_CANIF_TRANSMIT_ERROR "Status of DFC / Status of diagnostic fault check DFC_CANNM_E_CANIF_TRANSMIT_ERROR" UBYTE DFC_OneToOne 1 100 0.00 255.0 FORMAT "%5.1" ECU_ADDRESS 0x4000CBC0 /end MEASUREMENT
/begin MEASUREMENT DFC_st.DFC_CANNM_E_INIT_FAILED "Status of DFC / Status of diagnostic fault check DFC_CANNM_E_INIT_FAILED" UBYTE DFC_OneToOne 1 100 0.00 255.0 FORMAT "%5.1" ECU_ADDRESS 0x4000CBC1 /end MEASUREMENT
/begin MEASUREMENT DFC_st.DFC_CANNM_E_NETWORK_TIMEOUT "Status of DFC / Status of diagnostic fault check DFC_CANNM_E_NETWORK_TIMEOUT" UBYTE DFC_OneToOne 1 100 0.00 255.0 FORMAT "%5.1" ECU_ADDRESS 0x4000CBC2 /end MEASUREMENT
/begin MEASUREMENT DFC_st.DFC_CAN_E_TIMEOUT "Status of DFC / Status of diagnostic fault check DFC_CAN_E_TIMEOUT" UBYTE DFC_OneToOne 1 100 0.00 255.0 FORMAT "%5.1" ECU_ADDRESS 0x4000CBC3 /end MEASUREMENT
/begin MEASUREMENT DFC_st.DFC_COMM_E_NET_START_IND_CHANNEL_0 "Status of DFC / Status of diagnostic fault check DFC_COMM_E_NET_START_IND_CHANNEL_0" UBYTE DFC_OneToOne 1 100 0.00 255.0 FORMAT "%5.1" ECU_ADDRESS 0x4000CBC4 /end MEASUREMENT
/begin MEASUREMENT DFC_st.DFC_COMM_E_NET_START_IND_CHANNEL_1 "Status of DFC / Status of diagnostic fault check DFC_COMM_E_NET_START_IND_CHANNEL_1" UBYTE DFC_OneToOne 1 100 0.00 255.0 FORMAT "%5.1" ECU_ADDRESS 0x4000CBC5 /end MEASUREMENT
/begin MEASUREMENT DFC_st.DFC_COMM_E_NET_START_IND_CHANNEL_2 "Status of DFC / Status of diagnostic fault check DFC_COMM_E_NET_START_IND_CHANNEL_2" UBYTE DFC_OneToOne 1 100 0.00 255.0 FORMAT "%5.1" ECU_ADDRESS 0x4000CBC6 /end MEASUREMENT
/begin MEASUREMENT DFC_st.DFC_COMM_E_NET_START_IND_CHANNEL_3 "Status of DFC / Status of diagnostic fault check DFC_COMM_E_NET_START_IND_CHANNEL_3" UBYTE DFC_OneToOne 1 100 0.00 255.0 FORMAT "%5.1" ECU_ADDRESS 0x4000CBC7 /end MEASUREMENT
/begin MEASUREMENT DFC_st.DFC_COMM_E_NET_START_IND_CHANNEL_4 "Status of DFC / Status of diagnostic fault check DFC_COMM_E_NET_START_IND_CHANNEL_4" UBYTE DFC_OneToOne 1 100 0.00 255.0 FORMAT "%5.1" ECU_ADDRESS 0x4000CBC8 /end MEASUREMENT
/begin MEASUREMENT DFC_st.DFC_COMM_E_NET_START_IND_CHANNEL_5 "Status of DFC / Status of diagnostic fault check DFC_COMM_E_NET_START_IND_CHANNEL_5" UBYTE DFC_OneToOne 1 100 0.00 255.0 FORMAT "%5.1" ECU_ADDRESS 0x4000CBC9 /end MEASUREMENT
/begin MEASUREMENT DFC_st.DFC_PDUR_E_INIT_FAILED "Status of DFC / Status of diagnostic fault check DFC_PDUR_E_INIT_FAILED" UBYTE DFC_OneToOne 1 100 0.00 255.0 FORMAT "%5.1" ECU_ADDRESS 0x4000CBCA /end MEASUREMENT
/begin MEASUREMENT DFC_st.DFC_PDUR_E_PDU_INSTANCE_LOST "Status of DFC / Status of diagnostic fault check DFC_PDUR_E_PDU_INSTANCE_LOST" UBYTE DFC_OneToOne 1 100 0.00 255.0 FORMAT "%5.1" ECU_ADDRESS 0x4000CBCB /end MEASUREMENT
/begin MEASUREMENT DFC_st.DFC_RBA_IOEXTLIB_KEEPALIVE_DRV "Status of DFC / Status of diagnostic fault check DFC_RBA_IOEXTLIB_KEEPALIVE_DRV" UBYTE DFC_OneToOne 1 100 0.00 255.0 FORMAT "%5.1" ECU_ADDRESS 0x4000CBCC /end MEASUREMENT
/begin MEASUREMENT DFC_st.DFC_RBA_IOEXTLIB_KEEPALIVE_INI "Status of DFC / Status of diagnostic fault check DFC_RBA_IOEXTLIB_KEEPALIVE_INI" UBYTE DFC_OneToOne 1 100 0.00 255.0 FORMAT "%5.1" ECU_ADDRESS 0x4000CBCD /end MEASUREMENT
/begin MEASUREMENT DFC_st.DFC_rba_IoSigRtc_StopCounter "Status of DFC / Status of diagnostic fault check DFC_rba_IoSigRtc_StopCounter" UBYTE DFC_OneToOne 1 100 0.00 255.0 FORMAT "%5.1" ECU_ADDRESS 0x4000CBCE /end MEASUREMENT
/begin MEASUREMENT DFC_st.DFC_rba_MultiStackTrace_Threshold "Status of DFC / Status of diagnostic fault check DFC_rba_MultiStackTrace_Threshold" UBYTE DFC_OneToOne 1 100 0.00 255.0 FORMAT "%5.1" ECU_ADDRESS 0x4000CBCF /end MEASUREMENT
/begin MEASUREMENT DFC_st.DFC_rba_MRly_Diag_Stk_Event "Status of DFC / Status of diagnostic fault check DFC_rba_MRly_Diag_Stk_Event" UBYTE DFC_OneToOne 1 100 0.00 255.0 FORMAT "%5.1" ECU_ADDRESS 0x4000CBD0 /end MEASUREMENT
/begin MEASUREMENT DFC_st.DFC_rba_SyC_IrrSwOffTrigEngRun_Event "Status of DFC / Status of diagnostic fault check DFC_rba_SyC_IrrSwOffTrigEngRun_Event" UBYTE DFC_OneToOne 1 100 0.00 255.0 FORMAT "%5.1" ECU_ADDRESS 0x4000CBD1 /end MEASUREMENT
/begin MEASUREMENT DFC_st.DFC_rba_T15_Diag_ComInVld_Event "Status of DFC / Status of diagnostic fault check DFC_rba_T15_Diag_ComInVld_Event" UBYTE DFC_OneToOne 1 100 0.00 255.0 FORMAT "%5.1" ECU_ADDRESS 0x4000CBD2 /end MEASUREMENT
/begin MEASUREMENT DFC_st.DFC_rba_T15_Diag_ComOff_HwOn_Event "Status of DFC / Status of diagnostic fault check DFC_rba_T15_Diag_ComOff_HwOn_Event" UBYTE DFC_OneToOne 1 100 0.00 255.0 FORMAT "%5.1" ECU_ADDRESS 0x4000CBD3 /end MEASUREMENT
/begin MEASUREMENT DFC_st.DFC_rba_T15_Diag_ComOn_HwOff_Event "Status of DFC / Status of diagnostic fault check DFC_rba_T15_Diag_ComOn_HwOff_Event" UBYTE DFC_OneToOne 1 100 0.00 255.0 FORMAT "%5.1" ECU_ADDRESS 0x4000CBD4 /end MEASUREMENT
/begin MEASUREMENT DFC_st.DFC_BypAirActrOcCoil1 "Status of DFC / Status of diagnostic fault check DFC_BypAirActrOcCoil1" UBYTE DFC_OneToOne 1 100 0.00 255.0 FORMAT "%5.1" ECU_ADDRESS 0x4000CBD5 /end MEASUREMENT
/begin MEASUREMENT DFC_st.DFC_BypAirActrOcCoil2 "Status of DFC / Status of diagnostic fault check DFC_BypAirActrOcCoil2" UBYTE DFC_OneToOne 1 100 0.00 255.0 FORMAT "%5.1" ECU_ADDRESS 0x4000CBD6 /end MEASUREMENT
/begin MEASUREMENT DFC_st.DFC_BypAirActrOlCoil1 "Status of DFC / Status of diagnostic fault check DFC_BypAirActrOlCoil1" UBYTE DFC_OneToOne 1 100 0.00 255.0 FORMAT "%5.1" ECU_ADDRESS 0x4000CBD7 /end MEASUREMENT
/begin MEASUREMENT DFC_st.DFC_BypAirActrOlCoil2 "Status of DFC / Status of diagnostic fault check DFC_BypAirActrOlCoil2" UBYTE DFC_OneToOne 1 100 0.00 255.0 FORMAT "%5.1" ECU_ADDRESS 0x4000CBD8 /end MEASUREMENT
/begin MEASUREMENT DFC_st.DFC_BypAirActrOt "Status of DFC / Status of diagnostic fault check DFC_BypAirActrOt" UBYTE DFC_OneToOne 1 100 0.00 255.0 FORMAT "%5.1" ECU_ADDRESS 0x4000CBD9 /end MEASUREMENT
/begin MEASUREMENT DFC_st.DFC_BypAirActrScbCoil1 "Status of DFC / Status of diagnostic fault check DFC_BypAirActrScbCoil1" UBYTE DFC_OneToOne 1 100 0.00 255.0 FORMAT "%5.1" ECU_ADDRESS 0x4000CBDA /end MEASUREMENT
/begin MEASUREMENT DFC_st.DFC_BypAirActrScbCoil2 "Status of DFC / Status of diagnostic fault check DFC_BypAirActrScbCoil2" UBYTE DFC_OneToOne 1 100 0.00 255.0 FORMAT "%5.1" ECU_ADDRESS 0x4000CBDB /end MEASUREMENT
/begin MEASUREMENT DFC_st.DFC_BypAirActrScgCoil1 "Status of DFC / Status of diagnostic fault check DFC_BypAirActrScgCoil1" UBYTE DFC_OneToOne 1 100 0.00 255.0 FORMAT "%5.1" ECU_ADDRESS 0x4000CBDC /end MEASUREMENT
/begin MEASUREMENT DFC_st.DFC_BypAirActrScgCoil2 "Status of DFC / Status of diagnostic fault check DFC_BypAirActrScgCoil2" UBYTE DFC_OneToOne 1 100 0.00 255.0 FORMAT "%5.1" ECU_ADDRESS 0x4000CBDD /end MEASUREMENT
/begin MEASUREMENT DFC_st.DFC_CEngDsTPhysRngHi "Status of DFC / Status of diagnostic fault check DFC_CEngDsTPhysRngHi" UBYTE DFC_OneToOne 1 100 0.00 255.0 FORMAT "%5.1" ECU_ADDRESS 0x4000CBDE /end MEASUREMENT
/begin MEASUREMENT DFC_st.DFC_CEngDsTPhysRngLo "Status of DFC / Status of diagnostic fault check DFC_CEngDsTPhysRngLo" UBYTE DFC_OneToOne 1 100 0.00 255.0 FORMAT "%5.1" ECU_ADDRESS 0x4000CBDF /end MEASUREMENT
/begin MEASUREMENT DFC_st.DFC_CEngDsTSRCMax "Status of DFC / Status of diagnostic fault check DFC_CEngDsTSRCMax" UBYTE DFC_OneToOne 1 100 0.00 255.0 FORMAT "%5.1" ECU_ADDRESS 0x4000CBE0 /end MEASUREMENT
/begin MEASUREMENT DFC_st.DFC_CEngDsTSRCMin "Status of DFC / Status of diagnostic fault check DFC_CEngDsTSRCMin" UBYTE DFC_OneToOne 1 100 0.00 255.0 FORMAT "%5.1" ECU_ADDRESS 0x4000CBE1 /end MEASUREMENT
/begin MEASUREMENT DFC_st.DFC_DKmax "Status of DFC / Status of diagnostic fault check DFC_DKmax" UBYTE DFC_OneToOne 1 100 0.00 255.0 FORMAT "%5.1" ECU_ADDRESS 0x4000CBE2 /end MEASUREMENT
/begin MEASUREMENT DFC_st.DFC_DKmin "Status of DFC / Status of diagnostic fault check DFC_DKmin" UBYTE DFC_OneToOne 1 100 0.00 255.0 FORMAT "%5.1" ECU_ADDRESS 0x4000CBE3 /end MEASUREMENT
/begin MEASUREMENT DFC_st.DFC_DLLRmax "Status of DFC / Status of diagnostic fault check DFC_DLLRmax" UBYTE DFC_OneToOne 1 100 0.00 255.0 FORMAT "%5.1" ECU_ADDRESS 0x4000CBE4 /end MEASUREMENT
/begin MEASUREMENT DFC_st.DFC_DLLRmin "Status of DFC / Status of diagnostic fault check DFC_DLLRmin" UBYTE DFC_OneToOne 1 100 0.00 255.0 FORMAT "%5.1" ECU_ADDRESS 0x4000CBE5 /end MEASUREMENT
/begin MEASUREMENT DFC_st.DFC_DLLRnpl "Status of DFC / Status of diagnostic fault check DFC_DLLRnpl" UBYTE DFC_OneToOne 1 100 0.00 255.0 FORMAT "%5.1" ECU_ADDRESS 0x4000CBE6 /end MEASUREMENT
/begin MEASUREMENT DFC_st.DFC_DSSRngMax "Status of DFC / Status of diagnostic fault check DFC_DSSRngMax" UBYTE DFC_OneToOne 1 100 0.00 255.0 FORMAT "%5.1" ECU_ADDRESS 0x4000CBE7 /end MEASUREMENT
/begin MEASUREMENT DFC_st.DFC_DSSRngMin "Status of DFC / Status of diagnostic fault check DFC_DSSRngMin" UBYTE DFC_OneToOne 1 100 0.00 255.0 FORMAT "%5.1" ECU_ADDRESS 0x4000CBE8 /end MEASUREMENT
/begin MEASUREMENT DFC_st.DFC_DSSmax "Status of DFC / Status of diagnostic fault check DFC_DSSmax" UBYTE DFC_OneToOne 1 100 0.00 255.0 FORMAT "%5.1" ECU_ADDRESS 0x4000CBE9 /end MEASUREMENT
/begin MEASUREMENT DFC_st.DFC_DSSmin "Status of DFC / Status of diagnostic fault check DFC_DSSmin" UBYTE DFC_OneToOne 1 100 0.00 255.0 FORMAT "%5.1" ECU_ADDRESS 0x4000CBEA /end MEASUREMENT
/begin MEASUREMENT DFC_st.DFC_DSSnpl "Status of DFC / Status of diagnostic fault check DFC_DSSnpl" UBYTE DFC_OneToOne 1 100 0.00 255.0 FORMAT "%5.1" ECU_ADDRESS 0x4000CBEB /end MEASUREMENT
/begin MEASUREMENT DFC_st.DFC_DSSnplMax "Status of DFC / Status of diagnostic fault check DFC_DSSnplMax" UBYTE DFC_OneToOne 1 100 0.00 255.0 FORMAT "%5.1" ECU_ADDRESS 0x4000CBEC /end MEASUREMENT
/begin MEASUREMENT DFC_st.DFC_DSSnplMin "Status of DFC / Status of diagnostic fault check DFC_DSSnplMin" UBYTE DFC_OneToOne 1 100 0.00 255.0 FORMAT "%5.1" ECU_ADDRESS 0x4000CBED /end MEASUREMENT
/begin MEASUREMENT DFC_st.DFC_DSSsig "Status of DFC / Status of diagnostic fault check DFC_DSSsig" UBYTE DFC_OneToOne 1 100 0.00 255.0 FORMAT "%5.1" ECU_ADDRESS 0x4000CBEE /end MEASUREMENT
/begin MEASUREMENT DFC_st.DFC_EpmCrSErrSig "Status of DFC / Status of diagnostic fault check DFC_EpmCrSErrSig" UBYTE DFC_OneToOne 1 100 0.00 255.0 FORMAT "%5.1" ECU_ADDRESS 0x4000CBEF /end MEASUREMENT
/begin MEASUREMENT DFC_st.DFC_EpmCrSNoSig "Status of DFC / Status of diagnostic fault check DFC_EpmCrSNoSig" UBYTE DFC_OneToOne 1 100 0.00 255.0 FORMAT "%5.1" ECU_ADDRESS 0x4000CBF0 /end MEASUREMENT
/begin MEASUREMENT DFC_st.DFC_HEGOS1B1ElecNpl "Status of DFC / Status of diagnostic fault check DFC_HEGOS1B1ElecNpl" UBYTE DFC_OneToOne 1 100 0.00 255.0 FORMAT "%5.1" ECU_ADDRESS 0x4000CBF1 /end MEASUREMENT
/begin MEASUREMENT DFC_st.DFC_HSH "Status of DFC / Status of diagnostic fault check DFC_HSH" UBYTE DFC_OneToOne 1 100 0.00 255.0 FORMAT "%5.1" ECU_ADDRESS 0x4000CBF2 /end MEASUREMENT
/begin MEASUREMENT DFC_st.DFC_HSHEmax "Status of DFC / Status of diagnostic fault check DFC_HSHEmax" UBYTE DFC_OneToOne 1 100 0.00 255.0 FORMAT "%5.1" ECU_ADDRESS 0x4000CBF3 /end MEASUREMENT
/begin MEASUREMENT DFC_st.DFC_HSHEmin "Status of DFC / Status of diagnostic fault check DFC_HSHEmin" UBYTE DFC_OneToOne 1 100 0.00 255.0 FORMAT "%5.1" ECU_ADDRESS 0x4000CBF4 /end MEASUREMENT
/begin MEASUREMENT DFC_st.DFC_HSHEsig "Status of DFC / Status of diagnostic fault check DFC_HSHEsig" UBYTE DFC_OneToOne 1 100 0.00 255.0 FORMAT "%5.1" ECU_ADDRESS 0x4000CBF5 /end MEASUREMENT
/begin MEASUREMENT DFC_st.DFC_HSV "Status of DFC / Status of diagnostic fault check DFC_HSV" UBYTE DFC_OneToOne 1 100 0.00 255.0 FORMAT "%5.1" ECU_ADDRESS 0x4000CBF6 /end MEASUREMENT
/begin MEASUREMENT DFC_st.DFC_HSVEmax "Status of DFC / Status of diagnostic fault check DFC_HSVEmax" UBYTE DFC_OneToOne 1 100 0.00 255.0 FORMAT "%5.1" ECU_ADDRESS 0x4000CBF7 /end MEASUREMENT
/begin MEASUREMENT DFC_st.DFC_HSVEmin "Status of DFC / Status of diagnostic fault check DFC_HSVEmin" UBYTE DFC_OneToOne 1 100 0.00 255.0 FORMAT "%5.1" ECU_ADDRESS 0x4000CBF8 /end MEASUREMENT
/begin MEASUREMENT DFC_st.DFC_HSVEsig "Status of DFC / Status of diagnostic fault check DFC_HSVEsig" UBYTE DFC_OneToOne 1 100 0.00 255.0 FORMAT "%5.1" ECU_ADDRESS 0x4000CBF9 /end MEASUREMENT
/begin MEASUREMENT DFC_st.DFC_HdLampMax "Status of DFC / Status of diagnostic fault check DFC_HdLampMax" UBYTE DFC_OneToOne 1 100 0.00 255.0 FORMAT "%5.1" ECU_ADDRESS 0x4000CBFA /end MEASUREMENT
/begin MEASUREMENT DFC_st.DFC_HdLampMin "Status of DFC / Status of diagnostic fault check DFC_HdLampMin" UBYTE DFC_OneToOne 1 100 0.00 255.0 FORMAT "%5.1" ECU_ADDRESS 0x4000CBFB /end MEASUREMENT
/begin MEASUREMENT DFC_st.DFC_HdLampSig "Status of DFC / Status of diagnostic fault check DFC_HdLampSig" UBYTE DFC_OneToOne 1 100 0.00 255.0 FORMAT "%5.1" ECU_ADDRESS 0x4000CBFC /end MEASUREMENT
/begin MEASUREMENT DFC_st.DFC_IgnCoil1Err "Status of DFC / Status of diagnostic fault check DFC_IgnCoil1Err" UBYTE DFC_OneToOne 1 100 0.00 255.0 FORMAT "%5.1" ECU_ADDRESS 0x4000CBFD /end MEASUREMENT
/begin MEASUREMENT DFC_st.DFC_IgnCoil2Err "Status of DFC / Status of diagnostic fault check DFC_IgnCoil2Err" UBYTE DFC_OneToOne 1 100 0.00 255.0 FORMAT "%5.1" ECU_ADDRESS 0x4000CBFE /end MEASUREMENT
/begin MEASUREMENT DFC_st.DFC_IgnIgbtDiagSCG_0 "Status of DFC / Status of diagnostic fault check DFC_IgnIgbtDiagSCG_0" UBYTE DFC_OneToOne 1 100 0.00 255.0 FORMAT "%5.1" ECU_ADDRESS 0x4000CBFF /end MEASUREMENT
/begin MEASUREMENT DFC_st.DFC_IgnIgbtDiagSCG_1 "Status of DFC / Status of diagnostic fault check DFC_IgnIgbtDiagSCG_1" UBYTE DFC_OneToOne 1 100 0.00 255.0 FORMAT "%5.1" ECU_ADDRESS 0x4000CC00 /end MEASUREMENT
/begin MEASUREMENT DFC_st.DFC_IntkAirTAirFltDsPRCMax "Status of DFC / Status of diagnostic fault check DFC_IntkAirTAirFltDsPRCMax" UBYTE DFC_OneToOne 1 100 0.00 255.0 FORMAT "%5.1" ECU_ADDRESS 0x4000CC01 /end MEASUREMENT
/begin MEASUREMENT DFC_st.DFC_IntkAirTAirFltDsPRCMin "Status of DFC / Status of diagnostic fault check DFC_IntkAirTAirFltDsPRCMin" UBYTE DFC_OneToOne 1 100 0.00 255.0 FORMAT "%5.1" ECU_ADDRESS 0x4000CC02 /end MEASUREMENT
/begin MEASUREMENT DFC_st.DFC_IntkAirTAirFltDsSRCMax "Status of DFC / Status of diagnostic fault check DFC_IntkAirTAirFltDsSRCMax" UBYTE DFC_OneToOne 1 100 0.00 255.0 FORMAT "%5.1" ECU_ADDRESS 0x4000CC03 /end MEASUREMENT
/begin MEASUREMENT DFC_st.DFC_IntkAirTAirFltDsSRCMin "Status of DFC / Status of diagnostic fault check DFC_IntkAirTAirFltDsSRCMin" UBYTE DFC_OneToOne 1 100 0.00 255.0 FORMAT "%5.1" ECU_ADDRESS 0x4000CC04 /end MEASUREMENT
/begin MEASUREMENT DFC_st.DFC_IntkMnfldPNoSyn "Status of DFC / Status of diagnostic fault check DFC_IntkMnfldPNoSyn" UBYTE DFC_OneToOne 1 100 0.00 255.0 FORMAT "%5.1" ECU_ADDRESS 0x4000CC05 /end MEASUREMENT
/begin MEASUREMENT DFC_st.DFC_KAT "Status of DFC / Status of diagnostic fault check DFC_KAT" UBYTE DFC_OneToOne 1 100 0.00 255.0 FORMAT "%5.1" ECU_ADDRESS 0x4000CC06 /end MEASUREMENT
/begin MEASUREMENT DFC_st.DFC_KPEmax "Status of DFC / Status of diagnostic fault check DFC_KPEmax" UBYTE DFC_OneToOne 1 100 0.00 255.0 FORMAT "%5.1" ECU_ADDRESS 0x4000CC07 /end MEASUREMENT
/begin MEASUREMENT DFC_st.DFC_KPEmin "Status of DFC / Status of diagnostic fault check DFC_KPEmin" UBYTE DFC_OneToOne 1 100 0.00 255.0 FORMAT "%5.1" ECU_ADDRESS 0x4000CC08 /end MEASUREMENT
/begin MEASUREMENT DFC_st.DFC_KPEsig "Status of DFC / Status of diagnostic fault check DFC_KPEsig" UBYTE DFC_OneToOne 1 100 0.00 255.0 FORMAT "%5.1" ECU_ADDRESS 0x4000CC09 /end MEASUREMENT
/begin MEASUREMENT DFC_st.DFC_KVSFmax "Status of DFC / Status of diagnostic fault check DFC_KVSFmax" UBYTE DFC_OneToOne 1 100 0.00 255.0 FORMAT "%5.1" ECU_ADDRESS 0x4000CC0A /end MEASUREMENT
/begin MEASUREMENT DFC_st.DFC_KVSFmin "Status of DFC / Status of diagnostic fault check DFC_KVSFmin" UBYTE DFC_OneToOne 1 100 0.00 255.0 FORMAT "%5.1" ECU_ADDRESS 0x4000CC0B /end MEASUREMENT
/begin MEASUREMENT DFC_st.DFC_KVSOmax "Status of DFC / Status of diagnostic fault check DFC_KVSOmax" UBYTE DFC_OneToOne 1 100 0.00 255.0 FORMAT "%5.1" ECU_ADDRESS 0x4000CC0C /end MEASUREMENT
/begin MEASUREMENT DFC_st.DFC_KVSOmin "Status of DFC / Status of diagnostic fault check DFC_KVSOmin" UBYTE DFC_OneToOne 1 100 0.00 255.0 FORMAT "%5.1" ECU_ADDRESS 0x4000CC0D /end MEASUREMENT
/begin MEASUREMENT DFC_st.DFC_LASHmn "Status of DFC / Status of diagnostic fault check DFC_LASHmn" UBYTE DFC_OneToOne 1 100 0.00 255.0 FORMAT "%5.1" ECU_ADDRESS 0x4000CC0E /end MEASUREMENT
/begin MEASUREMENT DFC_st.DFC_LASHmx "Status of DFC / Status of diagnostic fault check DFC_LASHmx" UBYTE DFC_OneToOne 1 100 0.00 255.0 FORMAT "%5.1" ECU_ADDRESS 0x4000CC0F /end MEASUREMENT
/begin MEASUREMENT DFC_st.DFC_LATP "Status of DFC / Status of diagnostic fault check DFC_LATP" UBYTE DFC_OneToOne 1 100 0.00 255.0 FORMAT "%5.1" ECU_ADDRESS 0x4000CC10 /end MEASUREMENT
/begin MEASUREMENT DFC_st.DFC_LDLAHI "Status of DFC / Status of diagnostic fault check DFC_LDLAHI" UBYTE DFC_OneToOne 1 100 0.00 255.0 FORMAT "%5.1" ECU_ADDRESS 0x4000CC11 /end MEASUREMENT
/begin MEASUREMENT DFC_st.DFC_LFS1Max "Status of DFC / Status of diagnostic fault check DFC_LFS1Max" UBYTE DFC_OneToOne 1 100 0.00 255.0 FORMAT "%5.1" ECU_ADDRESS 0x4000CC12 /end MEASUREMENT
/begin MEASUREMENT DFC_st.DFC_LFS1Min "Status of DFC / Status of diagnostic fault check DFC_LFS1Min" UBYTE DFC_OneToOne 1 100 0.00 255.0 FORMAT "%5.1" ECU_ADDRESS 0x4000CC13 /end MEASUREMENT
/begin MEASUREMENT DFC_st.DFC_LFS1Sig "Status of DFC / Status of diagnostic fault check DFC_LFS1Sig" UBYTE DFC_OneToOne 1 100 0.00 255.0 FORMAT "%5.1" ECU_ADDRESS 0x4000CC14 /end MEASUREMENT
/begin MEASUREMENT DFC_st.DFC_LSHmax "Status of DFC / Status of diagnostic fault check DFC_LSHmax" UBYTE DFC_OneToOne 1 100 0.00 255.0 FORMAT "%5.1" ECU_ADDRESS 0x4000CC15 /end MEASUREMENT
/begin MEASUREMENT DFC_st.DFC_LSHmin "Status of DFC / Status of diagnostic fault check DFC_LSHmin" UBYTE DFC_OneToOne 1 100 0.00 255.0 FORMAT "%5.1" ECU_ADDRESS 0x4000CC16 /end MEASUREMENT
/begin MEASUREMENT DFC_st.DFC_LSHnpl "Status of DFC / Status of diagnostic fault check DFC_LSHnpl" UBYTE DFC_OneToOne 1 100 0.00 255.0 FORMAT "%5.1" ECU_ADDRESS 0x4000CC17 /end MEASUREMENT
/begin MEASUREMENT DFC_st.DFC_LSHsig "Status of DFC / Status of diagnostic fault check DFC_LSHsig" UBYTE DFC_OneToOne 1 100 0.00 255.0 FORMAT "%5.1" ECU_ADDRESS 0x4000CC18 /end MEASUREMENT
/begin MEASUREMENT DFC_st.DFC_LSVmax "Status of DFC / Status of diagnostic fault check DFC_LSVmax" UBYTE DFC_OneToOne 1 100 0.00 255.0 FORMAT "%5.1" ECU_ADDRESS 0x4000CC19 /end MEASUREMENT
/begin MEASUREMENT DFC_st.DFC_LSVmin "Status of DFC / Status of diagnostic fault check DFC_LSVmin" UBYTE DFC_OneToOne 1 100 0.00 255.0 FORMAT "%5.1" ECU_ADDRESS 0x4000CC1A /end MEASUREMENT
/begin MEASUREMENT DFC_st.DFC_LSVnpl "Status of DFC / Status of diagnostic fault check DFC_LSVnpl" UBYTE DFC_OneToOne 1 100 0.00 255.0 FORMAT "%5.1" ECU_ADDRESS 0x4000CC1B /end MEASUREMENT
/begin MEASUREMENT DFC_st.DFC_LSVsig "Status of DFC / Status of diagnostic fault check DFC_LSVsig" UBYTE DFC_OneToOne 1 100 0.00 255.0 FORMAT "%5.1" ECU_ADDRESS 0x4000CC1C /end MEASUREMENT
/begin MEASUREMENT DFC_st.DFC_MDCat "Status of DFC / Status of diagnostic fault check DFC_MDCat" UBYTE DFC_OneToOne 1 100 0.00 255.0 FORMAT "%5.1" ECU_ADDRESS 0x4000CC1D /end MEASUREMENT
/begin MEASUREMENT DFC_st.DFC_MDCatCurr "Status of DFC / Status of diagnostic fault check DFC_MDCatCurr" UBYTE DFC_OneToOne 1 100 0.00 255.0 FORMAT "%5.1" ECU_ADDRESS 0x4000CC1E /end MEASUREMENT
/begin MEASUREMENT DFC_st.DFC_MDCyl "Status of DFC / Status of diagnostic fault check DFC_MDCyl" UBYTE DFC_OneToOne 1 100 0.00 255.0 FORMAT "%5.1" ECU_ADDRESS 0x4000CC1F /end MEASUREMENT
/begin MEASUREMENT DFC_st.DFC_MDEmi "Status of DFC / Status of diagnostic fault check DFC_MDEmi" UBYTE DFC_OneToOne 1 100 0.00 255.0 FORMAT "%5.1" ECU_ADDRESS 0x4000CC20 /end MEASUREMENT
/begin MEASUREMENT DFC_st.DFC_MDEmiStrt "Status of DFC / Status of diagnostic fault check DFC_MDEmiStrt" UBYTE DFC_OneToOne 1 100 0.00 255.0 FORMAT "%5.1" ECU_ADDRESS 0x4000CC21 /end MEASUREMENT
/begin MEASUREMENT DFC_st.DFC_MDMpl "Status of DFC / Status of diagnostic fault check DFC_MDMpl" UBYTE DFC_OneToOne 1 100 0.00 255.0 FORMAT "%5.1" ECU_ADDRESS 0x4000CC22 /end MEASUREMENT
/begin MEASUREMENT DFC_st.DFC_MoCADCNTP "Status of DFC / Status of diagnostic fault check DFC_MoCADCNTP" UBYTE DFC_OneToOne 1 100 0.00 255.0 FORMAT "%5.1" ECU_ADDRESS 0x4000CC23 /end MEASUREMENT
/begin MEASUREMENT DFC_st.DFC_MoCADCTst "Status of DFC / Status of diagnostic fault check DFC_MoCADCTst" UBYTE DFC_OneToOne 1 100 0.00 255.0 FORMAT "%5.1" ECU_ADDRESS 0x4000CC24 /end MEASUREMENT
/begin MEASUREMENT DFC_st.DFC_MoFSidst "Status of DFC / Status of diagnostic fault check DFC_MoFSidst" UBYTE DFC_OneToOne 1 100 0.00 255.0 FORMAT "%5.1" ECU_ADDRESS 0x4000CC25 /end MEASUREMENT
/begin MEASUREMENT DFC_st.DFC_OCWDACom "Status of DFC / Status of diagnostic fault check DFC_OCWDACom" UBYTE DFC_OneToOne 1 100 0.00 255.0 FORMAT "%5.1" ECU_ADDRESS 0x4000CC26 /end MEASUREMENT
/begin MEASUREMENT DFC_st.DFC_OilPPSSwtMax "Status of DFC / Status of diagnostic fault check DFC_OilPPSSwtMax" UBYTE DFC_OneToOne 1 100 0.00 255.0 FORMAT "%5.1" ECU_ADDRESS 0x4000CC27 /end MEASUREMENT
/begin MEASUREMENT DFC_st.DFC_OilPPSSwtMin "Status of DFC / Status of diagnostic fault check DFC_OilPPSSwtMin" UBYTE DFC_OneToOne 1 100 0.00 255.0 FORMAT "%5.1" ECU_ADDRESS 0x4000CC28 /end MEASUREMENT
/begin MEASUREMENT DFC_st.DFC_OilPPSSwtSig "Status of DFC / Status of diagnostic fault check DFC_OilPPSSwtSig" UBYTE DFC_OneToOne 1 100 0.00 255.0 FORMAT "%5.1" ECU_ADDRESS 0x4000CC29 /end MEASUREMENT
/begin MEASUREMENT DFC_st.DFC_OvHEngSpdLimr "Status of DFC / Status of diagnostic fault check DFC_OvHEngSpdLimr" UBYTE DFC_OneToOne 1 100 0.00 255.0 FORMAT "%5.1" ECU_ADDRESS 0x4000CC2A /end MEASUREMENT
/begin MEASUREMENT DFC_st.DFC_RoVComVld "Status of DFC / Status of diagnostic fault check DFC_RoVComVld" UBYTE DFC_OneToOne 1 100 0.00 255.0 FORMAT "%5.1" ECU_ADDRESS 0x4000CC2B /end MEASUREMENT
/begin MEASUREMENT DFC_st.DFC_RoVSNpl "Status of DFC / Status of diagnostic fault check DFC_RoVSNpl" UBYTE DFC_OneToOne 1 100 0.00 255.0 FORMAT "%5.1" ECU_ADDRESS 0x4000CC2C /end MEASUREMENT
/begin MEASUREMENT DFC_st.DFC_RoVSOL "Status of DFC / Status of diagnostic fault check DFC_RoVSOL" UBYTE DFC_OneToOne 1 100 0.00 255.0 FORMAT "%5.1" ECU_ADDRESS 0x4000CC2D /end MEASUREMENT
/begin MEASUREMENT DFC_st.DFC_RoVSSCB "Status of DFC / Status of diagnostic fault check DFC_RoVSSCB" UBYTE DFC_OneToOne 1 100 0.00 255.0 FORMAT "%5.1" ECU_ADDRESS 0x4000CC2E /end MEASUREMENT
/begin MEASUREMENT DFC_st.DFC_RoVSSCG "Status of DFC / Status of diagnostic fault check DFC_RoVSSCG" UBYTE DFC_OneToOne 1 100 0.00 255.0 FORMAT "%5.1" ECU_ADDRESS 0x4000CC2F /end MEASUREMENT
/begin MEASUREMENT DFC_st.DFC_SdSTNpl "Status of DFC / Status of diagnostic fault check DFC_SdSTNpl" UBYTE DFC_OneToOne 1 100 0.00 255.0 FORMAT "%5.1" ECU_ADDRESS 0x4000CC30 /end MEASUREMENT
/begin MEASUREMENT DFC_st.DFC_SdSTSCB "Status of DFC / Status of diagnostic fault check DFC_SdSTSCB" UBYTE DFC_OneToOne 1 100 0.00 255.0 FORMAT "%5.1" ECU_ADDRESS 0x4000CC31 /end MEASUREMENT
/begin MEASUREMENT DFC_st.DFC_SdSTSCG "Status of DFC / Status of diagnostic fault check DFC_SdSTSCG" UBYTE DFC_OneToOne 1 100 0.00 255.0 FORMAT "%5.1" ECU_ADDRESS 0x4000CC32 /end MEASUREMENT
/begin MEASUREMENT DFC_st.DFC_SdSTSOL "Status of DFC / Status of diagnostic fault check DFC_SdSTSOL" UBYTE DFC_OneToOne 1 100 0.00 255.0 FORMAT "%5.1" ECU_ADDRESS 0x4000CC33 /end MEASUREMENT
/begin MEASUREMENT DFC_st.DFC_TEVEmax "Status of DFC / Status of diagnostic fault check DFC_TEVEmax" UBYTE DFC_OneToOne 1 100 0.00 255.0 FORMAT "%5.1" ECU_ADDRESS 0x4000CC34 /end MEASUREMENT
/begin MEASUREMENT DFC_st.DFC_TEVEmin "Status of DFC / Status of diagnostic fault check DFC_TEVEmin" UBYTE DFC_OneToOne 1 100 0.00 255.0 FORMAT "%5.1" ECU_ADDRESS 0x4000CC35 /end MEASUREMENT
/begin MEASUREMENT DFC_st.DFC_TEVEsig "Status of DFC / Status of diagnostic fault check DFC_TEVEsig" UBYTE DFC_OneToOne 1 100 0.00 255.0 FORMAT "%5.1" ECU_ADDRESS 0x4000CC36 /end MEASUREMENT
/begin MEASUREMENT DFC_st.DFC_TMnpl "Status of DFC / Status of diagnostic fault check DFC_TMnpl" UBYTE DFC_OneToOne 1 100 0.00 255.0 FORMAT "%5.1" ECU_ADDRESS 0x4000CC37 /end MEASUREMENT
/begin MEASUREMENT DFC_st.DFC_UBmax "Status of DFC / Status of diagnostic fault check DFC_UBmax" UBYTE DFC_OneToOne 1 100 0.00 255.0 FORMAT "%5.1" ECU_ADDRESS 0x4000CC38 /end MEASUREMENT
/begin MEASUREMENT DFC_st.DFC_UBmin "Status of DFC / Status of diagnostic fault check DFC_UBmin" UBYTE DFC_OneToOne 1 100 0.00 255.0 FORMAT "%5.1" ECU_ADDRESS 0x4000CC39 /end MEASUREMENT
/begin MEASUREMENT DFC_st.DFC_UBnpl "Status of DFC / Status of diagnostic fault check DFC_UBnpl" UBYTE DFC_OneToOne 1 100 0.00 255.0 FORMAT "%5.1" ECU_ADDRESS 0x4000CC3A /end MEASUREMENT
/begin MEASUREMENT DFC_st.DFC_VFZsig "Status of DFC / Status of diagnostic fault check DFC_VFZsig" UBYTE DFC_OneToOne 1 100 0.00 255.0 FORMAT "%5.1" ECU_ADDRESS 0x4000CC3B /end MEASUREMENT
/begin MEASUREMENT DFC_st.DFC_VFZsig2 "Status of DFC / Status of diagnostic fault check DFC_VFZsig2" UBYTE DFC_OneToOne 1 100 0.00 255.0 FORMAT "%5.1" ECU_ADDRESS 0x4000CC3C /end MEASUREMENT
/begin MEASUREMENT DFC_stClctFault_mp "Collected error states of all fault checks" UWORD DFC_OneToOne 1 100 0.00 65535.00 FORMAT "%8.2" ARRAY_SIZE 11 ECU_ADDRESS 0x40009E00 /end MEASUREMENT
/begin MEASUREMENT DFC_stClctTst_mp "Collected tested states of all fault checks" UWORD DFC_OneToOne 1 100 0.00 65535.00 FORMAT "%8.2" ARRAY_SIZE 11 ECU_ADDRESS 0x40009DEA /end MEASUREMENT
/begin MEASUREMENT DFC_stFinal "Disable (or check finished) status of all DFCs (for PID$41 calculation)" UWORD DFC_OneToOne 1 100 0.00 65535.00 FORMAT "%8.2" ARRAY_SIZE 11 ECU_ADDRESS 0x40005EE4 /end MEASUREMENT
/begin MEASUREMENT DFC_stMem "Fault entry exists - per DFC" UWORD DFC_OneToOne 1 100 0.00 65535.00 FORMAT "%8.2" ARRAY_SIZE 11 ECU_ADDRESS 0x4000CB86 /end MEASUREMENT
/begin MEASUREMENT DFC_stRdy "Ready state due to ""OK"" per DFC" UWORD DFC_OneToOne 1 100 0.00 65535.00 FORMAT "%8.2" ARRAY_SIZE 11 ECU_ADDRESS 0x4000CB70 /end MEASUREMENT
/begin MEASUREMENT DSQ_st.DSQ_DSMInhibitAlways "Status signal quality / Status of signal quality DSQ_DSMInhibitAlways" UBYTE DFC_OneToOne 1 100 0.00 255.0 FORMAT "%5.1" ECU_ADDRESS 0x400047F0 /end MEASUREMENT
/begin MEASUREMENT DSQ_st.DSQ_EpmReverseRun "Status signal quality / Status of signal quality DSQ_EpmReverseRun" UBYTE DFC_OneToOne 1 100 0.00 255.0 FORMAT "%5.1" ECU_ADDRESS 0x400047F1 /end MEASUREMENT
/begin MEASUREMENT DSQ_st.DSQ_MRly "Status signal quality / Status of signal quality DSQ_MRly" UBYTE DFC_OneToOne 1 100 0.00 255.0 FORMAT "%5.1" ECU_ADDRESS 0x400047F2 /end MEASUREMENT
/begin MEASUREMENT DSQ_st.DSQ_RvsRotPred "Status signal quality / Status of signal quality DSQ_RvsRotPred" UBYTE DFC_OneToOne 1 100 0.00 255.0 FORMAT "%5.1" ECU_ADDRESS 0x400047F3 /end MEASUREMENT
/begin MEASUREMENT DSQ_st.DSQ_StrtActr "Status signal quality / Status of signal quality DSQ_StrtActr" UBYTE DFC_OneToOne 1 100 0.00 255.0 FORMAT "%5.1" ECU_ADDRESS 0x400047F4 /end MEASUREMENT
/begin MEASUREMENT DSQ_st.DSQ_T15TurnOfDly "Status signal quality / Status of signal quality DSQ_T15TurnOfDly" UBYTE DFC_OneToOne 1 100 0.00 255.0 FORMAT "%5.1" ECU_ADDRESS 0x400047F5 /end MEASUREMENT
/begin FUNCTION DevLib_DigOutErrHndlr "1.145.0   Digital Output Error handling module" /begin DEF_CHARACTERISTIC DevLib_DigOutDbgSig_C /end DEF_CHARACTERISTIC /begin LOC_MEASUREMENT DevLib_stDigOutErr_mp /end LOC_MEASUREMENT FUNCTION_VERSION "1.145.0" /end FUNCTION
/begin FUNCTION DevLib_PsDiag "1.146.1   Common part of Digital and PWM powerstage diagnosis" FUNCTION_VERSION "1.146.1" /end FUNCTION
/begin FUNCTION DevLib_PWMOutErrHndlr "100.0.0   PWM Output error handling module" /begin DEF_CHARACTERISTIC DevLib_PWMOutDbgSig_C /end DEF_CHARACTERISTIC /begin LOC_MEASUREMENT DevLib_stPWMOutErr_mp /end LOC_MEASUREMENT FUNCTION_VERSION "100.0.0" /end FUNCTION
/begin FUNCTION DevLib_PwrStgState "100.5.0   Power Stage State"
 /begin DEF_CHARACTERISTIC DDRC_DurDeb.DevLib_tiBattUHiDebOk_C DDRC_DurDeb.DevLib_tiBattUHiDebDef_C DDRC_DurDeb.DevLib_tiBattULoDebOk_C DDRC_DurDeb.DevLib_tiBattULoDebDef_C DDRC_RatDeb.DevLib_tiBattUHiUDRat_C DDRC_RatDeb.DevLib_tiBattULoUDRat_C Devlib_PsDisbl.facLowHysLo_C Devlib_PsDisbl.facLowHysHi_C Devlib_PsDisbl.facHighHysLo_C Devlib_PsDisbl.facHighHysHi_C Devlib_PwrStg.BattLoHysLo_C Devlib_PwrStg.BattLoHysHi_C Devlib_PwrStg.BattHiHysLo_C Devlib_PwrStg.BattHiHysHi_C DFC_CtlMsk2.DFC_DevLibBattUHi_C DFC_CtlMsk2.DFC_DevLibBattULo_C DFC_DisblMsk2.DFC_DevLibBattUHi_C DFC_DisblMsk2.DFC_DevLibBattULo_C /end DEF_CHARACTERISTIC
 /begin IN_MEASUREMENT BattU_facCor BattU_u DSM_TripChgFinshd SyC_stSub /end IN_MEASUREMENT
 /begin OUT_MEASUREMENT DevLib_stPwrStgEnaCond /end OUT_MEASUREMENT
 FUNCTION_VERSION "100.5.0" /end FUNCTION
/begin FUNCTION DevLib_SRC "1.144.0   Device Library electrical Signal Range Check" FUNCTION_VERSION "1.144.0" /end FUNCTION
/begin FUNCTION DevLib_TransStage "1.145.0   Device Library Transition Stage for sensor replacement values" FUNCTION_VERSION "1.145.0" /end FUNCTION
/begin FUNCTION DFC "30000.19.0_2.1.0Diagnostic Fault Check"
 /begin DEF_CHARACTERISTIC DFC_CtlMsk2.DFC_Unused_C DFC_CtlMsk2.DFC_CANIF_E_CTRL_STOPPED_ERROR_VALUE_C DFC_CtlMsk2.DFC_CANIF_E_INVALID_DLC_ERROR_C DFC_CtlMsk2.DFC_CANNM_E_CANIF_TRANSMIT_ERROR_C DFC_CtlMsk2.DFC_CANNM_E_INIT_FAILED_C DFC_CtlMsk2.DFC_CANNM_E_NETWORK_TIMEOUT_C DFC_CtlMsk2.DFC_COMM_E_NET_START_IND_CHANNEL_0_C DFC_CtlMsk2.DFC_COMM_E_NET_START_IND_CHANNEL_1_C DFC_CtlMsk2.DFC_COMM_E_NET_START_IND_CHANNEL_2_C DFC_CtlMsk2.DFC_COMM_E_NET_START_IND_CHANNEL_3_C DFC_CtlMsk2.DFC_COMM_E_NET_START_IND_CHANNEL_4_C DFC_CtlMsk2.DFC_COMM_E_NET_START_IND_CHANNEL_5_C DFC_CtlMsk2.DFC_PDUR_E_INIT_FAILED_C DFC_CtlMsk2.DFC_PDUR_E_PDU_INSTANCE_LOST_C DFC_DisblMsk2.DFC_Unused_C DFC_DisblMsk2.DFC_CANIF_E_CTRL_STOPPED_ERROR_VALUE_C DFC_DisblMsk2.DFC_CANIF_E_INVALID_DLC_ERROR_C DFC_DisblMsk2.DFC_CANNM_E_CANIF_TRANSMIT_ERROR_C DFC_DisblMsk2.DFC_CANNM_E_INIT_FAILED_C DFC_DisblMsk2.DFC_CANNM_E_NETWORK_TIMEOUT_C DFC_DisblMsk2.DFC_COMM_E_NET_START_IND_CHANNEL_0_C DFC_DisblMsk2.DFC_COMM_E_NET_START_IND_CHANNEL_1_C DFC_DisblMsk2.DFC_COMM_E_NET_START_IND_CHANNEL_2_C DFC_DisblMsk2.DFC_COMM_E_NET_START_IND_CHANNEL_3_C DFC_DisblMsk2.DFC_COMM_E_NET_START_IND_CHANNEL_4_C DFC_DisblMsk2.DFC_COMM_E_NET_START_IND_CHANNEL_5_C DFC_DisblMsk2.DFC_PDUR_E_INIT_FAILED_C DFC_DisblMsk2.DFC_PDUR_E_PDU_INSTANCE_LOST_C DFC_DtcFuncUnit_C DFC_DtcGroup_C DFC_DtcSeverity_C /end DEF_CHARACTERISTIC
 /begin REF_CHARACTERISTIC DFC_CtlMsk2.DFC_BusDiagOpenLoad_Can0_C DFC_CtlMsk2.DFC_Com_ABSInfo_DLC_C DFC_CtlMsk2.DFC_Com_ABSInfo_TO_C DFC_CtlMsk2.DFC_BusDiagBusOff_Can0_C DFC_CtlMsk2.DFC_DevLibBattUHi_C DFC_CtlMsk2.DFC_DevLibBattULo_C DFC_CtlMsk2.DFC_StrtOL_C DFC_CtlMsk2.DFC_StrtOvrTemp_C DFC_CtlMsk2.DFC_StrtSCB_C DFC_CtlMsk2.DFC_StrtSCG_C DFC_CtlMsk2.DFC_MILLmpOL_C DFC_CtlMsk2.DFC_MILLmpOT_C DFC_CtlMsk2.DFC_MILLmpSCB_C DFC_CtlMsk2.DFC_MILLmpSCG_C DFC_CtlMsk2.DFC_EV1max_C DFC_CtlMsk2.DFC_EV1min_C DFC_CtlMsk2.DFC_EV1sig_C DFC_CtlMsk2.DFC_CEngDsTPlausSTC_C DFC_CtlMsk2.DFC_ClthStkOpn_C DFC_CtlMsk2.DFC_EVX_C DFC_CtlMsk2.DFC_IntkAirTAirFltDsSTC_C DFC_CtlMsk2.DFC_RoughRoad_C DFC_CtlMsk2.DFC_SSpMon1_C DFC_CtlMsk2.DFC_SSpMon1OT_C DFC_CtlMsk2.DFC_SSpMon1OV_C DFC_CtlMsk2.DFC_SSpMon1SCG_C DFC_CtlMsk2.DFC_SSpMon1UV_C DFC_CtlMsk2.DFC_SSpMon2_C DFC_CtlMsk2.DFC_SSpMon2OT_C DFC_CtlMsk2.DFC_SSpMon2OV_C DFC_CtlMsk2.DFC_SSpMon2SCG_C DFC_CtlMsk2.DFC_SSpMon2UV_C DFC_CtlMsk2.DFC_CANIF_E_CTRL_NOT_SLEEP_ERROR_VALUE_C DFC_CtlMsk2.DFC_CAN_E_TIMEOUT_C DFC_CtlMsk2.DFC_RBA_IOEXTLIB_KEEPALIVE_DRV_C DFC_CtlMsk2.DFC_RBA_IOEXTLIB_KEEPALIVE_INI_C DFC_CtlMsk2.DFC_rba_IoSigRtc_StopCounter_C DFC_CtlMsk2.DFC_rba_MultiStackTrace_Threshold_C DFC_CtlMsk2.DFC_rba_MRly_Diag_Stk_Event_C DFC_CtlMsk2.DFC_rba_SyC_IrrSwOffTrigEngRun_Event_C DFC_CtlMsk2.DFC_rba_T15_Diag_ComInVld_Event_C DFC_CtlMsk2.DFC_rba_T15_Diag_ComOff_HwOn_Event_C DFC_CtlMsk2.DFC_rba_T15_Diag_ComOn_HwOff_Event_C DFC_CtlMsk2.DFC_BypAirActrOcCoil1_C DFC_CtlMsk2.DFC_BypAirActrOcCoil2_C DFC_CtlMsk2.DFC_BypAirActrOlCoil1_C DFC_CtlMsk2.DFC_BypAirActrOlCoil2_C DFC_CtlMsk2.DFC_BypAirActrOt_C DFC_CtlMsk2.DFC_BypAirActrScbCoil1_C DFC_CtlMsk2.DFC_BypAirActrScbCoil2_C DFC_CtlMsk2.DFC_BypAirActrScgCoil1_C DFC_CtlMsk2.DFC_BypAirActrScgCoil2_C DFC_CtlMsk2.DFC_CEngDsTPhysRngHi_C DFC_CtlMsk2.DFC_CEngDsTPhysRngLo_C DFC_CtlMsk2.DFC_CEngDsTSRCMax_C DFC_CtlMsk2.DFC_CEngDsTSRCMin_C DFC_CtlMsk2.DFC_DKmax_C DFC_CtlMsk2.DFC_DKmin_C DFC_CtlMsk2.DFC_DLLRmax_C DFC_CtlMsk2.DFC_DLLRmin_C DFC_CtlMsk2.DFC_DLLRnpl_C DFC_CtlMsk2.DFC_DSSRngMax_C DFC_CtlMsk2.DFC_DSSRngMin_C DFC_CtlMsk2.DFC_DSSmax_C DFC_CtlMsk2.DFC_DSSmin_C DFC_CtlMsk2.DFC_DSSnpl_C DFC_CtlMsk2.DFC_DSSnplMax_C DFC_CtlMsk2.DFC_DSSnplMin_C DFC_CtlMsk2.DFC_DSSsig_C DFC_CtlMsk2.DFC_EpmCrSErrSig_C DFC_CtlMsk2.DFC_EpmCrSNoSig_C DFC_CtlMsk2.DFC_HEGOS1B1ElecNpl_C DFC_CtlMsk2.DFC_HSH_C DFC_CtlMsk2.DFC_HSHEmax_C DFC_CtlMsk2.DFC_HSHEmin_C DFC_CtlMsk2.DFC_HSHEsig_C DFC_CtlMsk2.DFC_HSV_C DFC_CtlMsk2.DFC_HSVEmax_C DFC_CtlMsk2.DFC_HSVEmin_C DFC_CtlMsk2.DFC_HSVEsig_C DFC_CtlMsk2.DFC_HdLampMax_C DFC_CtlMsk2.DFC_HdLampMin_C DFC_CtlMsk2.DFC_HdLampSig_C DFC_CtlMsk2.DFC_IgnCoil1Err_C DFC_CtlMsk2.DFC_IgnCoil2Err_C DFC_CtlMsk2.DFC_IgnIgbtDiagSCG_0_C DFC_CtlMsk2.DFC_IgnIgbtDiagSCG_1_C DFC_CtlMsk2.DFC_IntkAirTAirFltDsPRCMax_C DFC_CtlMsk2.DFC_IntkAirTAirFltDsPRCMin_C DFC_CtlMsk2.DFC_IntkAirTAirFltDsSRCMax_C DFC_CtlMsk2.DFC_IntkAirTAirFltDsSRCMin_C DFC_CtlMsk2.DFC_IntkMnfldPNoSyn_C DFC_CtlMsk2.DFC_KAT_C DFC_CtlMsk2.DFC_KPEmax_C DFC_CtlMsk2.DFC_KPEmin_C DFC_CtlMsk2.DFC_KPEsig_C DFC_CtlMsk2.DFC_KVSFmax_C DFC_CtlMsk2.DFC_KVSFmin_C DFC_CtlMsk2.DFC_KVSOmax_C DFC_CtlMsk2.DFC_KVSOmin_C DFC_CtlMsk2.DFC_LASHmn_C DFC_CtlMsk2.DFC_LASHmx_C DFC_CtlMsk2.DFC_LATP_C DFC_CtlMsk2.DFC_LDLAHI_C DFC_CtlMsk2.DFC_LFS1Max_C DFC_CtlMsk2.DFC_LFS1Min_C DFC_CtlMsk2.DFC_LFS1Sig_C DFC_CtlMsk2.DFC_LSHmax_C DFC_CtlMsk2.DFC_LSHmin_C DFC_CtlMsk2.DFC_LSHnpl_C DFC_CtlMsk2.DFC_LSHsig_C DFC_CtlMsk2.DFC_LSVmax_C DFC_CtlMsk2.DFC_LSVmin_C DFC_CtlMsk2.DFC_LSVnpl_C DFC_CtlMsk2.DFC_LSVsig_C DFC_CtlMsk2.DFC_MDCat_C DFC_CtlMsk2.DFC_MDCatCurr_C DFC_CtlMsk2.DFC_MDCyl_C DFC_CtlMsk2.DFC_MDEmi_C DFC_CtlMsk2.DFC_MDEmiStrt_C DFC_CtlMsk2.DFC_MDMpl_C DFC_CtlMsk2.DFC_MoCADCNTP_C DFC_CtlMsk2.DFC_MoCADCTst_C DFC_CtlMsk2.DFC_MoFSidst_C DFC_CtlMsk2.DFC_OCWDACom_C DFC_CtlMsk2.DFC_OilPPSSwtMax_C DFC_CtlMsk2.DFC_OilPPSSwtMin_C DFC_CtlMsk2.DFC_OilPPSSwtSig_C DFC_CtlMsk2.DFC_OvHEngSpdLimr_C DFC_CtlMsk2.DFC_RoVComVld_C DFC_CtlMsk2.DFC_RoVSNpl_C DFC_CtlMsk2.DFC_RoVSOL_C DFC_CtlMsk2.DFC_RoVSSCB_C DFC_CtlMsk2.DFC_RoVSSCG_C DFC_CtlMsk2.DFC_SdSTNpl_C DFC_CtlMsk2.DFC_SdSTSCB_C DFC_CtlMsk2.DFC_SdSTSCG_C DFC_CtlMsk2.DFC_SdSTSOL_C DFC_CtlMsk2.DFC_TEVEmax_C DFC_CtlMsk2.DFC_TEVEmin_C DFC_CtlMsk2.DFC_TEVEsig_C DFC_CtlMsk2.DFC_TMnpl_C DFC_CtlMsk2.DFC_UBmax_C DFC_CtlMsk2.DFC_UBmin_C DFC_CtlMsk2.DFC_UBnpl_C DFC_CtlMsk2.DFC_VFZsig_C DFC_CtlMsk2.DFC_VFZsig2_C DFC_DisblMsk2.DFC_BusDiagOpenLoad_Can0_C DFC_DisblMsk2.DFC_Com_ABSInfo_DLC_C DFC_DisblMsk2.DFC_Com_ABSInfo_TO_C DFC_DisblMsk2.DFC_BusDiagBusOff_Can0_C DFC_DisblMsk2.DFC_DevLibBattUHi_C DFC_DisblMsk2.DFC_DevLibBattULo_C DFC_DisblMsk2.DFC_StrtOL_C DFC_DisblMsk2.DFC_StrtOvrTemp_C DFC_DisblMsk2.DFC_StrtSCB_C DFC_DisblMsk2.DFC_StrtSCG_C DFC_DisblMsk2.DFC_MILLmpOL_C DFC_DisblMsk2.DFC_MILLmpOT_C DFC_DisblMsk2.DFC_MILLmpSCB_C DFC_DisblMsk2.DFC_MILLmpSCG_C DFC_DisblMsk2.DFC_EV1max_C DFC_DisblMsk2.DFC_EV1min_C DFC_DisblMsk2.DFC_EV1sig_C DFC_DisblMsk2.DFC_CEngDsTPlausSTC_C DFC_DisblMsk2.DFC_ClthStkOpn_C DFC_DisblMsk2.DFC_EVX_C DFC_DisblMsk2.DFC_IntkAirTAirFltDsSTC_C DFC_DisblMsk2.DFC_RoughRoad_C DFC_DisblMsk2.DFC_SSpMon1_C DFC_DisblMsk2.DFC_SSpMon1OT_C DFC_DisblMsk2.DFC_SSpMon1OV_C DFC_DisblMsk2.DFC_SSpMon1SCG_C DFC_DisblMsk2.DFC_SSpMon1UV_C DFC_DisblMsk2.DFC_SSpMon2_C DFC_DisblMsk2.DFC_SSpMon2OT_C DFC_DisblMsk2.DFC_SSpMon2OV_C DFC_DisblMsk2.DFC_SSpMon2SCG_C DFC_DisblMsk2.DFC_SSpMon2UV_C DFC_DisblMsk2.DFC_CANIF_E_CTRL_NOT_SLEEP_ERROR_VALUE_C DFC_DisblMsk2.DFC_CAN_E_TIMEOUT_C DFC_DisblMsk2.DFC_RBA_IOEXTLIB_KEEPALIVE_DRV_C DFC_DisblMsk2.DFC_RBA_IOEXTLIB_KEEPALIVE_INI_C DFC_DisblMsk2.DFC_rba_IoSigRtc_StopCounter_C DFC_DisblMsk2.DFC_rba_MultiStackTrace_Threshold_C DFC_DisblMsk2.DFC_rba_MRly_Diag_Stk_Event_C DFC_DisblMsk2.DFC_rba_SyC_IrrSwOffTrigEngRun_Event_C DFC_DisblMsk2.DFC_rba_T15_Diag_ComInVld_Event_C DFC_DisblMsk2.DFC_rba_T15_Diag_ComOff_HwOn_Event_C DFC_DisblMsk2.DFC_rba_T15_Diag_ComOn_HwOff_Event_C DFC_DisblMsk2.DFC_BypAirActrOcCoil1_C DFC_DisblMsk2.DFC_BypAirActrOcCoil2_C DFC_DisblMsk2.DFC_BypAirActrOlCoil1_C DFC_DisblMsk2.DFC_BypAirActrOlCoil2_C DFC_DisblMsk2.DFC_BypAirActrOt_C DFC_DisblMsk2.DFC_BypAirActrScbCoil1_C DFC_DisblMsk2.DFC_BypAirActrScbCoil2_C DFC_DisblMsk2.DFC_BypAirActrScgCoil1_C DFC_DisblMsk2.DFC_BypAirActrScgCoil2_C DFC_DisblMsk2.DFC_CEngDsTPhysRngHi_C DFC_DisblMsk2.DFC_CEngDsTPhysRngLo_C DFC_DisblMsk2.DFC_CEngDsTSRCMax_C DFC_DisblMsk2.DFC_CEngDsTSRCMin_C DFC_DisblMsk2.DFC_DKmax_C DFC_DisblMsk2.DFC_DKmin_C DFC_DisblMsk2.DFC_DLLRmax_C DFC_DisblMsk2.DFC_DLLRmin_C DFC_DisblMsk2.DFC_DLLRnpl_C DFC_DisblMsk2.DFC_DSSRngMax_C DFC_DisblMsk2.DFC_DSSRngMin_C DFC_DisblMsk2.DFC_DSSmax_C DFC_DisblMsk2.DFC_DSSmin_C DFC_DisblMsk2.DFC_DSSnpl_C DFC_DisblMsk2.DFC_DSSnplMax_C DFC_DisblMsk2.DFC_DSSnplMin_C DFC_DisblMsk2.DFC_DSSsig_C DFC_DisblMsk2.DFC_EpmCrSErrSig_C DFC_DisblMsk2.DFC_EpmCrSNoSig_C DFC_DisblMsk2.DFC_HEGOS1B1ElecNpl_C DFC_DisblMsk2.DFC_HSH_C DFC_DisblMsk2.DFC_HSHEmax_C DFC_DisblMsk2.DFC_HSHEmin_C DFC_DisblMsk2.DFC_HSHEsig_C DFC_DisblMsk2.DFC_HSV_C DFC_DisblMsk2.DFC_HSVEmax_C DFC_DisblMsk2.DFC_HSVEmin_C DFC_DisblMsk2.DFC_HSVEsig_C DFC_DisblMsk2.DFC_HdLampMax_C DFC_DisblMsk2.DFC_HdLampMin_C DFC_DisblMsk2.DFC_HdLampSig_C DFC_DisblMsk2.DFC_IgnCoil1Err_C DFC_DisblMsk2.DFC_IgnCoil2Err_C DFC_DisblMsk2.DFC_IgnIgbtDiagSCG_0_C DFC_DisblMsk2.DFC_IgnIgbtDiagSCG_1_C DFC_DisblMsk2.DFC_IntkAirTAirFltDsPRCMax_C DFC_DisblMsk2.DFC_IntkAirTAirFltDsPRCMin_C DFC_DisblMsk2.DFC_IntkAirTAirFltDsSRCMax_C DFC_DisblMsk2.DFC_IntkAirTAirFltDsSRCMin_C DFC_DisblMsk2.DFC_IntkMnfldPNoSyn_C DFC_DisblMsk2.DFC_KAT_C DFC_DisblMsk2.DFC_KPEmax_C DFC_DisblMsk2.DFC_KPEmin_C DFC_DisblMsk2.DFC_KPEsig_C DFC_DisblMsk2.DFC_KVSFmax_C DFC_DisblMsk2.DFC_KVSFmin_C DFC_DisblMsk2.DFC_KVSOmax_C DFC_DisblMsk2.DFC_KVSOmin_C DFC_DisblMsk2.DFC_LASHmn_C DFC_DisblMsk2.DFC_LASHmx_C DFC_DisblMsk2.DFC_LATP_C DFC_DisblMsk2.DFC_LDLAHI_C DFC_DisblMsk2.DFC_LFS1Max_C DFC_DisblMsk2.DFC_LFS1Min_C DFC_DisblMsk2.DFC_LFS1Sig_C DFC_DisblMsk2.DFC_LSHmax_C DFC_DisblMsk2.DFC_LSHmin_C DFC_DisblMsk2.DFC_LSHnpl_C DFC_DisblMsk2.DFC_LSHsig_C DFC_DisblMsk2.DFC_LSVmax_C DFC_DisblMsk2.DFC_LSVmin_C DFC_DisblMsk2.DFC_LSVnpl_C DFC_DisblMsk2.DFC_LSVsig_C DFC_DisblMsk2.DFC_MDCat_C DFC_DisblMsk2.DFC_MDCatCurr_C DFC_DisblMsk2.DFC_MDCyl_C DFC_DisblMsk2.DFC_MDEmi_C DFC_DisblMsk2.DFC_MDEmiStrt_C DFC_DisblMsk2.DFC_MDMpl_C DFC_DisblMsk2.DFC_MoCADCNTP_C DFC_DisblMsk2.DFC_MoCADCTst_C DFC_DisblMsk2.DFC_MoFSidst_C DFC_DisblMsk2.DFC_OCWDACom_C DFC_DisblMsk2.DFC_OilPPSSwtMax_C DFC_DisblMsk2.DFC_OilPPSSwtMin_C DFC_DisblMsk2.DFC_OilPPSSwtSig_C DFC_DisblMsk2.DFC_OvHEngSpdLimr_C DFC_DisblMsk2.DFC_RoVComVld_C DFC_DisblMsk2.DFC_RoVSNpl_C DFC_DisblMsk2.DFC_RoVSOL_C DFC_DisblMsk2.DFC_RoVSSCB_C DFC_DisblMsk2.DFC_RoVSSCG_C DFC_DisblMsk2.DFC_SdSTNpl_C DFC_DisblMsk2.DFC_SdSTSCB_C DFC_DisblMsk2.DFC_SdSTSCG_C DFC_DisblMsk2.DFC_SdSTSOL_C DFC_DisblMsk2.DFC_TEVEmax_C DFC_DisblMsk2.DFC_TEVEmin_C DFC_DisblMsk2.DFC_TEVEsig_C DFC_DisblMsk2.DFC_TMnpl_C DFC_DisblMsk2.DFC_UBmax_C DFC_DisblMsk2.DFC_UBmin_C DFC_DisblMsk2.DFC_UBnpl_C DFC_DisblMsk2.DFC_VFZsig_C DFC_DisblMsk2.DFC_VFZsig2_C /end REF_CHARACTERISTIC
 /begin OUT_MEASUREMENT DFC_b.TST_BusDiagOpenLoad_Can0 DFC_b.TST_Com_ABSInfo_DLC DFC_b.TST_Com_ABSInfo_TO DFC_b.TST_BusDiagBusOff_Can0 DFC_b.TST_DevLibBattUHi DFC_b.TST_DevLibBattULo DFC_b.TST_StrtOL DFC_b.TST_StrtOvrTemp DFC_b.TST_StrtSCB DFC_b.TST_StrtSCG DFC_b.TST_MILLmpOL DFC_b.TST_MILLmpOT DFC_b.TST_MILLmpSCB DFC_b.TST_MILLmpSCG DFC_b.TST_EV1max DFC_b.TST_EV1min DFC_b.TST_EV1sig DFC_b.TST_CEngDsTPlausSTC DFC_b.TST_ClthStkOpn DFC_b.TST_EVX DFC_b.TST_IntkAirTAirFltDsSTC DFC_b.TST_RoughRoad DFC_b.TST_SSpMon1 DFC_b.TST_SSpMon1OT DFC_b.TST_SSpMon1OV DFC_b.TST_SSpMon1SCG DFC_b.TST_SSpMon1UV DFC_b.TST_SSpMon2 DFC_b.TST_SSpMon2OT DFC_b.TST_SSpMon2OV DFC_b.TST_SSpMon2SCG DFC_b.TST_SSpMon2UV DFC_b.TST_CANIF_E_CTRL_NOT_SLEEP_ERROR_VALUE DFC_b.TST_CANIF_E_CTRL_STOPPED_ERROR_VALUE DFC_b.TST_CANIF_E_INVALID_DLC_ERROR DFC_b.TST_CANNM_E_CANIF_TRANSMIT_ERROR DFC_b.TST_CANNM_E_INIT_FAILED DFC_b.TST_CANNM_E_NETWORK_TIMEOUT DFC_b.TST_CAN_E_TIMEOUT DFC_b.TST_COMM_E_NET_START_IND_CHANNEL_0 DFC_b.TST_COMM_E_NET_START_IND_CHANNEL_1 DFC_b.TST_COMM_E_NET_START_IND_CHANNEL_2 DFC_b.TST_COMM_E_NET_START_IND_CHANNEL_3 DFC_b.TST_COMM_E_NET_START_IND_CHANNEL_4 DFC_b.TST_COMM_E_NET_START_IND_CHANNEL_5 DFC_b.TST_PDUR_E_INIT_FAILED DFC_b.TST_PDUR_E_PDU_INSTANCE_LOST DFC_b.TST_RBA_IOEXTLIB_KEEPALIVE_DRV DFC_b.TST_RBA_IOEXTLIB_KEEPALIVE_INI DFC_b.TST_rba_IoSigRtc_StopCounter DFC_b.TST_rba_MultiStackTrace_Threshold DFC_b.TST_rba_MRly_Diag_Stk_Event DFC_b.TST_rba_SyC_IrrSwOffTrigEngRun_Event DFC_b.TST_rba_T15_Diag_ComInVld_Event DFC_b.TST_rba_T15_Diag_ComOff_HwOn_Event DFC_b.TST_rba_T15_Diag_ComOn_HwOff_Event DFC_b.TST_BypAirActrOcCoil1 DFC_b.TST_BypAirActrOcCoil2 DFC_b.TST_BypAirActrOlCoil1 DFC_b.TST_BypAirActrOlCoil2 DFC_b.TST_BypAirActrOt DFC_b.TST_BypAirActrScbCoil1 DFC_b.TST_BypAirActrScbCoil2 DFC_b.TST_BypAirActrScgCoil1 DFC_b.TST_BypAirActrScgCoil2 DFC_b.TST_CEngDsTPhysRngHi DFC_b.TST_CEngDsTPhysRngLo DFC_b.TST_CEngDsTSRCMax DFC_b.TST_CEngDsTSRCMin DFC_b.TST_DKmax DFC_b.TST_DKmin DFC_b.TST_DLLRmax DFC_b.TST_DLLRmin DFC_b.TST_DLLRnpl DFC_b.TST_DSSRngMax DFC_b.TST_DSSRngMin DFC_b.TST_DSSmax DFC_b.TST_DSSmin DFC_b.TST_DSSnpl DFC_b.TST_DSSnplMax DFC_b.TST_DSSnplMin DFC_b.TST_DSSsig DFC_b.TST_EpmCrSErrSig DFC_b.TST_EpmCrSNoSig DFC_b.TST_HEGOS1B1ElecNpl DFC_b.TST_HSH DFC_b.TST_HSHEmax DFC_b.TST_HSHEmin DFC_b.TST_HSHEsig DFC_b.TST_HSV DFC_b.TST_HSVEmax DFC_b.TST_HSVEmin DFC_b.TST_HSVEsig DFC_b.TST_HdLampMax DFC_b.TST_HdLampMin DFC_b.TST_HdLampSig DFC_b.TST_IgnCoil1Err DFC_b.TST_IgnCoil2Err DFC_b.TST_IgnIgbtDiagSCG_0 DFC_b.TST_IgnIgbtDiagSCG_1 DFC_b.TST_IntkAirTAirFltDsPRCMax DFC_b.TST_IntkAirTAirFltDsPRCMin DFC_b.TST_IntkAirTAirFltDsSRCMax DFC_b.TST_IntkAirTAirFltDsSRCMin DFC_b.TST_IntkMnfldPNoSyn DFC_b.TST_KAT DFC_b.TST_KPEmax DFC_b.TST_KPEmin DFC_b.TST_KPEsig DFC_b.TST_KVSFmax DFC_b.TST_KVSFmin DFC_b.TST_KVSOmax DFC_b.TST_KVSOmin DFC_b.TST_LASHmn DFC_b.TST_LASHmx DFC_b.TST_LATP DFC_b.TST_LDLAHI DFC_b.TST_LFS1Max DFC_b.TST_LFS1Min DFC_b.TST_LFS1Sig DFC_b.TST_LSHmax DFC_b.TST_LSHmin DFC_b.TST_LSHnpl DFC_b.TST_LSHsig DFC_b.TST_LSVmax DFC_b.TST_LSVmin DFC_b.TST_LSVnpl DFC_b.TST_LSVsig DFC_b.TST_MDCat DFC_b.TST_MDCatCurr DFC_b.TST_MDCyl DFC_b.TST_MDEmi DFC_b.TST_MDEmiStrt DFC_b.TST_MDMpl DFC_b.TST_MoCADCNTP DFC_b.TST_MoCADCTst DFC_b.TST_MoFSidst DFC_b.TST_OCWDACom DFC_b.TST_OilPPSSwtMax DFC_b.TST_OilPPSSwtMin DFC_b.TST_OilPPSSwtSig DFC_b.TST_OvHEngSpdLimr DFC_b.TST_RoVComVld DFC_b.TST_RoVSNpl DFC_b.TST_RoVSOL DFC_b.TST_RoVSSCB DFC_b.TST_RoVSSCG DFC_b.TST_SdSTNpl DFC_b.TST_SdSTSCB DFC_b.TST_SdSTSCG DFC_b.TST_SdSTSOL DFC_b.TST_TEVEmax DFC_b.TST_TEVEmin DFC_b.TST_TEVEsig DFC_b.TST_TMnpl DFC_b.TST_UBmax DFC_b.TST_UBmin DFC_b.TST_UBnpl DFC_b.TST_VFZsig DFC_b.TST_VFZsig2 DFC_b.LDF_BusDiagOpenLoad_Can0 DFC_b.LDF_Com_ABSInfo_DLC DFC_b.LDF_Com_ABSInfo_TO DFC_b.LDF_BusDiagBusOff_Can0 DFC_b.LDF_DevLibBattUHi DFC_b.LDF_DevLibBattULo DFC_b.LDF_StrtOL DFC_b.LDF_StrtOvrTemp DFC_b.LDF_StrtSCB DFC_b.LDF_StrtSCG DFC_b.LDF_MILLmpOL DFC_b.LDF_MILLmpOT DFC_b.LDF_MILLmpSCB DFC_b.LDF_MILLmpSCG DFC_b.LDF_EV1max DFC_b.LDF_EV1min DFC_b.LDF_EV1sig DFC_b.LDF_CEngDsTPlausSTC DFC_b.LDF_ClthStkOpn DFC_b.LDF_EVX DFC_b.LDF_IntkAirTAirFltDsSTC DFC_b.LDF_RoughRoad DFC_b.LDF_SSpMon1 DFC_b.LDF_SSpMon1OT DFC_b.LDF_SSpMon1OV DFC_b.LDF_SSpMon1SCG DFC_b.LDF_SSpMon1UV DFC_b.LDF_SSpMon2 DFC_b.LDF_SSpMon2OT DFC_b.LDF_SSpMon2OV DFC_b.LDF_SSpMon2SCG DFC_b.LDF_SSpMon2UV DFC_b.LDF_CANIF_E_CTRL_NOT_SLEEP_ERROR_VALUE DFC_b.LDF_CANIF_E_CTRL_STOPPED_ERROR_VALUE DFC_b.LDF_CANIF_E_INVALID_DLC_ERROR DFC_b.LDF_CANNM_E_CANIF_TRANSMIT_ERROR DFC_b.LDF_CANNM_E_INIT_FAILED DFC_b.LDF_CANNM_E_NETWORK_TIMEOUT DFC_b.LDF_CAN_E_TIMEOUT DFC_b.LDF_COMM_E_NET_START_IND_CHANNEL_0 DFC_b.LDF_COMM_E_NET_START_IND_CHANNEL_1 DFC_b.LDF_COMM_E_NET_START_IND_CHANNEL_2 DFC_b.LDF_COMM_E_NET_START_IND_CHANNEL_3 DFC_b.LDF_COMM_E_NET_START_IND_CHANNEL_4 DFC_b.LDF_COMM_E_NET_START_IND_CHANNEL_5 DFC_b.LDF_PDUR_E_INIT_FAILED DFC_b.LDF_PDUR_E_PDU_INSTANCE_LOST DFC_b.LDF_RBA_IOEXTLIB_KEEPALIVE_DRV DFC_b.LDF_RBA_IOEXTLIB_KEEPALIVE_INI DFC_b.LDF_rba_IoSigRtc_StopCounter DFC_b.LDF_rba_MultiStackTrace_Threshold DFC_b.LDF_rba_MRly_Diag_Stk_Event DFC_b.LDF_rba_SyC_IrrSwOffTrigEngRun_Event DFC_b.LDF_rba_T15_Diag_ComInVld_Event DFC_b.LDF_rba_T15_Diag_ComOff_HwOn_Event DFC_b.LDF_rba_T15_Diag_ComOn_HwOff_Event DFC_b.LDF_BypAirActrOcCoil1 DFC_b.LDF_BypAirActrOcCoil2 DFC_b.LDF_BypAirActrOlCoil1 DFC_b.LDF_BypAirActrOlCoil2 DFC_b.LDF_BypAirActrOt DFC_b.LDF_BypAirActrScbCoil1 DFC_b.LDF_BypAirActrScbCoil2 DFC_b.LDF_BypAirActrScgCoil1 DFC_b.LDF_BypAirActrScgCoil2 DFC_b.LDF_CEngDsTPhysRngHi DFC_b.LDF_CEngDsTPhysRngLo DFC_b.LDF_CEngDsTSRCMax DFC_b.LDF_CEngDsTSRCMin DFC_b.LDF_DKmax DFC_b.LDF_DKmin DFC_b.LDF_DLLRmax DFC_b.LDF_DLLRmin DFC_b.LDF_DLLRnpl DFC_b.LDF_DSSRngMax DFC_b.LDF_DSSRngMin DFC_b.LDF_DSSmax DFC_b.LDF_DSSmin DFC_b.LDF_DSSnpl DFC_b.LDF_DSSnplMax DFC_b.LDF_DSSnplMin DFC_b.LDF_DSSsig DFC_b.LDF_EpmCrSErrSig DFC_b.LDF_EpmCrSNoSig DFC_b.LDF_HEGOS1B1ElecNpl DFC_b.LDF_HSH DFC_b.LDF_HSHEmax DFC_b.LDF_HSHEmin DFC_b.LDF_HSHEsig DFC_b.LDF_HSV DFC_b.LDF_HSVEmax DFC_b.LDF_HSVEmin DFC_b.LDF_HSVEsig DFC_b.LDF_HdLampMax DFC_b.LDF_HdLampMin DFC_b.LDF_HdLampSig DFC_b.LDF_IgnCoil1Err DFC_b.LDF_IgnCoil2Err DFC_b.LDF_IgnIgbtDiagSCG_0 DFC_b.LDF_IgnIgbtDiagSCG_1 DFC_b.LDF_IntkAirTAirFltDsPRCMax DFC_b.LDF_IntkAirTAirFltDsPRCMin DFC_b.LDF_IntkAirTAirFltDsSRCMax DFC_b.LDF_IntkAirTAirFltDsSRCMin DFC_b.LDF_IntkMnfldPNoSyn DFC_b.LDF_KAT DFC_b.LDF_KPEmax DFC_b.LDF_KPEmin DFC_b.LDF_KPEsig DFC_b.LDF_KVSFmax DFC_b.LDF_KVSFmin DFC_b.LDF_KVSOmax DFC_b.LDF_KVSOmin DFC_b.LDF_LASHmn DFC_b.LDF_LASHmx DFC_b.LDF_LATP DFC_b.LDF_LDLAHI DFC_b.LDF_LFS1Max DFC_b.LDF_LFS1Min DFC_b.LDF_LFS1Sig DFC_b.LDF_LSHmax DFC_b.LDF_LSHmin DFC_b.LDF_LSHnpl DFC_b.LDF_LSHsig DFC_b.LDF_LSVmax DFC_b.LDF_LSVmin DFC_b.LDF_LSVnpl DFC_b.LDF_LSVsig DFC_b.LDF_MDCat DFC_b.LDF_MDCatCurr DFC_b.LDF_MDCyl DFC_b.LDF_MDEmi DFC_b.LDF_MDEmiStrt DFC_b.LDF_MDMpl DFC_b.LDF_MoCADCNTP DFC_b.LDF_MoCADCTst DFC_b.LDF_MoFSidst DFC_b.LDF_OCWDACom DFC_b.LDF_OilPPSSwtMax DFC_b.LDF_OilPPSSwtMin DFC_b.LDF_OilPPSSwtSig DFC_b.LDF_OvHEngSpdLimr DFC_b.LDF_RoVComVld DFC_b.LDF_RoVSNpl DFC_b.LDF_RoVSOL DFC_b.LDF_RoVSSCB DFC_b.LDF_RoVSSCG DFC_b.LDF_SdSTNpl DFC_b.LDF_SdSTSCB DFC_b.LDF_SdSTSCG DFC_b.LDF_SdSTSOL DFC_b.LDF_TEVEmax DFC_b.LDF_TEVEmin DFC_b.LDF_TEVEsig DFC_b.LDF_TMnpl DFC_b.LDF_UBmax DFC_b.LDF_UBmin DFC_b.LDF_UBnpl DFC_b.LDF_VFZsig DFC_b.LDF_VFZsig2 DFC_b.TSC_BusDiagOpenLoad_Can0 DFC_b.TSC_Com_ABSInfo_DLC DFC_b.TSC_Com_ABSInfo_TO DFC_b.TSC_BusDiagBusOff_Can0 DFC_b.TSC_DevLibBattUHi DFC_b.TSC_DevLibBattULo DFC_b.TSC_StrtOL DFC_b.TSC_StrtOvrTemp DFC_b.TSC_StrtSCB DFC_b.TSC_StrtSCG DFC_b.TSC_MILLmpOL DFC_b.TSC_MILLmpOT DFC_b.TSC_MILLmpSCB DFC_b.TSC_MILLmpSCG DFC_b.TSC_EV1max DFC_b.TSC_EV1min DFC_b.TSC_EV1sig DFC_b.TSC_CEngDsTPlausSTC DFC_b.TSC_ClthStkOpn DFC_b.TSC_EVX DFC_b.TSC_IntkAirTAirFltDsSTC DFC_b.TSC_RoughRoad DFC_b.TSC_SSpMon1 DFC_b.TSC_SSpMon1OT DFC_b.TSC_SSpMon1OV DFC_b.TSC_SSpMon1SCG DFC_b.TSC_SSpMon1UV DFC_b.TSC_SSpMon2 DFC_b.TSC_SSpMon2OT DFC_b.TSC_SSpMon2OV DFC_b.TSC_SSpMon2SCG DFC_b.TSC_SSpMon2UV DFC_b.TSC_CANIF_E_CTRL_NOT_SLEEP_ERROR_VALUE DFC_b.TSC_CANIF_E_CTRL_STOPPED_ERROR_VALUE DFC_b.TSC_CANIF_E_INVALID_DLC_ERROR DFC_b.TSC_CANNM_E_CANIF_TRANSMIT_ERROR DFC_b.TSC_CANNM_E_INIT_FAILED DFC_b.TSC_CANNM_E_NETWORK_TIMEOUT DFC_b.TSC_CAN_E_TIMEOUT DFC_b.TSC_COMM_E_NET_START_IND_CHANNEL_0 DFC_b.TSC_COMM_E_NET_START_IND_CHANNEL_1 DFC_b.TSC_COMM_E_NET_START_IND_CHANNEL_2 DFC_b.TSC_COMM_E_NET_START_IND_CHANNEL_3 DFC_b.TSC_COMM_E_NET_START_IND_CHANNEL_4 DFC_b.TSC_COMM_E_NET_START_IND_CHANNEL_5 DFC_b.TSC_PDUR_E_INIT_FAILED DFC_b.TSC_PDUR_E_PDU_INSTANCE_LOST DFC_b.TSC_RBA_IOEXTLIB_KEEPALIVE_DRV DFC_b.TSC_RBA_IOEXTLIB_KEEPALIVE_INI DFC_b.TSC_rba_IoSigRtc_StopCounter DFC_b.TSC_rba_MultiStackTrace_Threshold DFC_b.TSC_rba_MRly_Diag_Stk_Event DFC_b.TSC_rba_SyC_IrrSwOffTrigEngRun_Event DFC_b.TSC_rba_T15_Diag_ComInVld_Event DFC_b.TSC_rba_T15_Diag_ComOff_HwOn_Event DFC_b.TSC_rba_T15_Diag_ComOn_HwOff_Event DFC_b.TSC_BypAirActrOcCoil1 DFC_b.TSC_BypAirActrOcCoil2 DFC_b.TSC_BypAirActrOlCoil1 DFC_b.TSC_BypAirActrOlCoil2 DFC_b.TSC_BypAirActrOt DFC_b.TSC_BypAirActrScbCoil1 DFC_b.TSC_BypAirActrScbCoil2 DFC_b.TSC_BypAirActrScgCoil1 DFC_b.TSC_BypAirActrScgCoil2 DFC_b.TSC_CEngDsTPhysRngHi DFC_b.TSC_CEngDsTPhysRngLo DFC_b.TSC_CEngDsTSRCMax DFC_b.TSC_CEngDsTSRCMin DFC_b.TSC_DKmax DFC_b.TSC_DKmin DFC_b.TSC_DLLRmax DFC_b.TSC_DLLRmin DFC_b.TSC_DLLRnpl DFC_b.TSC_DSSRngMax DFC_b.TSC_DSSRngMin DFC_b.TSC_DSSmax DFC_b.TSC_DSSmin DFC_b.TSC_DSSnpl DFC_b.TSC_DSSnplMax DFC_b.TSC_DSSnplMin DFC_b.TSC_DSSsig DFC_b.TSC_EpmCrSErrSig DFC_b.TSC_EpmCrSNoSig DFC_b.TSC_HEGOS1B1ElecNpl DFC_b.TSC_HSH DFC_b.TSC_HSHEmax DFC_b.TSC_HSHEmin DFC_b.TSC_HSHEsig DFC_b.TSC_HSV DFC_b.TSC_HSVEmax DFC_b.TSC_HSVEmin DFC_b.TSC_HSVEsig DFC_b.TSC_HdLampMax DFC_b.TSC_HdLampMin DFC_b.TSC_HdLampSig DFC_b.TSC_IgnCoil1Err DFC_b.TSC_IgnCoil2Err DFC_b.TSC_IgnIgbtDiagSCG_0 DFC_b.TSC_IgnIgbtDiagSCG_1 DFC_b.TSC_IntkAirTAirFltDsPRCMax DFC_b.TSC_IntkAirTAirFltDsPRCMin DFC_b.TSC_IntkAirTAirFltDsSRCMax DFC_b.TSC_IntkAirTAirFltDsSRCMin DFC_b.TSC_IntkMnfldPNoSyn DFC_b.TSC_KAT DFC_b.TSC_KPEmax DFC_b.TSC_KPEmin DFC_b.TSC_KPEsig DFC_b.TSC_KVSFmax DFC_b.TSC_KVSFmin DFC_b.TSC_KVSOmax DFC_b.TSC_KVSOmin DFC_b.TSC_LASHmn DFC_b.TSC_LASHmx DFC_b.TSC_LATP DFC_b.TSC_LDLAHI DFC_b.TSC_LFS1Max DFC_b.TSC_LFS1Min DFC_b.TSC_LFS1Sig DFC_b.TSC_LSHmax DFC_b.TSC_LSHmin DFC_b.TSC_LSHnpl DFC_b.TSC_LSHsig DFC_b.TSC_LSVmax DFC_b.TSC_LSVmin DFC_b.TSC_LSVnpl DFC_b.TSC_LSVsig DFC_b.TSC_MDCat DFC_b.TSC_MDCatCurr DFC_b.TSC_MDCyl DFC_b.TSC_MDEmi DFC_b.TSC_MDEmiStrt DFC_b.TSC_MDMpl DFC_b.TSC_MoCADCNTP DFC_b.TSC_MoCADCTst DFC_b.TSC_MoFSidst DFC_b.TSC_OCWDACom DFC_b.TSC_OilPPSSwtMax DFC_b.TSC_OilPPSSwtMin DFC_b.TSC_OilPPSSwtSig DFC_b.TSC_OvHEngSpdLimr DFC_b.TSC_RoVComVld DFC_b.TSC_RoVSNpl DFC_b.TSC_RoVSOL DFC_b.TSC_RoVSSCB DFC_b.TSC_RoVSSCG DFC_b.TSC_SdSTNpl DFC_b.TSC_SdSTSCB DFC_b.TSC_SdSTSCG DFC_b.TSC_SdSTSOL DFC_b.TSC_TEVEmax DFC_b.TSC_TEVEmin DFC_b.TSC_TEVEsig DFC_b.TSC_TMnpl DFC_b.TSC_UBmax DFC_b.TSC_UBmin DFC_b.TSC_UBnpl DFC_b.TSC_VFZsig DFC_b.TSC_VFZsig2 DFC_st.DFC_Unused DFC_st.DFC_BusDiagOpenLoad_Can0 DFC_st.DFC_Com_ABSInfo_DLC DFC_st.DFC_Com_ABSInfo_TO DFC_st.DFC_BusDiagBusOff_Can0 DFC_st.DFC_DevLibBattUHi DFC_st.DFC_DevLibBattULo DFC_st.DFC_StrtOL DFC_st.DFC_StrtOvrTemp DFC_st.DFC_StrtSCB DFC_st.DFC_StrtSCG DFC_st.DFC_MILLmpOL DFC_st.DFC_MILLmpOT DFC_st.DFC_MILLmpSCB DFC_st.DFC_MILLmpSCG DFC_st.DFC_EV1max DFC_st.DFC_EV1min DFC_st.DFC_EV1sig DFC_st.DFC_CEngDsTPlausSTC DFC_st.DFC_ClthStkOpn DFC_st.DFC_EVX DFC_st.DFC_IntkAirTAirFltDsSTC DFC_st.DFC_RoughRoad DFC_st.DFC_SSpMon1 DFC_st.DFC_SSpMon1OT DFC_st.DFC_SSpMon1OV DFC_st.DFC_SSpMon1SCG DFC_st.DFC_SSpMon1UV DFC_st.DFC_SSpMon2 DFC_st.DFC_SSpMon2OT DFC_st.DFC_SSpMon2OV DFC_st.DFC_SSpMon2SCG DFC_st.DFC_SSpMon2UV DFC_st.DFC_CANIF_E_CTRL_NOT_SLEEP_ERROR_VALUE DFC_st.DFC_CANIF_E_CTRL_STOPPED_ERROR_VALUE DFC_st.DFC_CANIF_E_INVALID_DLC_ERROR DFC_st.DFC_CANNM_E_CANIF_TRANSMIT_ERROR DFC_st.DFC_CANNM_E_INIT_FAILED DFC_st.DFC_CANNM_E_NETWORK_TIMEOUT DFC_st.DFC_CAN_E_TIMEOUT DFC_st.DFC_COMM_E_NET_START_IND_CHANNEL_0 DFC_st.DFC_COMM_E_NET_START_IND_CHANNEL_1 DFC_st.DFC_COMM_E_NET_START_IND_CHANNEL_2 DFC_st.DFC_COMM_E_NET_START_IND_CHANNEL_3 DFC_st.DFC_COMM_E_NET_START_IND_CHANNEL_4 DFC_st.DFC_COMM_E_NET_START_IND_CHANNEL_5 DFC_st.DFC_PDUR_E_INIT_FAILED DFC_st.DFC_PDUR_E_PDU_INSTANCE_LOST DFC_st.DFC_RBA_IOEXTLIB_KEEPALIVE_DRV DFC_st.DFC_RBA_IOEXTLIB_KEEPALIVE_INI DFC_st.DFC_rba_IoSigRtc_StopCounter DFC_st.DFC_rba_MultiStackTrace_Threshold DFC_st.DFC_rba_MRly_Diag_Stk_Event DFC_st.DFC_rba_SyC_IrrSwOffTrigEngRun_Event DFC_st.DFC_rba_T15_Diag_ComInVld_Event DFC_st.DFC_rba_T15_Diag_ComOff_HwOn_Event DFC_st.DFC_rba_T15_Diag_ComOn_HwOff_Event DFC_st.DFC_BypAirActrOcCoil1 DFC_st.DFC_BypAirActrOcCoil2 DFC_st.DFC_BypAirActrOlCoil1 DFC_st.DFC_BypAirActrOlCoil2 DFC_st.DFC_BypAirActrOt DFC_st.DFC_BypAirActrScbCoil1 DFC_st.DFC_BypAirActrScbCoil2 DFC_st.DFC_BypAirActrScgCoil1 DFC_st.DFC_BypAirActrScgCoil2 DFC_st.DFC_CEngDsTPhysRngHi DFC_st.DFC_CEngDsTPhysRngLo DFC_st.DFC_CEngDsTSRCMax DFC_st.DFC_CEngDsTSRCMin DFC_st.DFC_DKmax DFC_st.DFC_DKmin DFC_st.DFC_DLLRmax DFC_st.DFC_DLLRmin DFC_st.DFC_DLLRnpl DFC_st.DFC_DSSRngMax DFC_st.DFC_DSSRngMin DFC_st.DFC_DSSmax DFC_st.DFC_DSSmin DFC_st.DFC_DSSnpl DFC_st.DFC_DSSnplMax DFC_st.DFC_DSSnplMin DFC_st.DFC_DSSsig DFC_st.DFC_EpmCrSErrSig DFC_st.DFC_EpmCrSNoSig DFC_st.DFC_HEGOS1B1ElecNpl DFC_st.DFC_HSH DFC_st.DFC_HSHEmax DFC_st.DFC_HSHEmin DFC_st.DFC_HSHEsig DFC_st.DFC_HSV DFC_st.DFC_HSVEmax DFC_st.DFC_HSVEmin DFC_st.DFC_HSVEsig DFC_st.DFC_HdLampMax DFC_st.DFC_HdLampMin DFC_st.DFC_HdLampSig DFC_st.DFC_IgnCoil1Err DFC_st.DFC_IgnCoil2Err DFC_st.DFC_IgnIgbtDiagSCG_0 DFC_st.DFC_IgnIgbtDiagSCG_1 DFC_st.DFC_IntkAirTAirFltDsPRCMax DFC_st.DFC_IntkAirTAirFltDsPRCMin DFC_st.DFC_IntkAirTAirFltDsSRCMax DFC_st.DFC_IntkAirTAirFltDsSRCMin DFC_st.DFC_IntkMnfldPNoSyn DFC_st.DFC_KAT DFC_st.DFC_KPEmax DFC_st.DFC_KPEmin DFC_st.DFC_KPEsig DFC_st.DFC_KVSFmax DFC_st.DFC_KVSFmin DFC_st.DFC_KVSOmax DFC_st.DFC_KVSOmin DFC_st.DFC_LASHmn DFC_st.DFC_LASHmx DFC_st.DFC_LATP DFC_st.DFC_LDLAHI DFC_st.DFC_LFS1Max DFC_st.DFC_LFS1Min DFC_st.DFC_LFS1Sig DFC_st.DFC_LSHmax DFC_st.DFC_LSHmin DFC_st.DFC_LSHnpl DFC_st.DFC_LSHsig DFC_st.DFC_LSVmax DFC_st.DFC_LSVmin DFC_st.DFC_LSVnpl DFC_st.DFC_LSVsig DFC_st.DFC_MDCat DFC_st.DFC_MDCatCurr DFC_st.DFC_MDCyl DFC_st.DFC_MDEmi DFC_st.DFC_MDEmiStrt DFC_st.DFC_MDMpl DFC_st.DFC_MoCADCNTP DFC_st.DFC_MoCADCTst DFC_st.DFC_MoFSidst DFC_st.DFC_OCWDACom DFC_st.DFC_OilPPSSwtMax DFC_st.DFC_OilPPSSwtMin DFC_st.DFC_OilPPSSwtSig DFC_st.DFC_OvHEngSpdLimr DFC_st.DFC_RoVComVld DFC_st.DFC_RoVSNpl DFC_st.DFC_RoVSOL DFC_st.DFC_RoVSSCB DFC_st.DFC_RoVSSCG DFC_st.DFC_SdSTNpl DFC_st.DFC_SdSTSCB DFC_st.DFC_SdSTSCG DFC_st.DFC_SdSTSOL DFC_st.DFC_TEVEmax DFC_st.DFC_TEVEmin DFC_st.DFC_TEVEsig DFC_st.DFC_TMnpl DFC_st.DFC_UBmax DFC_st.DFC_UBmin DFC_st.DFC_UBnpl DFC_st.DFC_VFZsig DFC_st.DFC_VFZsig2 DSQ_st.DSQ_DSMInhibitAlways DSQ_st.DSQ_EpmReverseRun DSQ_st.DSQ_MRly DSQ_st.DSQ_RvsRotPred DSQ_st.DSQ_StrtActr DSQ_st.DSQ_T15TurnOfDly /end OUT_MEASUREMENT
 /begin LOC_MEASUREMENT DFC_lenMaxCllsn DFC_nrCllsnClear DFC_nrCllsnReInit DFC_nrCllsnReport DFC_numDfcMaxCllsn DFC_stClctFault_mp DFC_stClctTst_mp DFC_stFinal DFC_stMem DFC_stRdy /end LOC_MEASUREMENT
 FUNCTION_VERSION "30000.19.0_2.1.0" /end FUNCTION
/begin COMPU_METHOD DDRCTime_ms "" RAT_FUNC "%6.1" "ms" COEFFS 0 1 0 0 0 10 /end COMPU_METHOD
/begin COMPU_METHOD DDRC_Ratio "" TAB_VERB "%6.3" "-" COMPU_TAB_REF DDRC_Ratio /end COMPU_METHOD
/begin COMPU_VTAB DDRC_Ratio "" TAB_VERB 4 1 "Ratio1" 2 "Ratio2" 3 "Ratio3" 4 "Ratio4" /end COMPU_VTAB
/begin COMPU_METHOD Dem_DTCGroup_Verb "" TAB_VERB "%6.3" "-" COMPU_TAB_REF Dem_DTCGroup_Verb /end COMPU_METHOD
/begin COMPU_VTAB Dem_DTCGroup_Verb "" TAB_VERB 6 0 "DEM_DTC_GROUP_NONE" 1 "DEM_DTC_GROUP_EMISSION_REL" 2 "DEM_DTC_GROUP_POWERTRAIN" 4 "DEM_DTC_GROUP_CHASSIS" 8 "DEM_DTC_GROUP_BODY" 16 "DEM_DTC_GROUP_NETWORK_COM" /end COMPU_VTAB
/begin COMPU_METHOD Dem_DTCSeverity_Verb "" TAB_VERB "%6.3" "-" COMPU_TAB_REF Dem_DTCSeverity_Verb /end COMPU_METHOD
/begin COMPU_VTAB Dem_DTCSeverity_Verb "" TAB_VERB 4 0 "DEM_SEVERITY_NO_SEVERITY" 32 "DEM_SEVERITY_MAINTENANCE_ONLY" 64 "DEM_SEVERITY_CHECK_AT_NEXT_HALT" 128 "DEM_SEVERITY_CHECK_IMMEDIATELY" /end COMPU_VTAB
/begin COMPU_METHOD DFCDFP_Verb "" TAB_VERB "%2.1" "-" COMPU_TAB_REF DFCDFP_Verb /end COMPU_METHOD
/begin COMPU_VTAB DFCDFP_Verb "" TAB_VERB 187 0 "NoEntry" 1 "DFC_BusDiagOpenLoad_Can0" 2 "DFC_Com_ABSInfo_DLC" 3 "DFC_Com_ABSInfo_TO" 4 "DFC_BusDiagBusOff_Can0" 5 "DFC_DevLibBattUHi" 6 "DFC_DevLibBattULo" 7 "DFC_StrtOL" 8 "DFC_StrtOvrTemp" 9 "DFC_StrtSCB" 10 "DFC_StrtSCG" 11 "DFC_MILLmpOL" 12 "DFC_MILLmpOT" 13 "DFC_MILLmpSCB" 14 "DFC_MILLmpSCG" 15 "DFC_EV1max" 16 "DFC_EV1min" 17 "DFC_EV1sig" 18 "DFC_CEngDsTPlausSTC" 19 "DFC_ClthStkOpn" 20 "DFC_EVX" 21 "DFC_IntkAirTAirFltDsSTC" 22 "DFC_RoughRoad" 23 "DFC_SSpMon1" 24 "DFC_SSpMon1OT" 25 "DFC_SSpMon1OV" 26 "DFC_SSpMon1SCG" 27 "DFC_SSpMon1UV" 28 "DFC_SSpMon2" 29 "DFC_SSpMon2OT" 30 "DFC_SSpMon2OV" 31 "DFC_SSpMon2SCG" 32 "DFC_SSpMon2UV" 33 "DFC_CANIF_E_CTRL_NOT_SLEEP_ERROR_VALUE" 34 "DFC_CANIF_E_CTRL_STOPPED_ERROR_VALUE" 35 "DFC_CANIF_E_INVALID_DLC_ERROR" 36 "DFC_CANNM_E_CANIF_TRANSMIT_ERROR" 37 "DFC_CANNM_E_INIT_FAILED" 38 "DFC_CANNM_E_NETWORK_TIMEOUT" 39 "DFC_CAN_E_TIMEOUT" 40 "DFC_COMM_E_NET_START_IND_CHANNEL_0" 41 "DFC_COMM_E_NET_START_IND_CHANNEL_1" 42 "DFC_COMM_E_NET_START_IND_CHANNEL_2" 43 "DFC_COMM_E_NET_START_IND_CHANNEL_3" 44 "DFC_COMM_E_NET_START_IND_CHANNEL_4" 45 "DFC_COMM_E_NET_START_IND_CHANNEL_5" 46 "DFC_PDUR_E_INIT_FAILED" 47 "DFC_PDUR_E_PDU_INSTANCE_LOST" 48 "DFC_RBA_IOEXTLIB_KEEPALIVE_DRV" 49 "DFC_RBA_IOEXTLIB_KEEPALIVE_INI" 50 "DFC_rba_IoSigRtc_StopCounter" 51 "DFC_rba_MultiStackTrace_Threshold" 52 "DFC_rba_MRly_Diag_Stk_Event" 53 "DFC_rba_SyC_IrrSwOffTrigEngRun_Event" 54 "DFC_rba_T15_Diag_ComInVld_Event" 55 "DFC_rba_T15_Diag_ComOff_HwOn_Event" 56 "DFC_rba_T15_Diag_ComOn_HwOff_Event" 57 "DFC_BypAirActrOcCoil1" 58 "DFC_BypAirActrOcCoil2" 59 "DFC_BypAirActrOlCoil1" 60 "DFC_BypAirActrOlCoil2" 61 "DFC_BypAirActrOt" 62 "DFC_BypAirActrScbCoil1" 63 "DFC_BypAirActrScbCoil2" 64 "DFC_BypAirActrScgCoil1" 65 "DFC_BypAirActrScgCoil2" 66 "DFC_CEngDsTPhysRngHi" 67 "DFC_CEngDsTPhysRngLo" 68 "DFC_CEngDsTSRCMax" 69 "DFC_CEngDsTSRCMin" 70 "DFC_DKmax" 71 "DFC_DKmin" 72 "DFC_DLLRmax" 73 "DFC_DLLRmin" 74 "DFC_DLLRnpl" 75 "DFC_DSSRngMax" 76 "DFC_DSSRngMin" 77 "DFC_DSSmax" 78 "DFC_DSSmin" 79 "DFC_DSSnpl" 80 "DFC_DSSnplMax" 81 "DFC_DSSnplMin" 82 "DFC_DSSsig" 83 "DFC_EpmCrSErrSig" 84 "DFC_EpmCrSNoSig" 85 "DFC_HEGOS1B1ElecNpl" 86 "DFC_HSH" 87 "DFC_HSHEmax" 88 "DFC_HSHEmin" 89 "DFC_HSHEsig" 90 "DFC_HSV" 91 "DFC_HSVEmax" 92 "DFC_HSVEmin" 93 "DFC_HSVEsig" 94 "DFC_HdLampMax" 95 "DFC_HdLampMin" 96 "DFC_HdLampSig" 97 "DFC_IgnCoil1Err" 98 "DFC_IgnCoil2Err" 99 "DFC_IgnIgbtDiagSCG_0" 100 "DFC_IgnIgbtDiagSCG_1" 101 "DFC_IntkAirTAirFltDsPRCMax" 102 "DFC_IntkAirTAirFltDsPRCMin" 103 "DFC_IntkAirTAirFltDsSRCMax" 104 "DFC_IntkAirTAirFltDsSRCMin" 105 "DFC_IntkMnfldPNoSyn" 106 "DFC_KAT" 107 "DFC_KPEmax" 108 "DFC_KPEmin" 109 "DFC_KPEsig" 110 "DFC_KVSFmax" 111 "DFC_KVSFmin" 112 "DFC_KVSOmax" 113 "DFC_KVSOmin" 114 "DFC_LASHmn" 115 "DFC_LASHmx" 116 "DFC_LATP" 117 "DFC_LDLAHI" 118 "DFC_LFS1Max" 119 "DFC_LFS1Min" 120 "DFC_LFS1Sig" 121 "DFC_LSHmax" 122 "DFC_LSHmin" 123 "DFC_LSHnpl" 124 "DFC_LSHsig" 125 "DFC_LSVmax" 126 "DFC_LSVmin" 127 "DFC_LSVnpl" 128 "DFC_LSVsig" 129 "DFC_MDCat" 130 "DFC_MDCatCurr" 131 "DFC_MDCyl" 132 "DFC_MDEmi" 133 "DFC_MDEmiStrt" 134 "DFC_MDMpl" 135 "DFC_MoCADCNTP" 136 "DFC_MoCADCTst" 137 "DFC_MoFSidst" 138 "DFC_OCWDACom" 139 "DFC_OilPPSSwtMax" 140 "DFC_OilPPSSwtMin" 141 "DFC_OilPPSSwtSig" 142 "DFC_OvHEngSpdLimr" 143 "DFC_RoVComVld" 144 "DFC_RoVSNpl" 145 "DFC_RoVSOL" 146 "DFC_RoVSSCB" 147 "DFC_RoVSSCG" 148 "DFC_SdSTNpl" 149 "DFC_SdSTSCB" 150 "DFC_SdSTSCG" 151 "DFC_SdSTSOL" 152 "DFC_TEVEmax" 153 "DFC_TEVEmin" 154 "DFC_TEVEsig" 155 "DFC_TMnpl" 156 "DFC_UBmax" 157 "DFC_UBmin" 158 "DFC_UBnpl" 159 "DFC_VFZsig" 160 "DFC_VFZsig2" 161 "DFP_AAA" 162 "DFP_BM" 163 "DFP_DK" 164 "DFP_DLLR" 165 "DFP_DSS" 166 "DFP_EV1" 167 "DFP_HdLamp" 168 "DFP_HSH" 169 "DFP_HSHE" 170 "DFP_HSV" 171 "DFP_HSVE" 172 "DFP_KAT" 173 "DFP_KPE" 174 "DFP_LASH" 175 "DFP_LATP" 176 "DFP_LDLAHI" 177 "DFP_LFS1" 178 "DFP_LSH" 179 "DFP_LSV" 180 "DFP_N" 181 "DFP_OilPPSSwt" 182 "DFP_STRTR" 183 "DFP_TEVE" 184 "DFP_UBR" 185 "DFP_VFZ" 186 "DFP_ZZZ" DEFAULT_VALUE "---" /end COMPU_VTAB
/begin COMPU_METHOD DFC_OneToOne "" RAT_FUNC "%6.2" "-" COEFFS 0 1 0 0 0 1 /end COMPU_METHOD
/begin COMPU_METHOD DFES_OneToOne "" RAT_FUNC "%6.2" "-" COEFFS 0 1 0 0 0 1 /end COMPU_METHOD
/begin COMPU_METHOD DIABAS_CALIDCVNCTRL_SC_Compu "" TAB_VERB "%6.3" "" COMPU_TAB_REF DIABAS_CALIDCVNCTRL_SC_Compu /end COMPU_METHOD
/begin COMPU_VTAB DIABAS_CALIDCVNCTRL_SC_Compu "" TAB_VERB 3 0 "CALIDCVN_LEG" 1 "CALIDCVN_MIX" 2 "CALIDCVN_AUTO" /end COMPU_VTAB
/begin COMPU_METHOD DIABAS_CALIDCVNLENSEQ_SC_Compu "" RAT_FUNC "%6.2" "" COEFFS 0 1 0 0 0 1 /end COMPU_METHOD
/begin COMPU_METHOD DIABAS_CRCTAB_SY_Compu "" TAB_VERB "%6.3" "" COMPU_TAB_REF DIABAS_CRCTAB_SY_Compu /end COMPU_METHOD
/begin COMPU_VTAB DIABAS_CRCTAB_SY_Compu "" TAB_VERB 2 0 "False" 1 "True" /end COMPU_VTAB
/begin COMPU_METHOD DIABAS_CUSVAR_SC_Compu "" RAT_FUNC "%6.2" "" COEFFS 0 1 0 0 0 1 /end COMPU_METHOD
/begin COMPU_METHOD DIABAS_IFFLOATSIG_SC_Compu "" TAB_VERB "%6.3" "" COMPU_TAB_REF DIABAS_IFFLOATSIG_SC_Compu /end COMPU_METHOD
/begin COMPU_VTAB DIABAS_IFFLOATSIG_SC_Compu "" TAB_VERB 2 0 "False" 1 "True" /end COMPU_VTAB
/begin COMPU_METHOD DIABAS_PNDRPRTMOD2_SC_Compu "" TAB_VERB "%6.3" "" COMPU_TAB_REF DIABAS_PNDRPRTMOD2_SC_Compu /end COMPU_METHOD
/begin COMPU_VTAB DIABAS_PNDRPRTMOD2_SC_Compu "" TAB_VERB 2 0 "False" 1 "True" /end COMPU_VTAB
/begin COMPU_METHOD DIABAS_PRMIDAUTVIEW_SC_Compu "" TAB_VERB "%6.3" "" COMPU_TAB_REF DIABAS_PRMIDAUTVIEW_SC_Compu /end COMPU_METHOD
/begin COMPU_VTAB DIABAS_PRMIDAUTVIEW_SC_Compu "" TAB_VERB 2 0 "False" 1 "True" /end COMPU_VTAB
/begin COMPU_METHOD DIABAS_SCRCTL_RCNT_RESET_SY_Compu "" TAB_VERB "%6.3" "" COMPU_TAB_REF DIABAS_SCRCTL_RCNT_RESET_SY_Compu /end COMPU_METHOD
/begin COMPU_VTAB DIABAS_SCRCTL_RCNT_RESET_SY_Compu "" TAB_VERB 2 0 "False" 1 "True" /end COMPU_VTAB
/begin COMPU_METHOD DIABAS_SRV8_SC_Compu "" RAT_FUNC "%6.2" "" COEFFS 0 1 0 0 0 1 /end COMPU_METHOD
/begin COMPU_METHOD DIABAS_VAR_SY_Compu "" TAB_VERB "%6.3" "" COMPU_TAB_REF DIABAS_VAR_SY_Compu /end COMPU_METHOD
/begin COMPU_VTAB DIABAS_VAR_SY_Compu "" TAB_VERB 51 0 "kein Kundenbezug" 1 "DAI" 3 "VWW" 4 "POR" 5 "AUD" 6 "OPE" 9 "FIA" 11 "BMW" 14 "PSA" 15 "REN" 17 "ALF" 18 "SAB" 19 "VOL" 20 "NIS" 21 "GMU" 22 "FOR" 26 "IMJ" 36 "MAN" 51 "SEA" 53 "CHR" 54 "JAG" 55 "ROL" 57 "FORD_EU_Diesel" 69 "FER" 72 "TOY" 123 "MIT" 147 "HYU" 159 "HON" 160 "MAZ" 183 "CU" 190 "LRG" 204 "VVW" 214 "AVT" 242 "Iveco" 243 "DMC" 248 "SUZ" 270 "KEF" 289 "AMG" 308 "TAT" 319 "MVM" 328 "MM" 339 "AML" 385 "UAES" 578 "AL" 590 "SCANIA" 658 "Isuzu" 760 "WEICHAI" 828 "RBCD" 999 "ALL" 2887 "Nonox" 9454 "Fuso" /end COMPU_VTAB
/begin COMPU_METHOD DIAGCOM_CALCAN_SC_Compu "" TAB_VERB "%6.3" "" COMPU_TAB_REF DIAGCOM_CALCAN_SC_Compu /end COMPU_METHOD
/begin COMPU_VTAB DIAGCOM_CALCAN_SC_Compu "" TAB_VERB 2 0 "False" 1 "True" /end COMPU_VTAB
/begin COMPU_METHOD DIAG_PROTOCOL_SY_Compu "" TAB_VERB "%6.3" "" COMPU_TAB_REF DIAG_PROTOCOL_SY_Compu /end COMPU_METHOD
/begin COMPU_VTAB DIAG_PROTOCOL_SY_Compu "" TAB_VERB 2 0 "DIAG_I14230" 1 "DIAG_I14229" /end COMPU_VTAB
/begin COMPU_METHOD DifCoef_COMPU "" RAT_FUNC "%6.2" "J/m/K/s" COEFFS 0 1 0 0 0 1 /end COMPU_METHOD
/begin COMPU_METHOD DifCoef_q0p0001_COMPU "" RAT_FUNC "%7.6" "J/m/K/s" COEFFS 0 10000 0 0 0 1 /end COMPU_METHOD
/begin COMPU_METHOD DINH_DEF25DEB0DI_SC_Compu "" TAB_VERB "%6.3" "" COMPU_TAB_REF DINH_DEF25DEB0DI_SC_Compu /end COMPU_METHOD
/begin COMPU_VTAB DINH_DEF25DEB0DI_SC_Compu "" TAB_VERB 2 0 "False" 1 "True" /end COMPU_VTAB
/begin COMPU_METHOD DINH_FID_VIEW_SC_Compu "" TAB_VERB "%6.3" "" COMPU_TAB_REF DINH_FID_VIEW_SC_Compu /end COMPU_METHOD
/begin COMPU_VTAB DINH_FID_VIEW_SC_Compu "" TAB_VERB 2 0 "False" 1 "True" /end COMPU_VTAB
/begin COMPU_METHOD DINH_MONINHBCNT_SC_Compu "" RAT_FUNC "%6.2" "" COEFFS 0 1 0 0 0 1 /end COMPU_METHOD
/begin COMPU_METHOD DINH_NEWTRIPWITHFCMCLR_SC_Compu "" TAB_VERB "%6.3" "" COMPU_TAB_REF DINH_NEWTRIPWITHFCMCLR_SC_Compu /end COMPU_METHOD
/begin COMPU_VTAB DINH_NEWTRIPWITHFCMCLR_SC_Compu "" TAB_VERB 2 0 "False" 1 "True" /end COMPU_VTAB
/begin COMPU_METHOD DIPO_SY_Compu "" TAB_VERB "%6.3" "" COMPU_TAB_REF DIPO_SY_Compu /end COMPU_METHOD
/begin COMPU_VTAB DIPO_SY_Compu "" TAB_VERB 2 0 "0" 1 "1" /end COMPU_VTAB
/begin COMPU_METHOD DISTAB_SY_Compu "" TAB_VERB "%6.3" "" COMPU_TAB_REF DISTAB_SY_Compu /end COMPU_METHOD
/begin COMPU_VTAB DISTAB_SY_Compu "" TAB_VERB 2 0 "No Distab" 1 "Distab" /end COMPU_VTAB
/begin COMPU_METHOD DIUMPR_500MD_SY_Compu "" TAB_VERB "%6.3" "" COMPU_TAB_REF DIUMPR_500MD_SY_Compu /end COMPU_METHOD
/begin COMPU_VTAB DIUMPR_500MD_SY_Compu "" TAB_VERB 2 0 "0" 1 "1" /end COMPU_VTAB
/begin COMPU_METHOD DIUMPR_COLDSTARTDEN_SC_Compu "" TAB_VERB "%6.3" "" COMPU_TAB_REF DIUMPR_COLDSTARTDEN_SC_Compu /end COMPU_METHOD
/begin COMPU_VTAB DIUMPR_COLDSTARTDEN_SC_Compu "" TAB_VERB 2 0 "False" 1 "True" /end COMPU_VTAB
/begin COMPU_METHOD DIUMPR_DATAFROMCAN_SC_Compu "" TAB_VERB "%6.3" "" COMPU_TAB_REF DIUMPR_DATAFROMCAN_SC_Compu /end COMPU_METHOD
/begin COMPU_VTAB DIUMPR_DATAFROMCAN_SC_Compu "" TAB_VERB 2 0 "False" 1 "True" /end COMPU_VTAB
/begin COMPU_METHOD DIUMPR_DSTTRVLDSNCERST_SC_Compu "" TAB_VERB "%6.3" "" COMPU_TAB_REF DIUMPR_DSTTRVLDSNCERST_SC_Compu /end COMPU_METHOD
/begin COMPU_VTAB DIUMPR_DSTTRVLDSNCERST_SC_Compu "" TAB_VERB 2 0 "False" 1 "True" /end COMPU_VTAB
/begin COMPU_METHOD Fact "" RAT_FUNC "%6.5" "-" COEFFS 0 8192 0 0 0 1 /end COMPU_METHOD
/begin COMPU_METHOD OneToOne "" RAT_FUNC "%6.2" "-" COEFFS 0 1 0 0 0 1 /end COMPU_METHOD
/begin COMPU_METHOD Volt_Batt "" RAT_FUNC "%6.1" "mV" COEFFS 0 0.05 0 0 0 1 /end COMPU_METHOD
/begin RECORD_LAYOUT Kw_Ws16 FNC_VALUES 1 SWORD COLUMN_DIR DIRECT /end RECORD_LAYOUT
/begin RECORD_LAYOUT Val_Wu16 FNC_VALUES 1 UWORD COLUMN_DIR DIRECT /end RECORD_LAYOUT
/begin RECORD_LAYOUT Val_Wu8 FNC_VALUES 1 UBYTE COLUMN_DIR DIRECT /end RECORD_LAYOUT
/end MODULE
/end PROJECT
