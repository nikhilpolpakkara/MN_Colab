ASAP2_VERSION 1 60
/begin PROJECT MSE2_BJ10_0038_00 "MDG1"
/begin HEADER "" VERSION "MSE2_BJ10_0038_00" PROJECT_NO MSE2_BJ10_0038_00 /end HEADER
/begin MODULE DIM ""
/begin MOD_COMMON "" BYTE_ORDER MSB_FIRST ALIGNMENT_BYTE 1 ALIGNMENT_WORD 2 ALIGNMENT_LONG 4 ALIGNMENT_INT64 4 ALIGNMENT_FLOAT32_IEEE 4 ALIGNMENT_FLOAT64_IEEE 4 /end MOD_COMMON
/begin CHARACTERISTIC DFC_CtlMsk2.DFC_RoughRoad_C "Behaviour control mask / Behaviour control masks of check DFC_RoughRoad" VALUE 0x90803AE Val_Wu8 255.0 DFES_OneToOne 0.00 255.0 FORMAT "%5.1" /end CHARACTERISTIC
/begin CHARACTERISTIC DFC_CtlMsk2.DFC_MDCat_C "Behaviour control mask / Behaviour control masks of check DFC_MDCat" VALUE 0x9080419 Val_Wu8 255.0 DFES_OneToOne 0.00 255.0 FORMAT "%5.1" /end CHARACTERISTIC
/begin CHARACTERISTIC DFC_CtlMsk2.DFC_MDCatCurr_C "Behaviour control mask / Behaviour control masks of check DFC_MDCatCurr" VALUE 0x908041A Val_Wu8 255.0 DFES_OneToOne 0.00 255.0 FORMAT "%5.1" /end CHARACTERISTIC
/begin CHARACTERISTIC DFC_CtlMsk2.DFC_MDCyl_C "Behaviour control mask / Behaviour control masks of check DFC_MDCyl" VALUE 0x908041B Val_Wu8 255.0 DFES_OneToOne 0.00 255.0 FORMAT "%5.1" /end CHARACTERISTIC
/begin CHARACTERISTIC DFC_CtlMsk2.DFC_MDEmi_C "Behaviour control mask / Behaviour control masks of check DFC_MDEmi" VALUE 0x908041C Val_Wu8 255.0 DFES_OneToOne 0.00 255.0 FORMAT "%5.1" /end CHARACTERISTIC
/begin CHARACTERISTIC DFC_CtlMsk2.DFC_MDEmiStrt_C "Behaviour control mask / Behaviour control masks of check DFC_MDEmiStrt" VALUE 0x908041D Val_Wu8 255.0 DFES_OneToOne 0.00 255.0 FORMAT "%5.1" /end CHARACTERISTIC
/begin CHARACTERISTIC DFC_CtlMsk2.DFC_MDMpl_C "Behaviour control mask / Behaviour control masks of check DFC_MDMpl" VALUE 0x908041E Val_Wu8 255.0 DFES_OneToOne 0.00 255.0 FORMAT "%5.1" /end CHARACTERISTIC
/begin CHARACTERISTIC DFC_CtlMsk2.DFC_MoCADCNTP_C "Behaviour control mask / Behaviour control masks of check DFC_MoCADCNTP" VALUE 0x908041F Val_Wu8 255.0 DFES_OneToOne 0.00 255.0 FORMAT "%5.1" /end CHARACTERISTIC
/begin CHARACTERISTIC DFC_CtlMsk2.DFC_MoCADCTst_C "Behaviour control mask / Behaviour control masks of check DFC_MoCADCTst" VALUE 0x9080420 Val_Wu8 255.0 DFES_OneToOne 0.00 255.0 FORMAT "%5.1" /end CHARACTERISTIC
/begin CHARACTERISTIC DFC_DisblMsk2.DFC_RoughRoad_C "disable mask / Disable masks of check DFC_RoughRoad" VALUE 0x9080D7E Val_Wu8 255.0 DFES_OneToOne 0.00 255.0 FORMAT "%5.1" /end CHARACTERISTIC
/begin CHARACTERISTIC DFC_DisblMsk2.DFC_MDCat_C "disable mask / Disable masks of check DFC_MDCat" VALUE 0x9080DE9 Val_Wu8 255.0 DFES_OneToOne 0.00 255.0 FORMAT "%5.1" /end CHARACTERISTIC
/begin CHARACTERISTIC DFC_DisblMsk2.DFC_MDCatCurr_C "disable mask / Disable masks of check DFC_MDCatCurr" VALUE 0x9080DEA Val_Wu8 255.0 DFES_OneToOne 0.00 255.0 FORMAT "%5.1" /end CHARACTERISTIC
/begin CHARACTERISTIC DFC_DisblMsk2.DFC_MDCyl_C "disable mask / Disable masks of check DFC_MDCyl" VALUE 0x9080DEB Val_Wu8 255.0 DFES_OneToOne 0.00 255.0 FORMAT "%5.1" /end CHARACTERISTIC
/begin CHARACTERISTIC DFC_DisblMsk2.DFC_MDEmi_C "disable mask / Disable masks of check DFC_MDEmi" VALUE 0x9080DEC Val_Wu8 255.0 DFES_OneToOne 0.00 255.0 FORMAT "%5.1" /end CHARACTERISTIC
/begin CHARACTERISTIC DFC_DisblMsk2.DFC_MDEmiStrt_C "disable mask / Disable masks of check DFC_MDEmiStrt" VALUE 0x9080DED Val_Wu8 255.0 DFES_OneToOne 0.00 255.0 FORMAT "%5.1" /end CHARACTERISTIC
/begin CHARACTERISTIC DFC_DisblMsk2.DFC_MDMpl_C "disable mask / Disable masks of check DFC_MDMpl" VALUE 0x9080DEE Val_Wu8 255.0 DFES_OneToOne 0.00 255.0 FORMAT "%5.1" /end CHARACTERISTIC
/begin CHARACTERISTIC DFC_DisblMsk2.DFC_MoCADCNTP_C "disable mask / Disable masks of check DFC_MoCADCNTP" VALUE 0x9080DEF Val_Wu8 255.0 DFES_OneToOne 0.00 255.0 FORMAT "%5.1" /end CHARACTERISTIC
/begin CHARACTERISTIC DFC_DisblMsk2.DFC_MoCADCTst_C "disable mask / Disable masks of check DFC_MoCADCTst" VALUE 0x9080DF0 Val_Wu8 255.0 DFES_OneToOne 0.00 255.0 FORMAT "%5.1" /end CHARACTERISTIC
/begin CHARACTERISTIC MisfDet_axleSeln_C "Axle selection for rough road detection" VALUE 0x9082DE8 RB_Val_Wu8 3.000 dez 0.00 3.000 FORMAT "%5.3" EXTENDED_LIMITS 0.00 255.0 /end CHARACTERISTIC
/begin CHARACTERISTIC MisfDet_ctDef_C "number of defect cycles for MIL on" VALUE 0x9082F18 RB_Val_Wu8 255.0 OneToOne 0.00 255.0 FORMAT "%5.1" /end CHARACTERISTIC
/begin CHARACTERISTIC MisfDet_ctOk_C "number of ok cycles for healing" VALUE 0x9082F19 RB_Val_Wu8 255.0 OneToOne 0.00 255.0 FORMAT "%5.1" /end CHARACTERISTIC
/begin CHARACTERISTIC MisfDet_dnThdContRdcFac_C "factor on negative dn Values for reduction of dnThdCont" VALUE 0x9082F1E RB_Val_Wu16 0.9999847 fak_uw_b1 0.00 0.9999847 FORMAT "%9.7" /end CHARACTERISTIC
/begin CHARACTERISTIC MisfDet_dnThdContRdcIdx_C "selection of dn value in ascending order for reduction of dnThdCont" VALUE 0x9082F20 RB_Val_Wu8 255.0 OneToOne 0.00 255.0 FORMAT "%5.1" /end CHARACTERISTIC
/begin CHARACTERISTIC MisfDet_dnThdDecFilFac_C "filter factore for limitation of negative gradient of detection threshold" VALUE 0x9082F22 RB_Val_Wu16 0.9999847 fak_uw_b1 0.00 0.9999847 FORMAT "%9.7" /end CHARACTERISTIC
/begin CHARACTERISTIC MisfDet_dnThdDecMaxCont_T "maximum negative gradient of detection threshold for continuous misfires" CURVE 0x9082F24 RB_Curve_S16_S16 4095.938 dn_Compu -2048.000 2047.938 FORMAT "%8.3"
 /begin AXIS_DESCR STD_AXIS MisfDet_nEngSync EngN 4 -16384.00 16383.50 FORMAT "%8.2" DEPOSIT ABSOLUTE /end AXIS_DESCR
/end CHARACTERISTIC
/begin CHARACTERISTIC MisfDet_dnThdDecMax_T "maximum negative gradient of detection threshold" CURVE 0x9082F36 RB_Curve_S16_S16 4095.938 dn_Compu -2048.000 2047.938 FORMAT "%8.3"
 /begin AXIS_DESCR STD_AXIS MisfDet_nEngSync EngN 4 -16384.00 16383.50 FORMAT "%8.2" DEPOSIT ABSOLUTE /end AXIS_DESCR
/end CHARACTERISTIC
/begin CHARACTERISTIC MisfDet_dnThdFacStrt_T "Factor to detection threshold at engine start" CURVE 0x9082F48 RB_Curve_U16_U16 1.999969 fak_uw_b2 0.00 1.999969 FORMAT "%8.6"
 /begin AXIS_DESCR STD_AXIS MisfDet_tiEngRunSum t_q0p1 4 0.00 6553.500 FORMAT "%8.3" DEPOSIT ABSOLUTE /end AXIS_DESCR
/end CHARACTERISTIC
/begin AXIS_PTS MisfDet_dnThdIdleTq_AX "torque axis for base maps at idle" 0x9082FA0 MisfDet_tqBascSync RB_Axis_U16 99.99847 rel_uw_b100 6 0.00 99.99847 FORMAT "%8.5" DEPOSIT ABSOLUTE /end AXIS_PTS
/begin CHARACTERISTIC MisfDet_dnThdMapDrvCatHeatGrip.Std.Cmn_GM "Thresholds for catalyst heating at driving operation closed clutch / standard engine roughness / all transmission types" MAP 0x9082FD8 RB_MapGroup_S16 4095.938 dn_Compu -2048.000 2047.938 FORMAT "%8.3"
 /begin AXIS_DESCR COM_AXIS MisfDet_tqBascSync rel_uw_b100 8 0.00 99.99847 FORMAT "%8.5" AXIS_PTS_REF MisfDet_dnThdTq_AX /end AXIS_DESCR
 /begin AXIS_DESCR COM_AXIS MisfDet_nEngSync EngN 8 -16384.00 16383.50 FORMAT "%8.2" AXIS_PTS_REF MisfDet_dnThdN_AX /end AXIS_DESCR
/end CHARACTERISTIC
/begin CHARACTERISTIC MisfDet_dnThdMapDrvCatHeatGrip.Cont.Cmn_GM "Thresholds for catalyst heating at driving operation closed clutch / continuous misfire (filtered engine roughness) / all transmission types" MAP 0x9083058 RB_MapGroup_S16 4095.938 dn_Compu -2048.000 2047.938 FORMAT "%8.3"
 /begin AXIS_DESCR COM_AXIS MisfDet_tqBascSync rel_uw_b100 8 0.00 99.99847 FORMAT "%8.5" AXIS_PTS_REF MisfDet_dnThdTq_AX /end AXIS_DESCR
 /begin AXIS_DESCR COM_AXIS MisfDet_nEngSync EngN 8 -16384.00 16383.50 FORMAT "%8.2" AXIS_PTS_REF MisfDet_dnThdN_AX /end AXIS_DESCR
/end CHARACTERISTIC
/begin CHARACTERISTIC MisfDet_dnThdMapDrvCatHeatOpen.Std.Cmn_GM "Thresholds for catalyst heating at driving operation slipping clutch / standard engine roughness / all transmission types" MAP 0x90830D8 RB_MapGroup_S16 4095.938 dn_Compu -2048.000 2047.938 FORMAT "%8.3"
 /begin AXIS_DESCR COM_AXIS MisfDet_tqBascSync rel_uw_b100 8 0.00 99.99847 FORMAT "%8.5" AXIS_PTS_REF MisfDet_dnThdTq_AX /end AXIS_DESCR
 /begin AXIS_DESCR COM_AXIS MisfDet_nEngSync EngN 8 -16384.00 16383.50 FORMAT "%8.2" AXIS_PTS_REF MisfDet_dnThdN_AX /end AXIS_DESCR
/end CHARACTERISTIC
/begin CHARACTERISTIC MisfDet_dnThdMapDrvCatHeatOpen.Cont.Cmn_GM "Thresholds for catalyst heating at driving operation slipping clutch / continuous misfire (filtered engine roughness) / all transmission types" MAP 0x9083158 RB_MapGroup_S16 4095.938 dn_Compu -2048.000 2047.938 FORMAT "%8.3"
 /begin AXIS_DESCR COM_AXIS MisfDet_tqBascSync rel_uw_b100 8 0.00 99.99847 FORMAT "%8.5" AXIS_PTS_REF MisfDet_dnThdTq_AX /end AXIS_DESCR
 /begin AXIS_DESCR COM_AXIS MisfDet_nEngSync EngN 8 -16384.00 16383.50 FORMAT "%8.2" AXIS_PTS_REF MisfDet_dnThdN_AX /end AXIS_DESCR
/end CHARACTERISTIC
/begin CHARACTERISTIC MisfDet_dnThdMapDrvCatHeatSlip.Std.Cmn_GM "Thresholds for catalyst heating at driving operation opened clutch / standard engine roughness / all transmission types" MAP 0x90831D8 RB_MapGroup_S16 4095.938 dn_Compu -2048.000 2047.938 FORMAT "%8.3"
 /begin AXIS_DESCR COM_AXIS MisfDet_tqBascSync rel_uw_b100 8 0.00 99.99847 FORMAT "%8.5" AXIS_PTS_REF MisfDet_dnThdTq_AX /end AXIS_DESCR
 /begin AXIS_DESCR COM_AXIS MisfDet_nEngSync EngN 8 -16384.00 16383.50 FORMAT "%8.2" AXIS_PTS_REF MisfDet_dnThdN_AX /end AXIS_DESCR
/end CHARACTERISTIC
/begin CHARACTERISTIC MisfDet_dnThdMapDrvCatHeatSlip.Cont.Cmn_GM "Thresholds for catalyst heating at driving operation opened clutch / continuous misfire (filtered engine roughness) / all transmission types" MAP 0x9083258 RB_MapGroup_S16 4095.938 dn_Compu -2048.000 2047.938 FORMAT "%8.3"
 /begin AXIS_DESCR COM_AXIS MisfDet_tqBascSync rel_uw_b100 8 0.00 99.99847 FORMAT "%8.5" AXIS_PTS_REF MisfDet_dnThdTq_AX /end AXIS_DESCR
 /begin AXIS_DESCR COM_AXIS MisfDet_nEngSync EngN 8 -16384.00 16383.50 FORMAT "%8.2" AXIS_PTS_REF MisfDet_dnThdN_AX /end AXIS_DESCR
/end CHARACTERISTIC
/begin CHARACTERISTIC MisfDet_dnThdMapIdle.Std.Cmn_GT "Thresholds for idle / standard engine roughness / all transmission types" CURVE 0x90832D8 RB_CurveGroup_S16 4095.938 dn_Compu -2048.000 2047.938 FORMAT "%8.3"
 /begin AXIS_DESCR COM_AXIS MisfDet_tqBascSync rel_uw_b100 6 0.00 99.99847 FORMAT "%8.5" AXIS_PTS_REF MisfDet_dnThdIdleTq_AX /end AXIS_DESCR
/end CHARACTERISTIC
/begin CHARACTERISTIC MisfDet_dnThdMapIdle.Cont.Cmn_GT "Thresholds for idle / continuous misfire (filtered engine roughness) / all transmission types" CURVE 0x90832E4 RB_CurveGroup_S16 4095.938 dn_Compu -2048.000 2047.938 FORMAT "%8.3"
 /begin AXIS_DESCR COM_AXIS MisfDet_tqBascSync rel_uw_b100 6 0.00 99.99847 FORMAT "%8.5" AXIS_PTS_REF MisfDet_dnThdIdleTq_AX /end AXIS_DESCR
/end CHARACTERISTIC
/begin CHARACTERISTIC MisfDet_dnThdMapPtGrip.Std.Cmn_GM "Thresholds for closed clutch / standard engine roughness / all transmission types" MAP 0x90832F0 RB_MapGroup_S16 4095.938 dn_Compu -2048.000 2047.938 FORMAT "%8.3"
 /begin AXIS_DESCR COM_AXIS MisfDet_tqBascSync rel_uw_b100 8 0.00 99.99847 FORMAT "%8.5" AXIS_PTS_REF MisfDet_dnThdTq_AX /end AXIS_DESCR
 /begin AXIS_DESCR COM_AXIS MisfDet_nEngSync EngN 8 -16384.00 16383.50 FORMAT "%8.2" AXIS_PTS_REF MisfDet_dnThdN_AX /end AXIS_DESCR
/end CHARACTERISTIC
/begin CHARACTERISTIC MisfDet_dnThdMapPtGrip.Cont.Cmn_GM "Thresholds for closed clutch / continuous misfire (filtered engine roughness) / all transmission types" MAP 0x9083370 RB_MapGroup_S16 4095.938 dn_Compu -2048.000 2047.938 FORMAT "%8.3"
 /begin AXIS_DESCR COM_AXIS MisfDet_tqBascSync rel_uw_b100 8 0.00 99.99847 FORMAT "%8.5" AXIS_PTS_REF MisfDet_dnThdTq_AX /end AXIS_DESCR
 /begin AXIS_DESCR COM_AXIS MisfDet_nEngSync EngN 8 -16384.00 16383.50 FORMAT "%8.2" AXIS_PTS_REF MisfDet_dnThdN_AX /end AXIS_DESCR
/end CHARACTERISTIC
/begin CHARACTERISTIC MisfDet_dnThdMapPtOpen.Std.Cmn_GM "Thresholds for slipping clutch / standard engine roughness / all transmission types" MAP 0x90833F0 RB_MapGroup_S16 4095.938 dn_Compu -2048.000 2047.938 FORMAT "%8.3"
 /begin AXIS_DESCR COM_AXIS MisfDet_tqBascSync rel_uw_b100 8 0.00 99.99847 FORMAT "%8.5" AXIS_PTS_REF MisfDet_dnThdTq_AX /end AXIS_DESCR
 /begin AXIS_DESCR COM_AXIS MisfDet_nEngSync EngN 8 -16384.00 16383.50 FORMAT "%8.2" AXIS_PTS_REF MisfDet_dnThdN_AX /end AXIS_DESCR
/end CHARACTERISTIC
/begin CHARACTERISTIC MisfDet_dnThdMapPtOpen.Cont.Cmn_GM "Thresholds for slipping clutch / continuous misfire (filtered engine roughness) / all transmission types" MAP 0x9083470 RB_MapGroup_S16 4095.938 dn_Compu -2048.000 2047.938 FORMAT "%8.3"
 /begin AXIS_DESCR COM_AXIS MisfDet_tqBascSync rel_uw_b100 8 0.00 99.99847 FORMAT "%8.5" AXIS_PTS_REF MisfDet_dnThdTq_AX /end AXIS_DESCR
 /begin AXIS_DESCR COM_AXIS MisfDet_nEngSync EngN 8 -16384.00 16383.50 FORMAT "%8.2" AXIS_PTS_REF MisfDet_dnThdN_AX /end AXIS_DESCR
/end CHARACTERISTIC
/begin CHARACTERISTIC MisfDet_dnThdMapPtSlip.Std.Cmn_GM "Thresholds for opened clutch / standard engine roughness / all transmission types" MAP 0x90834F0 RB_MapGroup_S16 4095.938 dn_Compu -2048.000 2047.938 FORMAT "%8.3"
 /begin AXIS_DESCR COM_AXIS MisfDet_tqBascSync rel_uw_b100 8 0.00 99.99847 FORMAT "%8.5" AXIS_PTS_REF MisfDet_dnThdTq_AX /end AXIS_DESCR
 /begin AXIS_DESCR COM_AXIS MisfDet_nEngSync EngN 8 -16384.00 16383.50 FORMAT "%8.2" AXIS_PTS_REF MisfDet_dnThdN_AX /end AXIS_DESCR
/end CHARACTERISTIC
/begin CHARACTERISTIC MisfDet_dnThdMapPtSlip.Cont.Cmn_GM "Thresholds for opened clutch / continuous misfire (filtered engine roughness) / all transmission types" MAP 0x9083570 RB_MapGroup_S16 4095.938 dn_Compu -2048.000 2047.938 FORMAT "%8.3"
 /begin AXIS_DESCR COM_AXIS MisfDet_tqBascSync rel_uw_b100 8 0.00 99.99847 FORMAT "%8.5" AXIS_PTS_REF MisfDet_dnThdTq_AX /end AXIS_DESCR
 /begin AXIS_DESCR COM_AXIS MisfDet_nEngSync EngN 8 -16384.00 16383.50 FORMAT "%8.2" AXIS_PTS_REF MisfDet_dnThdN_AX /end AXIS_DESCR
/end CHARACTERISTIC
/begin CHARACTERISTIC MisfDet_dnThdMinCont.Cmn_GM "Threshold limitation for continuous misfires / all transmission types" MAP 0x90835F0 RB_MapGroup_S16 4095.875 dn_Compu -2047.938 2047.938 FORMAT "%8.3" EXTENDED_LIMITS -2048.000 2047.938
 /begin AXIS_DESCR COM_AXIS MisfDet_tqBascSync rel_uw_b100 8 0.00 99.99847 FORMAT "%8.5" AXIS_PTS_REF MisfDet_dnThdTq_AX /end AXIS_DESCR
 /begin AXIS_DESCR COM_AXIS MisfDet_nEngSync EngN 8 -16384.00 16383.50 FORMAT "%8.2" AXIS_PTS_REF MisfDet_dnThdN_AX /end AXIS_DESCR
/end CHARACTERISTIC
/begin AXIS_PTS MisfDet_dnThdN_AX "engine speed axis for base maps" 0x9082FAE MisfDet_nEngSync RB_Axis_S16 32767.50 EngN 8 -16384.00 16383.50 FORMAT "%8.2" DEPOSIT ABSOLUTE /end AXIS_PTS
/begin CHARACTERISTIC MisfDet_dnThdOffsTCatHeat_T "temperature dependent offset to detection threshold during catalyst heating" CURVE 0x9082F5A RB_Curve_S16_S16 4095.938 dn_Compu -2048.000 2047.938 FORMAT "%8.3"
 /begin AXIS_DESCR STD_AXIS MisfDet_tEng Temp_Cels 8 -3549.940 3003.560 FORMAT "%8.3" DEPOSIT ABSOLUTE /end AXIS_DESCR
/end CHARACTERISTIC
/begin CHARACTERISTIC MisfDet_dnThdOffsT_T "temperature dependent offset to detection threshold" CURVE 0x9082F7C RB_Curve_S16_S16 4095.938 dn_Compu -2048.000 2047.938 FORMAT "%8.3"
 /begin AXIS_DESCR STD_AXIS MisfDet_tEng Temp_Cels 8 -3549.940 3003.560 FORMAT "%8.3" DEPOSIT ABSOLUTE /end AXIS_DESCR
/end CHARACTERISTIC
/begin CHARACTERISTIC MisfDet_dnThdTiMinDynLim_C "Time after start without dynamic limitation" VALUE 0x9082F9E RB_Val_Wu8 25.50 t_q0p1 0.00 25.50 FORMAT "%5.2" /end CHARACTERISTIC
/begin AXIS_PTS MisfDet_dnThdTq_AX "torque axis for base maps" 0x9082FC0 MisfDet_tqBascSync RB_Axis_U16 99.99847 rel_uw_b100 8 0.00 99.99847 FORMAT "%8.5" DEPOSIT ABSOLUTE /end AXIS_PTS
/begin CHARACTERISTIC MisfDet_dVWhlDecMax_C "limitation of negative gradient oh wheel acceleration" VALUE 0x9082DEA RB_Val_Wu16 1638.375 accgrd_q0p025_m_DIV_s3 0.00 1638.375 FORMAT "%8.3" /end CHARACTERISTIC
/begin CHARACTERISTIC MisfDet_dVWhlFil_C "Filter factor for differentiated wheel speeds" VALUE 0x9082DEC RB_Val_Wu16 0.9999847 fak_uw_b1 0.00 0.9999847 FORMAT "%9.7" /end CHARACTERISTIC
/begin CHARACTERISTIC MisfDet_dVWhlFrntThd_M "Threshold map to detect rough road front axle" MAP 0x9082DEE RB_Map_U16S16_U16 1310.700 acc_q0p02 0.00 1310.700 FORMAT "%8.3"
 /begin AXIS_DESCR STD_AXIS MisfDet_tqBasc rel_uw_b100 4 0.00 99.99847 FORMAT "%8.5" DEPOSIT ABSOLUTE /end AXIS_DESCR
 /begin AXIS_DESCR STD_AXIS VehV_v Vel 4 -327.6800 327.6700 FORMAT "%8.4" DEPOSIT ABSOLUTE /end AXIS_DESCR
/end CHARACTERISTIC
/begin CHARACTERISTIC MisfDet_dVWhlReThd_M "Threshold map to detect rough road rear axle" MAP 0x9082E22 RB_Map_U16S16_U16 1310.700 acc_q0p02 0.00 1310.700 FORMAT "%8.3"
 /begin AXIS_DESCR STD_AXIS MisfDet_tqBasc rel_uw_b100 4 0.00 99.99847 FORMAT "%8.5" DEPOSIT ABSOLUTE /end AXIS_DESCR
 /begin AXIS_DESCR STD_AXIS VehV_v Vel 4 -327.6800 327.6700 FORMAT "%8.4" DEPOSIT ABSOLUTE /end AXIS_DESCR
/end CHARACTERISTIC
/begin CHARACTERISTIC MisfDet_nrCycMisfCont_C "Number of consecutive misfires for condition continuous misfire" VALUE 0x9082E66 RB_Val_Wu8 255.0 OneToOne 0.00 255.0 FORMAT "%5.1" /end CHARACTERISTIC
/begin CHARACTERISTIC MisfDet_nrDcycDrvRcdrRst_C "Number of driving cycles to reset endurance test counters" VALUE 0x9082F1B RB_Val_Wu8 255.0 OneToOne 0.00 255.0 FORMAT "%5.1" /end CHARACTERISTIC
/begin CHARACTERISTIC MisfDet_rGripMaxOpen_C "Maximum grip for status open drive train" VALUE 0x9082FD2 RB_Val_Ws16 655.3500 Fact100 -327.6800 327.6700 FORMAT "%8.4" /end CHARACTERISTIC
/begin CHARACTERISTIC MisfDet_rGripMinClsd_C "Minimum grip for status engaged drive train" VALUE 0x9082FD4 RB_Val_Ws16 655.3500 Fact100 -327.6800 327.6700 FORMAT "%8.4" /end CHARACTERISTIC
/begin CHARACTERISTIC MisfDet_segPosnLen_C "segment length value" VALUE 0x9082E58 RB_Val_Wu8 710.0 kw_tooth_sy 10.00 720.0 FORMAT "%5.1" EXTENDED_LIMITS 0.00 2550. /end CHARACTERISTIC
/begin CHARACTERISTIC MisfDet_segPosnStrt_C "starting position of the standard segment" VALUE 0x9082E59 RB_Val_Ws8 2550. kw_tooth_sy -1280. 1270. FORMAT "%5.0" /end CHARACTERISTIC
/begin CHARACTERISTIC MisfDet_segTiDly_C "initial value for delay of igntition to segment time" VALUE 0x9082E5A RB_Val_Wu8 3.000 dez 0.00 3.000 FORMAT "%5.3" EXTENDED_LIMITS 0.00 255.0 /end CHARACTERISTIC
/begin CHARACTERISTIC MisfDet_segTiInin_C "initialisation value for segment duration related to 360 derees crankshaft" VALUE 0x9082E5C RB_Val_Wu16 65.53500 t1msxs_b65p535 0.00 65.53500 FORMAT "%8.5" /end CHARACTERISTIC
/begin CHARACTERISTIC MisfDet_segTiMnpl_CA "manipulation of segment time (for testing purpose)" VAL_BLK 0x9082E5E RB_ValA_Ws16 11.99982 kw_q1p8310eEm4 -6.000000 5.999817 FORMAT "%8.6" NUMBER 2 /end CHARACTERISTIC
/begin CHARACTERISTIC MisfDet_stcCatDmgDebIntlNr_C "number of encounters from catalyst damaging till FSP entry" VALUE 0x9082E6A RB_Val_Wu8 2.000 OneToOne 1.000 3.000 FORMAT "%5.3" EXTENDED_LIMITS 0.00 255.0 /end CHARACTERISTIC
/begin CHARACTERISTIC MisfDet_stcCatDmgDebNMax_C "maximum engine speed for debouncing" VALUE 0x9082E6C RB_Val_Ws16 32767.50 EngN -16384.00 16383.50 FORMAT "%8.2" /end CHARACTERISTIC
/begin CHARACTERISTIC MisfDet_stcCatDmgDebTqMax_T "maximum torque for debouncing" CURVE 0x9082E6E RB_Curve_S16_U16_Static 99.99847 rel_uw_b100 0.00 99.99847 FORMAT "%8.5"
 /begin AXIS_DESCR STD_AXIS Epm_nEng EngN 10 -16384.00 16383.50 FORMAT "%8.2" DEPOSIT ABSOLUTE /end AXIS_DESCR
/end CHARACTERISTIC
/begin CHARACTERISTIC MisfDet_stcCatExtFirstIntlFac_C "Extension factor for first cat interval in case of cold engine" VALUE 0x9082E98 RB_Val_Wu8 255.0 OneToOne 0.00 255.0 FORMAT "%5.1" /end CHARACTERISTIC
/begin CHARACTERISTIC MisfDet_stcCatExtFirstIntlT_C "Maximum temperature for extension of first cat interval" VALUE 0x9082E9A RB_Val_Ws16 6553.500 Temp_Cels -3549.940 3003.560 FORMAT "%8.3" /end CHARACTERISTIC
/begin CHARACTERISTIC MisfDet_stcCatRatMinCylIdn_C "Minimum contribution ratio of misfire sum for cylinder individual misfire fault" VALUE 0x9082E9C Val_Wu16 99.99847 rel_uw_b100 0.00 99.99847 FORMAT "%8.5" /end CHARACTERISTIC
/begin CHARACTERISTIC MisfDet_stcCatRatMinMpl_C "Minimum contribution ratio of misfire sum for multiple misfire fault" VALUE 0x9082E9E Val_Wu16 99.99847 rel_uw_b100 0.00 99.99847 FORMAT "%8.5" /end CHARACTERISTIC
/begin CHARACTERISTIC MisfDet_stcCatThdStrt_CA "Threshold for catalyst damaging at first interval" VAL_BLK 0x9082EA0 RB_ValA_Wu16 65535.00 OneToOne 0.00 65535.00 FORMAT "%8.2" NUMBER 1 /end CHARACTERISTIC
/begin CHARACTERISTIC MisfDet_stcCatThd_CA "Threshold for catalyst damaging" VAL_BLK 0x9082EA2 RB_ValA_Wu16 65535.00 OneToOne 0.00 65535.00 FORMAT "%8.2" NUMBER 1 /end CHARACTERISTIC
/begin CHARACTERISTIC MisfDet_stcCatWghtFacPfiMax_C "weighting factor for misfire counter at open locked injector" VALUE 0x9082EA4 RB_Val_Wu8 255.0 OneToOne 0.00 255.0 FORMAT "%5.1" /end CHARACTERISTIC
/begin CHARACTERISTIC MisfDet_stcCatWghtFac_M "weighting factor for misfire counter" MAP 0x9082EA6 RB_Map_S16U16_U8 255.0 OneToOne 0.00 255.0 FORMAT "%5.1"
 /begin AXIS_DESCR STD_AXIS Epm_nEng EngN 8 -16384.00 16383.50 FORMAT "%8.2" DEPOSIT ABSOLUTE /end AXIS_DESCR
 /begin AXIS_DESCR STD_AXIS MisfDet_tqBasc rel_uw_b100 8 0.00 99.99847 FORMAT "%8.5" DEPOSIT ABSOLUTE /end AXIS_DESCR
/end CHARACTERISTIC
/begin CHARACTERISTIC MisfDet_stcEmiNrIntl_C "Number of damaged emission intervals which will cause a fault memory entry" VALUE 0x9082F0C Val_Wu8 255.0 OneToOne 0.00 255.0 FORMAT "%5.1" /end CHARACTERISTIC
/begin CHARACTERISTIC MisfDet_stcEmiRatMinCylIdn_C "minimum ratio of misfire sum for cylinder individual fault code" VALUE 0x9082F0E Val_Wu16 99.99847 rel_uw_b100 0.00 99.99847 FORMAT "%8.5" /end CHARACTERISTIC
/begin CHARACTERISTIC MisfDet_stcEmiRatMinMpl_C "minimum ratio of misfire sum for multiple fault code" VALUE 0x9082F10 Val_Wu16 99.99847 rel_uw_b100 0.00 99.99847 FORMAT "%8.5" /end CHARACTERISTIC
/begin CHARACTERISTIC MisfDet_stcEmiThdStrtCatHeat_C "threshold for emission exceedance first interval cat heating" VALUE 0x9082F12 RB_Val_Wu16 65535.00 OneToOne 0.00 65535.00 FORMAT "%8.2" /end CHARACTERISTIC
/begin CHARACTERISTIC MisfDet_stcEmiThdStrt_C "threshold for emission exceedance first interval" VALUE 0x9082F14 RB_Val_Wu16 65535.00 OneToOne 0.00 65535.00 FORMAT "%8.2" /end CHARACTERISTIC
/begin CHARACTERISTIC MisfDet_stcEmiThd_C "threshold for emission exceedance" VALUE 0x9082F16 RB_Val_Wu16 65535.00 OneToOne 0.00 65535.00 FORMAT "%8.2" /end CHARACTERISTIC
/begin CHARACTERISTIC MisfDet_stCfgOBD_C "configuration switch Obd requirement" VALUE 0x9082F1A RB_Val_Wu8 255.0 OneToOne 0.00 255.0 FORMAT "%5.1" /end CHARACTERISTIC
/begin CHARACTERISTIC MisfDet_stRoughRoadDiagCfg_C "Selection of the wheel speed diagnostics" VALUE 0x9082E56 RB_Val_Wu8 255.0 OneToOne 0.00 255.0 FORMAT "%5.1" /end CHARACTERISTIC
/begin CHARACTERISTIC MisfDet_stSegTiCalcnCfgCal_C "Configuration switch segment time calculation for calibration features" VALUE 0x9082E62 RB_Val_Wu8 255.0 dez 0.00 255.0 FORMAT "%5.1" /end CHARACTERISTIC
/begin CHARACTERISTIC MisfDet_stSegTiCalcnCfg_C "Configuration switch segment time calculation" VALUE 0x9082E64 RB_Val_Wu16 65535.00 dez 0.00 65535.00 FORMAT "%8.2" /end CHARACTERISTIC
/begin CHARACTERISTIC MisfDet_stSigSelnCfg_C "Configuration code word for FC:MisfDet_SigSeln" VALUE 0x9082E68 RB_Val_Wu16 65535.00 OneToOne 0.00 65535.00 FORMAT "%8.2" /end CHARACTERISTIC
/begin CHARACTERISTIC MisfDet_stStcCatCfg_C "configuration code word MisfDet_stcCat" VALUE 0x9082F0A RB_Val_Wu8 255.0 OneToOne 0.00 255.0 FORMAT "%5.1" /end CHARACTERISTIC
/begin CHARACTERISTIC MisfDet_stStcMiscCfg_C "configuration switch StcMisc" VALUE 0x9082F1C RB_Val_Wu8 255.0 OneToOne 0.00 255.0 FORMAT "%5.1" /end CHARACTERISTIC
/begin CHARACTERISTIC MisfDet_stThdCalcnCfg_C "configuration mask threshold calculation" VALUE 0x9082F9F RB_Val_Wu8 255.0 OneToOne 0.00 255.0 FORMAT "%5.1" /end CHARACTERISTIC
/begin CHARACTERISTIC MisfDet_stThdMapSelnCfg_C "configuration code word ThdMapSeln" VALUE 0x9082FD6 RB_Val_Wu8 255.0 OneToOne 0.00 255.0 FORMAT "%5.1" /end CHARACTERISTIC
/begin CHARACTERISTIC MoCADC_ctDebNTPThd_C "Debounce level for a correct calibrated null load test pulse condition" VALUE 0x9080340 Val_Wu8 5100.00 t20ms_ub_b5100 0.00 5100.00 /end CHARACTERISTIC
/begin CHARACTERISTIC MoCADC_ctDebNTP_C "Final value of Error counter for verifying of Null-Load-Test-Pulse" VALUE 0x9080290 Val_Wu8 5100.00 t20ms_ub_b5100 0.00 5100.00 /end CHARACTERISTIC
/begin CHARACTERISTIC MoCADC_ctDebTstThd_C "Debounce level for a correct calibrated test voltage verification" VALUE 0x9080341 Val_Wu8 255.0 dez 0.00 255.0 FORMAT "%5.1" /end CHARACTERISTIC
/begin CHARACTERISTIC MoCADC_ctDebTst_C "Error counter end value of test voltage verification" VALUE 0x9080291 Val_Wu8 255.0 dez 0.00 255.0 FORMAT "%5.1" /end CHARACTERISTIC
/begin CHARACTERISTIC MoCADC_ctRstNTP_C "Number of permitted resets for verifying of Null-Load-Test-Pulse" VALUE 0x9080292 Val_Wu8 255.0 dez 0.00 255.0 FORMAT "%5.1" /end CHARACTERISTIC
/begin CHARACTERISTIC MoCADC_ctRstTst_C "Number of permissible resets in case of an error in test voltage verification" VALUE 0x9080293 Val_Wu8 255.0 dez 0.00 255.0 FORMAT "%5.1" /end CHARACTERISTIC
/begin CHARACTERISTIC MoCADC_uNTPMax_C "Maximum ADC value in case of ADC channel moved to low during the ADC verification" VALUE 0x9080294 Val_Wu8 2.490 spg_q0p00977 0.00 2.490 FORMAT "%5.3" /end CHARACTERISTIC
/begin CHARACTERISTIC MoCADC_uTstMax_C "Maximum test voltage in ADC test" VALUE 0x90802BC Val_Ws16 319995.1 spg_q4p88_mV -160000.0 159995.1 FORMAT "%8.1" /end CHARACTERISTIC
/begin CHARACTERISTIC MoCADC_uTstMin_C "Minimum test voltage in ADC test" VALUE 0x90802BE Val_Ws16 319995.1 spg_q4p88_mV -160000.0 159995.1 FORMAT "%8.1" /end CHARACTERISTIC
/begin CHARACTERISTIC MoCCom_ctBusErrThd_C "Debounce level for a correct calibrated function of error counter for bus communication error" VALUE 0x9080342 Val_Wu8 255.0 dez 0.00 255.0 FORMAT "%5.1" /end CHARACTERISTIC
/begin CHARACTERISTIC MoCCom_ctErrFCThd_C "Debounce level for a correct calibrated function of error counter for failure in function controller" VALUE 0x9080343 Val_Wu8 255.0 dez 0.00 255.0 FORMAT "%5.1" /end CHARACTERISTIC
/begin CHARACTERISTIC MoCCom_ctErrMMThd_C "Debounce level for a correct calibrated function for error counter of monitoring module" VALUE 0x9080344 Val_Wu8 255.0 dez 0.00 255.0 FORMAT "%5.1" /end CHARACTERISTIC
/begin CHARACTERISTIC MoCCom_ctErrPwrThd_C "Debounce level for a correct calibrated function of error counter for failure in power devices" VALUE 0x9080345 Val_Wu8 255.0 dez 0.00 255.0 FORMAT "%5.1" /end CHARACTERISTIC
/begin CHARACTERISTIC MoCCPU_PtlRespTstActv_CW "Codeword to destroy the partial response if enabled" VALUE 0x9080295 Val_Wu8 1.000 dez 0.00 1.000 FORMAT "%5.3" EXTENDED_LIMITS 0.00 255.0 /end CHARACTERISTIC
/begin CHARACTERISTIC MoCEMM_ChkRAMTst_CW "Codeword to request error reaction during RAM test" VALUE 0x9080346 Val_Wu8 255.0 dez 0.00 255.0 FORMAT "%5.1" /end CHARACTERISTIC
/begin CHARACTERISTIC MoCEMM_ChkROMTst_CW "Codeword to request error reaction during ROM test" VALUE 0x9080347 Val_Wu8 255.0 dez 0.00 255.0 FORMAT "%5.1" /end CHARACTERISTIC
/begin CHARACTERISTIC MoCGTM_cntrCMPErrbitHealMax_C "Number of times CMP patter match should occur to initiate healing of MoCGTM_cntrCMPErrbit" VALUE 0x9080296 Val_Wu8 255.0 dez 0.00 255.0 FORMAT "%5.1" /end CHARACTERISTIC
/begin CHARACTERISTIC MoCGTM_cntrDebErrMax_C "Max. allowed deviation between badcase created and detected occured" VALUE 0x9080297 Val_Wu8 255.0 dez 0.00 255.0 FORMAT "%5.1" /end CHARACTERISTIC
/begin CHARACTERISTIC MoCGTM_cntrDebErrThd_C "Threshold for incrementing MaxValueIndicator for deviation between badcase created and detected" VALUE 0x9080348 Val_Wu8 255.0 dez 0.00 255.0 FORMAT "%5.1" /end CHARACTERISTIC
/begin CHARACTERISTIC MoCGTM_cntrRouteSigErrThd_C "Debounce level for a correct calibrated function of error counter for error in signal routing in GTM" VALUE 0x9080349 Val_Wu8 255.0 dez 0.00 255.0 FORMAT "%5.1" /end CHARACTERISTIC
/begin CHARACTERISTIC MoCGTM_stChksTstActv_CW "Calibration for ECU-MST test of MCS ROM check" VALUE 0x908034A Val_Wu8 1.000 dez 0.00 1.000 FORMAT "%5.3" EXTENDED_LIMITS 0.00 255.0 /end CHARACTERISTIC
/begin CHARACTERISTIC MoCGTM_stSWResetDem_CW "Codeword for enabling reset and Error pin as error reaction in case of failure of MoCGTM tests" VALUE 0x908029C Val_Wu8 255.0 dez 0.00 255.0 FORMAT "%5.1" /end CHARACTERISTIC
/begin CHARACTERISTIC MoCGTM_stTestActv_CW "Codeword to activate MFT (Monitoring Function Test) and check the error reaction from MoCGTM_Co" VALUE 0x908034B Val_Wu8 1.000 dez 0.00 1.000 FORMAT "%5.3" EXTENDED_LIMITS 0.00 255.0 /end CHARACTERISTIC
/begin CHARACTERISTIC MoCMem_ctDebErrChkRAMThd_C "Threshold for incrementing MaxValueIndicator for double storage and cyclic RAM Test" VALUE 0x908034C Val_Wu8 255.0 dez 0.00 255.0 FORMAT "%5.1" /end CHARACTERISTIC
/begin CHARACTERISTIC MoCMem_ctDebErrChkRAM_C "Error tolerance threshold for double storage and cyclic RAM-Test" VALUE 0x908029D Val_Wu8 255.0 dez 0.00 255.0 FORMAT "%5.1" /end CHARACTERISTIC
/begin CHARACTERISTIC MoCMem_ctDebErrChkROMThd_C "Threshold for incrementing MaxValueIndicator for double storage and cyclic ROM Test" VALUE 0x908034D Val_Wu8 255.0 dez 0.00 255.0 FORMAT "%5.1" /end CHARACTERISTIC
/begin CHARACTERISTIC MoCMem_ctDebErrChkROM_C "Error tolerance threshold for cyclic ROM-Test" VALUE 0x908029E Val_Wu8 255.0 dez 0.00 255.0 FORMAT "%5.1" /end CHARACTERISTIC
/begin CHARACTERISTIC MoCMem_ctDebHealChkRAMCpl_C "Complement of the tolerance threshold of the healing counter for the double storage and the cyclical RAM-tests" VALUE 0x908034E Val_Wu8 255.0 dez 0.00 255.0 FORMAT "%5.1" /end CHARACTERISTIC
/begin CHARACTERISTIC MoCMem_ctDebHealChkRAM_C "Tolerance threshold of the healing counter for the double storage and the cyclical RAM-tests" VALUE 0x908029F Val_Wu8 255.0 dez 0.00 255.0 FORMAT "%5.1" /end CHARACTERISTIC
/begin CHARACTERISTIC MoCMem_ctDebHealChkROMCpl_C "Complement of the tolerance threshold of the healing counter for the cyclical ROM-tests" VALUE 0x908034F Val_Wu8 255.0 dez 0.00 255.0 FORMAT "%5.1" /end CHARACTERISTIC
/begin CHARACTERISTIC MoCMem_ctDebHealChkROM_C "Tolerance threshold of the healing counter for the cyclical ROM-tests" VALUE 0x90802A0 Val_Wu8 255.0 dez 0.00 255.0 FORMAT "%5.1" /end CHARACTERISTIC
/begin CHARACTERISTIC MoCMem_noMEMChkRstCpl_CW "Double storage for MoCMem_noMEMChkRst_CW" VALUE 0x9080350 Val_Wu8 255.0 dez 0.00 255.0 FORMAT "%5.1" /end CHARACTERISTIC
/begin CHARACTERISTIC MoCMem_noMEMChkRst_CW "Disables the error reaction found during the cyclical memory check (Depends on MOCMEM_CONF_SERIES_TOOLCHAIN and MO_ROM_SY)" VALUE 0x90802A1 Val_Wu8 255.0 dez 0.00 255.0 FORMAT "%5.1" /end CHARACTERISTIC
/begin CHARACTERISTIC MoCMem_numRamChk_C "Number of 32-bit memory cells to be tested in cyclical RAM-check" VALUE 0x9080312 Val_Wu16 65535.00 dez 0.00 65535.00 FORMAT "%8.2" /end CHARACTERISTIC
/begin CHARACTERISTIC MoCMem_numRomChk_CA "Number of 32-bit memory cells to be tested in cyclical ROM-check." VAL_BLK 0x9080314 ValA_Wu16 65535.00 dez 0.00 65535.00 FORMAT "%8.2" NUMBER 4 /end CHARACTERISTIC
/begin CHARACTERISTIC MoCMem_numStckChk_C "Number of 32-bit memory cells to be tested in cyclical stack-check." VALUE 0x90802A2 Val_Wu8 255.0 dez 0.00 255.0 FORMAT "%5.1" /end CHARACTERISTIC
/begin CHARACTERISTIC MoCMem_RamTst_CW "Code word for simulating error in cyclic RAM, Stack and CSA test" VALUE 0x9080351 Val_Wu8 255.0 dez 0.00 255.0 FORMAT "%5.1" /end CHARACTERISTIC
/begin CHARACTERISTIC MoCMem_RomTst_CW "code word for requiring the reaction test of the cyclic ROM test" VALUE 0x9080352 Val_Wu8 255.0 dez 0.00 255.0 FORMAT "%5.1" /end CHARACTERISTIC
/begin CHARACTERISTIC MoCMem_stSwtAutRamChkConf_C "Switch to select automatic configuration of block size for the cyclic RAM check" VALUE 0x90802A3 Val_Wu8 255.0 dez 0.00 255.0 FORMAT "%5.1" /end CHARACTERISTIC
/begin CHARACTERISTIC MoCMem_stSwtAutRomChkConf_C "Switch to select automatic configuration of block size for the cyclic ROM check" VALUE 0x90802A4 Val_Wu8 255.0 dez 0.00 255.0 FORMAT "%5.1" /end CHARACTERISTIC
/begin CHARACTERISTIC MoCSOP_ctDebSOPTst_C "Maximum duration of the power stages shut-off path test" VALUE 0x908031C Val_Wu16 65535.00 dez 0.00 65535.00 FORMAT "%8.2" /end CHARACTERISTIC
/begin CHARACTERISTIC MoCSOP_stCANErrReac_CW "codeword for activating the error reaction CAN-driver-disabling" VALUE 0x90802A5 Val_Wu8 255.0 dez 0.00 255.0 FORMAT "%5.1" /end CHARACTERISTIC
/begin CHARACTERISTIC MoCSOP_stMMErrReac_CW "code word for activating the fault reaction MM reset" VALUE 0x90802A6 Val_Wu8 255.0 dez 0.00 255.0 FORMAT "%5.1" /end CHARACTERISTIC
/begin CHARACTERISTIC MoFGearLvr_cntrDeb_C "Counter to debounce neutral swtch sensor output" VALUE 0x90802A7 Val_Wu8 255.0 OneToOne 0.00 255.0 FORMAT "%5.1" /end CHARACTERISTIC
/begin CHARACTERISTIC MoFGearLvr_stInvNeut_C "Calibration for input neutral switch sensor inversion. Adapt to L1 NEUTINV" VALUE 0x90802A8 Val_Wu8 255.0 OneToOne 0.00 255.0 FORMAT "%5.1" /end CHARACTERISTIC
/begin CHARACTERISTIC MoFGearLvr_uActvnValMax_C "Maximum Voltage limit for Neutral Gear Activation. Adapt to L1 parameter NEUTGEARACTMAX" VALUE 0x908031E Val_Wu16 319.9951 spg_uw_q0p00488 0.00 319.9951 FORMAT "%8.4" /end CHARACTERISTIC
/begin CHARACTERISTIC MoFGearLvr_uActvnValMin_C "Minimum Voltage limit for Neutral Gear Activation. Adapt to L1 parameter NEUTGEARACTMIN" VALUE 0x9080320 Val_Wu16 319.9951 spg_uw_q0p00488 0.00 319.9951 FORMAT "%8.4" /end CHARACTERISTIC
/begin CHARACTERISTIC MoFGearLvr_uDeactvnValMax_C "Maximum Voltage limit for Neutral Gear Deactivation. Adapt to L1 parameter NEUTGEARINACTMAX" VALUE 0x9080322 Val_Wu16 319.9951 spg_uw_q0p00488 0.00 319.9951 FORMAT "%8.4" /end CHARACTERISTIC
/begin CHARACTERISTIC MoFGearLvr_uDeactvnValMin_C "Miniimum Voltage limit for Neutral Gear Deactivation. Adapt to L1 parameter NEUTGEARINACTMIN" VALUE 0x9080324 Val_Wu16 319.9951 spg_uw_q0p00488 0.00 319.9951 FORMAT "%8.4" /end CHARACTERISTIC
/begin MEASUREMENT MisfDet_cntrMisfDiag "counter of misfire events for diagnosis service-tester" UWORD OneToOne 1 100 0.00 65535.00 FORMAT "%8.2" ARRAY_SIZE 1 ECU_ADDRESS 0x40007E46
 /begin IF_DATA XCPplus 0x0102
  /begin DAQ_EVENT VARIABLE /begin AVAILABLE_EVENT_LIST EVENT 0 EVENT 1 EVENT 2 EVENT 3 /end AVAILABLE_EVENT_LIST /begin DEFAULT_EVENT_LIST EVENT 0 /end DEFAULT_EVENT_LIST /end DAQ_EVENT
 /end IF_DATA
/end MEASUREMENT
/begin MEASUREMENT MisfDet_cntrMisfDiagFild "exponential weighted moving average of misfire events for diagnosis service-tester" FLOAT32_IEEE OneToOne 1 100 -1.00000000E+037 1.00000000E+037 FORMAT "%10.0" ARRAY_SIZE 1 ECU_ADDRESS 0x4000CD78
 /begin IF_DATA XCPplus 0x0102
  /begin DAQ_EVENT VARIABLE /begin AVAILABLE_EVENT_LIST EVENT 0 EVENT 1 EVENT 2 EVENT 3 /end AVAILABLE_EVENT_LIST /begin DEFAULT_EVENT_LIST EVENT 2 /end DEFAULT_EVENT_LIST /end DAQ_EVENT
 /end IF_DATA
/end MEASUREMENT
/begin MEASUREMENT MisfDet_ctDef "counter of defect cycles for MIL on" UBYTE OneToOne 1 100 0.00 255.0 FORMAT "%5.1" ARRAY_SIZE 1 ECU_ADDRESS 0x4000CD74
 /begin IF_DATA XCPplus 0x0102
  /begin DAQ_EVENT VARIABLE /begin AVAILABLE_EVENT_LIST EVENT 0 EVENT 1 EVENT 2 EVENT 3 /end AVAILABLE_EVENT_LIST /begin DEFAULT_EVENT_LIST EVENT 0 /end DEFAULT_EVENT_LIST /end DAQ_EVENT
 /end IF_DATA
/end MEASUREMENT
/begin MEASUREMENT MisfDet_ctOk "counter of OK cycles for healing" UBYTE OneToOne 1 100 0.00 255.0 FORMAT "%5.1" ARRAY_SIZE 1 ECU_ADDRESS 0x4000CD70
 /begin IF_DATA XCPplus 0x0102
  /begin DAQ_EVENT VARIABLE /begin AVAILABLE_EVENT_LIST EVENT 0 EVENT 1 EVENT 2 EVENT 3 /end AVAILABLE_EVENT_LIST /begin DEFAULT_EVENT_LIST EVENT 0 /end DEFAULT_EVENT_LIST /end DAQ_EVENT
 /end IF_DATA
/end MEASUREMENT
/begin MEASUREMENT MisfDet_ctOkFltTyp "counter of OK cycles for healing of specific misfire fault types" UBYTE OneToOne 1 100 0.00 255.0 FORMAT "%5.1" ARRAY_SIZE 3 ECU_ADDRESS 0x4000CD6C
 /begin IF_DATA XCPplus 0x0102
  /begin DAQ_EVENT VARIABLE /begin AVAILABLE_EVENT_LIST EVENT 0 EVENT 1 EVENT 2 EVENT 3 /end AVAILABLE_EVENT_LIST /begin DEFAULT_EVENT_LIST EVENT 0 /end DEFAULT_EVENT_LIST /end DAQ_EVENT
 /end IF_DATA
/end MEASUREMENT
/begin MEASUREMENT MisfDet_cylCntrSegTi "Cylinder counter for Misfire Detection according to Segment time" UBYTE dez 1 100 0.00 255.0 FORMAT "%5.1" ECU_ADDRESS 0x40007F82
 /begin IF_DATA XCPplus 0x0102
  /begin DAQ_EVENT VARIABLE /begin AVAILABLE_EVENT_LIST EVENT 0 EVENT 1 EVENT 2 EVENT 3 /end AVAILABLE_EVENT_LIST /begin DEFAULT_EVENT_LIST EVENT 0 /end DEFAULT_EVENT_LIST /end DAQ_EVENT
 /end IF_DATA
/end MEASUREMENT
/begin MEASUREMENT MisfDet_cylFrzFrmData "Cylinder number relevant for similar conditions" SBYTE OneToOne 1 100 -128.0 127.0 FORMAT "%5.1" ECU_ADDRESS 0x4000CD68
 /begin IF_DATA XCPplus 0x0102
  /begin DAQ_EVENT VARIABLE /begin AVAILABLE_EVENT_LIST EVENT 0 EVENT 1 EVENT 2 EVENT 3 /end AVAILABLE_EVENT_LIST /begin DEFAULT_EVENT_LIST EVENT 0 /end DEFAULT_EVENT_LIST /end DAQ_EVENT
 /end IF_DATA
/end MEASUREMENT
/begin MEASUREMENT MisfDet_dnThd "Threshold for circular acceleration" SWORD dn_Compu 1 100 -2048.000 2047.938 FORMAT "%8.3" ECU_ADDRESS 0x40007FDA
 /begin IF_DATA XCPplus 0x0102
  /begin DAQ_EVENT VARIABLE /begin AVAILABLE_EVENT_LIST EVENT 0 EVENT 1 EVENT 2 EVENT 3 /end AVAILABLE_EVENT_LIST /begin DEFAULT_EVENT_LIST EVENT 0 /end DEFAULT_EVENT_LIST /end DAQ_EVENT
 /end IF_DATA
/end MEASUREMENT
/begin MEASUREMENT MisfDet_dnThdCont "Threshold for continuous misfires" SWORD dn_Compu 1 100 -2048.000 2047.938 FORMAT "%8.3" ECU_ADDRESS 0x40007FD8
 /begin IF_DATA XCPplus 0x0102
  /begin DAQ_EVENT VARIABLE /begin AVAILABLE_EVENT_LIST EVENT 0 EVENT 1 EVENT 2 EVENT 3 /end AVAILABLE_EVENT_LIST /begin DEFAULT_EVENT_LIST EVENT 0 /end DEFAULT_EVENT_LIST /end DAQ_EVENT
 /end IF_DATA
/end MEASUREMENT
/begin MEASUREMENT MisfDet_dnThdContRdcVal "value for reduction of dnThdCont" SWORD dn_Compu 1 100 -2048.000 2047.938 FORMAT "%8.3" ECU_ADDRESS 0x40007E16
 /begin IF_DATA XCPplus 0x0102
  /begin DAQ_EVENT VARIABLE /begin AVAILABLE_EVENT_LIST EVENT 0 EVENT 1 EVENT 2 EVENT 3 /end AVAILABLE_EVENT_LIST /begin DEFAULT_EVENT_LIST EVENT 0 /end DEFAULT_EVENT_LIST /end DAQ_EVENT
 /end IF_DATA
/end MEASUREMENT
/begin MEASUREMENT MisfDet_dnThdCor "preliminary detection threshold including correction offsets and factors" SWORD dn_Compu 1 100 -2048.000 2047.938 FORMAT "%8.3" ECU_ADDRESS 0x40007FD6
 /begin IF_DATA XCPplus 0x0102
  /begin DAQ_EVENT VARIABLE /begin AVAILABLE_EVENT_LIST EVENT 0 EVENT 1 EVENT 2 EVENT 3 /end AVAILABLE_EVENT_LIST /begin DEFAULT_EVENT_LIST EVENT 0 /end DEFAULT_EVENT_LIST /end DAQ_EVENT
 /end IF_DATA
/end MEASUREMENT
/begin MEASUREMENT MisfDet_dnThdCorCont "preliminary detection threshold for continuous misfires including correction offsets and factors" SWORD dn_Compu 1 100 -2048.000 2047.938 FORMAT "%8.3" ECU_ADDRESS 0x40007E14
 /begin IF_DATA XCPplus 0x0102
  /begin DAQ_EVENT VARIABLE /begin AVAILABLE_EVENT_LIST EVENT 0 EVENT 1 EVENT 2 EVENT 3 /end AVAILABLE_EVENT_LIST /begin DEFAULT_EVENT_LIST EVENT 0 /end DEFAULT_EVENT_LIST /end DAQ_EVENT
 /end IF_DATA
/end MEASUREMENT
/begin MEASUREMENT MisfDet_dnThdDecLim "limitation of negative gradients of detection threshold" SWORD dn_Compu 1 100 -2048.000 2047.938 FORMAT "%8.3" ECU_ADDRESS 0x40007E12
 /begin IF_DATA XCPplus 0x0102
  /begin DAQ_EVENT VARIABLE /begin AVAILABLE_EVENT_LIST EVENT 0 EVENT 1 EVENT 2 EVENT 3 /end AVAILABLE_EVENT_LIST /begin DEFAULT_EVENT_LIST EVENT 0 /end DEFAULT_EVENT_LIST /end DAQ_EVENT
 /end IF_DATA
/end MEASUREMENT
/begin MEASUREMENT MisfDet_dnThdDecLimCont "limitation of negative gradients of detection threshold for continuous misfire" SWORD dn_Compu 1 100 -2048.000 2047.938 FORMAT "%8.3" ECU_ADDRESS 0x40007E10
 /begin IF_DATA XCPplus 0x0102
  /begin DAQ_EVENT VARIABLE /begin AVAILABLE_EVENT_LIST EVENT 0 EVENT 1 EVENT 2 EVENT 3 /end AVAILABLE_EVENT_LIST /begin DEFAULT_EVENT_LIST EVENT 0 /end DEFAULT_EVENT_LIST /end DAQ_EVENT
 /end IF_DATA
/end MEASUREMENT
/begin MEASUREMENT MisfDet_dnThdDynLim "Threshold for sporadic misfires with limited dynamic" SWORD dn_Compu 1 100 -2048.000 2047.938 FORMAT "%8.3" ECU_ADDRESS 0x40007E0E
 /begin IF_DATA XCPplus 0x0102
  /begin DAQ_EVENT VARIABLE /begin AVAILABLE_EVENT_LIST EVENT 0 EVENT 1 EVENT 2 EVENT 3 /end AVAILABLE_EVENT_LIST /begin DEFAULT_EVENT_LIST EVENT 0 /end DEFAULT_EVENT_LIST /end DAQ_EVENT
 /end IF_DATA
/end MEASUREMENT
/begin MEASUREMENT MisfDet_dnThdDynLimCont "Threshold for continuous misfires with limited dynamic" SWORD dn_Compu 1 100 -2048.000 2047.938 FORMAT "%8.3" ECU_ADDRESS 0x40007E0C
 /begin IF_DATA XCPplus 0x0102
  /begin DAQ_EVENT VARIABLE /begin AVAILABLE_EVENT_LIST EVENT 0 EVENT 1 EVENT 2 EVENT 3 /end AVAILABLE_EVENT_LIST /begin DEFAULT_EVENT_LIST EVENT 0 /end DEFAULT_EVENT_LIST /end DAQ_EVENT
 /end IF_DATA
/end MEASUREMENT
/begin MEASUREMENT MisfDet_dnThdFacStrt "Factor to detection threshold at engine start" UWORD fak_uw_b2 1 100 0.00 1.999969 FORMAT "%8.6" ECU_ADDRESS 0x40007FC2
 /begin IF_DATA XCPplus 0x0102
  /begin DAQ_EVENT VARIABLE /begin AVAILABLE_EVENT_LIST EVENT 0 EVENT 1 EVENT 2 EVENT 3 /end AVAILABLE_EVENT_LIST /begin DEFAULT_EVENT_LIST EVENT 2 /end DEFAULT_EVENT_LIST /end DAQ_EVENT
 /end IF_DATA
/end MEASUREMENT
/begin MEASUREMENT MisfDet_dnThdMapOut "Threshold output from map" SWORD dn_Compu 1 100 -2048.000 2047.938 FORMAT "%8.3" ECU_ADDRESS 0x40007FD4
 /begin IF_DATA XCPplus 0x0102
  /begin DAQ_EVENT VARIABLE /begin AVAILABLE_EVENT_LIST EVENT 0 EVENT 1 EVENT 2 EVENT 3 /end AVAILABLE_EVENT_LIST /begin DEFAULT_EVENT_LIST EVENT 0 /end DEFAULT_EVENT_LIST /end DAQ_EVENT
 /end IF_DATA
/end MEASUREMENT
/begin MEASUREMENT MisfDet_dnThdMapOutCont "threshold for continuous misfires, output from map" SWORD dn_Compu 1 100 -2048.000 2047.938 FORMAT "%8.3" ECU_ADDRESS 0x40007FD2
 /begin IF_DATA XCPplus 0x0102
  /begin DAQ_EVENT VARIABLE /begin AVAILABLE_EVENT_LIST EVENT 0 EVENT 1 EVENT 2 EVENT 3 /end AVAILABLE_EVENT_LIST /begin DEFAULT_EVENT_LIST EVENT 0 /end DEFAULT_EVENT_LIST /end DAQ_EVENT
 /end IF_DATA
/end MEASUREMENT
/begin MEASUREMENT MisfDet_dnThdMinContOut "Threshold limitation for continuous misfires map output" SWORD dn_Compu 1 100 -2048.000 2047.938 FORMAT "%8.3" ECU_ADDRESS 0x40007FD0
 /begin IF_DATA XCPplus 0x0102
  /begin DAQ_EVENT VARIABLE /begin AVAILABLE_EVENT_LIST EVENT 0 EVENT 1 EVENT 2 EVENT 3 /end AVAILABLE_EVENT_LIST /begin DEFAULT_EVENT_LIST EVENT 0 /end DEFAULT_EVENT_LIST /end DAQ_EVENT
 /end IF_DATA
/end MEASUREMENT
/begin MEASUREMENT MisfDet_dnThdOffsT "temperature dependent offset to detection threshold" SWORD dn_Compu 1 100 -2048.000 2047.938 FORMAT "%8.3" ECU_ADDRESS 0x40007FCE
 /begin IF_DATA XCPplus 0x0102
  /begin DAQ_EVENT VARIABLE /begin AVAILABLE_EVENT_LIST EVENT 0 EVENT 1 EVENT 2 EVENT 3 /end AVAILABLE_EVENT_LIST /begin DEFAULT_EVENT_LIST EVENT 2 /end DEFAULT_EVENT_LIST /end DAQ_EVENT
 /end IF_DATA
/end MEASUREMENT
/begin MEASUREMENT MisfDet_dnThdSyncContFiltd "filtered detection threshold for continuous misfires" SWORD dn_Compu 1 100 -2048.000 2047.938 FORMAT "%8.3" ECU_ADDRESS 0x40007E0A
 /begin IF_DATA XCPplus 0x0102
  /begin DAQ_EVENT VARIABLE /begin AVAILABLE_EVENT_LIST EVENT 0 EVENT 1 EVENT 2 EVENT 3 /end AVAILABLE_EVENT_LIST /begin DEFAULT_EVENT_LIST EVENT 0 /end DEFAULT_EVENT_LIST /end DAQ_EVENT
 /end IF_DATA
/end MEASUREMENT
/begin MEASUREMENT MisfDet_dVWhl "Differentiated wheel speed" UWORD acc_q0p02 1 100 0.00 1310.700 FORMAT "%8.3" ARRAY_SIZE 2 ECU_ADDRESS 0x40005D68
 /begin IF_DATA XCPplus 0x0102
  /begin DAQ_EVENT VARIABLE /begin AVAILABLE_EVENT_LIST EVENT 0 EVENT 1 EVENT 2 EVENT 3 /end AVAILABLE_EVENT_LIST /begin DEFAULT_EVENT_LIST EVENT 1 /end DEFAULT_EVENT_LIST /end DAQ_EVENT
 /end IF_DATA
/end MEASUREMENT
/begin MEASUREMENT MisfDet_dVWhlAvrgFrnt "averaged wheel acceleration front axle" UWORD acc_q0p02 1 100 0.00 1310.700 FORMAT "%8.3" ECU_ADDRESS 0x40005C30
 /begin IF_DATA XCPplus 0x0102
  /begin DAQ_EVENT VARIABLE /begin AVAILABLE_EVENT_LIST EVENT 0 EVENT 1 EVENT 2 EVENT 3 /end AVAILABLE_EVENT_LIST /begin DEFAULT_EVENT_LIST EVENT 1 /end DEFAULT_EVENT_LIST /end DAQ_EVENT
 /end IF_DATA
/end MEASUREMENT
/begin MEASUREMENT MisfDet_dVWhlAvrgRe "averaged wheel acceleration rear axle" UWORD acc_q0p02 1 100 0.00 1310.700 FORMAT "%8.3" ECU_ADDRESS 0x40005C2E
 /begin IF_DATA XCPplus 0x0102
  /begin DAQ_EVENT VARIABLE /begin AVAILABLE_EVENT_LIST EVENT 0 EVENT 1 EVENT 2 EVENT 3 /end AVAILABLE_EVENT_LIST /begin DEFAULT_EVENT_LIST EVENT 1 /end DEFAULT_EVENT_LIST /end DAQ_EVENT
 /end IF_DATA
/end MEASUREMENT
/begin MEASUREMENT MisfDet_dVWhlFild "Filtered differentiated wheel speed" UWORD acc_q0p02 1 100 0.00 1310.700 FORMAT "%8.3" ARRAY_SIZE 2 ECU_ADDRESS 0x40005D6C
 /begin IF_DATA XCPplus 0x0102
  /begin DAQ_EVENT VARIABLE /begin AVAILABLE_EVENT_LIST EVENT 0 EVENT 1 EVENT 2 EVENT 3 /end AVAILABLE_EVENT_LIST /begin DEFAULT_EVENT_LIST EVENT 1 /end DEFAULT_EVENT_LIST /end DAQ_EVENT
 /end IF_DATA
/end MEASUREMENT
/begin MEASUREMENT MisfDet_dVWhlFrntThd "Threshold to detect rough road front axle" UWORD acc_q0p02 1 100 0.00 1310.700 FORMAT "%8.3" ECU_ADDRESS 0x40005C2C
 /begin IF_DATA XCPplus 0x0102
  /begin DAQ_EVENT VARIABLE /begin AVAILABLE_EVENT_LIST EVENT 0 EVENT 1 EVENT 2 EVENT 3 /end AVAILABLE_EVENT_LIST /begin DEFAULT_EVENT_LIST EVENT 1 /end DEFAULT_EVENT_LIST /end DAQ_EVENT
 /end IF_DATA
/end MEASUREMENT
/begin MEASUREMENT MisfDet_dVWhlFrntThdMapOut "Threshold to detect rough road front axle, output of map" UWORD acc_q0p02 1 100 0.00 1310.700 FORMAT "%8.3" ECU_ADDRESS 0x40005C2A
 /begin IF_DATA XCPplus 0x0102
  /begin DAQ_EVENT VARIABLE /begin AVAILABLE_EVENT_LIST EVENT 0 EVENT 1 EVENT 2 EVENT 3 /end AVAILABLE_EVENT_LIST /begin DEFAULT_EVENT_LIST EVENT 1 /end DEFAULT_EVENT_LIST /end DAQ_EVENT
 /end IF_DATA
/end MEASUREMENT
/begin MEASUREMENT MisfDet_dVWhlReThd "Threshold to detect rough road rear axle" UWORD acc_q0p02 1 100 0.00 1310.700 FORMAT "%8.3" ECU_ADDRESS 0x40005C28
 /begin IF_DATA XCPplus 0x0102
  /begin DAQ_EVENT VARIABLE /begin AVAILABLE_EVENT_LIST EVENT 0 EVENT 1 EVENT 2 EVENT 3 /end AVAILABLE_EVENT_LIST /begin DEFAULT_EVENT_LIST EVENT 1 /end DEFAULT_EVENT_LIST /end DAQ_EVENT
 /end IF_DATA
/end MEASUREMENT
/begin MEASUREMENT MisfDet_dVWhlReThdMapOut "Threshold to detect rough road rear axle, output of map" UWORD acc_q0p02 1 100 0.00 1310.700 FORMAT "%8.3" ECU_ADDRESS 0x40005C26
 /begin IF_DATA XCPplus 0x0102
  /begin DAQ_EVENT VARIABLE /begin AVAILABLE_EVENT_LIST EVENT 0 EVENT 1 EVENT 2 EVENT 3 /end AVAILABLE_EVENT_LIST /begin DEFAULT_EVENT_LIST EVENT 1 /end DEFAULT_EVENT_LIST /end DAQ_EVENT
 /end IF_DATA
/end MEASUREMENT
/begin MEASUREMENT MisfDet_flgRoughRoad "Rough road detected" UBYTE B_TRUE 1 100 0.00 1.00000000000 BIT_MASK 0x1 FORMAT "%13.11" ECU_ADDRESS 0x40006386
 /begin IF_DATA XCPplus 0x0102
  /begin DAQ_EVENT VARIABLE /begin AVAILABLE_EVENT_LIST EVENT 0 EVENT 1 EVENT 2 EVENT 3 /end AVAILABLE_EVENT_LIST /begin DEFAULT_EVENT_LIST EVENT 1 /end DEFAULT_EVENT_LIST /end DAQ_EVENT
 /end IF_DATA
/end MEASUREMENT
/begin MEASUREMENT MisfDet_flgRoughRoadFrnt "Rough road detected at front axle" UBYTE B_TRUE 1 100 0.00 1.00000000000 BIT_MASK 0x1 FORMAT "%13.11" ECU_ADDRESS 0x40006294
 /begin IF_DATA XCPplus 0x0102
  /begin DAQ_EVENT VARIABLE /begin AVAILABLE_EVENT_LIST EVENT 0 EVENT 1 EVENT 2 EVENT 3 /end AVAILABLE_EVENT_LIST /begin DEFAULT_EVENT_LIST EVENT 1 /end DEFAULT_EVENT_LIST /end DAQ_EVENT
 /end IF_DATA
/end MEASUREMENT
/begin MEASUREMENT MisfDet_flgRoughRoadPrel "rough road detection without checking grip state" UBYTE B_TRUE 1 100 0.00 1.00000000000 BIT_MASK 0x1 FORMAT "%13.11" ECU_ADDRESS 0x40006293
 /begin IF_DATA XCPplus 0x0102
  /begin DAQ_EVENT VARIABLE /begin AVAILABLE_EVENT_LIST EVENT 0 EVENT 1 EVENT 2 EVENT 3 /end AVAILABLE_EVENT_LIST /begin DEFAULT_EVENT_LIST EVENT 1 /end DEFAULT_EVENT_LIST /end DAQ_EVENT
 /end IF_DATA
/end MEASUREMENT
/begin MEASUREMENT MisfDet_flgRoughRoadRe "Rough road detected at rear axle" UBYTE B_TRUE 1 100 0.00 1.00000000000 BIT_MASK 0x1 FORMAT "%13.11" ECU_ADDRESS 0x40006292
 /begin IF_DATA XCPplus 0x0102
  /begin DAQ_EVENT VARIABLE /begin AVAILABLE_EVENT_LIST EVENT 0 EVENT 1 EVENT 2 EVENT 3 /end AVAILABLE_EVENT_LIST /begin DEFAULT_EVENT_LIST EVENT 1 /end DEFAULT_EVENT_LIST /end DAQ_EVENT
 /end IF_DATA
/end MEASUREMENT
/begin MEASUREMENT MisfDet_idxThdMap "index of threshold map" UBYTE MisfDet_idxThdMap_VERB 1 100 0.00 21.0000000000 FORMAT "%13.10" ECU_ADDRESS 0x40007E09
 /begin IF_DATA XCPplus 0x0102
  /begin DAQ_EVENT VARIABLE /begin AVAILABLE_EVENT_LIST EVENT 0 EVENT 1 EVENT 2 EVENT 3 /end AVAILABLE_EVENT_LIST /begin DEFAULT_EVENT_LIST EVENT 0 /end DEFAULT_EVENT_LIST /end DAQ_EVENT
 /end IF_DATA
/end MEASUREMENT
/begin MEASUREMENT MisfDet_idxThdMapSync "index for map selection synchronised" UBYTE MisfDet_idxThdMap_VERB 1 100 0.00 21.0000000000 FORMAT "%13.10" ECU_ADDRESS 0x40007E08
 /begin IF_DATA XCPplus 0x0102
  /begin DAQ_EVENT VARIABLE /begin AVAILABLE_EVENT_LIST EVENT 0 EVENT 1 EVENT 2 EVENT 3 /end AVAILABLE_EVENT_LIST /begin DEFAULT_EVENT_LIST EVENT 0 /end DEFAULT_EVENT_LIST /end DAQ_EVENT
 /end IF_DATA
/end MEASUREMENT
/begin MEASUREMENT MisfDet_ignCntr "Ignition counter endurance test" ULONG OneToOne 1 100 0.00 4294967295.00 FORMAT "%13.2" ECU_ADDRESS 0x4000CD60
 /begin IF_DATA XCPplus 0x0102
  /begin DAQ_EVENT VARIABLE /begin AVAILABLE_EVENT_LIST EVENT 0 EVENT 1 EVENT 2 EVENT 3 /end AVAILABLE_EVENT_LIST /begin DEFAULT_EVENT_LIST EVENT 0 /end DEFAULT_EVENT_LIST /end DAQ_EVENT
 /end IF_DATA
/end MEASUREMENT
/begin MEASUREMENT MisfDet_maskCntMisf "bit mask counted misfires during past working cycle" UWORD OneToOne 1 100 0.00 65535.00 FORMAT "%8.2" ECU_ADDRESS 0x40007E4C
 /begin IF_DATA XCPplus 0x0102
  /begin DAQ_EVENT VARIABLE /begin AVAILABLE_EVENT_LIST EVENT 0 EVENT 1 EVENT 2 EVENT 3 /end AVAILABLE_EVENT_LIST /begin DEFAULT_EVENT_LIST EVENT 0 /end DEFAULT_EVENT_LIST /end DAQ_EVENT
 /end IF_DATA
/end MEASUREMENT
/begin MEASUREMENT MisfDet_maskDet "Bit mask detected misfires during past working cycle" UWORD OneToOne 1 100 0.00 65535.00 FORMAT "%8.2" ECU_ADDRESS 0x40007E4A
 /begin IF_DATA XCPplus 0x0102
  /begin DAQ_EVENT VARIABLE /begin AVAILABLE_EVENT_LIST EVENT 0 EVENT 1 EVENT 2 EVENT 3 /end AVAILABLE_EVENT_LIST /begin DEFAULT_EVENT_LIST EVENT 0 /end DEFAULT_EVENT_LIST /end DAQ_EVENT
 /end IF_DATA
/end MEASUREMENT
/begin MEASUREMENT MisfDet_maskMisfCont "bit mask continuous misfiring cylinder" UWORD OneToOne 1 100 0.00 65535.00 FORMAT "%8.2" ECU_ADDRESS 0x40007E48
 /begin IF_DATA XCPplus 0x0102
  /begin DAQ_EVENT VARIABLE /begin AVAILABLE_EVENT_LIST EVENT 0 EVENT 1 EVENT 2 EVENT 3 /end AVAILABLE_EVENT_LIST /begin DEFAULT_EVENT_LIST EVENT 0 /end DEFAULT_EVENT_LIST /end DAQ_EVENT
 /end IF_DATA
/end MEASUREMENT
/begin MEASUREMENT MisfDet_maskSegPosnDnCalc "Calculation request for engine roughness of the respective segment position" UBYTE OneToOne 1 100 0.00 255.0 FORMAT "%5.1" ECU_ADDRESS 0x40007F7F
 /begin IF_DATA XCPplus 0x0102
  /begin DAQ_EVENT VARIABLE /begin AVAILABLE_EVENT_LIST EVENT 0 EVENT 1 EVENT 2 EVENT 3 /end AVAILABLE_EVENT_LIST /begin DEFAULT_EVENT_LIST EVENT 0 /end DEFAULT_EVENT_LIST /end DAQ_EVENT
 /end IF_DATA
/end MEASUREMENT
/begin MEASUREMENT MisfDet_maskSegTiVld "Validity of segment time of the respective segment position" UBYTE OneToOne 1 100 0.00 255.0 FORMAT "%5.1" ECU_ADDRESS 0x40007F7E
 /begin IF_DATA XCPplus 0x0102
  /begin DAQ_EVENT VARIABLE /begin AVAILABLE_EVENT_LIST EVENT 0 EVENT 1 EVENT 2 EVENT 3 /end AVAILABLE_EVENT_LIST /begin DEFAULT_EVENT_LIST EVENT 0 /end DEFAULT_EVENT_LIST /end DAQ_EVENT
 /end IF_DATA
/end MEASUREMENT
/begin MEASUREMENT MisfDet_maskSegTiVldSegBasd "Validity of segment time of the respective segment position" UBYTE OneToOne 1 100 0.00 255.0 FORMAT "%5.1" ECU_ADDRESS 0x40007E55
 /begin IF_DATA XCPplus 0x0102
  /begin DAQ_EVENT VARIABLE /begin AVAILABLE_EVENT_LIST EVENT 0 EVENT 1 EVENT 2 EVENT 3 /end AVAILABLE_EVENT_LIST /begin DEFAULT_EVENT_LIST EVENT 0 /end DEFAULT_EVENT_LIST /end DAQ_EVENT
 /end IF_DATA
/end MEASUREMENT
/begin MEASUREMENT MisfDet_maskStcCatFltCylIdn "cylinder individual fault state single cylinder fault" UWORD OneToOne 1 100 0.00 65535.00 FORMAT "%8.2" ECU_ADDRESS 0x40007FB8
 /begin IF_DATA XCPplus 0x0102
  /begin DAQ_EVENT VARIABLE /begin AVAILABLE_EVENT_LIST EVENT 0 EVENT 1 EVENT 2 EVENT 3 /end AVAILABLE_EVENT_LIST /begin DEFAULT_EVENT_LIST EVENT 0 /end DEFAULT_EVENT_LIST /end DAQ_EVENT
 /end IF_DATA
/end MEASUREMENT
/begin MEASUREMENT MisfDet_maskStcCatFltMpl "cylinder individual fault state multiple fault" UWORD OneToOne 1 100 0.00 65535.00 FORMAT "%8.2" ECU_ADDRESS 0x40007FB6
 /begin IF_DATA XCPplus 0x0102
  /begin DAQ_EVENT VARIABLE /begin AVAILABLE_EVENT_LIST EVENT 0 EVENT 1 EVENT 2 EVENT 3 /end AVAILABLE_EVENT_LIST /begin DEFAULT_EVENT_LIST EVENT 0 /end DEFAULT_EVENT_LIST /end DAQ_EVENT
 /end IF_DATA
/end MEASUREMENT
/begin MEASUREMENT MisfDet_maskStcEmiFltCylIdn "cylinder individual fault state single cylinder fault" UWORD OneToOne 1 100 0.00 65535.00 FORMAT "%8.2" ECU_ADDRESS 0x40007FB4
 /begin IF_DATA XCPplus 0x0102
  /begin DAQ_EVENT VARIABLE /begin AVAILABLE_EVENT_LIST EVENT 0 EVENT 1 EVENT 2 EVENT 3 /end AVAILABLE_EVENT_LIST /begin DEFAULT_EVENT_LIST EVENT 0 /end DEFAULT_EVENT_LIST /end DAQ_EVENT
 /end IF_DATA
/end MEASUREMENT
/begin MEASUREMENT MisfDet_maskStcEmiFltMpl "cylinder individual fault state multiple fault" UWORD OneToOne 1 100 0.00 65535.00 FORMAT "%8.2" ECU_ADDRESS 0x40007FB2
 /begin IF_DATA XCPplus 0x0102
  /begin DAQ_EVENT VARIABLE /begin AVAILABLE_EVENT_LIST EVENT 0 EVENT 1 EVENT 2 EVENT 3 /end AVAILABLE_EVENT_LIST /begin DEFAULT_EVENT_LIST EVENT 0 /end DEFAULT_EVENT_LIST /end DAQ_EVENT
 /end IF_DATA
/end MEASUREMENT
/begin MEASUREMENT MisfDet_misfCntrCyl "misfire counter endurance test" UWORD OneToOne 1 100 0.00 65535.00 FORMAT "%8.2" ARRAY_SIZE 1 ECU_ADDRESS 0x4000CD5C
 /begin IF_DATA XCPplus 0x0102
  /begin DAQ_EVENT VARIABLE /begin AVAILABLE_EVENT_LIST EVENT 0 EVENT 1 EVENT 2 EVENT 3 /end AVAILABLE_EVENT_LIST /begin DEFAULT_EVENT_LIST EVENT 0 /end DEFAULT_EVENT_LIST /end DAQ_EVENT
 /end IF_DATA
/end MEASUREMENT
/begin MEASUREMENT MisfDet_misfCntrSum "sum of cylinder individual misfire counter endurance test" UWORD OneToOne 1 100 0.00 65535.00 FORMAT "%8.2" ECU_ADDRESS 0x40007E18
 /begin IF_DATA XCPplus 0x0102
  /begin DAQ_EVENT VARIABLE /begin AVAILABLE_EVENT_LIST EVENT 0 EVENT 1 EVENT 2 EVENT 3 /end AVAILABLE_EVENT_LIST /begin DEFAULT_EVENT_LIST EVENT 0 /end DEFAULT_EVENT_LIST /end DAQ_EVENT
 /end IF_DATA
/end MEASUREMENT
/begin MEASUREMENT MisfDet_nrCylMisfNoId "number of misfiring cylinders without cylinder identification" UBYTE OneToOne 1 100 0.00 255.0 FORMAT "%5.1" ARRAY_SIZE 1 ECU_ADDRESS 0x40007F7C
 /begin IF_DATA XCPplus 0x0102
  /begin DAQ_EVENT VARIABLE /begin AVAILABLE_EVENT_LIST EVENT 0 EVENT 1 EVENT 2 EVENT 3 /end AVAILABLE_EVENT_LIST /begin DEFAULT_EVENT_LIST EVENT 0 /end DEFAULT_EVENT_LIST /end DAQ_EVENT
 /end IF_DATA
/end MEASUREMENT
/begin MEASUREMENT MisfDet_nrDcycDrvRcdr "Number driving cycles to reset endurance test counters" UBYTE OneToOne 1 100 0.00 255.0 FORMAT "%5.1" ECU_ADDRESS 0x4000CD64
 /begin IF_DATA XCPplus 0x0102
  /begin DAQ_EVENT VARIABLE /begin AVAILABLE_EVENT_LIST EVENT 0 EVENT 1 EVENT 2 EVENT 3 /end AVAILABLE_EVENT_LIST /begin DEFAULT_EVENT_LIST EVENT 3 /end DEFAULT_EVENT_LIST /end DAQ_EVENT
 /end IF_DATA
/end MEASUREMENT
/begin MEASUREMENT MisfDet_nrMisfConsc "NUmber of consecutive misfires" UBYTE OneToOne 1 100 0.00 255.0 FORMAT "%5.1" ARRAY_SIZE 1 ECU_ADDRESS 0x40007F78
 /begin IF_DATA XCPplus 0x0102
  /begin DAQ_EVENT VARIABLE /begin AVAILABLE_EVENT_LIST EVENT 0 EVENT 1 EVENT 2 EVENT 3 /end AVAILABLE_EVENT_LIST /begin DEFAULT_EVENT_LIST EVENT 0 /end DEFAULT_EVENT_LIST /end DAQ_EVENT
 /end IF_DATA
/end MEASUREMENT
/begin MEASUREMENT MisfDet_RoughRoadDstLog "Driven distance during detected rough road" UWORD len_q50_m 1 100 0.00 3276750. FORMAT "%8.0" ECU_ADDRESS 0x40005D70
 /begin IF_DATA XCPplus 0x0102
  /begin DAQ_EVENT VARIABLE /begin AVAILABLE_EVENT_LIST EVENT 0 EVENT 1 EVENT 2 EVENT 3 /end AVAILABLE_EVENT_LIST /begin DEFAULT_EVENT_LIST EVENT 1 /end DEFAULT_EVENT_LIST /end DAQ_EVENT
 /end IF_DATA
/end MEASUREMENT
/begin MEASUREMENT MisfDet_segPosnLen "segment length" UBYTE kw_tooth_sy 1 100 0.00 2550. FORMAT "%5.0" ECU_ADDRESS 0x40007F75
 /begin IF_DATA XCPplus 0x0102
  /begin DAQ_EVENT VARIABLE /begin AVAILABLE_EVENT_LIST EVENT 0 EVENT 1 EVENT 2 EVENT 3 /end AVAILABLE_EVENT_LIST /begin DEFAULT_EVENT_LIST EVENT 0 /end DEFAULT_EVENT_LIST /end DAQ_EVENT
 /end IF_DATA
/end MEASUREMENT
/begin MEASUREMENT MisfDet_segPosnLenSync "Segment length, synchronised" UBYTE kw_tooth_sy 1 100 0.00 2550. FORMAT "%5.0" ECU_ADDRESS 0x40007F74 /end MEASUREMENT
/begin MEASUREMENT MisfDet_segPosnSegTi "Current segment position of the segment time" UBYTE Compu_SegPosnInt_VERB 1 100 0.00 258.000000000 FORMAT "%13.9" ECU_ADDRESS 0x40007F73
 /begin IF_DATA XCPplus 0x0102
  /begin DAQ_EVENT VARIABLE /begin AVAILABLE_EVENT_LIST EVENT 0 EVENT 1 EVENT 2 EVENT 3 /end AVAILABLE_EVENT_LIST /begin DEFAULT_EVENT_LIST EVENT 0 /end DEFAULT_EVENT_LIST /end DAQ_EVENT
 /end IF_DATA
/end MEASUREMENT
/begin MEASUREMENT MisfDet_segPosnStrt "starting position of the segment" SBYTE kw_tooth_sy 1 100 -1280. 1270. FORMAT "%5.0" ECU_ADDRESS 0x40007F87
 /begin IF_DATA XCPplus 0x0102
  /begin DAQ_EVENT VARIABLE /begin AVAILABLE_EVENT_LIST EVENT 0 EVENT 1 EVENT 2 EVENT 3 /end AVAILABLE_EVENT_LIST /begin DEFAULT_EVENT_LIST EVENT 0 /end DEFAULT_EVENT_LIST /end DAQ_EVENT
 /end IF_DATA
/end MEASUREMENT
/begin MEASUREMENT MisfDet_segTi "segment time value" ULONG tsquant_l 1 100 0.00 214748364.750 FORMAT "%13.3" ECU_ADDRESS 0x40007FFC
 /begin IF_DATA XCPplus 0x0102
  /begin DAQ_EVENT VARIABLE /begin AVAILABLE_EVENT_LIST EVENT 0 EVENT 1 EVENT 2 EVENT 3 /end AVAILABLE_EVENT_LIST /begin DEFAULT_EVENT_LIST EVENT 0 /end DEFAULT_EVENT_LIST /end DAQ_EVENT
 /end IF_DATA
/end MEASUREMENT
/begin MEASUREMENT MisfDet_segTiAry "Array of segment times (per segment position)" ULONG tsquant_l 1 100 0.00 214748364.750 FORMAT "%13.3" ARRAY_SIZE 1 ECU_ADDRESS 0x40007FF8
 /begin IF_DATA XCPplus 0x0102
  /begin DAQ_EVENT VARIABLE /begin AVAILABLE_EVENT_LIST EVENT 0 EVENT 1 EVENT 2 EVENT 3 /end AVAILABLE_EVENT_LIST /begin DEFAULT_EVENT_LIST EVENT 0 /end DEFAULT_EVENT_LIST /end DAQ_EVENT
 /end IF_DATA
/end MEASUREMENT
/begin MEASUREMENT MisfDet_segTiDly "delay of igntition to segment time" UBYTE dez 1 100 0.00 255.0 FORMAT "%5.1" ECU_ADDRESS 0x40007F72
 /begin IF_DATA XCPplus 0x0102
  /begin DAQ_EVENT VARIABLE /begin AVAILABLE_EVENT_LIST EVENT 0 EVENT 1 EVENT 2 EVENT 3 /end AVAILABLE_EVENT_LIST /begin DEFAULT_EVENT_LIST EVENT 0 /end DEFAULT_EVENT_LIST /end DAQ_EVENT
 /end IF_DATA
/end MEASUREMENT
/begin MEASUREMENT MisfDet_segTiDlyCorr "correction value for segment time delay to ignition" SBYTE OneToOne 1 100 -128.0 127.0 FORMAT "%5.1" ECU_ADDRESS 0x40007E54 /end MEASUREMENT
/begin MEASUREMENT MisfDet_segTiSegBasd "segment time based on raw time stamps" ULONG tsquant_l 1 100 0.00 214748364.750 FORMAT "%13.3" ARRAY_SIZE 1 ECU_ADDRESS 0x40007E50
 /begin IF_DATA XCPplus 0x0102
  /begin DAQ_EVENT VARIABLE /begin AVAILABLE_EVENT_LIST EVENT 0 EVENT 1 EVENT 2 EVENT 3 /end AVAILABLE_EVENT_LIST /begin DEFAULT_EVENT_LIST EVENT 0 /end DEFAULT_EVENT_LIST /end DAQ_EVENT
 /end IF_DATA
/end MEASUREMENT
/begin MEASUREMENT MisfDet_simrCdn.n "Freeze frame data for similar conditions misfire fault / engine speed for similar conditions" UWORD nmot_uw_q0p25 1 100 0.00 16383.75 FORMAT "%8.2" ECU_ADDRESS 0x40007E1A /end MEASUREMENT
/begin MEASUREMENT MisfDet_simrCdn.load "Freeze frame data for similar conditions misfire fault / load for similar conditions" UBYTE rel_ub_b99p6 1 100 0.00 99.61 FORMAT "%5.2" ECU_ADDRESS 0x40007E1C /end MEASUREMENT
/begin MEASUREMENT MisfDet_simrCdn.T "Freeze frame data for similar conditions misfire fault / Warm-Up state for similar coditions" UBYTE B_TRUE 1 100 0.00 1.00000000000 BIT_MASK 0x1 FORMAT "%13.11" ECU_ADDRESS 0x40007E1D /end MEASUREMENT
/begin MEASUREMENT MisfDet_stCatDmg "cat damage during past intervall" UBYTE B_TRUE 1 100 0.00 1.00000000000 BIT_MASK 0x1 FORMAT "%13.11" ECU_ADDRESS 0x40006411
 /begin IF_DATA XCPplus 0x0102
  /begin DAQ_EVENT VARIABLE /begin AVAILABLE_EVENT_LIST EVENT 0 EVENT 1 EVENT 2 EVENT 3 /end AVAILABLE_EVENT_LIST /begin DEFAULT_EVENT_LIST EVENT 0 /end DEFAULT_EVENT_LIST /end DAQ_EVENT
 /end IF_DATA
/end MEASUREMENT
/begin MEASUREMENT MisfDet_stCatDmgBnk "exhaust bank individual statusbyte for catalyst damaging misfire rate exceeded" UBYTE OneToOne 1 100 0.00 255.0 FORMAT "%5.1" ECU_ADDRESS 0x40007F71
 /begin IF_DATA XCPplus 0x0102
  /begin DAQ_EVENT VARIABLE /begin AVAILABLE_EVENT_LIST EVENT 0 EVENT 1 EVENT 2 EVENT 3 /end AVAILABLE_EVENT_LIST /begin DEFAULT_EVENT_LIST EVENT 0 /end DEFAULT_EVENT_LIST /end DAQ_EVENT
 /end IF_DATA
/end MEASUREMENT
/begin MEASUREMENT MisfDet_stCatDmgBnkCurrIntl "Catalyst damage bank index" UBYTE OneToOne 1 100 0.00 255.0 FORMAT "%5.1" ECU_ADDRESS 0x40007F70
 /begin IF_DATA XCPplus 0x0102
  /begin DAQ_EVENT VARIABLE /begin AVAILABLE_EVENT_LIST EVENT 0 EVENT 1 EVENT 2 EVENT 3 /end AVAILABLE_EVENT_LIST /begin DEFAULT_EVENT_LIST EVENT 0 /end DEFAULT_EVENT_LIST /end DAQ_EVENT
 /end IF_DATA
/end MEASUREMENT
/begin MEASUREMENT MisfDet_stCatDmgCurrIntl "Condition for catalyst damaging misfire detected for this kat- intervall" UBYTE B_TRUE 1 100 0.00 1.00000000000 BIT_MASK 0x1 FORMAT "%13.11" ECU_ADDRESS 0x40006410
 /begin IF_DATA XCPplus 0x0102
  /begin DAQ_EVENT VARIABLE /begin AVAILABLE_EVENT_LIST EVENT 0 EVENT 1 EVENT 2 EVENT 3 /end AVAILABLE_EVENT_LIST /begin DEFAULT_EVENT_LIST EVENT 0 /end DEFAULT_EVENT_LIST /end DAQ_EVENT
 /end IF_DATA
/end MEASUREMENT
/begin MEASUREMENT MisfDet_stCatDmgDebd "status debouncing for catalyst damaging expired" UBYTE B_TRUE 1 100 0.00 1.00000000000 BIT_MASK 0x1 FORMAT "%13.11" ECU_ADDRESS 0x4000628F
 /begin IF_DATA XCPplus 0x0102
  /begin DAQ_EVENT VARIABLE /begin AVAILABLE_EVENT_LIST EVENT 0 EVENT 1 EVENT 2 EVENT 3 /end AVAILABLE_EVENT_LIST /begin DEFAULT_EVENT_LIST EVENT 0 /end DEFAULT_EVENT_LIST /end DAQ_EVENT
 /end IF_DATA
/end MEASUREMENT
/begin MEASUREMENT MisfDet_stCatDmgDebMisfOutdRng "status misfire detected out of range for debouncing" UBYTE B_TRUE 1 100 0.00 1.00000000000 BIT_MASK 0x1 FORMAT "%13.11" ECU_ADDRESS 0x4000628E
 /begin IF_DATA XCPplus 0x0102
  /begin DAQ_EVENT VARIABLE /begin AVAILABLE_EVENT_LIST EVENT 0 EVENT 1 EVENT 2 EVENT 3 /end AVAILABLE_EVENT_LIST /begin DEFAULT_EVENT_LIST EVENT 0 /end DEFAULT_EVENT_LIST /end DAQ_EVENT
 /end IF_DATA
/end MEASUREMENT
/begin MEASUREMENT MisfDet_stCatDmgDebOutOfRng "status out of range for debouncing" UBYTE B_TRUE 1 100 0.00 1.00000000000 BIT_MASK 0x1 FORMAT "%13.11" ECU_ADDRESS 0x4000628D
 /begin IF_DATA XCPplus 0x0102
  /begin DAQ_EVENT VARIABLE /begin AVAILABLE_EVENT_LIST EVENT 0 EVENT 1 EVENT 2 EVENT 3 /end AVAILABLE_EVENT_LIST /begin DEFAULT_EVENT_LIST EVENT 0 /end DEFAULT_EVENT_LIST /end DAQ_EVENT
 /end IF_DATA
/end MEASUREMENT
/begin MEASUREMENT MisfDet_stCatDmgLstIntl "catalyst damaging at past interval" UBYTE B_TRUE 1 100 0.00 1.00000000000 BIT_MASK 0x1 FORMAT "%13.11" ECU_ADDRESS 0x4000640F
 /begin IF_DATA XCPplus 0x0102
  /begin DAQ_EVENT VARIABLE /begin AVAILABLE_EVENT_LIST EVENT 0 EVENT 1 EVENT 2 EVENT 3 /end AVAILABLE_EVENT_LIST /begin DEFAULT_EVENT_LIST EVENT 0 /end DEFAULT_EVENT_LIST /end DAQ_EVENT
 /end IF_DATA
/end MEASUREMENT
/begin MEASUREMENT MisfDet_stCatFltMpl "multiple misfire fault detected" UBYTE B_TRUE 1 100 0.00 1.00000000000 BIT_MASK 0x1 FORMAT "%13.11" ECU_ADDRESS 0x4000628C
 /begin IF_DATA XCPplus 0x0102
  /begin DAQ_EVENT VARIABLE /begin AVAILABLE_EVENT_LIST EVENT 0 EVENT 1 EVENT 2 EVENT 3 /end AVAILABLE_EVENT_LIST /begin DEFAULT_EVENT_LIST EVENT 0 /end DEFAULT_EVENT_LIST /end DAQ_EVENT
 /end IF_DATA
/end MEASUREMENT
/begin MEASUREMENT MisfDet_StcCatCntrSimrCdn.misfBnk "counter of catalyst damage in similar conditions / misfire counter sum of exhaust bank under similar conditions" UWORD OneToOne 1 100 0.00 65535.00 FORMAT "%8.2" ARRAY_SIZE 1 ECU_ADDRESS 0x40007E3C /end MEASUREMENT
/begin MEASUREMENT MisfDet_StcCatCntrSimrCdn.ign "counter of catalyst damage in similar conditions / ignition counter in cat interval" UWORD OneToOne 1 100 0.00 65535.00 FORMAT "%8.2" ECU_ADDRESS 0x40007E3E /end MEASUREMENT
/begin MEASUREMENT MisfDet_stcCatDmgDebIntlCntr "counter encountered from catalyst damaging till FSP entry" UBYTE OneToOne 1 100 0.00 255.0 FORMAT "%5.1" ECU_ADDRESS 0x40007E44
 /begin IF_DATA XCPplus 0x0102
  /begin DAQ_EVENT VARIABLE /begin AVAILABLE_EVENT_LIST EVENT 0 EVENT 1 EVENT 2 EVENT 3 /end AVAILABLE_EVENT_LIST /begin DEFAULT_EVENT_LIST EVENT 0 /end DEFAULT_EVENT_LIST /end DAQ_EVENT
 /end IF_DATA
/end MEASUREMENT
/begin MEASUREMENT MisfDet_stcCatDmgNrCyl "Number of catalyst damaging cylinders" UBYTE OneToOne 1 100 0.00 255.0 FORMAT "%5.1" ECU_ADDRESS 0x40007F6C
 /begin IF_DATA XCPplus 0x0102
  /begin DAQ_EVENT VARIABLE /begin AVAILABLE_EVENT_LIST EVENT 0 EVENT 1 EVENT 2 EVENT 3 /end AVAILABLE_EVENT_LIST /begin DEFAULT_EVENT_LIST EVENT 3 /end DEFAULT_EVENT_LIST /end DAQ_EVENT
 /end IF_DATA
/end MEASUREMENT
/begin MEASUREMENT MisfDet_stcCatIgnCntr "Ignition counter for cat interval" UWORD OneToOne 1 100 0.00 65535.00 FORMAT "%8.2" ECU_ADDRESS 0x40007FAE
 /begin IF_DATA XCPplus 0x0102
  /begin DAQ_EVENT VARIABLE /begin AVAILABLE_EVENT_LIST EVENT 0 EVENT 1 EVENT 2 EVENT 3 /end AVAILABLE_EVENT_LIST /begin DEFAULT_EVENT_LIST EVENT 0 /end DEFAULT_EVENT_LIST /end DAQ_EVENT
 /end IF_DATA
/end MEASUREMENT
/begin MEASUREMENT MisfDet_stcCatIntlLen "Number of ignitions of cat interval" UWORD OneToOne 1 100 0.00 65535.00 FORMAT "%8.2" ECU_ADDRESS 0x40007FAC
 /begin IF_DATA XCPplus 0x0102
  /begin DAQ_EVENT VARIABLE /begin AVAILABLE_EVENT_LIST EVENT 0 EVENT 1 EVENT 2 EVENT 3 /end AVAILABLE_EVENT_LIST /begin DEFAULT_EVENT_LIST EVENT 0 /end DEFAULT_EVENT_LIST /end DAQ_EVENT
 /end IF_DATA
/end MEASUREMENT
/begin MEASUREMENT MisfDet_stcCatIntlLenMaxSimrCdn "Length of cat interval for similar conditions" UWORD OneToOne 1 100 0.00 65535.00 FORMAT "%8.2" ECU_ADDRESS 0x40007E42
 /begin IF_DATA XCPplus 0x0102
  /begin DAQ_EVENT VARIABLE /begin AVAILABLE_EVENT_LIST EVENT 0 EVENT 1 EVENT 2 EVENT 3 /end AVAILABLE_EVENT_LIST /begin DEFAULT_EVENT_LIST EVENT 0 /end DEFAULT_EVENT_LIST /end DAQ_EVENT
 /end IF_DATA
/end MEASUREMENT
/begin MEASUREMENT MisfDet_stcCatMisfCntrBnk "Weighted misfire counter for exhaust bank" UWORD OneToOne 1 100 0.00 65535.00 FORMAT "%8.2" ARRAY_SIZE 1 ECU_ADDRESS 0x40007FAA
 /begin IF_DATA XCPplus 0x0102
  /begin DAQ_EVENT VARIABLE /begin AVAILABLE_EVENT_LIST EVENT 0 EVENT 1 EVENT 2 EVENT 3 /end AVAILABLE_EVENT_LIST /begin DEFAULT_EVENT_LIST EVENT 0 /end DEFAULT_EVENT_LIST /end DAQ_EVENT
 /end IF_DATA
/end MEASUREMENT
/begin MEASUREMENT MisfDet_stcCatMisfCntrCyl "weighted misfire counter cylinder individual" UWORD OneToOne 1 100 0.00 65535.00 FORMAT "%8.2" ARRAY_SIZE 1 ECU_ADDRESS 0x40007FA8
 /begin IF_DATA XCPplus 0x0102
  /begin DAQ_EVENT VARIABLE /begin AVAILABLE_EVENT_LIST EVENT 0 EVENT 1 EVENT 2 EVENT 3 /end AVAILABLE_EVENT_LIST /begin DEFAULT_EVENT_LIST EVENT 0 /end DEFAULT_EVENT_LIST /end DAQ_EVENT
 /end IF_DATA
/end MEASUREMENT
/begin MEASUREMENT MisfDet_stcCatMisfCntrSumNotWght "unweighted misfire counter for cat interval" UWORD dez 1 100 0.00 65535.00 FORMAT "%8.2" ECU_ADDRESS 0x40007FA6
 /begin IF_DATA XCPplus 0x0102
  /begin DAQ_EVENT VARIABLE /begin AVAILABLE_EVENT_LIST EVENT 0 EVENT 1 EVENT 2 EVENT 3 /end AVAILABLE_EVENT_LIST /begin DEFAULT_EVENT_LIST EVENT 0 /end DEFAULT_EVENT_LIST /end DAQ_EVENT
 /end IF_DATA
/end MEASUREMENT
/begin MEASUREMENT MisfDet_stcCatThd "Threshold for catalyst damaging" UWORD OneToOne 1 100 0.00 65535.00 FORMAT "%8.2" ECU_ADDRESS 0x40007FA4
 /begin IF_DATA XCPplus 0x0102
  /begin DAQ_EVENT VARIABLE /begin AVAILABLE_EVENT_LIST EVENT 0 EVENT 1 EVENT 2 EVENT 3 /end AVAILABLE_EVENT_LIST /begin DEFAULT_EVENT_LIST EVENT 0 /end DEFAULT_EVENT_LIST /end DAQ_EVENT
 /end IF_DATA
/end MEASUREMENT
/begin MEASUREMENT MisfDet_stcCatThdMaxSimrCdn "Threshold for catalyst damaging for similar conditions" UWORD OneToOne 1 100 0.00 65535.00 FORMAT "%8.2" ECU_ADDRESS 0x40007E40
 /begin IF_DATA XCPplus 0x0102
  /begin DAQ_EVENT VARIABLE /begin AVAILABLE_EVENT_LIST EVENT 0 EVENT 1 EVENT 2 EVENT 3 /end AVAILABLE_EVENT_LIST /begin DEFAULT_EVENT_LIST EVENT 0 /end DEFAULT_EVENT_LIST /end DAQ_EVENT
 /end IF_DATA
/end MEASUREMENT
/begin MEASUREMENT MisfDet_stcCatWghtFac "weighting factor for misfire counter" UBYTE OneToOne 1 100 0.00 255.0 FORMAT "%5.1" ECU_ADDRESS 0x40007F6B
 /begin IF_DATA XCPplus 0x0102
  /begin DAQ_EVENT VARIABLE /begin AVAILABLE_EVENT_LIST EVENT 0 EVENT 1 EVENT 2 EVENT 3 /end AVAILABLE_EVENT_LIST /begin DEFAULT_EVENT_LIST EVENT 3 /end DEFAULT_EVENT_LIST /end DAQ_EVENT
 /end IF_DATA
/end MEASUREMENT
/begin MEASUREMENT MisfDet_stcEmiIgnCntr "ignition counter for emission interval" UWORD OneToOne 1 100 0.00 65535.00 FORMAT "%8.2" ECU_ADDRESS 0x40007FA2
 /begin IF_DATA XCPplus 0x0102
  /begin DAQ_EVENT VARIABLE /begin AVAILABLE_EVENT_LIST EVENT 0 EVENT 1 EVENT 2 EVENT 3 /end AVAILABLE_EVENT_LIST /begin DEFAULT_EVENT_LIST EVENT 0 /end DEFAULT_EVENT_LIST /end DAQ_EVENT
 /end IF_DATA
/end MEASUREMENT
/begin MEASUREMENT MisfDet_stcEmiIntlCntr "interval counter for emission statistic" UBYTE OneToOne 1 100 0.00 255.0 FORMAT "%5.1" ECU_ADDRESS 0x40007F6A
 /begin IF_DATA XCPplus 0x0102
  /begin DAQ_EVENT VARIABLE /begin AVAILABLE_EVENT_LIST EVENT 0 EVENT 1 EVENT 2 EVENT 3 /end AVAILABLE_EVENT_LIST /begin DEFAULT_EVENT_LIST EVENT 0 /end DEFAULT_EVENT_LIST /end DAQ_EVENT
 /end IF_DATA
/end MEASUREMENT
/begin MEASUREMENT MisfDet_stcEmiIntlDmgCntr "counter iof damaged emission intervals" UBYTE OneToOne 1 100 0.00 255.0 FORMAT "%5.1" ECU_ADDRESS 0x40007F69
 /begin IF_DATA XCPplus 0x0102
  /begin DAQ_EVENT VARIABLE /begin AVAILABLE_EVENT_LIST EVENT 0 EVENT 1 EVENT 2 EVENT 3 /end AVAILABLE_EVENT_LIST /begin DEFAULT_EVENT_LIST EVENT 0 /end DEFAULT_EVENT_LIST /end DAQ_EVENT
 /end IF_DATA
/end MEASUREMENT
/begin MEASUREMENT MisfDet_stcEmiMisfCntrCyl "cylinder individual misfire counter for emission statistic" UWORD OneToOne 1 100 0.00 65535.00 FORMAT "%8.2" ARRAY_SIZE 1 ECU_ADDRESS 0x40007FA0
 /begin IF_DATA XCPplus 0x0102
  /begin DAQ_EVENT VARIABLE /begin AVAILABLE_EVENT_LIST EVENT 0 EVENT 1 EVENT 2 EVENT 3 /end AVAILABLE_EVENT_LIST /begin DEFAULT_EVENT_LIST EVENT 0 /end DEFAULT_EVENT_LIST /end DAQ_EVENT
 /end IF_DATA
/end MEASUREMENT
/begin MEASUREMENT MisfDet_stcEmiMisfCntrSum "misfire sum counter emission statistic" UWORD OneToOne 1 100 0.00 65535.00 FORMAT "%8.2" ECU_ADDRESS 0x40007F9E
 /begin IF_DATA XCPplus 0x0102
  /begin DAQ_EVENT VARIABLE /begin AVAILABLE_EVENT_LIST EVENT 0 EVENT 1 EVENT 2 EVENT 3 /end AVAILABLE_EVENT_LIST /begin DEFAULT_EVENT_LIST EVENT 0 /end DEFAULT_EVENT_LIST /end DAQ_EVENT
 /end IF_DATA
/end MEASUREMENT
/begin MEASUREMENT MisfDet_stcEmiStructCntr.misfSum "structure for counters of emission statistic / misfire sum counter" UWORD OneToOne 1 100 0.00 65535.00 FORMAT "%8.2" ECU_ADDRESS 0x40007E30 /end MEASUREMENT
/begin MEASUREMENT MisfDet_stcEmiStructCntr.misfCyl "structure for counters of emission statistic / cylinder individual misfire counter" UWORD OneToOne 1 100 0.00 65535.00 FORMAT "%8.2" ARRAY_SIZE 1 ECU_ADDRESS 0x40007E32 /end MEASUREMENT
/begin MEASUREMENT MisfDet_stcEmiStructCntr.ign "structure for counters of emission statistic / ignition counter in emission interval" UWORD OneToOne 1 100 0.00 65535.00 FORMAT "%8.2" ECU_ADDRESS 0x40007E34 /end MEASUREMENT
/begin MEASUREMENT MisfDet_stcEmiStructCntr.intl "structure for counters of emission statistic / counter emission intervals" UBYTE OneToOne 1 100 0.00 255.0 FORMAT "%5.1" ECU_ADDRESS 0x40007E36 /end MEASUREMENT
/begin MEASUREMENT MisfDet_stcEmiStructCntr.dmgIntl "structure for counters of emission statistic / number of damaged intervals" UBYTE OneToOne 1 100 0.00 255.0 FORMAT "%5.1" ECU_ADDRESS 0x40007E37 /end MEASUREMENT
/begin MEASUREMENT MisfDet_stcEmiStructCntr.stCylDmgCylIdn "structure for counters of emission statistic / status erroneous cylinders for cylinder individual fault" UWORD OneToOne 1 100 0.00 65535.00 FORMAT "%8.2" ECU_ADDRESS 0x40007E38 /end MEASUREMENT
/begin MEASUREMENT MisfDet_stcEmiStructCntr.stCylDmgMtpl "structure for counters of emission statistic / status erroneous cylinders for multiple ault" UWORD OneToOne 1 100 0.00 65535.00 FORMAT "%8.2" ECU_ADDRESS 0x40007E3A /end MEASUREMENT
/begin MEASUREMENT MisfDet_stcEmiStructSimrCdn.misfSum "structure for counters of emission statistic if similar conditions are encountered / misfire sum counter" UWORD OneToOne 1 100 0.00 65535.00 FORMAT "%8.2" ECU_ADDRESS 0x40007E28 /end MEASUREMENT
/begin MEASUREMENT MisfDet_stcEmiStructSimrCdn.ign "structure for counters of emission statistic if similar conditions are encountered / ignition counter in emission interval" UWORD OneToOne 1 100 0.00 65535.00 FORMAT "%8.2" ECU_ADDRESS 0x40007E2A /end MEASUREMENT
/begin MEASUREMENT MisfDet_stcEmiStructSimrCdn.intl "structure for counters of emission statistic if similar conditions are encountered / counter emission intervals" UWORD OneToOne 1 100 0.00 65535.00 FORMAT "%8.2" ECU_ADDRESS 0x40007E2C /end MEASUREMENT
/begin MEASUREMENT MisfDet_stcEmiStructSimrCdn.dmgIntl "structure for counters of emission statistic if similar conditions are encountered / number of damaged intervals" UBYTE OneToOne 1 100 0.00 255.0 FORMAT "%5.1" ECU_ADDRESS 0x40007E2E /end MEASUREMENT
/begin MEASUREMENT MisfDet_stcEmiStructSimrCdnStrt.misfSum "structure for counters of emission statistic if similar conditions are encountered first interval / misfire sum counter" UWORD OneToOne 1 100 0.00 65535.00 FORMAT "%8.2" ECU_ADDRESS 0x40007E20 /end MEASUREMENT
/begin MEASUREMENT MisfDet_stcEmiStructSimrCdnStrt.ign "structure for counters of emission statistic if similar conditions are encountered first interval / ignition counter in emission interval" UWORD OneToOne 1 100 0.00 65535.00 FORMAT "%8.2" ECU_ADDRESS 0x40007E22 /end MEASUREMENT
/begin MEASUREMENT MisfDet_stcEmiStructSimrCdnStrt.intl "structure for counters of emission statistic if similar conditions are encountered first interval / counter emission intervals" UWORD OneToOne 1 100 0.00 65535.00 FORMAT "%8.2" ECU_ADDRESS 0x40007E24 /end MEASUREMENT
/begin MEASUREMENT MisfDet_stcEmiStructSimrCdnStrt.dmgIntl "structure for counters of emission statistic if similar conditions are encountered first interval / number of damaged intervals" UBYTE OneToOne 1 100 0.00 255.0 FORMAT "%5.1" ECU_ADDRESS 0x40007E26 /end MEASUREMENT
/begin MEASUREMENT MisfDet_stcEmiThd "threshold for emission exceedance" UWORD OneToOne 1 100 0.00 65535.00 FORMAT "%8.2" ECU_ADDRESS 0x40007F9C
 /begin IF_DATA XCPplus 0x0102
  /begin DAQ_EVENT VARIABLE /begin AVAILABLE_EVENT_LIST EVENT 0 EVENT 1 EVENT 2 EVENT 3 /end AVAILABLE_EVENT_LIST /begin DEFAULT_EVENT_LIST EVENT 0 /end DEFAULT_EVENT_LIST /end DAQ_EVENT
 /end IF_DATA
/end MEASUREMENT
/begin MEASUREMENT MisfDet_stCntMisf "count misfire event" UBYTE B_TRUE 1 100 0.00 1.00000000000 BIT_MASK 0x1 FORMAT "%13.11" ECU_ADDRESS 0x40006380
 /begin IF_DATA XCPplus 0x0102
  /begin DAQ_EVENT VARIABLE /begin AVAILABLE_EVENT_LIST EVENT 0 EVENT 1 EVENT 2 EVENT 3 /end AVAILABLE_EVENT_LIST /begin DEFAULT_EVENT_LIST EVENT 0 /end DEFAULT_EVENT_LIST /end DAQ_EVENT
 /end IF_DATA
/end MEASUREMENT
/begin MEASUREMENT MisfDet_stDnThdDynLim "dynamic limitation enabled" UBYTE B_TRUE 1 100 0.00 1.00000000000 BIT_MASK 0x1 FORMAT "%13.11" ECU_ADDRESS 0x4000637B
 /begin IF_DATA XCPplus 0x0102
  /begin DAQ_EVENT VARIABLE /begin AVAILABLE_EVENT_LIST EVENT 0 EVENT 1 EVENT 2 EVENT 3 /end AVAILABLE_EVENT_LIST /begin DEFAULT_EVENT_LIST EVENT 2 /end DEFAULT_EVENT_LIST /end DAQ_EVENT
 /end IF_DATA
/end MEASUREMENT
/begin MEASUREMENT MisfDet_stEmiDmgCurrIntl "State of emission damgage current interval" UBYTE B_TRUE 1 100 0.00 1.00000000000 BIT_MASK 0x1 FORMAT "%13.11" ECU_ADDRESS 0x4000640B
 /begin IF_DATA XCPplus 0x0102
  /begin DAQ_EVENT VARIABLE /begin AVAILABLE_EVENT_LIST EVENT 0 EVENT 1 EVENT 2 EVENT 3 /end AVAILABLE_EVENT_LIST /begin DEFAULT_EVENT_LIST EVENT 0 /end DEFAULT_EVENT_LIST /end DAQ_EVENT
 /end IF_DATA
/end MEASUREMENT
/begin MEASUREMENT MisfDet_stEmiFltMpl "Status multiple fault by emission exceedance" UBYTE B_TRUE 1 100 0.00 1.00000000000 BIT_MASK 0x1 FORMAT "%13.11" ECU_ADDRESS 0x4000628B
 /begin IF_DATA XCPplus 0x0102
  /begin DAQ_EVENT VARIABLE /begin AVAILABLE_EVENT_LIST EVENT 0 EVENT 1 EVENT 2 EVENT 3 /end AVAILABLE_EVENT_LIST /begin DEFAULT_EVENT_LIST EVENT 0 /end DEFAULT_EVENT_LIST /end DAQ_EVENT
 /end IF_DATA
/end MEASUREMENT
/begin MEASUREMENT MisfDet_stExhDmgSuspc "suspicion for emission relevant misfire rate" UBYTE B_TRUE 1 100 0.00 1.00000000000 BIT_MASK 0x1 FORMAT "%13.11" ECU_ADDRESS 0x4000640A
 /begin IF_DATA XCPplus 0x0102
  /begin DAQ_EVENT VARIABLE /begin AVAILABLE_EVENT_LIST EVENT 0 EVENT 1 EVENT 2 EVENT 3 /end AVAILABLE_EVENT_LIST /begin DEFAULT_EVENT_LIST EVENT 0 /end DEFAULT_EVENT_LIST /end DAQ_EVENT
 /end IF_DATA
/end MEASUREMENT
/begin MEASUREMENT MisfDet_stFlt "status of fault types in DFES" UBYTE OneToOne 1 100 0.00 255.0 FORMAT "%5.1" ECU_ADDRESS 0x4000CD66
 /begin IF_DATA XCPplus 0x0102
  /begin DAQ_EVENT VARIABLE /begin AVAILABLE_EVENT_LIST EVENT 0 EVENT 1 EVENT 2 EVENT 3 /end AVAILABLE_EVENT_LIST /begin DEFAULT_EVENT_LIST EVENT 0 /end DEFAULT_EVENT_LIST /end DAQ_EVENT
 /end IF_DATA
/end MEASUREMENT
/begin MEASUREMENT MisfDet_stFltCfmd "status of fault types in service 03" UBYTE OneToOne 1 100 0.00 255.0 FORMAT "%5.1" ECU_ADDRESS 0x4000CD67
 /begin IF_DATA XCPplus 0x0102
  /begin DAQ_EVENT VARIABLE /begin AVAILABLE_EVENT_LIST EVENT 0 EVENT 1 EVENT 2 EVENT 3 /end AVAILABLE_EVENT_LIST /begin DEFAULT_EVENT_LIST EVENT 0 /end DEFAULT_EVENT_LIST /end DAQ_EVENT
 /end IF_DATA
/end MEASUREMENT
/begin MEASUREMENT MisfDet_stFltCurrDcyc "status of fault types at current driving cycle" UBYTE OneToOne 1 100 0.00 255.0 FORMAT "%5.1" ECU_ADDRESS 0x40007F6E
 /begin IF_DATA XCPplus 0x0102
  /begin DAQ_EVENT VARIABLE /begin AVAILABLE_EVENT_LIST EVENT 0 EVENT 1 EVENT 2 EVENT 3 /end AVAILABLE_EVENT_LIST /begin DEFAULT_EVENT_LIST EVENT 0 /end DEFAULT_EVENT_LIST /end DAQ_EVENT
 /end IF_DATA
/end MEASUREMENT
/begin MEASUREMENT MisfDet_stFltCyl "bit mask cylinders with fault code entry" UWORD OneToOne 1 100 0.00 65535.00 FORMAT "%8.2" ECU_ADDRESS 0x4000800C
 /begin IF_DATA XCPplus 0x0102
  /begin DAQ_EVENT VARIABLE /begin AVAILABLE_EVENT_LIST EVENT 0 EVENT 1 EVENT 2 EVENT 3 /end AVAILABLE_EVENT_LIST /begin DEFAULT_EVENT_LIST EVENT 0 /end DEFAULT_EVENT_LIST /end DAQ_EVENT
 /end IF_DATA
/end MEASUREMENT
/begin MEASUREMENT MisfDet_stFltLstDcyc "status of fault types at last driving cycle" UBYTE OneToOne 1 100 0.00 255.0 FORMAT "%5.1" ECU_ADDRESS 0x40007E1E
 /begin IF_DATA XCPplus 0x0102
  /begin DAQ_EVENT VARIABLE /begin AVAILABLE_EVENT_LIST EVENT 0 EVENT 1 EVENT 2 EVENT 3 /end AVAILABLE_EVENT_LIST /begin DEFAULT_EVENT_LIST EVENT 2 /end DEFAULT_EVENT_LIST /end DAQ_EVENT
 /end IF_DATA
/end MEASUREMENT
/begin MEASUREMENT MisfDet_stFltLstDcycNv "status of fault types at last driving cycle" UBYTE OneToOne 1 100 0.00 255.0 FORMAT "%5.1" ECU_ADDRESS 0x4000CD65
 /begin IF_DATA XCPplus 0x0102
  /begin DAQ_EVENT VARIABLE /begin AVAILABLE_EVENT_LIST EVENT 0 EVENT 1 EVENT 2 EVENT 3 /end AVAILABLE_EVENT_LIST /begin DEFAULT_EVENT_LIST EVENT 2 /end DEFAULT_EVENT_LIST /end DAQ_EVENT
 /end IF_DATA
/end MEASUREMENT
/begin MEASUREMENT MisfDet_stFltPrevDcyc "status of fault types of past driving cycles" UBYTE OneToOne 1 100 0.00 255.0 FORMAT "%5.1" ECU_ADDRESS 0x40007F6D
 /begin IF_DATA XCPplus 0x0102
  /begin DAQ_EVENT VARIABLE /begin AVAILABLE_EVENT_LIST EVENT 0 EVENT 1 EVENT 2 EVENT 3 /end AVAILABLE_EVENT_LIST /begin DEFAULT_EVENT_LIST EVENT 2 /end DEFAULT_EVENT_LIST /end DAQ_EVENT
 /end IF_DATA
/end MEASUREMENT
/begin MEASUREMENT MisfDet_stMisfCont "Status continuous misfires" UBYTE B_TRUE 1 100 0.00 1.00000000000 BIT_MASK 0x1 FORMAT "%13.11" ECU_ADDRESS 0x40006375
 /begin IF_DATA XCPplus 0x0102
  /begin DAQ_EVENT VARIABLE /begin AVAILABLE_EVENT_LIST EVENT 0 EVENT 1 EVENT 2 EVENT 3 /end AVAILABLE_EVENT_LIST /begin DEFAULT_EVENT_LIST EVENT 0 /end DEFAULT_EVENT_LIST /end DAQ_EVENT
 /end IF_DATA
/end MEASUREMENT
/begin MEASUREMENT MisfDet_stOk "Status of ok report specific for the fault types" UBYTE OneToOne 1 100 0.00 255.0 FORMAT "%5.1" ECU_ADDRESS 0x40007E1F
 /begin IF_DATA XCPplus 0x0102
  /begin DAQ_EVENT VARIABLE /begin AVAILABLE_EVENT_LIST EVENT 0 EVENT 1 EVENT 2 EVENT 3 /end AVAILABLE_EVENT_LIST /begin DEFAULT_EVENT_LIST EVENT 0 /end DEFAULT_EVENT_LIST /end DAQ_EVENT
 /end IF_DATA
/end MEASUREMENT
/begin MEASUREMENT MisfDet_stSegTiVld "condition segment time plausible" UBYTE B_TRUE 1 100 0.00 1.00000000000 BIT_MASK 0x1 FORMAT "%13.11" ECU_ADDRESS 0x400063F7
 /begin IF_DATA XCPplus 0x0102
  /begin DAQ_EVENT VARIABLE /begin AVAILABLE_EVENT_LIST EVENT 0 EVENT 1 EVENT 2 EVENT 3 /end AVAILABLE_EVENT_LIST /begin DEFAULT_EVENT_LIST EVENT 0 /end DEFAULT_EVENT_LIST /end DAQ_EVENT
 /end IF_DATA
/end MEASUREMENT
/begin MEASUREMENT MisfDet_stSimrCdn "similar conditions encaountered for misfire faults" UBYTE B_TRUE 1 100 0.00 1.00000000000 BIT_MASK 0x1 FORMAT "%13.11" ECU_ADDRESS 0x400063F6
 /begin IF_DATA XCPplus 0x0102
  /begin DAQ_EVENT VARIABLE /begin AVAILABLE_EVENT_LIST EVENT 0 EVENT 1 EVENT 2 EVENT 3 /end AVAILABLE_EVENT_LIST /begin DEFAULT_EVENT_LIST EVENT 2 /end DEFAULT_EVENT_LIST /end DAQ_EVENT
 /end IF_DATA
/end MEASUREMENT
/begin MEASUREMENT MisfDet_stStcCatIntlHealSimrCdn "status healing with similar conditions encountered" UBYTE B_TRUE 1 100 0.00 1.00000000000 BIT_MASK 0x1 FORMAT "%13.11" ECU_ADDRESS 0x400063F5
 /begin IF_DATA XCPplus 0x0102
  /begin DAQ_EVENT VARIABLE /begin AVAILABLE_EVENT_LIST EVENT 0 EVENT 1 EVENT 2 EVENT 3 /end AVAILABLE_EVENT_LIST /begin DEFAULT_EVENT_LIST EVENT 0 /end DEFAULT_EVENT_LIST /end DAQ_EVENT
 /end IF_DATA
/end MEASUREMENT
/begin MEASUREMENT MisfDet_stStcCatRstCompl200ms "State reset of catalyst statistics completed (200ms)" UBYTE B_TRUE 1 100 0.00 1.00000000000 BIT_MASK 0x1 FORMAT "%13.11" ECU_ADDRESS 0x400063F4
 /begin IF_DATA XCPplus 0x0102
  /begin DAQ_EVENT VARIABLE /begin AVAILABLE_EVENT_LIST EVENT 0 EVENT 1 EVENT 2 EVENT 3 /end AVAILABLE_EVENT_LIST /begin DEFAULT_EVENT_LIST EVENT 3 /end DEFAULT_EVENT_LIST /end DAQ_EVENT
 /end IF_DATA
/end MEASUREMENT
/begin MEASUREMENT MisfDet_stStcCatStrt "Status first interval (200 CrS rev)" UBYTE B_TRUE 1 100 0.00 1.00000000000 BIT_MASK 0x1 FORMAT "%13.11" ECU_ADDRESS 0x400063F3
 /begin IF_DATA XCPplus 0x0102
  /begin DAQ_EVENT VARIABLE /begin AVAILABLE_EVENT_LIST EVENT 0 EVENT 1 EVENT 2 EVENT 3 /end AVAILABLE_EVENT_LIST /begin DEFAULT_EVENT_LIST EVENT 0 /end DEFAULT_EVENT_LIST /end DAQ_EVENT
 /end IF_DATA
/end MEASUREMENT
/begin MEASUREMENT MisfDet_stStcEmiDmgLstIntl "Exhaust damage during last interval" UBYTE B_TRUE 1 100 0.00 1.00000000000 BIT_MASK 0x1 FORMAT "%13.11" ECU_ADDRESS 0x400063F2
 /begin IF_DATA XCPplus 0x0102
  /begin DAQ_EVENT VARIABLE /begin AVAILABLE_EVENT_LIST EVENT 0 EVENT 1 EVENT 2 EVENT 3 /end AVAILABLE_EVENT_LIST /begin DEFAULT_EVENT_LIST EVENT 0 /end DEFAULT_EVENT_LIST /end DAQ_EVENT
 /end IF_DATA
/end MEASUREMENT
/begin MEASUREMENT MisfDet_stStcEmiFrzFrm "Status Freeze Frame reservation" UBYTE B_TRUE 1 100 0.00 1.00000000000 BIT_MASK 0x1 FORMAT "%13.11" ECU_ADDRESS 0x400063F1
 /begin IF_DATA XCPplus 0x0102
  /begin DAQ_EVENT VARIABLE /begin AVAILABLE_EVENT_LIST EVENT 0 EVENT 1 EVENT 2 EVENT 3 /end AVAILABLE_EVENT_LIST /begin DEFAULT_EVENT_LIST EVENT 0 /end DEFAULT_EVENT_LIST /end DAQ_EVENT
 /end IF_DATA
/end MEASUREMENT
/begin MEASUREMENT MisfDet_stStcEmiIntlHealSimrCdn "Status healing encountering similar conditions" UBYTE B_TRUE 1 100 0.00 1.00000000000 BIT_MASK 0x1 FORMAT "%13.11" ECU_ADDRESS 0x400063F0
 /begin IF_DATA XCPplus 0x0102
  /begin DAQ_EVENT VARIABLE /begin AVAILABLE_EVENT_LIST EVENT 0 EVENT 1 EVENT 2 EVENT 3 /end AVAILABLE_EVENT_LIST /begin DEFAULT_EVENT_LIST EVENT 0 /end DEFAULT_EVENT_LIST /end DAQ_EVENT
 /end IF_DATA
/end MEASUREMENT
/begin MEASUREMENT MisfDet_stStcEmiIntlHealSimrCdnStrt "Status healing first interval encountering similar conditions" UBYTE B_TRUE 1 100 0.00 1.00000000000 BIT_MASK 0x1 FORMAT "%13.11" ECU_ADDRESS 0x400063EF
 /begin IF_DATA XCPplus 0x0102
  /begin DAQ_EVENT VARIABLE /begin AVAILABLE_EVENT_LIST EVENT 0 EVENT 1 EVENT 2 EVENT 3 /end AVAILABLE_EVENT_LIST /begin DEFAULT_EVENT_LIST EVENT 0 /end DEFAULT_EVENT_LIST /end DAQ_EVENT
 /end IF_DATA
/end MEASUREMENT
/begin MEASUREMENT MisfDet_stStcEmiStrt "status first emission interval" UBYTE B_TRUE 1 100 0.00 1.00000000000 BIT_MASK 0x1 FORMAT "%13.11" ECU_ADDRESS 0x400063EE
 /begin IF_DATA XCPplus 0x0102
  /begin DAQ_EVENT VARIABLE /begin AVAILABLE_EVENT_LIST EVENT 0 EVENT 1 EVENT 2 EVENT 3 /end AVAILABLE_EVENT_LIST /begin DEFAULT_EVENT_LIST EVENT 0 /end DEFAULT_EVENT_LIST /end DAQ_EVENT
 /end IF_DATA
/end MEASUREMENT
/begin MEASUREMENT MisfDet_stStcEmiStrtCatHeat "status cat heat t first emission interval" UBYTE B_TRUE 1 100 0.00 1.00000000000 BIT_MASK 0x1 FORMAT "%13.11" ECU_ADDRESS 0x400063ED
 /begin IF_DATA XCPplus 0x0102
  /begin DAQ_EVENT VARIABLE /begin AVAILABLE_EVENT_LIST EVENT 0 EVENT 1 EVENT 2 EVENT 3 /end AVAILABLE_EVENT_LIST /begin DEFAULT_EVENT_LIST EVENT 0 /end DEFAULT_EVENT_LIST /end DAQ_EVENT
 /end IF_DATA
/end MEASUREMENT
/begin MEASUREMENT MisfDet_stStcEmiStrtSrv "Status first interval (independent from configuration)" UBYTE B_TRUE 1 100 0.00 1.00000000000 BIT_MASK 0x1 FORMAT "%13.11" ECU_ADDRESS 0x400063EC
 /begin IF_DATA XCPplus 0x0102
  /begin DAQ_EVENT VARIABLE /begin AVAILABLE_EVENT_LIST EVENT 0 EVENT 1 EVENT 2 EVENT 3 /end AVAILABLE_EVENT_LIST /begin DEFAULT_EVENT_LIST EVENT 0 /end DEFAULT_EVENT_LIST /end DAQ_EVENT
 /end IF_DATA
/end MEASUREMENT
/begin MEASUREMENT MisfDet_vWhl "Wheel speed for rough road detection" UWORD vfzg_uw_b90_m_DIV_s 1 100 0.00 90.27662 FORMAT "%8.5" ARRAY_SIZE 2 ECU_ADDRESS 0x40005C22
 /begin IF_DATA XCPplus 0x0102
  /begin DAQ_EVENT VARIABLE /begin AVAILABLE_EVENT_LIST EVENT 0 EVENT 1 EVENT 2 EVENT 3 /end AVAILABLE_EVENT_LIST /begin DEFAULT_EVENT_LIST EVENT 1 /end DEFAULT_EVENT_LIST /end DAQ_EVENT
 /end IF_DATA
/end MEASUREMENT
/begin MEASUREMENT MisfDet_vWhlUsd "Wheel speeds used for rough road detection" UBYTE OneToOne 1 100 0.00 255.0 FORMAT "%5.1" ECU_ADDRESS 0x40006291
 /begin IF_DATA XCPplus 0x0102
  /begin DAQ_EVENT VARIABLE /begin AVAILABLE_EVENT_LIST EVENT 0 EVENT 1 EVENT 2 EVENT 3 /end AVAILABLE_EVENT_LIST /begin DEFAULT_EVENT_LIST EVENT 1 /end DEFAULT_EVENT_LIST /end DAQ_EVENT
 /end IF_DATA
/end MEASUREMENT
/begin MEASUREMENT MisfDet_vWhlVld "Gültige Radgeschwindigkeiten" UBYTE OneToOne 1 100 0.00 255.0 FORMAT "%5.1" ECU_ADDRESS 0x40006290
 /begin IF_DATA XCPplus 0x0102
  /begin DAQ_EVENT VARIABLE /begin AVAILABLE_EVENT_LIST EVENT 0 EVENT 1 EVENT 2 EVENT 3 /end AVAILABLE_EVENT_LIST /begin DEFAULT_EVENT_LIST EVENT 1 /end DEFAULT_EVENT_LIST /end DAQ_EVENT
 /end IF_DATA
/end MEASUREMENT
/begin MEASUREMENT MoCADC_bChkActv "Bit info ADC check by Null Load Testimpuls is active" UBYTE B_TRUE 1 100 0.00 1.00000000000 BIT_MASK 0x8 FORMAT "%13.11" ECU_ADDRESS 0x4000A160
 /begin IF_DATA XCPplus 0x0102
  /begin DAQ_EVENT VARIABLE /begin AVAILABLE_EVENT_LIST EVENT 0 EVENT 1 EVENT 2 EVENT 3 /end AVAILABLE_EVENT_LIST /begin DEFAULT_EVENT_LIST EVENT 1 /end DEFAULT_EVENT_LIST /end DAQ_EVENT
 /end IF_DATA
/end MEASUREMENT
/begin MEASUREMENT MoCADC_bDef "Bit info ADC check detected an error" UBYTE B_TRUE 1 100 0.00 1.00000000000 BIT_MASK 0x80 FORMAT "%13.11" ECU_ADDRESS 0x4000A160
 /begin IF_DATA XCPplus 0x0102
  /begin DAQ_EVENT VARIABLE /begin AVAILABLE_EVENT_LIST EVENT 0 EVENT 1 EVENT 2 EVENT 3 /end AVAILABLE_EVENT_LIST /begin DEFAULT_EVENT_LIST EVENT 1 /end DEFAULT_EVENT_LIST /end DAQ_EVENT
 /end IF_DATA
/end MEASUREMENT
/begin MEASUREMENT MoCADC_bNTPActv "Null load test impulse check active in ADC monitoring" UBYTE B_TRUE 1 100 0.00 1.00000000000 BIT_MASK 0x1 FORMAT "%13.11" ECU_ADDRESS 0x4000A160
 /begin IF_DATA XCPplus 0x0102
  /begin DAQ_EVENT VARIABLE /begin AVAILABLE_EVENT_LIST EVENT 0 EVENT 1 EVENT 2 EVENT 3 /end AVAILABLE_EVENT_LIST /begin DEFAULT_EVENT_LIST EVENT 1 /end DEFAULT_EVENT_LIST /end DAQ_EVENT
 /end IF_DATA
/end MEASUREMENT
/begin MEASUREMENT MoCADC_bNTPErr "Bitinfo in MoCADC_st for irreversible error in ADC check by NuLL Load Testimpuls" UBYTE B_TRUE 1 100 0.00 1.00000000000 BIT_MASK 0x40 FORMAT "%13.11" ECU_ADDRESS 0x4000A160
 /begin IF_DATA XCPplus 0x0102
  /begin DAQ_EVENT VARIABLE /begin AVAILABLE_EVENT_LIST EVENT 0 EVENT 1 EVENT 2 EVENT 3 /end AVAILABLE_EVENT_LIST /begin DEFAULT_EVENT_LIST EVENT 1 /end DEFAULT_EVENT_LIST /end DAQ_EVENT
 /end IF_DATA
/end MEASUREMENT
/begin MEASUREMENT MoCADC_bNTPRel "Null load test impulse was released" UBYTE B_TRUE 1 100 0.00 1.00000000000 BIT_MASK 0x2 FORMAT "%13.11" ECU_ADDRESS 0x4000A160
 /begin IF_DATA XCPplus 0x0102
  /begin DAQ_EVENT VARIABLE /begin AVAILABLE_EVENT_LIST EVENT 0 EVENT 1 EVENT 2 EVENT 3 /end AVAILABLE_EVENT_LIST /begin DEFAULT_EVENT_LIST EVENT 1 /end DEFAULT_EVENT_LIST /end DAQ_EVENT
 /end IF_DATA
/end MEASUREMENT
/begin MEASUREMENT MoCADC_bTstErr "Bitinfo in MoCADC_st for testvoltage out of permissible range" UBYTE B_TRUE 1 100 0.00 1.00000000000 BIT_MASK 0x4 FORMAT "%13.11" ECU_ADDRESS 0x4000A160
 /begin IF_DATA XCPplus 0x0102
  /begin DAQ_EVENT VARIABLE /begin AVAILABLE_EVENT_LIST EVENT 0 EVENT 1 EVENT 2 EVENT 3 /end AVAILABLE_EVENT_LIST /begin DEFAULT_EVENT_LIST EVENT 1 /end DEFAULT_EVENT_LIST /end DAQ_EVENT
 /end IF_DATA
/end MEASUREMENT
/begin MEASUREMENT MoCADC_ctDebNTP "Error counter for verifying of Null-load-Test-pulse" UBYTE OneToOne 1 100 0.00 255.0 FORMAT "%5.1" ECU_ADDRESS 0x4000A162 /end MEASUREMENT
/begin MEASUREMENT MoCADC_ctDebNTPCpl "Double storage for error counter for testing with null load test pulse procedure" UBYTE OneToOne 1 100 0.00 255.0 FORMAT "%5.1" ECU_ADDRESS 0x4000A023 /end MEASUREMENT
/begin MEASUREMENT MoCADC_ctDebNTPExcddThdNv "Counter for exceedance of the debounce level of a correct calibrated Null-Load-Test-Pulse" UBYTE OneToOne 1 100 0.00 255.0 FORMAT "%5.1" ECU_ADDRESS 0x4000CD5B /end MEASUREMENT
/begin MEASUREMENT MoCADC_ctDebNTPMaxNv "MaxValueIndicator for debouncing counter of null load test pusle" UBYTE OneToOne 1 100 0.00 255.0 FORMAT "%5.1" ECU_ADDRESS 0x4000CD5A /end MEASUREMENT
/begin MEASUREMENT MoCADC_ctDebNTPOld "Old value of the debounce counter of null load test pulse" UBYTE OneToOne 1 100 0.00 255.0 FORMAT "%5.1" ECU_ADDRESS 0x4000A022 /end MEASUREMENT
/begin MEASUREMENT MoCADC_ctDebTst "Error counter for testing the test voltage" UBYTE OneToOne 1 100 0.00 255.0 FORMAT "%5.1" ECU_ADDRESS 0x4000A161 /end MEASUREMENT
/begin MEASUREMENT MoCADC_ctDebTstCpl "Double storage for error counter for testing with test voltage" UBYTE OneToOne 1 100 0.00 255.0 FORMAT "%5.1" ECU_ADDRESS 0x4000A021 /end MEASUREMENT
/begin MEASUREMENT MoCADC_ctDebTstExcddThdNv "Counter for exceedance of the debounce level of a correct calibrated test voltage verification" UBYTE OneToOne 1 100 0.00 255.0 FORMAT "%5.1" ECU_ADDRESS 0x4000CD59 /end MEASUREMENT
/begin MEASUREMENT MoCADC_ctDebTstMaxNv "MaxValueIndicator for debouncing counter of testvoltage verification" UBYTE OneToOne 1 100 0.00 255.0 FORMAT "%5.1" ECU_ADDRESS 0x4000CD58 /end MEASUREMENT
/begin MEASUREMENT MoCADC_ctDebTstOld "Old value of the debounce counter of test voltage verification" UBYTE OneToOne 1 100 0.00 255.0 FORMAT "%5.1" ECU_ADDRESS 0x4000A020 /end MEASUREMENT
/begin MEASUREMENT MoCADC_ctTstNTP "counter of testflag in diagnosis for ADC - Null Load TestPulse check" UBYTE OneToOne 1 100 0.00 255.0 FORMAT "%5.1" ECU_ADDRESS 0x4000A01F /end MEASUREMENT
/begin MEASUREMENT MoCADC_ctTstTst "counter of testflag in diagnosis for ADC - testvoltage check" UBYTE OneToOne 1 100 0.00 255.0 FORMAT "%5.1" ECU_ADDRESS 0x4000A01E /end MEASUREMENT
/begin MEASUREMENT MoCADC_flgClrNTP "Flag bit to indicate request to clear fault memory" UBYTE B_TRUE 1 100 0.00 1.00000000000 BIT_MASK 0x1 FORMAT "%13.11" ECU_ADDRESS 0x4000628A
 /begin IF_DATA XCPplus 0x0102
  /begin DAQ_EVENT VARIABLE /begin AVAILABLE_EVENT_LIST EVENT 0 EVENT 1 EVENT 2 EVENT 3 /end AVAILABLE_EVENT_LIST /begin DEFAULT_EVENT_LIST EVENT 1 /end DEFAULT_EVENT_LIST /end DAQ_EVENT
 /end IF_DATA
/end MEASUREMENT
/begin MEASUREMENT MoCADC_flgClrTst "Flag bit to indicate request to clear fault memory" UBYTE B_TRUE 1 100 0.00 1.00000000000 BIT_MASK 0x1 FORMAT "%13.11" ECU_ADDRESS 0x40006289
 /begin IF_DATA XCPplus 0x0102
  /begin DAQ_EVENT VARIABLE /begin AVAILABLE_EVENT_LIST EVENT 0 EVENT 1 EVENT 2 EVENT 3 /end AVAILABLE_EVENT_LIST /begin DEFAULT_EVENT_LIST EVENT 1 /end DEFAULT_EVENT_LIST /end DAQ_EVENT
 /end IF_DATA
/end MEASUREMENT
/begin MEASUREMENT MoCADC_st "Status Info of ADC monitoring" UBYTE dez 1 100 0.00 255.0 FORMAT "%5.1" ECU_ADDRESS 0x4000A160 /end MEASUREMENT
/begin MEASUREMENT MoCADC_stCpl "Double storage of status Info of ADC monitoring" UBYTE dez 1 100 0.00 255.0 FORMAT "%5.1" ECU_ADDRESS 0x4000A01D /end MEASUREMENT
/begin MEASUREMENT MoCADC_stMsg "Status info from ADC Monitoring, message forLevel1" UBYTE dez 1 100 0.00 255.0 FORMAT "%5.1" ECU_ADDRESS 0x40006395
 /begin IF_DATA XCPplus 0x0102
  /begin DAQ_EVENT VARIABLE /begin AVAILABLE_EVENT_LIST EVENT 0 EVENT 1 EVENT 2 EVENT 3 /end AVAILABLE_EVENT_LIST /begin DEFAULT_EVENT_LIST EVENT 1 /end DEFAULT_EVENT_LIST /end DAQ_EVENT
 /end IF_DATA
/end MEASUREMENT
/begin MEASUREMENT MoCADC_uNTP_mp "Voltage at ADC for acceleration pedal signal 2" UWORD spg_q0p00977 1 100 0.00 639.9902 FORMAT "%8.4" ECU_ADDRESS 0x40009EA6 /end MEASUREMENT
/begin MEASUREMENT MoCADC_uTst_mp "Voltage at ADC test voltage input" SWORD spg_q4p88_mV 1 100 -160000.0 159995.1 FORMAT "%8.1" ECU_ADDRESS 0x40009EA4 /end MEASUREMENT
/begin MEASUREMENT MoCCom_bCPUNew "condition new question received for instruction test" UBYTE B_TRUE 1 100 0.00 1.00000000000 BIT_MASK 0x1 FORMAT "%13.11" ECU_ADDRESS 0x4000A00C
 /begin IF_DATA XCPplus 0x0102
  /begin DAQ_EVENT VARIABLE /begin AVAILABLE_EVENT_LIST EVENT 0 EVENT 1 EVENT 2 EVENT 3 /end AVAILABLE_EVENT_LIST /begin DEFAULT_EVENT_LIST EVENT 1 /end DEFAULT_EVENT_LIST /end DAQ_EVENT
 /end IF_DATA
/end MEASUREMENT
/begin MEASUREMENT MoCCom_bPFCNew "condition new question received for program flow check" UBYTE B_TRUE 1 100 0.00 1.00000000000 BIT_MASK 0x2 FORMAT "%13.11" ECU_ADDRESS 0x4000A00C
 /begin IF_DATA XCPplus 0x0102
  /begin DAQ_EVENT VARIABLE /begin AVAILABLE_EVENT_LIST EVENT 0 EVENT 1 EVENT 2 EVENT 3 /end AVAILABLE_EVENT_LIST /begin DEFAULT_EVENT_LIST EVENT 1 /end DEFAULT_EVENT_LIST /end DAQ_EVENT
 /end IF_DATA
/end MEASUREMENT
/begin MEASUREMENT MoCCom_ctBusErr "error counter for communication bus error between FC and other ASICS like power stage ASIC, Monitoring module etc" UBYTE OneToOne 1 100 0.00 255.0 FORMAT "%5.1" ECU_ADDRESS 0x4000A01C /end MEASUREMENT
/begin MEASUREMENT MoCCom_ctBusErrExcddThdNv "Counter for exceedance of the debounce level of a correct calibrated of error counter for Bus communication failure" UBYTE OneToOne 1 100 0.00 255.0 FORMAT "%5.1" ECU_ADDRESS 0x4000CD57 /end MEASUREMENT
/begin MEASUREMENT MoCCom_ctBusErrMaxNv "MaxValueIndicator for debouncing counter of error counter for bus communication error" UBYTE OneToOne 1 100 0.00 255.0 FORMAT "%5.1" ECU_ADDRESS 0x4000CD56 /end MEASUREMENT
/begin MEASUREMENT MoCCom_ctBusErrOld "Old value of the debounce counter of error counter for bus communication error" UBYTE OneToOne 1 100 0.00 255.0 FORMAT "%5.1" ECU_ADDRESS 0x4000A01B /end MEASUREMENT
/begin MEASUREMENT MoCCom_ctCorRespCnt "Counter for counting the number of corrections of the response counter" UBYTE OneToOne 1 100 0.00 255.0 FORMAT "%5.1" ECU_ADDRESS 0x4000B5AD /end MEASUREMENT
/begin MEASUREMENT MoCCom_ctErrFC "error counter for failure in function controller" UBYTE OneToOne 1 100 0.00 255.0 FORMAT "%5.1" ECU_ADDRESS 0x4000A00E /end MEASUREMENT
/begin MEASUREMENT MoCCom_ctErrFCCpl "RAM data redundancy for MoCCom_ctErrFC" UBYTE OneToOne 1 100 0.00 255.0 FORMAT "%5.1" ECU_ADDRESS 0x4000A01A /end MEASUREMENT
/begin MEASUREMENT MoCCom_ctErrFCExcddThdNv "Counter for exceedance of the debounce level of a correct calibrated of error counter for failure in function controller" UBYTE OneToOne 1 100 0.00 255.0 FORMAT "%5.1" ECU_ADDRESS 0x4000CD55 /end MEASUREMENT
/begin MEASUREMENT MoCCom_ctErrFCMaxNv "MaxValueIndicator for debouncing counter of error counter for failure in function controller" UBYTE OneToOne 1 100 0.00 255.0 FORMAT "%5.1" ECU_ADDRESS 0x4000CD54 /end MEASUREMENT
/begin MEASUREMENT MoCCom_ctErrFCOld "Old value of the debounce counter of error counter for failure in function controller" UBYTE OneToOne 1 100 0.00 255.0 FORMAT "%5.1" ECU_ADDRESS 0x4000A019 /end MEASUREMENT
/begin MEASUREMENT MoCCom_ctErrMM "error counter of monitoring module" UBYTE OneToOne 1 100 0.00 255.0 FORMAT "%5.1" ECU_ADDRESS 0x4000A00D /end MEASUREMENT
/begin MEASUREMENT MoCCom_ctErrMMExcddThdNv "Counter for exceedance of the debounce level of a correct calibrated for error counter of monitoring module" UBYTE OneToOne 1 100 0.00 255.0 FORMAT "%5.1" ECU_ADDRESS 0x4000CD53 /end MEASUREMENT
/begin MEASUREMENT MoCCom_ctErrMMMaxNv "MaxValue Indicator for debouncing counter for error counter of monitoring module" UBYTE OneToOne 1 100 0.00 255.0 FORMAT "%5.1" ECU_ADDRESS 0x4000CD52 /end MEASUREMENT
/begin MEASUREMENT MoCCom_ctErrMMMsg "info for level 1: error counter of monitoring module" UBYTE dez 1 100 0.00 255.0 FORMAT "%5.1" ECU_ADDRESS 0x40007F68 /end MEASUREMENT
/begin MEASUREMENT MoCCom_ctErrMMOld "old value of the error count got from the monitoring module" UBYTE OneToOne 1 100 0.00 255.0 FORMAT "%5.1" ECU_ADDRESS 0x4000A018 /end MEASUREMENT
/begin MEASUREMENT MoCCom_ctErrMMOldNv "Old value of the debounce counter for error counter of monitoring module" UBYTE OneToOne 1 100 0.00 255.0 FORMAT "%5.1" ECU_ADDRESS 0x4000A017 /end MEASUREMENT
/begin MEASUREMENT MoCCom_ctErrOSTimeout "error counter for timeout of operating system" UBYTE OneToOne 1 100 0.00 255.0 FORMAT "%5.1" ECU_ADDRESS 0x4000A016 /end MEASUREMENT
/begin MEASUREMENT MoCCom_ctErrPwr "debounce counter for error in power devices" UBYTE OneToOne 1 100 0.00 255.0 FORMAT "%5.1" ECU_ADDRESS 0x4000A015 /end MEASUREMENT
/begin MEASUREMENT MoCCom_ctErrPwrExcddThdNv "Counter for exceedance of the debounce level of a correct calibrated of error counter for failure in power devices" UBYTE OneToOne 1 100 0.00 255.0 FORMAT "%5.1" ECU_ADDRESS 0x4000CD51 /end MEASUREMENT
/begin MEASUREMENT MoCCom_ctErrPwrMaxNv "MaxValueIndicator for debouncing counter of error counter for failure in power devices" UBYTE OneToOne 1 100 0.00 255.0 FORMAT "%5.1" ECU_ADDRESS 0x4000CD50 /end MEASUREMENT
/begin MEASUREMENT MoCCom_ctErrPwrOld "Old value of the debounce counter of error counter for failure in power devices" UBYTE OneToOne 1 100 0.00 255.0 FORMAT "%5.1" ECU_ADDRESS 0x4000A014 /end MEASUREMENT
/begin MEASUREMENT MoCCom_ctRespOffsetTst "Counter used for test purpose in time of response" SWORD OneToOne 1 100 -32768.00 32767.00 FORMAT "%8.2" ECU_ADDRESS 0x4000A026 /end MEASUREMENT
/begin MEASUREMENT MoCCom_ctSOPNoRdy "Counter for shut down path test not ready" UBYTE OneToOne 1 100 0.00 255.0 FORMAT "%5.1" ECU_ADDRESS 0x4000A013 /end MEASUREMENT
/begin MEASUREMENT MoCCom_ctSOPTstActv "Counter for number of active shut off path test calls" UWORD OneToOne 1 100 0.00 65535.00 FORMAT "%8.2" ECU_ADDRESS 0x40009FFE /end MEASUREMENT
/begin MEASUREMENT MoCCom_Query "Enlarged query from monitoring module" ULONG dez 1 100 0.00 4294967295.00 FORMAT "%13.2" ECU_ADDRESS 0x4000A004 /end MEASUREMENT
/begin MEASUREMENT MoCCom_Response "Response to the query from monitoring module" ULONG dez 1 100 0.00 4294967295.00 FORMAT "%13.2" ECU_ADDRESS 0x4000A008 /end MEASUREMENT
/begin MEASUREMENT MoCCom_Response_mp "copy of the response to the monitoring module" ULONG dez 1 100 0.00 4294967295.00 FORMAT "%13.2" ECU_ADDRESS 0x40009C08 /end MEASUREMENT
/begin MEASUREMENT MoCCom_stCheckState "Actual step of MoCCOM inner state machine" UBYTE OneToOne 1 100 0.00 255.0 FORMAT "%5.1" ECU_ADDRESS 0x4000A012 /end MEASUREMENT
/begin MEASUREMENT MoCCom_stCheckStateCpl "complement variable for actual step of moccom inner state machine" UBYTE OneToOne 1 100 0.00 255.0 FORMAT "%5.1" ECU_ADDRESS 0x4000A011 /end MEASUREMENT
/begin MEASUREMENT MoCCom_stComState "Actual step of MoCCOM WD communication state machine" UBYTE OneToOne 1 100 0.00 255.0 FORMAT "%5.1" ECU_ADDRESS 0x4000A025 /end MEASUREMENT
/begin MEASUREMENT MoCCom_stMm "status of the monitoring module" UBYTE OneToOne 1 100 0.00 255.0 FORMAT "%5.1" ECU_ADDRESS 0x4000A010 /end MEASUREMENT
/begin MEASUREMENT MoCCom_stMmRespCnt "counter for receiving the 4 response bytes" UBYTE OneToOne 1 100 0.00 255.0 FORMAT "%5.1" ECU_ADDRESS 0x4000A00F /end MEASUREMENT
/begin MEASUREMENT MoCCom_stQueryNew "Bitbase for info 'new query from monitoring module'" UBYTE OneToOne 1 100 0.00 255.0 FORMAT "%5.1" ECU_ADDRESS 0x4000A00C /end MEASUREMENT
/begin MEASUREMENT MoCCom_SwShrPtlResp "Partial response contribution from software sharing modules" ULONG OneToOne 1 100 0.00 4294967295.00 FORMAT "%13.2" ECU_ADDRESS 0x4000A000 /end MEASUREMENT
/begin MEASUREMENT MoCCPU_ctSeq "Sequence counter for instruction test" UBYTE OneToOne 1 100 0.00 255.0 FORMAT "%5.1" ECU_ADDRESS 0x40009FFD /end MEASUREMENT
/begin MEASUREMENT MoCCPU_IpoIn "Input Value for interpolation routine in instruction test" SWORD dez 1 100 -32768.00 32767.00 FORMAT "%8.2" ECU_ADDRESS 0x40009FF0 /end MEASUREMENT
/begin MEASUREMENT MoCCPU_PartResp "Partial response from instruction test to monitoring module" ULONG OneToOne 1 100 0.00 4294967295.00 FORMAT "%13.2" ECU_ADDRESS 0x40009FF4
 /begin IF_DATA XCPplus 0x0102
  /begin DAQ_EVENT VARIABLE /begin AVAILABLE_EVENT_LIST EVENT 0 EVENT 1 EVENT 2 EVENT 3 /end AVAILABLE_EVENT_LIST /begin DEFAULT_EVENT_LIST EVENT 1 /end DEFAULT_EVENT_LIST /end DAQ_EVENT
 /end IF_DATA
/end MEASUREMENT
/begin MEASUREMENT MoCCPU_Query "Takeover of a new query out of query-response communication" UBYTE OneToOne 1 100 0.00 15.00 FORMAT "%5.2" ECU_ADDRESS 0x40009FFC
 /begin IF_DATA XCPplus 0x0102
  /begin DAQ_EVENT VARIABLE /begin AVAILABLE_EVENT_LIST EVENT 0 EVENT 1 EVENT 2 EVENT 3 /end AVAILABLE_EVENT_LIST /begin DEFAULT_EVENT_LIST EVENT 1 /end DEFAULT_EVENT_LIST /end DAQ_EVENT
 /end IF_DATA
/end MEASUREMENT
/begin MEASUREMENT MoCCPU_TempRes "Temporary result in instruction test" ULONG OneToOne 1 100 0.00 4294967295.00 FORMAT "%13.2" ECU_ADDRESS 0x40009FF8 /end MEASUREMENT
/begin MEASUREMENT MoCEMM_ChkRAMTst "Variable to keep state of MoCEMM_ChkRAMTst_CW over reset" UBYTE OneToOne 1 100 0.00 255.0 FORMAT "%5.1" ECU_ADDRESS 0x4000F979
 /begin IF_DATA XCPplus 0x0102
  /begin DAQ_EVENT VARIABLE /begin AVAILABLE_EVENT_LIST EVENT 0 EVENT 1 EVENT 2 EVENT 3 /end AVAILABLE_EVENT_LIST /begin DEFAULT_EVENT_LIST EVENT 1 /end DEFAULT_EVENT_LIST /end DAQ_EVENT
 /end IF_DATA
/end MEASUREMENT
/begin MEASUREMENT MoCEMM_ChkROMTst "Variable to keep state of MoCEMM_ChkROMTst_CW over reset" UBYTE OneToOne 1 100 0.00 255.0 FORMAT "%5.1" ECU_ADDRESS 0x4000F978
 /begin IF_DATA XCPplus 0x0102
  /begin DAQ_EVENT VARIABLE /begin AVAILABLE_EVENT_LIST EVENT 0 EVENT 1 EVENT 2 EVENT 3 /end AVAILABLE_EVENT_LIST /begin DEFAULT_EVENT_LIST EVENT 1 /end DEFAULT_EVENT_LIST /end DAQ_EVENT
 /end IF_DATA
/end MEASUREMENT
/begin MEASUREMENT MoCEMM_tiRamCheck "Runtime of RAM test during startup" ULONG OneToOne 1 100 0.00 4294967295.00 FORMAT "%13.2" ECU_ADDRESS 0x4000F974 /end MEASUREMENT
/begin MEASUREMENT MoCEMM_tiRomCheck "Runtime of ROM test during startup" ULONG OneToOne 1 100 0.00 4294967295.00 FORMAT "%13.2" ECU_ADDRESS 0x4000F970 /end MEASUREMENT
/begin MEASUREMENT MoCEMM_wdgTout "Variable to store timeout of internal watchdog" UWORD OneToOne 1 100 0.00 65535.00 FORMAT "%8.2" ECU_ADDRESS 0x4000F96E /end MEASUREMENT
/begin MEASUREMENT MoCGTM_aryCMPErrBit "Output array obtained from CMP_IRQ_NOTIFY" UBYTE OneToOne 1 100 0.00 255.0 FORMAT "%5.1" ARRAY_SIZE 4 ECU_ADDRESS 0x4000A15C /end MEASUREMENT
/begin MEASUREMENT MoCGTM_aryCMPErrBitCpl "Complement variable for Output array obtained from CMP_IRQ_NOTIFY" UBYTE OneToOne 1 100 0.00 255.0 FORMAT "%5.1" ARRAY_SIZE 4 ECU_ADDRESS 0x40009FEC /end MEASUREMENT
/begin MEASUREMENT MoCGTM_bbOut1 "Bit bases for storing status of compare bit" UBYTE OneToOne 1 100 0.00 255.0 FORMAT "%5.1" ECU_ADDRESS 0x4000A14C
 /begin IF_DATA XCPplus 0x0102
  /begin DAQ_EVENT VARIABLE /begin AVAILABLE_EVENT_LIST EVENT 0 EVENT 1 EVENT 2 EVENT 3 /end AVAILABLE_EVENT_LIST /begin DEFAULT_EVENT_LIST EVENT 1 /end DEFAULT_EVENT_LIST /end DAQ_EVENT
 /end IF_DATA
/end MEASUREMENT
/begin MEASUREMENT MoCGTM_bbOut1Cpl "complement variable for MoCGTMCo_bbOut1" UBYTE OneToOne 1 100 0.00 255.0 FORMAT "%5.1" ECU_ADDRESS 0x40009FE8 /end MEASUREMENT
/begin MEASUREMENT MoCGTM_cmpErrAryIdx "Array index for CMP unit check" UBYTE OneToOne 1 100 0.00 255.0 FORMAT "%5.1" ECU_ADDRESS 0x4000A158 /end MEASUREMENT
/begin MEASUREMENT MoCGTM_cmpErrAryIdxCpl "Complement variable for MoCGTM_cmpErrAryIdx" UBYTE OneToOne 1 100 0.00 255.0 FORMAT "%5.1" ECU_ADDRESS 0x40009FE7 /end MEASUREMENT
/begin MEASUREMENT MoCGTM_cntrBadcase "Number of bad cases triggered by MCS" ULONG OneToOne 1 100 0.00 4294967295.00 FORMAT "%13.2" ECU_ADDRESS 0x4000A148 /end MEASUREMENT
/begin MEASUREMENT MoCGTM_cntrCMPErrbit "Number of times badcase detected by CMP unit" ULONG OneToOne 1 100 0.00 4294967295.00 FORMAT "%13.2" ECU_ADDRESS 0x4000A144 /end MEASUREMENT
/begin MEASUREMENT MoCGTM_cntrCMPErrbitCpl "Complement variable for MoCGTM_CMPErrbitCnt" ULONG OneToOne 1 100 0.00 4294967295.00 FORMAT "%13.2" ECU_ADDRESS 0x40009FDC /end MEASUREMENT
/begin MEASUREMENT MoCGTM_cntrCMPErrbitHeal "Healing counter for MoCGTM_cntrCMPErrbit" UBYTE OneToOne 1 100 0.00 255.0 FORMAT "%5.1" ECU_ADDRESS 0x4000A157 /end MEASUREMENT
/begin MEASUREMENT MoCGTM_cntrCMPErrbitHealCpl "Complement variable for MoCGTM_cntrCMPErrbitHeal" UBYTE OneToOne 1 100 0.00 255.0 FORMAT "%5.1" ECU_ADDRESS 0x40009FE6 /end MEASUREMENT
/begin MEASUREMENT MoCGTM_cntrDebErr "Error Debounce Counter for Pattern Mismatch error" UBYTE OneToOne 1 100 0.00 255.0 FORMAT "%5.1" ECU_ADDRESS 0x4000A156 /end MEASUREMENT
/begin MEASUREMENT MoCGTM_cntrDebErrCpl "Complement of the Error Debounce Counter for Pattern Mismatch error" UBYTE OneToOne 1 100 0.00 255.0 FORMAT "%5.1" ECU_ADDRESS 0x40009FE5 /end MEASUREMENT
/begin MEASUREMENT MoCGTM_cntrDebErrExcddThdNv "Counter for exceedence of the debounce level of Error Debounce Counter for Pattern Mismatch error" UBYTE OneToOne 1 100 0.00 255.0 FORMAT "%5.1" ECU_ADDRESS 0x4000CD4F /end MEASUREMENT
/begin MEASUREMENT MoCGTM_cntrDebErrMax "Max. deviation between badcase created and detected occurred" UBYTE OneToOne 1 100 0.00 255.0 FORMAT "%5.1" ECU_ADDRESS 0x40009FE4 /end MEASUREMENT
/begin MEASUREMENT MoCGTM_cntrDebErrMaxNv "MaxValueIndicator of debouncing of Error counter for Pattern Mismatch" UBYTE OneToOne 1 100 0.00 255.0 FORMAT "%5.1" ECU_ADDRESS 0x4000CD4E /end MEASUREMENT
/begin MEASUREMENT MoCGTM_cntrDebErrOld "Old value of the debounce counter of error counter for counter deviation in GTM" UBYTE OneToOne 1 100 0.00 255.0 FORMAT "%5.1" ECU_ADDRESS 0x40009FE3 /end MEASUREMENT
/begin MEASUREMENT MoCGTM_cntrMCS1 "Number of times MCS1 triggered from core" ULONG OneToOne 1 100 0.00 4294967295.00 FORMAT "%13.2" ECU_ADDRESS 0x4000A140 /end MEASUREMENT
/begin MEASUREMENT MoCGTM_cntrMCS1Old "previous raster value of Number of times MCS1 triggered from core" ULONG OneToOne 1 100 0.00 4294967295.00 FORMAT "%13.2" ECU_ADDRESS 0x4000A13C /end MEASUREMENT
/begin MEASUREMENT MoCGTM_cntrMCS1OldCpl "complement variable for MoCGTM_cntrMCS1Old" ULONG OneToOne 1 100 0.00 4294967295.00 FORMAT "%13.2" ECU_ADDRESS 0x40009FD8 /end MEASUREMENT
/begin MEASUREMENT MoCGTM_cntrMCS2 "Number of times MCS2 triggered from core" ULONG OneToOne 1 100 0.00 4294967295.00 FORMAT "%13.2" ECU_ADDRESS 0x4000A138 /end MEASUREMENT
/begin MEASUREMENT MoCGTM_cntrMCS2Old "previous raster value of Number of times MCS2 triggered from core" ULONG OneToOne 1 100 0.00 4294967295.00 FORMAT "%13.2" ECU_ADDRESS 0x4000A134 /end MEASUREMENT
/begin MEASUREMENT MoCGTM_cntrMCS2OldCpl "complement variable for MoCGTM_cntrMCS2Old" ULONG OneToOne 1 100 0.00 4294967295.00 FORMAT "%13.2" ECU_ADDRESS 0x40009FD4 /end MEASUREMENT
/begin MEASUREMENT MoCGTM_cntrMsmCMPErrBit "Number of mismatch between MoCGTM_aryCMPErrBit and MoCGTM_exptCMPErrBit_CA" UBYTE OneToOne 1 100 0.00 255.0 FORMAT "%5.1" ECU_ADDRESS 0x4000A155 /end MEASUREMENT
/begin MEASUREMENT MoCGTM_cntrRouteSigErr "Number of time signal routing error occured in GTM" UBYTE OneToOne 1 100 0.00 255.0 FORMAT "%5.1" ECU_ADDRESS 0x4000A154 /end MEASUREMENT
/begin MEASUREMENT MoCGTM_cntrRouteSigErrCpl "Complement variable for MoCGTM_cntrRouteSigErr" UBYTE OneToOne 1 100 0.00 255.0 FORMAT "%5.1" ECU_ADDRESS 0x40009FE2 /end MEASUREMENT
/begin MEASUREMENT MoCGTM_cntrRouteSigErrExcddThdNv "Counter for exceedance of the debounce level of a correct calibrated of error counter for error in signal routing in GTM" UBYTE OneToOne 1 100 0.00 255.0 FORMAT "%5.1" ECU_ADDRESS 0x4000CD4D /end MEASUREMENT
/begin MEASUREMENT MoCGTM_cntrRouteSigErrMaxNv "MaxValueIndicator for debouncing counter of error counter for error in signal routing in GTM" UBYTE OneToOne 1 100 0.00 255.0 FORMAT "%5.1" ECU_ADDRESS 0x4000CD4C /end MEASUREMENT
/begin MEASUREMENT MoCGTM_cntrRouteSigErrOld "Old value of the debounce counter of error counter for error in signal routing in GTM" UBYTE OneToOne 1 100 0.00 255.0 FORMAT "%5.1" ECU_ADDRESS 0x40009FE1 /end MEASUREMENT
/begin MEASUREMENT MoCGTM_currChksVal "Value of calculated checksum of current MCS module" ULONG OneToOne 1 100 0.00 4294967295.00 FORMAT "%13.2" ECU_ADDRESS 0x4000A130 /end MEASUREMENT
/begin MEASUREMENT MoCGTM_currChksValCpl "Complement of value of calculated checksum of current MCS module" ULONG OneToOne 1 100 0.00 4294967295.00 FORMAT "%13.2" ECU_ADDRESS 0x40009FD0 /end MEASUREMENT
/begin MEASUREMENT MoCGTM_currMCSModlAryIdx "Array index for MCS modules used during MCS ROM memory check" UBYTE OneToOne 1 100 0.00 255.0 FORMAT "%5.1" ECU_ADDRESS 0x4000A153 /end MEASUREMENT
/begin MEASUREMENT MoCGTM_flgCmpErr "compare error bit status" UBYTE B_TRUE 1 100 0.00 1.00000000000 BIT_MASK 0x1 FORMAT "%13.11" ECU_ADDRESS 0x4000A14C /end MEASUREMENT
/begin MEASUREMENT MoCGTM_McsData_ptr1Cpl "Complement for MCS data pointer1" ULONG OneToOne 1 100 0.00 4294967295.00 FORMAT "%13.2" ECU_ADDRESS 0x40009FCC /end MEASUREMENT
/begin MEASUREMENT MoCGTM_McsData_ptr2Cpl "Complement for MCS data pointer2" ULONG OneToOne 1 100 0.00 4294967295.00 FORMAT "%13.2" ECU_ADDRESS 0x40009FC8 /end MEASUREMENT
/begin MEASUREMENT MoCGTM_numMCS1Ch "MCS channel number selected for MCS1" UBYTE OneToOne 1 100 0.00 255.0 FORMAT "%5.1" ECU_ADDRESS 0x4000A152 /end MEASUREMENT
/begin MEASUREMENT MoCGTM_numMCS1Modl "MCS module number selected for MCS1" UBYTE OneToOne 1 100 0.00 255.0 FORMAT "%5.1" ECU_ADDRESS 0x4000A151 /end MEASUREMENT
/begin MEASUREMENT MoCGTM_numMCS2Ch "MCS channel number selected for MCS2" UBYTE OneToOne 1 100 0.00 255.0 FORMAT "%5.1" ECU_ADDRESS 0x4000A150 /end MEASUREMENT
/begin MEASUREMENT MoCGTM_numMCS2Modl "MCS module number selected for MCS2" UBYTE OneToOne 1 100 0.00 255.0 FORMAT "%5.1" ECU_ADDRESS 0x4000A14F /end MEASUREMENT
/begin MEASUREMENT MoCGTM_PtlResp "Partial respose of MoCGTM_Co" ULONG OneToOne 1 100 0.00 4294967295.00 FORMAT "%13.2" ECU_ADDRESS 0x40009FB8
 /begin IF_DATA XCPplus 0x0102
  /begin DAQ_EVENT VARIABLE /begin AVAILABLE_EVENT_LIST EVENT 0 EVENT 1 EVENT 2 EVENT 3 /end AVAILABLE_EVENT_LIST /begin DEFAULT_EVENT_LIST EVENT 1 /end DEFAULT_EVENT_LIST /end DAQ_EVENT
 /end IF_DATA
/end MEASUREMENT
/begin MEASUREMENT MoCGTM_PtlRespCpl "Complement variable for MoCGTM_PtlResp" ULONG OneToOne 1 100 0.00 4294967295.00 FORMAT "%13.2" ECU_ADDRESS 0x40009FC4
 /begin IF_DATA XCPplus 0x0102
  /begin DAQ_EVENT VARIABLE /begin AVAILABLE_EVENT_LIST EVENT 0 EVENT 1 EVENT 2 EVENT 3 /end AVAILABLE_EVENT_LIST /begin DEFAULT_EVENT_LIST EVENT 1 /end DEFAULT_EVENT_LIST /end DAQ_EVENT
 /end IF_DATA
/end MEASUREMENT
/begin MEASUREMENT MoCGTM_stBadcaseTrig "Indicates creation of badcase in MCS2" ULONG OneToOne 1 100 0.00 4294967295.00 FORMAT "%13.2" ECU_ADDRESS 0x4000A12C /end MEASUREMENT
/begin MEASUREMENT MoCGTM_stErr "Indicates failure in BSW function call" UBYTE OneToOne 1 100 0.00 255.0 FORMAT "%5.1" ECU_ADDRESS 0x4000A14E /end MEASUREMENT
/begin MEASUREMENT MoCGTM_stErrChks "Status of checksum error in MCS ROM check" UBYTE OneToOne 1 100 0.00 255.0 FORMAT "%5.1" ECU_ADDRESS 0x4000A14D /end MEASUREMENT
/begin MEASUREMENT MoCGTM_stErrCpl "Complement variable for MoCGTM_stErr" UBYTE OneToOne 1 100 0.00 255.0 FORMAT "%5.1" ECU_ADDRESS 0x40009FE0 /end MEASUREMENT
/begin MEASUREMENT MoCGTM_tiCurrMCSVal "Timestamp at which TIM read to be performed after MCS trigger from safety core" ULONG OneToOne 1 100 0.00 4294967295.00 FORMAT "%13.2" ECU_ADDRESS 0x4000A128 /end MEASUREMENT
/begin MEASUREMENT MoCGTM_tiCurrTskcall "Time stamp current task call" ULONG OneToOne 1 100 0.00 4294967295.00 FORMAT "%13.2" ECU_ADDRESS 0x40009FC0 /end MEASUREMENT
/begin MEASUREMENT MoCGTM_tiExeMCS1_MP "Measurement of time taken for complete execution of MCS1 in ticks" ULONG RBPtCel_ti_0p4_1 1 100 0.00 1717986918.00 FORMAT "%13.2" ECU_ADDRESS 0x40009E7C /end MEASUREMENT
/begin MEASUREMENT MoCGTM_tiExeMCS2_MP "Measurement of time taken for complete execution of MCS2 in ticks" ULONG RBPtCel_ti_0p4_1 1 100 0.00 1717986918.00 FORMAT "%13.2" ECU_ADDRESS 0x40009E78 /end MEASUREMENT
/begin MEASUREMENT MoCGTM_tiFallEdgeBadcase_MP "Measurement point for Falling edge time stamp in MCS2 during badcase" ULONG OneToOne 1 100 0.00 4294967295.00 FORMAT "%13.2" ECU_ADDRESS 0x40009E74 /end MEASUREMENT
/begin MEASUREMENT MoCGTM_tiFallEdgeMCS1_MP "Measurement point for Falling edge time stamp in MCS1" ULONG OneToOne 1 100 0.00 4294967295.00 FORMAT "%13.2" ECU_ADDRESS 0x40009E70 /end MEASUREMENT
/begin MEASUREMENT MoCGTM_tiFallEdgeMCS2_MP "Measurement point for Falling edge time stamp in MCS2" ULONG OneToOne 1 100 0.00 4294967295.00 FORMAT "%13.2" ECU_ADDRESS 0x40009E6C /end MEASUREMENT
/begin MEASUREMENT MoCGTM_tiMCSTIMRead "Current rising edge time stamp received from TIM before the control trigger from safety core is passed" ULONG OneToOne 1 100 0.00 4294967295.00 FORMAT "%13.2" ECU_ADDRESS 0x4000A124 /end MEASUREMENT
/begin MEASUREMENT MoCGTM_tiPrevMCS1Trig_MP "Measurement point for Timestamp of previous trigger for MCS1 execution from safety core" ULONG OneToOne 1 100 0.00 4294967295.00 FORMAT "%13.2" ECU_ADDRESS 0x40009E68 /end MEASUREMENT
/begin MEASUREMENT MoCGTM_tiPrevMCS2Trig_MP "Measurement point for Timestamp of previous trigger for MCS2 execution from safety core" ULONG OneToOne 1 100 0.00 4294967295.00 FORMAT "%13.2" ECU_ADDRESS 0x40009E64 /end MEASUREMENT
/begin MEASUREMENT MoCGTM_tiPrevTskcall "Time stamp previous task call" ULONG OneToOne 1 100 0.00 4294967295.00 FORMAT "%13.2" ECU_ADDRESS 0x40009FBC /end MEASUREMENT
/begin MEASUREMENT MoCGTM_tiRisngEdgeMCS1_MP "Measurement point for Rising edge time stamp in MCS1" ULONG OneToOne 1 100 0.00 4294967295.00 FORMAT "%13.2" ECU_ADDRESS 0x40009E60 /end MEASUREMENT
/begin MEASUREMENT MoCGTM_tiRisngEdgeMCS2_MP "Measurement point for Rising edge time stamp in MCS2" ULONG OneToOne 1 100 0.00 4294967295.00 FORMAT "%13.2" ECU_ADDRESS 0x40009E5C /end MEASUREMENT
/begin MEASUREMENT MoCGTM_tiTskCalldst_MP "Measurepoint time between two task calls" ULONG OneToOne 1 100 0.00 4294967295.00 FORMAT "%13.2" ECU_ADDRESS 0x40009E58 /end MEASUREMENT
/begin MEASUREMENT MoCMem_adChkSumBlk "Addresses of checksum blocks configured for cyclic memory check" ULONG dez 1 100 0.00 4294967295.00 FORMAT "%13.2" ARRAY_SIZE 2 ECU_ADDRESS 0x40009EE0 /end MEASUREMENT
/begin MEASUREMENT MoCMem_adChkSumBlkCpl "Double storage for MoCMem_adChkSumBlk" ULONG dez 1 100 0.00 4294967295.00 FORMAT "%13.2" ARRAY_SIZE 2 ECU_ADDRESS 0x40009FA4 /end MEASUREMENT
/begin MEASUREMENT MoCMem_adrChkStckEnd "End address of the current tested stack memory" ULONG OneToOne 1 100 0.00 4294967295.00 FORMAT "%13.2" ECU_ADDRESS 0x4000A118 /end MEASUREMENT
/begin MEASUREMENT MoCMem_adrChkStckStrt "Start address of the current tested stack memory" ULONG OneToOne 1 100 0.00 4294967295.00 FORMAT "%13.2" ECU_ADDRESS 0x4000A114 /end MEASUREMENT
/begin MEASUREMENT MoCMem_ctDebErrChkRAM "error debounce counter for double storage and cyclical RAM-test" UBYTE OneToOne 1 100 0.00 255.0 FORMAT "%5.1" ECU_ADDRESS 0x4000A122 /end MEASUREMENT
/begin MEASUREMENT MoCMem_ctDebErrChkRAMCpl "complement of the error debounce counter for double storage and cyclical RAM-test" UBYTE OneToOne 1 100 0.00 255.0 FORMAT "%5.1" ECU_ADDRESS 0x40009FB4 /end MEASUREMENT
/begin MEASUREMENT MoCMem_ctDebErrChkRAMExcddThdNv "Counter how often the threshold for MaxValueIndicator for double storage and cyclic RAM-Test is exeeded" UBYTE OneToOne 1 100 0.00 255.0 FORMAT "%5.1" ECU_ADDRESS 0x4000CD4B /end MEASUREMENT
/begin MEASUREMENT MoCMem_ctDebErrChkRAMMaxNv "MaxValueIndicator for double storage and cyclic RAM-Test" UBYTE OneToOne 1 100 0.00 255.0 FORMAT "%5.1" ECU_ADDRESS 0x4000CD4A /end MEASUREMENT
/begin MEASUREMENT MoCMem_ctDebErrChkRAMOld "Old value of counter how often the threshold for MaxValueIndicator for double storage and cyclic RAM-Test is exeeded" UBYTE OneToOne 1 100 0.00 255.0 FORMAT "%5.1" ECU_ADDRESS 0x40009FB3 /end MEASUREMENT
/begin MEASUREMENT MoCMem_ctDebErrChkROM "error debounce counter for cyclical ROM-test" UBYTE OneToOne 1 100 0.00 255.0 FORMAT "%5.1" ECU_ADDRESS 0x4000A121 /end MEASUREMENT
/begin MEASUREMENT MoCMem_ctDebErrChkROMCpl "complement of the error debounce counter for cyclical ROM-test" UBYTE OneToOne 1 100 0.00 255.0 FORMAT "%5.1" ECU_ADDRESS 0x40009FB2 /end MEASUREMENT
/begin MEASUREMENT MoCMem_ctDebErrChkROMExcddThdNv "Counter how often the threshold for MaxValueIndicator for double storage and cyclic ROM-Test is exeeded" UBYTE OneToOne 1 100 0.00 255.0 FORMAT "%5.1" ECU_ADDRESS 0x4000CD49 /end MEASUREMENT
/begin MEASUREMENT MoCMem_ctDebErrChkROMMaxNv "MaxValueIndicator for double storage and cyclic ROM-Test" UBYTE OneToOne 1 100 0.00 255.0 FORMAT "%5.1" ECU_ADDRESS 0x4000CD48 /end MEASUREMENT
/begin MEASUREMENT MoCMem_ctDebErrChkROMOld "Old value of counter how often the threshold for MaxValueIndicator for double storage and cyclic ROM-Test is exeeded" UBYTE OneToOne 1 100 0.00 255.0 FORMAT "%5.1" ECU_ADDRESS 0x40009FB1 /end MEASUREMENT
/begin MEASUREMENT MoCMem_ctDebHealChkRAM "error healing counter for double storage and cyclical RAM-test" UBYTE OneToOne 1 100 0.00 255.0 FORMAT "%5.1" ECU_ADDRESS 0x4000A120 /end MEASUREMENT
/begin MEASUREMENT MoCMem_ctDebHealChkRAMCpl "complement of the error healing counter for double storage and cyclical RAM-test" UBYTE OneToOne 1 100 0.00 255.0 FORMAT "%5.1" ECU_ADDRESS 0x40009FB0 /end MEASUREMENT
/begin MEASUREMENT MoCMem_ctDebHealChkROM "error healing counter for cyclical ROM-test" UBYTE OneToOne 1 100 0.00 255.0 FORMAT "%5.1" ECU_ADDRESS 0x4000A11F /end MEASUREMENT
/begin MEASUREMENT MoCMem_ctDebHealChkROMCpl "complement of the error healing counter for cyclical ROM-test" UBYTE OneToOne 1 100 0.00 255.0 FORMAT "%5.1" ECU_ADDRESS 0x40009FAF /end MEASUREMENT
/begin MEASUREMENT MoCMem_idxCSAry "Array index to point to the desired checksum block" UBYTE OneToOne 1 100 0.00 255.0 FORMAT "%5.1" ECU_ADDRESS 0x4000A11E /end MEASUREMENT
/begin MEASUREMENT MoCMem_idxCSAryCpl "Double storage for MoCMem_idxCSAry" UBYTE OneToOne 1 100 0.00 255.0 FORMAT "%5.1" ECU_ADDRESS 0x40009FAE /end MEASUREMENT
/begin MEASUREMENT MoCMem_nrPostBldChks "Current checksum for cyclical RAM-check where post build pointers are stored" ULONG OneToOne 1 100 0.00 4294967295.00 FORMAT "%13.2" ECU_ADDRESS 0x4000A100
 /begin IF_DATA XCPplus 0x0102
  /begin DAQ_EVENT VARIABLE /begin AVAILABLE_EVENT_LIST EVENT 0 EVENT 1 EVENT 2 EVENT 3 /end AVAILABLE_EVENT_LIST /begin DEFAULT_EVENT_LIST EVENT 1 /end DEFAULT_EVENT_LIST /end DAQ_EVENT
 /end IF_DATA
/end MEASUREMENT
/begin MEASUREMENT MoCMem_nrRamChk "Number of 32-bit memory cells to be tested in cyclical RAM check" UWORD OneToOne 1 100 0.00 65535.00 FORMAT "%8.2" ECU_ADDRESS 0x4000A0FE /end MEASUREMENT
/begin MEASUREMENT MoCMem_nrRamChkCpl "Double storage of the number of 32-bit memory cells to be tested in cyclical RAM check" UWORD OneToOne 1 100 0.00 65535.00 FORMAT "%8.2" ECU_ADDRESS 0x40009F96 /end MEASUREMENT
/begin MEASUREMENT MoCMem_nrRamChkSize "Memory size in Byte that is tested in the cyclic RAM check" ULONG OneToOne 1 100 0.00 4294967295.00 FORMAT "%13.2" ECU_ADDRESS 0x4000A110 /end MEASUREMENT
/begin MEASUREMENT MoCMem_nrRomChk "Number of 32-bit memory cells to be tested in cyclical ROM check" UWORD OneToOne 1 100 0.00 65535.00 FORMAT "%8.2" ARRAY_SIZE 4 ECU_ADDRESS 0x4000A0F6 /end MEASUREMENT
/begin MEASUREMENT MoCMem_nrRomChkCpl "Double storage of the number of 32-bit memory cells to be tested in cyclical ROM check" UWORD OneToOne 1 100 0.00 65535.00 FORMAT "%8.2" ARRAY_SIZE 4 ECU_ADDRESS 0x40009F8E /end MEASUREMENT
/begin MEASUREMENT MoCMem_nrRomChkSize "Memory size in Byte that is tested in the cyclic ROM check" ULONG OneToOne 1 100 0.00 4294967295.00 FORMAT "%13.2" ECU_ADDRESS 0x4000A10C /end MEASUREMENT
/begin MEASUREMENT MoCMem_numChkSumCurrent "current checksum for cyclical ROM-check" ULONG OneToOne 1 100 0.00 4294967295.00 FORMAT "%13.2" ECU_ADDRESS 0x4000A108 /end MEASUREMENT
/begin MEASUREMENT MoCMem_numChkSumCurrentCpl "RAM data redundancy for MoCMem_numChkSumCurrent" ULONG OneToOne 1 100 0.00 4294967295.00 FORMAT "%13.2" ECU_ADDRESS 0x40009FA0 /end MEASUREMENT
/begin MEASUREMENT MoCMem_RamOffsetPtr "pointer with the address for the cyclic checked RAM area which should be checkt at the next cyclic call of the cyclic RAM check" ULONG default 1 100 0.00 4294967295.00 FORMAT "%13.2" ECU_ADDRESS 0x40009EE8 /end MEASUREMENT
/begin MEASUREMENT MoCMem_RamOffsetPtrCpl "duplicate storage of MoCMem_RamOffsetPtr" ULONG OneToOne 1 100 0.00 4294967295.00 FORMAT "%13.2" ECU_ADDRESS 0x40009F9C /end MEASUREMENT
/begin MEASUREMENT MoCMem_RomCurrentPtr "pointer with the address for the cyclic checked ROM area which should be checkt at the next cyclic call of the cyclic ROM check" ULONG default 1 100 0.00 4294967295.00 FORMAT "%13.2" ECU_ADDRESS 0x4000A104 /end MEASUREMENT
/begin MEASUREMENT MoCMem_RomCurrentPtrCpl "duplicate storage of MoCMem_RomCurrentPtrCpl" ULONG OneToOne 1 100 0.00 4294967295.00 FORMAT "%13.2" ECU_ADDRESS 0x40009F98 /end MEASUREMENT
/begin MEASUREMENT MoCMem_st "Request of a complete memory test during initialisation; status of complete ROM test" UBYTE OneToOne 1 100 0.00 255.0 FORMAT "%5.1" ECU_ADDRESS 0x4000F96D
 /begin IF_DATA XCPplus 0x0102
  /begin DAQ_EVENT VARIABLE /begin AVAILABLE_EVENT_LIST EVENT 0 EVENT 1 EVENT 2 EVENT 3 /end AVAILABLE_EVENT_LIST /begin DEFAULT_EVENT_LIST EVENT 1 /end DEFAULT_EVENT_LIST /end DAQ_EVENT
 /end IF_DATA
/end MEASUREMENT
/begin MEASUREMENT MoCMem_stCpl "Double storage for request of complete RAM/ROM-memory checks during initialization" UBYTE OneToOne 1 100 0.00 255.0 FORMAT "%5.1" ECU_ADDRESS 0x4000F96C /end MEASUREMENT
/begin MEASUREMENT MoCMem_stDataCycChkBlk "DME support available for data set block" UBYTE OneToOne 1 100 0.00 255.0 FORMAT "%5.1" ARRAY_SIZE 2 ECU_ADDRESS 0x4000A11C /end MEASUREMENT
/begin MEASUREMENT MoCMem_stDataCycChkBlkCpl "Double storage of DME support available for data set block" UBYTE OneToOne 1 100 0.00 255.0 FORMAT "%5.1" ARRAY_SIZE 2 ECU_ADDRESS 0x40009FAC /end MEASUREMENT
/begin MEASUREMENT MoCMem_Temp1Ptr "start pointer to ROM block which is currently cyclically checked" ULONG default 1 100 0.00 4294967295.00 FORMAT "%13.2" ECU_ADDRESS 0x40009EF0 /end MEASUREMENT
/begin MEASUREMENT MoCMem_Temp2Ptr "end pointer to ROM block which is currently cyclically checked" UBYTE default 1 100 0.00 255.0 FORMAT "%5.1" ECU_ADDRESS 0x40009EEC /end MEASUREMENT
/begin MEASUREMENT MoCPFC_Checksum "Inter result of checksum calculation in the program flow check" ULONG OneToOne 1 100 0.00 4294967295.00 FORMAT "%13.2" ECU_ADDRESS 0x40009F84
 /begin IF_DATA XCPplus 0x0102
  /begin DAQ_EVENT VARIABLE /begin AVAILABLE_EVENT_LIST EVENT 0 EVENT 1 EVENT 2 EVENT 3 /end AVAILABLE_EVENT_LIST /begin DEFAULT_EVENT_LIST EVENT 1 /end DEFAULT_EVENT_LIST /end DAQ_EVENT
 /end IF_DATA
/end MEASUREMENT
/begin MEASUREMENT MoCPFC_Checkword "Modul specific signature for building the checksum of the PFC in function monitoring" ULONG OneToOne 1 100 0.00 4294967295.00 FORMAT "%13.2" ECU_ADDRESS 0x40009F88
 /begin IF_DATA XCPplus 0x0102
  /begin DAQ_EVENT VARIABLE /begin AVAILABLE_EVENT_LIST EVENT 0 EVENT 1 EVENT 2 EVENT 3 /end AVAILABLE_EVENT_LIST /begin DEFAULT_EVENT_LIST EVENT 1 /end DEFAULT_EVENT_LIST /end DAQ_EVENT
 /end IF_DATA
/end MEASUREMENT
/begin MEASUREMENT MoCPFC_Counter "Module call counter for program flow check in monitoring" UBYTE OneToOne 1 100 0.00 255.0 FORMAT "%5.1" ECU_ADDRESS 0x40009F8C
 /begin IF_DATA XCPplus 0x0102
  /begin DAQ_EVENT VARIABLE /begin AVAILABLE_EVENT_LIST EVENT 0 EVENT 1 EVENT 2 EVENT 3 /end AVAILABLE_EVENT_LIST /begin DEFAULT_EVENT_LIST EVENT 1 /end DEFAULT_EVENT_LIST /end DAQ_EVENT
 /end IF_DATA
/end MEASUREMENT
/begin MEASUREMENT MoCPFC_PartResp "Partial response from program flow check to monitoring module" ULONG OneToOne 1 100 0.00 4294967295.00 FORMAT "%13.2" ECU_ADDRESS 0x40009F80
 /begin IF_DATA XCPplus 0x0102
  /begin DAQ_EVENT VARIABLE /begin AVAILABLE_EVENT_LIST EVENT 0 EVENT 1 EVENT 2 EVENT 3 /end AVAILABLE_EVENT_LIST /begin DEFAULT_EVENT_LIST EVENT 1 /end DEFAULT_EVENT_LIST /end DAQ_EVENT
 /end IF_DATA
/end MEASUREMENT
/begin MEASUREMENT MoCSOP_cntrWaitMMCANCfg "counter variable used to add an additional delay to make sure that CAN TDI and WDR bits are set in Monitoring module" UBYTE OneToOne 1 100 0.00 255.0 FORMAT "%5.1" ECU_ADDRESS 0x40009F7F /end MEASUREMENT
/begin MEASUREMENT MoCSOP_ctBusErr "error counter for communication bus error between FC and other ASICS like power stage ASIC, Monitoring module etc" UBYTE OneToOne 1 100 0.00 255.0 FORMAT "%5.1" ECU_ADDRESS 0x40009F7E /end MEASUREMENT
/begin MEASUREMENT MoCSOP_ctDebSOPTst "Number of repetitions of shut-off path test (implementation of a time monitoring)" UWORD OneToOne 1 100 0.00 65535.00 FORMAT "%8.2" ECU_ADDRESS 0x40009F72 /end MEASUREMENT
/begin MEASUREMENT MoCSOP_ctErrMM "Copy of the error counter from the monitoring module in function controller" UBYTE OneToOne 1 100 0.00 255.0 FORMAT "%5.1" ECU_ADDRESS 0x40009F7D /end MEASUREMENT
/begin MEASUREMENT MoCSOP_ctErrOSTimeout "error counter handling Alarm Task period" UBYTE OneToOne 1 100 0.00 255.0 FORMAT "%5.1" ECU_ADDRESS 0x40009F7C /end MEASUREMENT
/begin MEASUREMENT MoCSOP_ctErrRespTime "error counter for an error setting the response time" UBYTE OneToOne 1 100 0.00 255.0 FORMAT "%5.1" ECU_ADDRESS 0x40009F7B /end MEASUREMENT
/begin MEASUREMENT MoCSOP_ctRespOffsetTst "Counter used for test purpose in time of response" UWORD OneToOne 1 100 0.00 65535.00 FORMAT "%8.2" ECU_ADDRESS 0x40009F70 /end MEASUREMENT
/begin MEASUREMENT MoCSOP_numQuery "new query from UM in function monitoring" UBYTE OneToOne 1 100 0.00 255.0 FORMAT "%5.1" ECU_ADDRESS 0x40009F7A /end MEASUREMENT
/begin MEASUREMENT MoCSOP_RAMInitCorrResp1 "array contains the correction-values for different responses to the monitoring module" ULONG OneToOne 1 100 0.00 4294967295.00 FORMAT "%13.2" ARRAY_SIZE 16 ECU_ADDRESS 0x4000A028 /end MEASUREMENT
/begin MEASUREMENT MoCSOP_RAMInitCorrResp2 "array contains the correction-values for different responses to the monitoring module" ULONG OneToOne 1 100 0.00 4294967295.00 FORMAT "%13.2" ARRAY_SIZE 16 ECU_ADDRESS 0x4000A068 /end MEASUREMENT
/begin MEASUREMENT MoCSOP_stActMsg "copy of the status variable for synchronizing shut off path test and query-/response communication" UBYTE dez 1 100 0.00 255.0 FORMAT "%5.1" ECU_ADDRESS 0x40007F67 /end MEASUREMENT
/begin MEASUREMENT MoCSOP_stActvMsg "Information for level 1, 2: Shut-off path test is on or WDA-line is active (injections disabled)" UBYTE dez 1 100 0.00 255.0 FORMAT "%5.1" ECU_ADDRESS 0x40007F66 /end MEASUREMENT
/begin MEASUREMENT MoCSOP_stBusErr "status variable for communication bus error between FC and other ASICS like power stage ASIC, Monitoring module etc" UBYTE OneToOne 1 100 0.00 255.0 FORMAT "%5.1" ECU_ADDRESS 0x40009F79 /end MEASUREMENT
/begin MEASUREMENT MoCSOP_stComActv "status for communication from MoCCOM active" UBYTE OneToOne 1 100 0.00 255.0 FORMAT "%5.1" ECU_ADDRESS 0x40009F75 /end MEASUREMENT
/begin MEASUREMENT MoCSOP_stComActvCpl "RAM data redundancy for MoCSOP_stComActv" UBYTE OneToOne 1 100 0.00 255.0 FORMAT "%5.1" ECU_ADDRESS 0x40009F74 /end MEASUREMENT
/begin MEASUREMENT MoCSOP_stErr "contains the state of the communication via SPI-subsystem to the monitoring module" UBYTE OneToOne 1 100 0.00 255.0 FORMAT "%5.1" ECU_ADDRESS 0x40009F78 /end MEASUREMENT
/begin MEASUREMENT MoCSOP_stMm "MM status Byte" UBYTE OneToOne 1 100 0.00 255.0 FORMAT "%5.1" ECU_ADDRESS 0x40009F77 /end MEASUREMENT
/begin MEASUREMENT MoCSOP_stMmRespCnt "response to MM (4 bytes) byte counter (0..3). Normally 3 if no error occurs." UBYTE OneToOne 1 100 0.00 255.0 FORMAT "%5.1" ECU_ADDRESS 0x40009F76 /end MEASUREMENT
/begin MEASUREMENT MoCSOP_stRdy "Status variable for synchronisation from shut-off path test and query/response communication (test is done completely)" UBYTE OneToOne 1 100 0.00 255.0 FORMAT "%5.1" ECU_ADDRESS 0x4000B5AC /end MEASUREMENT
/begin MEASUREMENT MoCSOP_stRdyCpl "Double storage for status variable for synchronisation from shut-off path test and query/response communication" UBYTE OneToOne 1 100 0.00 255.0 FORMAT "%5.1" ECU_ADDRESS 0x4000B5AB /end MEASUREMENT
/begin MEASUREMENT MoCSOP_stRdyMsg "information for level 1,2 about status of synchronizing shut off path test and query-/resonse-communication" UBYTE OneToOne 1 100 0.00 255.0 FORMAT "%5.1" ECU_ADDRESS 0x400063C6 /end MEASUREMENT
/begin MEASUREMENT MoExe_ctCyc "10 ms counter to generate scheduling for monitoring" UBYTE OneToOne 1 100 0.00 255.0 FORMAT "%5.1" ECU_ADDRESS 0x4000A0F4 /end MEASUREMENT
/begin MEASUREMENT MoFGearLvrIn_bblOutCpl "RAM data redundancy for MoFGearLvrIn" UBYTE OneToOne 1 100 0.00 255.0 FORMAT "%5.1" ECU_ADDRESS 0x40009F6F
 /begin IF_DATA XCPplus 0x0102
  /begin DAQ_EVENT VARIABLE /begin AVAILABLE_EVENT_LIST EVENT 0 EVENT 1 EVENT 2 EVENT 3 /end AVAILABLE_EVENT_LIST /begin DEFAULT_EVENT_LIST EVENT 1 /end DEFAULT_EVENT_LIST /end DAQ_EVENT
 /end IF_DATA
/end MEASUREMENT
/begin MEASUREMENT MoFGearLvr_cntrDeb "Debounce counter for Neutral switch in Function monitoring" UBYTE OneToOne 1 100 0.00 255.0 FORMAT "%5.1" ECU_ADDRESS 0x4000A0F3
 /begin IF_DATA XCPplus 0x0102
  /begin DAQ_EVENT VARIABLE /begin AVAILABLE_EVENT_LIST EVENT 0 EVENT 1 EVENT 2 EVENT 3 /end AVAILABLE_EVENT_LIST /begin DEFAULT_EVENT_LIST EVENT 1 /end DEFAULT_EVENT_LIST /end DAQ_EVENT
 /end IF_DATA
/end MEASUREMENT
/begin MEASUREMENT MoFGearLvr_cntrDebCpl "RAM data redundancy for MoFGearLvr_cntrDeb" UBYTE OneToOne 1 100 0.00 255.0 FORMAT "%5.1" ECU_ADDRESS 0x40009F6E
 /begin IF_DATA XCPplus 0x0102
  /begin DAQ_EVENT VARIABLE /begin AVAILABLE_EVENT_LIST EVENT 0 EVENT 1 EVENT 2 EVENT 3 /end AVAILABLE_EVENT_LIST /begin DEFAULT_EVENT_LIST EVENT 1 /end DEFAULT_EVENT_LIST /end DAQ_EVENT
 /end IF_DATA
/end MEASUREMENT
/begin MEASUREMENT MoFGearLvr_flgGearLvrRaw_MP "Measurement point to read the neutral switch output" UBYTE B_TRUE 1 100 0.00 1.00000000000 BIT_MASK 0x1 FORMAT "%13.11" ECU_ADDRESS 0x40009E56
 /begin IF_DATA XCPplus 0x0102
  /begin DAQ_EVENT VARIABLE /begin AVAILABLE_EVENT_LIST EVENT 0 EVENT 1 EVENT 2 EVENT 3 /end AVAILABLE_EVENT_LIST /begin DEFAULT_EVENT_LIST EVENT 1 /end DEFAULT_EVENT_LIST /end DAQ_EVENT
 /end IF_DATA
/end MEASUREMENT
/begin MEASUREMENT MoFGearLvr_flgNeutGear "Status of Gear neutral position in function monitoring" UBYTE B_TRUE 1 100 0.00 1.00000000000 BIT_MASK 0x1 FORMAT "%13.11" ECU_ADDRESS 0x4000A0F2
 /begin IF_DATA XCPplus 0x0102
  /begin DAQ_EVENT VARIABLE /begin AVAILABLE_EVENT_LIST EVENT 0 EVENT 1 EVENT 2 EVENT 3 /end AVAILABLE_EVENT_LIST /begin DEFAULT_EVENT_LIST EVENT 1 /end DEFAULT_EVENT_LIST /end DAQ_EVENT
 /end IF_DATA
/end MEASUREMENT
/begin MEASUREMENT MoFGear_ratGearlvrcorr "Neutral Switch output voltage after correction using Routing factor" UWORD spg_uw_q0p00488 1 100 0.00 319.9951 FORMAT "%8.4" ECU_ADDRESS 0x4000A0F0
 /begin IF_DATA XCPplus 0x0102
  /begin DAQ_EVENT VARIABLE /begin AVAILABLE_EVENT_LIST EVENT 0 EVENT 1 EVENT 2 EVENT 3 /end AVAILABLE_EVENT_LIST /begin DEFAULT_EVENT_LIST EVENT 1 /end DEFAULT_EVENT_LIST /end DAQ_EVENT
 /end IF_DATA
/end MEASUREMENT
/begin MEASUREMENT MoFGear_ratGearlvrcorrCpl "Ram data Redundancy for MoFGear_ratGearlvrcorr" UWORD OneToOne 1 100 0.00 65535.00 FORMAT "%8.2" ECU_ADDRESS 0x40009F6C
 /begin IF_DATA XCPplus 0x0102
  /begin DAQ_EVENT VARIABLE /begin AVAILABLE_EVENT_LIST EVENT 0 EVENT 1 EVENT 2 EVENT 3 /end AVAILABLE_EVENT_LIST /begin DEFAULT_EVENT_LIST EVENT 1 /end DEFAULT_EVENT_LIST /end DAQ_EVENT
 /end IF_DATA
/end MEASUREMENT
/begin MEASUREMENT MoFIn_stICOInjL1 "injection cut off pattern total in function monitoring" UBYTE OneToOne 1 100 0.00 255.0 FORMAT "%5.1" ECU_ADDRESS 0x4000A0EE
 /begin IF_DATA XCPplus 0x0102
  /begin DAQ_EVENT VARIABLE /begin AVAILABLE_EVENT_LIST EVENT 0 EVENT 1 EVENT 2 EVENT 3 /end AVAILABLE_EVENT_LIST /begin DEFAULT_EVENT_LIST EVENT 1 /end DEFAULT_EVENT_LIST /end DAQ_EVENT
 /end IF_DATA
/end MEASUREMENT
/begin MEASUREMENT MoFIn_stICOInjL1Cpl "RAM data redundancy for MoFIn_stICOInjL1" UBYTE OneToOne 1 100 0.00 255.0 FORMAT "%5.1" ECU_ADDRESS 0x40009F6A /end MEASUREMENT
/begin MEASUREMENT MoFIn_stIgnFadeOutMskL1 "Fade out mask ignition output in Function monitoring" UWORD OneToOne 1 100 0.00 65535.00 FORMAT "%8.2" ECU_ADDRESS 0x4000A0EC
 /begin IF_DATA XCPplus 0x0102
  /begin DAQ_EVENT VARIABLE /begin AVAILABLE_EVENT_LIST EVENT 0 EVENT 1 EVENT 2 EVENT 3 /end AVAILABLE_EVENT_LIST /begin DEFAULT_EVENT_LIST EVENT 1 /end DEFAULT_EVENT_LIST /end DAQ_EVENT
 /end IF_DATA
/end MEASUREMENT
/begin MEASUREMENT MoFIn_stIgnFadeOutMskL1Cpl "RAM data redundancy for MoFIn_stIgnFadeOutMskL1" UWORD OneToOne 1 100 0.00 65535.00 FORMAT "%8.2" ECU_ADDRESS 0x40009F68 /end MEASUREMENT
/begin MEASUREMENT Mo_bECom "Request of complete memory tests from communication (MOCSOP and MOCCOM)" UBYTE B_TRUE 1 100 0.00 1.00000000000 BIT_MASK 0x80 FORMAT "%13.11" ECU_ADDRESS 0x4000F96D /end MEASUREMENT
/begin MEASUREMENT Mo_bEMem "Request of complete memory tests from cyclic memory test" UBYTE B_TRUE 1 100 0.00 1.00000000000 BIT_MASK 0x8 FORMAT "%13.11" ECU_ADDRESS 0x4000F96D /end MEASUREMENT
/begin MEASUREMENT Mo_bEPcp "Request of complete memory tests from PCP monitoring" UBYTE B_TRUE 1 100 0.00 1.00000000000 BIT_MASK 0x40 FORMAT "%13.11" ECU_ADDRESS 0x4000F96D /end MEASUREMENT
/begin MEASUREMENT Mo_bERam "Request of complete RAM test" UBYTE B_TRUE 1 100 0.00 1.00000000000 BIT_MASK 0x1 FORMAT "%13.11" ECU_ADDRESS 0x4000F96D /end MEASUREMENT
/begin MEASUREMENT Mo_bERomSPg "Request of complete ROM test (single fault)" UBYTE B_TRUE 1 100 0.00 1.00000000000 BIT_MASK 0x2 FORMAT "%13.11" ECU_ADDRESS 0x4000F96D /end MEASUREMENT
/begin MEASUREMENT Mo_bERomXPg "Request of complete ROM test (multiple fault)" UBYTE B_TRUE 1 100 0.00 1.00000000000 BIT_MASK 0x4 FORMAT "%13.11" ECU_ADDRESS 0x4000F96D /end MEASUREMENT
/begin MEASUREMENT Mo_bReqRamChkExt "bit for extern request of the complete RAM check" UBYTE B_TRUE 1 100 0.00 1.00000000000 BIT_MASK 0x20 FORMAT "%13.11" ECU_ADDRESS 0x4000F96D /end MEASUREMENT
/begin MEASUREMENT Mo_bReqRomChkExt "bit for extern request of the complete ROM check" UBYTE B_TRUE 1 100 0.00 1.00000000000 BIT_MASK 0x10 FORMAT "%13.11" ECU_ADDRESS 0x4000F96D /end MEASUREMENT
/begin MEASUREMENT Mo_flgIrrvErrNTPMsg "Irreversible error bit of ADC implemented as message - Null Load TestPulse check" UBYTE B_TRUE 1 100 0.00 1.00000000000 BIT_MASK 0x1 FORMAT "%13.11" ECU_ADDRESS 0x400063EB
 /begin IF_DATA XCPplus 0x0102
  /begin DAQ_EVENT VARIABLE /begin AVAILABLE_EVENT_LIST EVENT 0 EVENT 1 EVENT 2 EVENT 3 /end AVAILABLE_EVENT_LIST /begin DEFAULT_EVENT_LIST EVENT 1 /end DEFAULT_EVENT_LIST /end DAQ_EVENT
 /end IF_DATA
/end MEASUREMENT
/begin MEASUREMENT Mo_flgIrrvErrTstMsg "Irreversible error bit of ADC implemented as message - Testvoltage check" UBYTE B_TRUE 1 100 0.00 1.00000000000 BIT_MASK 0x1 FORMAT "%13.11" ECU_ADDRESS 0x400063EA
 /begin IF_DATA XCPplus 0x0102
  /begin DAQ_EVENT VARIABLE /begin AVAILABLE_EVENT_LIST EVENT 0 EVENT 1 EVENT 2 EVENT 3 /end AVAILABLE_EVENT_LIST /begin DEFAULT_EVENT_LIST EVENT 1 /end DEFAULT_EVENT_LIST /end DAQ_EVENT
 /end IF_DATA
/end MEASUREMENT
/begin FUNCTION MisfDet_RoughRoadByWhlSpd "104.6.0   Rough road detection by wheel speeds"
 /begin DEF_CHARACTERISTIC DFC_CtlMsk2.DFC_RoughRoad_C DFC_DisblMsk2.DFC_RoughRoad_C MisfDet_axleSeln_C MisfDet_dVWhlDecMax_C MisfDet_dVWhlFil_C MisfDet_dVWhlFrntThd_M MisfDet_dVWhlReThd_M MisfDet_stRoughRoadDiagCfg_C /end DEF_CHARACTERISTIC
 /begin IN_MEASUREMENT B_kuppl ESC_tiSampling MisfDet_stBlkStc MisfDet_stFcmClr10ms MisfDet_tqBasc VehV_stFrntWhlErr VehV_stReWhlErr VehV_v VehV_vFrntWhlRaw VehV_vReWhlRaw /end IN_MEASUREMENT
 /begin OUT_MEASUREMENT MisfDet_flgRoughRoad MisfDet_RoughRoadDstLog /end OUT_MEASUREMENT
 /begin LOC_MEASUREMENT MisfDet_dVWhl MisfDet_dVWhlAvrgFrnt MisfDet_dVWhlAvrgRe MisfDet_dVWhlFild MisfDet_dVWhlFrntThd MisfDet_dVWhlFrntThdMapOut MisfDet_dVWhlReThd MisfDet_dVWhlReThdMapOut MisfDet_flgRoughRoadFrnt MisfDet_flgRoughRoadPrel MisfDet_flgRoughRoadRe MisfDet_vWhl MisfDet_vWhlUsd MisfDet_vWhlVld /end LOC_MEASUREMENT
 FUNCTION_VERSION "104.6.0" /end FUNCTION
/begin FUNCTION MisfDet_SegTiCalcn "1.23.2    Segment time calculation of misfire detection"
 /begin DEF_CHARACTERISTIC MisfDet_segPosnLen_C MisfDet_segPosnStrt_C MisfDet_segTiDly_C MisfDet_segTiInin_C MisfDet_segTiMnpl_CA MisfDet_stSegTiCalcnCfgCal_C MisfDet_stSegTiCalcnCfg_C /end DEF_CHARACTERISTIC
 /begin REF_CHARACTERISTIC EpmSeq_phiInt_CA MisfDet_dnQnts_C /end REF_CHARACTERISTIC
 /begin IN_MEASUREMENT EpmSyn_phiInt Epm_ctCyl Epm_nEng MisfDet_dnThd MisfDet_stCalcIntrpt MisfDet_stIgnIntrpt MisfDet_stMisfSti MisfDet_stReIni MisfDet_stTqZero /end IN_MEASUREMENT
 /begin OUT_MEASUREMENT MisfDet_cylCntrSegTi MisfDet_maskSegPosnDnCalc MisfDet_maskSegTiVld MisfDet_segPosnLen MisfDet_segPosnLenSync MisfDet_segPosnSegTi MisfDet_segPosnStrt MisfDet_segTi MisfDet_segTiAry MisfDet_segTiDly MisfDet_stSegTiVld /end OUT_MEASUREMENT
 /begin LOC_MEASUREMENT MisfDet_maskSegTiVldSegBasd MisfDet_segTiDlyCorr MisfDet_segTiSegBasd /end LOC_MEASUREMENT
 FUNCTION_VERSION "1.23.2" /end FUNCTION
/begin FUNCTION MisfDet_SigSeln "1.14.1    Selection of the misfire signal for the statistical evaluation" /begin DEF_CHARACTERISTIC MisfDet_nrCycMisfCont_C MisfDet_stSigSelnCfg_C /end DEF_CHARACTERISTIC
 /begin IN_MEASUREMENT Epm_stSync MisfDet_cylCntr MisfDet_stBlkStc MisfDet_stDet MisfDet_stDnDet MisfDet_stInjLockdOpen MisfDet_stNoInjSync MisfDet_stReIni /end IN_MEASUREMENT
 /begin OUT_MEASUREMENT MisfDet_nrCylMisfNoId MisfDet_nrMisfConsc MisfDet_stCntMisf MisfDet_stMisfCont /end OUT_MEASUREMENT
 /begin LOC_MEASUREMENT MisfDet_maskCntMisf MisfDet_maskDet MisfDet_maskMisfCont /end LOC_MEASUREMENT
 FUNCTION_VERSION "1.14.1" /end FUNCTION
/begin FUNCTION MisfDet_Srv06 "1.11.0    Service 06 of misfire detection"
 /begin IN_MEASUREMENT DSMAUX_stDCy Epm_nEng MisfDet_cylCntr MisfDet_stCntMisf MisfDet_stFcmClr MisfDet_stFcmClr100ms MisfDet_stReIni SyC_stSub /end IN_MEASUREMENT
 /begin OUT_MEASUREMENT MisfDet_cntrMisfDiag MisfDet_cntrMisfDiagFild /end OUT_MEASUREMENT
 FUNCTION_VERSION "1.11.0" /end FUNCTION
/begin FUNCTION MisfDet_StcCat "1.24.1    Misfire statistic for detection of catalyst damaging misfire and cylinder deactivation"
 /begin DEF_CHARACTERISTIC DFC_CtlMsk2.DFC_MDCatCurr_C DFC_DisblMsk2.DFC_MDCatCurr_C MisfDet_stcCatDmgDebIntlNr_C MisfDet_stcCatDmgDebNMax_C MisfDet_stcCatDmgDebTqMax_T MisfDet_stcCatExtFirstIntlFac_C MisfDet_stcCatExtFirstIntlT_C MisfDet_stcCatRatMinCylIdn_C MisfDet_stcCatRatMinMpl_C MisfDet_stcCatThdStrt_CA MisfDet_stcCatThd_CA MisfDet_stcCatWghtFacPfiMax_C MisfDet_stcCatWghtFac_M MisfDet_stStcCatCfg_C /end DEF_CHARACTERISTIC
 /begin REF_CHARACTERISTIC MisfDet_stCfgOBD_C /end REF_CHARACTERISTIC
 /begin IN_MEASUREMENT Epm_nEng MisfDet_cylCntr MisfDet_nEngSync MisfDet_nrCylMisfNoId MisfDet_stBlkStc MisfDet_stCntMisf MisfDet_stFcmClr MisfDet_stFcmClr200ms MisfDet_stFltLstDcyc MisfDet_stFltPrevDcyc MisfDet_stInjLockdOpen MisfDet_stNoInjSync MisfDet_stReIni MisfDet_stReIni200ms MisfDet_stSimrCdn MisfDet_tEngStrt MisfDet_tqBasc MisfDet_tqBascSync SyC_stSub /end IN_MEASUREMENT
 /begin OUT_MEASUREMENT MisfDet_maskStcCatFltCylIdn MisfDet_maskStcCatFltMpl MisfDet_stCatDmg MisfDet_stCatDmgBnk MisfDet_stCatDmgCurrIntl MisfDet_stCatDmgLstIntl MisfDet_stcCatIgnCntr MisfDet_stcCatIntlLen MisfDet_stcCatMisfCntrBnk MisfDet_stcCatMisfCntrCyl MisfDet_stcCatMisfCntrSumNotWght MisfDet_stcCatThd MisfDet_stcCatWghtFac MisfDet_stStcCatIntlHealSimrCdn MisfDet_stStcCatStrt /end OUT_MEASUREMENT
 /begin LOC_MEASUREMENT MisfDet_stCatDmgBnkCurrIntl MisfDet_stCatDmgDebd MisfDet_stCatDmgDebMisfOutdRng MisfDet_stCatDmgDebOutOfRng MisfDet_stCatFltMpl MisfDet_StcCatCntrSimrCdn.misfBnk MisfDet_StcCatCntrSimrCdn.ign MisfDet_stcCatDmgDebIntlCntr MisfDet_stcCatDmgNrCyl MisfDet_stcCatIntlLenMaxSimrCdn MisfDet_stcCatThdMaxSimrCdn MisfDet_stStcCatRstCompl200ms /end LOC_MEASUREMENT
 FUNCTION_VERSION "1.24.1" /end FUNCTION
/begin FUNCTION MisfDet_StcExh "1.22.1    Misfire statistic for detection of exhaust limit exceedance"
 /begin DEF_CHARACTERISTIC MisfDet_stcEmiNrIntl_C MisfDet_stcEmiRatMinCylIdn_C MisfDet_stcEmiRatMinMpl_C MisfDet_stcEmiThdStrtCatHeat_C MisfDet_stcEmiThdStrt_C MisfDet_stcEmiThd_C /end DEF_CHARACTERISTIC
 /begin REF_CHARACTERISTIC MisfDet_stCfgOBD_C /end REF_CHARACTERISTIC
 /begin IN_MEASUREMENT MisfDet_cylCntr MisfDet_nrCylMisfNoId MisfDet_stBlkStc MisfDet_stCatHeat MisfDet_stCntMisf MisfDet_stFcmClr MisfDet_stFltPrevDcyc MisfDet_stReIni MisfDet_stSimrCdn /end IN_MEASUREMENT
 /begin OUT_MEASUREMENT MisfDet_maskStcEmiFltCylIdn MisfDet_maskStcEmiFltMpl MisfDet_stcEmiIgnCntr MisfDet_stcEmiIntlCntr MisfDet_stcEmiIntlDmgCntr MisfDet_stcEmiMisfCntrCyl MisfDet_stcEmiMisfCntrSum MisfDet_stcEmiThd MisfDet_stEmiDmgCurrIntl MisfDet_stStcEmiDmgLstIntl MisfDet_stStcEmiIntlHealSimrCdn MisfDet_stStcEmiIntlHealSimrCdnStrt MisfDet_stStcEmiStrt MisfDet_stStcEmiStrtSrv /end OUT_MEASUREMENT
 /begin LOC_MEASUREMENT MisfDet_stcEmiStructCntr.misfSum MisfDet_stcEmiStructCntr.misfCyl MisfDet_stcEmiStructCntr.ign MisfDet_stcEmiStructCntr.intl MisfDet_stcEmiStructCntr.dmgIntl MisfDet_stcEmiStructCntr.stCylDmgCylIdn MisfDet_stcEmiStructCntr.stCylDmgMtpl MisfDet_stcEmiStructSimrCdn.misfSum MisfDet_stcEmiStructSimrCdn.ign MisfDet_stcEmiStructSimrCdn.intl MisfDet_stcEmiStructSimrCdn.dmgIntl MisfDet_stcEmiStructSimrCdnStrt.misfSum MisfDet_stcEmiStructSimrCdnStrt.ign MisfDet_stcEmiStructSimrCdnStrt.intl MisfDet_stcEmiStructSimrCdnStrt.dmgIntl MisfDet_stEmiFltMpl MisfDet_stStcEmiFrzFrm MisfDet_stStcEmiStrtCatHeat /end LOC_MEASUREMENT
 FUNCTION_VERSION "1.22.1" /end FUNCTION
/begin FUNCTION MisfDet_StcIfDSM "1.21.2    Misfire interface to diagnostic system manager (DSM)"
 /begin DEF_CHARACTERISTIC DFC_CtlMsk2.DFC_MDCat_C DFC_CtlMsk2.DFC_MDCyl_C DFC_CtlMsk2.DFC_MDEmi_C DFC_CtlMsk2.DFC_MDEmiStrt_C DFC_CtlMsk2.DFC_MDMpl_C DFC_DisblMsk2.DFC_MDCat_C DFC_DisblMsk2.DFC_MDCyl_C DFC_DisblMsk2.DFC_MDEmi_C DFC_DisblMsk2.DFC_MDEmiStrt_C DFC_DisblMsk2.DFC_MDMpl_C MisfDet_ctDef_C MisfDet_ctOk_C MisfDet_stCfgOBD_C /end DEF_CHARACTERISTIC
 /begin IN_MEASUREMENT DSMAUX_stDCy DSM_TripChgFinshd MisfDet_stcEmiMisfCntrCyl MisfDet_stFcmClr100ms MisfDet_stStcCatIntlHealSimrCdn MisfDet_stStcEmiIntlHealSimrCdn MisfDet_stStcEmiIntlHealSimrCdnStrt SyC_stSub /end IN_MEASUREMENT
 /begin OUT_MEASUREMENT MisfDet_stFlt MisfDet_stFltCurrDcyc MisfDet_stFltCyl MisfDet_stFltLstDcyc MisfDet_stFltLstDcycNv MisfDet_stFltPrevDcyc MisfDet_stSimrCdn /end OUT_MEASUREMENT
 /begin LOC_MEASUREMENT MisfDet_ctDef MisfDet_ctOk MisfDet_ctOkFltTyp MisfDet_cylFrzFrmData MisfDet_simrCdn.n MisfDet_simrCdn.load MisfDet_simrCdn.T MisfDet_stFltCfmd MisfDet_stOk /end LOC_MEASUREMENT
 FUNCTION_VERSION "1.21.2" /end FUNCTION
/begin FUNCTION MisfDet_StcMisc "1.11.2    Miscellaneous misfire statistics (similar conditions, longterm calibration support, arv,)" /begin DEF_CHARACTERISTIC MisfDet_nrDcycDrvRcdrRst_C MisfDet_stStcMiscCfg_C /end DEF_CHARACTERISTIC
 /begin IN_MEASUREMENT Epm_nEng MisfDet_cylCntr MisfDet_stBlkStc MisfDet_stCntMisf SyC_stSub /end IN_MEASUREMENT
 /begin OUT_MEASUREMENT MisfDet_ignCntr MisfDet_misfCntrCyl MisfDet_misfCntrSum MisfDet_stExhDmgSuspc /end OUT_MEASUREMENT
 /begin LOC_MEASUREMENT MisfDet_nrDcycDrvRcdr /end LOC_MEASUREMENT
 FUNCTION_VERSION "1.11.2" /end FUNCTION
/begin FUNCTION MisfDet_ThdCalcn "1.22.1    Misfire detection, Threshold calculation"
 /begin DEF_CHARACTERISTIC MisfDet_dnThdContRdcFac_C MisfDet_dnThdContRdcIdx_C MisfDet_dnThdDecFilFac_C MisfDet_dnThdDecMaxCont_T MisfDet_dnThdDecMax_T MisfDet_dnThdFacStrt_T MisfDet_dnThdOffsTCatHeat_T MisfDet_dnThdOffsT_T MisfDet_dnThdTiMinDynLim_C MisfDet_stThdCalcnCfg_C /end DEF_CHARACTERISTIC
 /begin REF_CHARACTERISTIC MisfDet_dnFilFacMax_C /end REF_CHARACTERISTIC
 /begin IN_MEASUREMENT MisfDet_dnFltdCyl MisfDet_dnThdMapOut MisfDet_dnThdMapOutCont MisfDet_dnThdMinContOut MisfDet_nEngSync MisfDet_stCalcIntrpt MisfDet_stCatHeat MisfDet_tEng MisfDet_tiEngRun MisfDet_tiEngRunSum /end IN_MEASUREMENT
 /begin OUT_MEASUREMENT MisfDet_dnThd MisfDet_dnThdCont MisfDet_dnThdCor MisfDet_dnThdOffsT /end OUT_MEASUREMENT
 /begin LOC_MEASUREMENT MisfDet_dnThdContRdcVal MisfDet_dnThdCorCont MisfDet_dnThdDecLim MisfDet_dnThdDecLimCont MisfDet_dnThdDynLim MisfDet_dnThdDynLimCont MisfDet_dnThdFacStrt MisfDet_dnThdSyncContFiltd MisfDet_stDnThdDynLim /end LOC_MEASUREMENT
 FUNCTION_VERSION "1.22.1" /end FUNCTION
/begin FUNCTION MisfDet_ThdMapSeln "1.7.2     Base map selection for threshold calculation"
 /begin DEF_CHARACTERISTIC MisfDet_dnThdIdleTq_AX MisfDet_dnThdMapDrvCatHeatGrip.Std.Cmn_GM MisfDet_dnThdMapDrvCatHeatGrip.Cont.Cmn_GM MisfDet_dnThdMapDrvCatHeatOpen.Std.Cmn_GM MisfDet_dnThdMapDrvCatHeatOpen.Cont.Cmn_GM MisfDet_dnThdMapDrvCatHeatSlip.Std.Cmn_GM MisfDet_dnThdMapDrvCatHeatSlip.Cont.Cmn_GM MisfDet_dnThdMapIdle.Std.Cmn_GT MisfDet_dnThdMapIdle.Cont.Cmn_GT MisfDet_dnThdMapPtGrip.Std.Cmn_GM MisfDet_dnThdMapPtGrip.Cont.Cmn_GM MisfDet_dnThdMapPtOpen.Std.Cmn_GM MisfDet_dnThdMapPtOpen.Cont.Cmn_GM MisfDet_dnThdMapPtSlip.Std.Cmn_GM MisfDet_dnThdMapPtSlip.Cont.Cmn_GM MisfDet_dnThdMinCont.Cmn_GM MisfDet_dnThdN_AX MisfDet_dnThdTq_AX MisfDet_rGripMaxOpen_C MisfDet_rGripMinClsd_C MisfDet_stThdMapSelnCfg_C /end DEF_CHARACTERISTIC
 /begin IN_MEASUREMENT MisfDet_dnDly MisfDet_nEngSync MisfDet_stCalcIntrpt MisfDet_stCatHeat MisfDet_stIdle MisfDet_stOpenPt MisfDet_tqBascSync /end IN_MEASUREMENT
 /begin OUT_MEASUREMENT MisfDet_dnThdMapOut MisfDet_dnThdMapOutCont MisfDet_dnThdMinContOut /end OUT_MEASUREMENT
 /begin LOC_MEASUREMENT MisfDet_idxThdMap MisfDet_idxThdMapSync /end LOC_MEASUREMENT
 FUNCTION_VERSION "1.7.2" /end FUNCTION
/begin FUNCTION MoCADC_Co "81.2.0    Microcontroller Monitoring: AD-converter"
 /begin DEF_CHARACTERISTIC DFC_CtlMsk2.DFC_MoCADCNTP_C DFC_CtlMsk2.DFC_MoCADCTst_C DFC_DisblMsk2.DFC_MoCADCNTP_C DFC_DisblMsk2.DFC_MoCADCTst_C MoCADC_ctDebNTPThd_C MoCADC_ctDebNTP_C MoCADC_ctDebTstThd_C MoCADC_ctDebTst_C MoCADC_ctRstNTP_C MoCADC_ctRstTst_C MoCADC_uNTPMax_C MoCADC_uTstMax_C MoCADC_uTstMin_C /end DEF_CHARACTERISTIC
 /begin REF_CHARACTERISTIC Mo_swtClrCntrMax_C /end REF_CHARACTERISTIC
 /begin IN_MEASUREMENT MoExe_ctCyc Mo_ctRst Mo_ctRstCpl Mo_stCplChk Mo_stMoC Mo_stMoCCpl Mo_stMoF Mo_stMoFCpl /end IN_MEASUREMENT
 /begin OUT_MEASUREMENT MoCADC_bChkActv MoCADC_bDef MoCADC_bNTPActv MoCADC_bNTPErr MoCADC_bNTPRel MoCADC_bTstErr MoCADC_st MoCADC_stMsg Mo_flgIrrvErrNTPMsg Mo_flgIrrvErrTstMsg /end OUT_MEASUREMENT
 /begin LOC_MEASUREMENT MoCADC_ctDebNTP MoCADC_ctDebNTPCpl MoCADC_ctDebNTPExcddThdNv MoCADC_ctDebNTPMaxNv MoCADC_ctDebNTPOld MoCADC_ctDebTst MoCADC_ctDebTstCpl MoCADC_ctDebTstExcddThdNv MoCADC_ctDebTstMaxNv MoCADC_ctDebTstOld MoCADC_ctTstNTP MoCADC_ctTstTst MoCADC_flgClrNTP MoCADC_flgClrTst MoCADC_stCpl MoCADC_uNTP_mp MoCADC_uTst_mp /end LOC_MEASUREMENT
 FUNCTION_VERSION "81.2.0" /end FUNCTION
/begin FUNCTION MoCCom_Co "83.4.0    Microcontroller Monitoring: Query-response-communication between MM and FC"
 /begin DEF_CHARACTERISTIC MoCCom_ctBusErrThd_C MoCCom_ctErrFCThd_C MoCCom_ctErrMMThd_C MoCCom_ctErrPwrThd_C /end DEF_CHARACTERISTIC
 /begin REF_CHARACTERISTIC MoCSOP_ctDebSOPTst_C Mo_swtClrCntrMax_C /end REF_CHARACTERISTIC
 /begin IN_MEASUREMENT MoCCPU_PartResp MoCGTM_PtlResp MoCMem_st MoCMem_stCpl MoCPFC_PartResp MoCSOP_stActvMsg MoCSOP_stComActv MoCSOP_stComActvCpl MoCSOP_stRdy MoCSOP_stRdyCpl Mo_bECom Mo_stCplChk SyC_stSub /end IN_MEASUREMENT
 /begin OUT_MEASUREMENT MoCCom_bCPUNew MoCCom_bPFCNew MoCCom_ctErrFC MoCCom_ctErrMM MoCCom_ctErrMMMsg MoCCom_Query MoCCom_stQueryNew MoCCom_SwShrPtlResp /end OUT_MEASUREMENT
 /begin LOC_MEASUREMENT MoCCom_ctBusErr MoCCom_ctBusErrExcddThdNv MoCCom_ctBusErrMaxNv MoCCom_ctBusErrOld MoCCom_ctCorRespCnt MoCCom_ctErrFCCpl MoCCom_ctErrFCExcddThdNv MoCCom_ctErrFCMaxNv MoCCom_ctErrFCOld MoCCom_ctErrMMExcddThdNv MoCCom_ctErrMMMaxNv MoCCom_ctErrMMOld MoCCom_ctErrMMOldNv MoCCom_ctErrOSTimeout MoCCom_ctErrPwr MoCCom_ctErrPwrExcddThdNv MoCCom_ctErrPwrMaxNv MoCCom_ctErrPwrOld MoCCom_ctRespOffsetTst MoCCom_ctSOPNoRdy MoCCom_ctSOPTstActv MoCCom_Response MoCCom_Response_mp MoCCom_stCheckState MoCCom_stCheckStateCpl MoCCom_stComState MoCCom_stMm MoCCom_stMmRespCnt /end LOC_MEASUREMENT
 FUNCTION_VERSION "83.4.0" /end FUNCTION
/begin FUNCTION MoCCPU_Co "81.0.0    Microcontroller Monitoring: Instruction test" /begin DEF_CHARACTERISTIC MoCCPU_PtlRespTstActv_CW /end DEF_CHARACTERISTIC /begin IN_MEASUREMENT MoCCom_bCPUNew MoCCom_Query /end IN_MEASUREMENT /begin OUT_MEASUREMENT MoCCPU_PartResp MoCCPU_Query /end OUT_MEASUREMENT /begin LOC_MEASUREMENT MoCCPU_ctSeq MoCCPU_IpoIn MoCCPU_TempRes /end LOC_MEASUREMENT FUNCTION_VERSION "81.0.0" /end FUNCTION
/begin FUNCTION MoCEMM_Co "2.2.0     Microcontroller Monitoring: Error Management Module(EMM)" /begin DEF_CHARACTERISTIC MoCEMM_ChkRAMTst_CW MoCEMM_ChkROMTst_CW /end DEF_CHARACTERISTIC /begin IN_MEASUREMENT MoCMem_st MoCMem_stCpl /end IN_MEASUREMENT
 /begin LOC_MEASUREMENT MoCEMM_ChkRAMTst MoCEMM_ChkROMTst MoCEMM_tiRamCheck MoCEMM_tiRomCheck MoCEMM_wdgTout /end LOC_MEASUREMENT
 FUNCTION_VERSION "2.2.0" /end FUNCTION
/begin FUNCTION MoCGTM_Co "81.2.0    Microcontroller Monitoring: Generic Timer Module (GTM)"
 /begin DEF_CHARACTERISTIC MoCGTM_cntrCMPErrbitHealMax_C MoCGTM_cntrDebErrMax_C MoCGTM_cntrDebErrThd_C MoCGTM_cntrRouteSigErrThd_C MoCGTM_stChksTstActv_CW MoCGTM_stSWResetDem_CW MoCGTM_stTestActv_CW /end DEF_CHARACTERISTIC
 /begin REF_CHARACTERISTIC Mo_swtClrCntrMax_C /end REF_CHARACTERISTIC
 /begin IN_MEASUREMENT MoCMem_st MoCMem_stCpl Mo_stCplChk Mo_stMoC Mo_stMoCCpl /end IN_MEASUREMENT
 /begin OUT_MEASUREMENT MoCGTM_bbOut1 MoCGTM_flgCmpErr MoCGTM_PtlResp /end OUT_MEASUREMENT
 /begin LOC_MEASUREMENT MoCGTM_aryCMPErrBit MoCGTM_aryCMPErrBitCpl MoCGTM_bbOut1Cpl MoCGTM_cmpErrAryIdx MoCGTM_cmpErrAryIdxCpl MoCGTM_cntrBadcase MoCGTM_cntrCMPErrbit MoCGTM_cntrCMPErrbitCpl MoCGTM_cntrCMPErrbitHeal MoCGTM_cntrCMPErrbitHealCpl MoCGTM_cntrDebErr MoCGTM_cntrDebErrCpl MoCGTM_cntrDebErrExcddThdNv MoCGTM_cntrDebErrMax MoCGTM_cntrDebErrMaxNv MoCGTM_cntrDebErrOld MoCGTM_cntrMCS1 MoCGTM_cntrMCS1Old MoCGTM_cntrMCS1OldCpl MoCGTM_cntrMCS2 MoCGTM_cntrMCS2Old MoCGTM_cntrMCS2OldCpl MoCGTM_cntrMsmCMPErrBit MoCGTM_cntrRouteSigErr MoCGTM_cntrRouteSigErrCpl MoCGTM_cntrRouteSigErrExcddThdNv MoCGTM_cntrRouteSigErrMaxNv MoCGTM_cntrRouteSigErrOld MoCGTM_currChksVal MoCGTM_currChksValCpl MoCGTM_currMCSModlAryIdx MoCGTM_McsData_ptr1Cpl MoCGTM_McsData_ptr2Cpl MoCGTM_numMCS1Ch MoCGTM_numMCS1Modl MoCGTM_numMCS2Ch MoCGTM_numMCS2Modl MoCGTM_PtlRespCpl MoCGTM_stBadcaseTrig MoCGTM_stErr MoCGTM_stErrChks MoCGTM_stErrCpl MoCGTM_tiCurrMCSVal MoCGTM_tiCurrTskcall MoCGTM_tiExeMCS1_MP MoCGTM_tiExeMCS2_MP MoCGTM_tiFallEdgeBadcase_MP MoCGTM_tiFallEdgeMCS1_MP MoCGTM_tiFallEdgeMCS2_MP MoCGTM_tiMCSTIMRead MoCGTM_tiPrevMCS1Trig_MP MoCGTM_tiPrevMCS2Trig_MP MoCGTM_tiPrevTskcall MoCGTM_tiRisngEdgeMCS1_MP MoCGTM_tiRisngEdgeMCS2_MP MoCGTM_tiTskCalldst_MP /end LOC_MEASUREMENT
 FUNCTION_VERSION "81.2.0" /end FUNCTION
/begin FUNCTION MoCMem_Co "81.4.0    Microcontroller Monitoring: Cyclic memory test"
 /begin DEF_CHARACTERISTIC MoCMem_ctDebErrChkRAMThd_C MoCMem_ctDebErrChkRAM_C MoCMem_ctDebErrChkROMThd_C MoCMem_ctDebErrChkROM_C MoCMem_ctDebHealChkRAMCpl_C MoCMem_ctDebHealChkRAM_C MoCMem_ctDebHealChkROMCpl_C MoCMem_ctDebHealChkROM_C MoCMem_noMEMChkRstCpl_CW MoCMem_noMEMChkRst_CW MoCMem_numRamChk_C MoCMem_numRomChk_CA MoCMem_numStckChk_C MoCMem_RamTst_CW MoCMem_RomTst_CW MoCMem_stSwtAutRamChkConf_C MoCMem_stSwtAutRomChkConf_C /end DEF_CHARACTERISTIC
 /begin REF_CHARACTERISTIC Mo_swtClrCntrMax_C /end REF_CHARACTERISTIC
 /begin IN_MEASUREMENT MoExe_ctCyc Mo_stCplChk Mo_stMoC Mo_stMoCCpl /end IN_MEASUREMENT
 /begin OUT_MEASUREMENT MoCMem_nrPostBldChks MoCMem_st MoCMem_stCpl Mo_bECom Mo_bEMem Mo_bEPcp Mo_bERam Mo_bERomSPg Mo_bERomXPg Mo_bReqRamChkExt Mo_bReqRomChkExt /end OUT_MEASUREMENT
 /begin LOC_MEASUREMENT MoCMem_adChkSumBlk MoCMem_adChkSumBlkCpl MoCMem_adrChkStckEnd MoCMem_adrChkStckStrt MoCMem_ctDebErrChkRAM MoCMem_ctDebErrChkRAMCpl MoCMem_ctDebErrChkRAMExcddThdNv MoCMem_ctDebErrChkRAMMaxNv MoCMem_ctDebErrChkRAMOld MoCMem_ctDebErrChkROM MoCMem_ctDebErrChkROMCpl MoCMem_ctDebErrChkROMExcddThdNv MoCMem_ctDebErrChkROMMaxNv MoCMem_ctDebErrChkROMOld MoCMem_ctDebHealChkRAM MoCMem_ctDebHealChkRAMCpl MoCMem_ctDebHealChkROM MoCMem_ctDebHealChkROMCpl MoCMem_idxCSAry MoCMem_idxCSAryCpl MoCMem_nrRamChk MoCMem_nrRamChkCpl MoCMem_nrRamChkSize MoCMem_nrRomChk MoCMem_nrRomChkCpl MoCMem_nrRomChkSize MoCMem_numChkSumCurrent MoCMem_numChkSumCurrentCpl MoCMem_RamOffsetPtr MoCMem_RamOffsetPtrCpl MoCMem_RomCurrentPtr MoCMem_RomCurrentPtrCpl MoCMem_stDataCycChkBlk MoCMem_stDataCycChkBlkCpl MoCMem_Temp1Ptr MoCMem_Temp2Ptr /end LOC_MEASUREMENT
 FUNCTION_VERSION "81.4.0" /end FUNCTION
/begin FUNCTION MoCPFC_Co "14.2.0    Microcontroller Monitoring: Program flow check" /begin IN_MEASUREMENT MoCCom_bPFCNew MoCCom_Query /end IN_MEASUREMENT /begin OUT_MEASUREMENT MoCPFC_Checksum MoCPFC_PartResp /end OUT_MEASUREMENT /begin LOC_MEASUREMENT MoCPFC_Checkword MoCPFC_Counter /end LOC_MEASUREMENT FUNCTION_VERSION "14.2.0" /end FUNCTION
/begin FUNCTION MoCSOP_Co "9001.2.0  Microcontroller Monitoring: Shut-off path test"
 /begin DEF_CHARACTERISTIC MoCSOP_ctDebSOPTst_C MoCSOP_stCANErrReac_CW MoCSOP_stMMErrReac_CW /end DEF_CHARACTERISTIC
 /begin IN_MEASUREMENT MoCMem_st MoCMem_stCpl Mo_stCplChk /end IN_MEASUREMENT
 /begin OUT_MEASUREMENT MoCSOP_stActMsg MoCSOP_stActvMsg MoCSOP_stComActv MoCSOP_stComActvCpl MoCSOP_stRdy MoCSOP_stRdyCpl MoCSOP_stRdyMsg /end OUT_MEASUREMENT
 /begin LOC_MEASUREMENT MoCSOP_cntrWaitMMCANCfg MoCSOP_ctBusErr MoCSOP_ctDebSOPTst MoCSOP_ctErrMM MoCSOP_ctErrOSTimeout MoCSOP_ctErrRespTime MoCSOP_ctRespOffsetTst MoCSOP_numQuery MoCSOP_RAMInitCorrResp1 MoCSOP_RAMInitCorrResp2 MoCSOP_stBusErr MoCSOP_stErr MoCSOP_stMm MoCSOP_stMmRespCnt /end LOC_MEASUREMENT
 FUNCTION_VERSION "9001.2.0" /end FUNCTION
/begin FUNCTION MoExe_Co "666.0.0   Monitoring: Execution control" /begin OUT_MEASUREMENT MoExe_ctCyc /end OUT_MEASUREMENT FUNCTION_VERSION "666.0.0" /end FUNCTION
/begin FUNCTION MoFGearLvr_In "387.0.1   Function Monitoring: Gear lever input signals"
 /begin DEF_CHARACTERISTIC MoFGearLvr_cntrDeb_C MoFGearLvr_stInvNeut_C MoFGearLvr_uActvnValMax_C MoFGearLvr_uActvnValMin_C MoFGearLvr_uDeactvnValMax_C MoFGearLvr_uDeactvnValMin_C /end DEF_CHARACTERISTIC
 /begin IN_MEASUREMENT Mo_stCplChk Mo_stMoC Mo_stMoCCpl /end IN_MEASUREMENT
 /begin OUT_MEASUREMENT MoFGearLvr_flgNeutGear /end OUT_MEASUREMENT
 /begin LOC_MEASUREMENT MoFGearLvrIn_bblOutCpl MoFGearLvr_cntrDeb MoFGearLvr_cntrDebCpl MoFGearLvr_flgGearLvrRaw_MP MoFGear_ratGearlvrcorr MoFGear_ratGearlvrcorrCpl /end LOC_MEASUREMENT
 FUNCTION_VERSION "387.0.1" /end FUNCTION
/begin FUNCTION MoFIn_Co "9104.0.0  Function Monitoring: Input signals"
 /begin IN_MEASUREMENT azoffmsk_w evz_auscpl evz_austot Mo_stCplChk Mo_stMoC Mo_stMoCCpl /end IN_MEASUREMENT
 /begin OUT_MEASUREMENT MoFIn_stICOInjL1 MoFIn_stIgnFadeOutMskL1 /end OUT_MEASUREMENT
 /begin LOC_MEASUREMENT MoFIn_stICOInjL1Cpl MoFIn_stIgnFadeOutMskL1Cpl /end LOC_MEASUREMENT
 FUNCTION_VERSION "9104.0.0" /end FUNCTION
/begin COMPU_METHOD accgrd_q0p025_m_DIV_s3 "" RAT_FUNC "%6.4" "m/s^3" COEFFS 0 40 0 0 0 1 /end COMPU_METHOD
/begin COMPU_METHOD acc_q0p02 "" RAT_FUNC "%6.4" "m/(s^2)" COEFFS 0 50 0 0 0 1 /end COMPU_METHOD
/begin COMPU_METHOD B_TRUE "" TAB_VERB "%6.3" "" COMPU_TAB_REF B_TRUE /end COMPU_METHOD
/begin COMPU_VTAB B_TRUE "" TAB_VERB 2 0 "FALSE" 1 "TRUE" /end COMPU_VTAB
/begin COMPU_METHOD Compu_SegPosnInt_VERB "" TAB_VERB "%6.3" "" COMPU_TAB_REF Compu_SegPosnInt_VERB /end COMPU_METHOD
/begin COMPU_VTAB Compu_SegPosnInt_VERB "" TAB_VERB 4 0 "Std" 256 "Altv" 257 "Idle" 258 "PfltRgn" /end COMPU_VTAB
/begin COMPU_METHOD dez "" RAT_FUNC "%6.2" "" COEFFS 0 1 0 0 0 1 /end COMPU_METHOD
/begin COMPU_METHOD DFES_OneToOne "" RAT_FUNC "%6.2" "-" COEFFS 0 1 0 0 0 1 /end COMPU_METHOD
/begin COMPU_METHOD dn_Compu "" RAT_FUNC "%6.4" "rad/s^2" COEFFS 0 16 0 0 0 1 /end COMPU_METHOD
/begin COMPU_METHOD EngN "" RAT_FUNC "%6.3" "rpm" COEFFS 0 2 0 0 0 1 /end COMPU_METHOD
/begin COMPU_METHOD Fact100 "" RAT_FUNC "%6.4" "-" COEFFS 0 100 0 0 0 1 /end COMPU_METHOD
/begin COMPU_METHOD fak_uw_b1 "" RAT_FUNC "%7.6" "-" COEFFS 0 65536 0 0 0 1 /end COMPU_METHOD
/begin COMPU_METHOD fak_uw_b2 "" RAT_FUNC "%7.6" "-" COEFFS 0 65536 0 0 0 2 /end COMPU_METHOD
/begin COMPU_METHOD kw_q1p8310eEm4 "" RAT_FUNC "%6.5" "deg_32CrS" COEFFS 0 32768 0 0 0 6 /end COMPU_METHOD
/begin COMPU_METHOD kw_tooth_sy "" RAT_FUNC "%6.1" "deg KW" COEFFS 0 0.1 0 0 0 1 /end COMPU_METHOD
/begin COMPU_METHOD len_q50_m "" RAT_FUNC "%6.1" "m" COEFFS 0 0.02 0 0 0 1 /end COMPU_METHOD
/begin COMPU_METHOD MisfDet_idxThdMap_VERB "" TAB_VERB "%6.3" "" COMPU_TAB_REF MisfDet_idxThdMap_VERB /end COMPU_METHOD
/begin COMPU_VTAB MisfDet_idxThdMap_VERB "" TAB_VERB 22 0 "PtOpen" 1 "PtSlip" 12 "IdleStrat" 13 "IdleLamSplit" 14 "IdleAltvPosn" 15 "IdleThermCoorn" 16 "IdleCatWrm" 17 "IdleCatHeat" 18 "IdlePfltRgn" 19 "IdleAltvPosnLamSplit" 20 "EclOpen" 2 "PtGrip" 3 "Hem" 4 "DrvStrat" 5 "DrvCatHeatOpen" 6 "DrvCatHeatSlip" 7 "DrvCatHeatGrip" 8 "PfltRgnPtOpen" 9 "PfltRgnPtSlip" 10 "PfltRgnPtGrip" 11 "Idle" 21 "EclSlip" /end COMPU_VTAB
/begin COMPU_METHOD nmot_uw_q0p25 "" RAT_FUNC "%6.3" "1/min" COEFFS 0 1 0 0 0 0.25 /end COMPU_METHOD
/begin COMPU_METHOD OneToOne "" RAT_FUNC "%6.2" "-" COEFFS 0 1 0 0 0 1 /end COMPU_METHOD
/begin COMPU_METHOD Prc_q0p1_COMPU "" RAT_FUNC "%6.3" "%" COEFFS 0 10 0 0 0 1 /end COMPU_METHOD
/begin COMPU_METHOD PREDRV_T15RST_SY_Compu "" TAB_VERB "%6.3" "" COMPU_TAB_REF PREDRV_T15RST_SY_Compu /end COMPU_METHOD
/begin COMPU_VTAB PREDRV_T15RST_SY_Compu "" TAB_VERB 2 0 "False" 1 "True" /end COMPU_VTAB
/begin COMPU_METHOD Pres "" RAT_FUNC "%6.3" "kPa" COEFFS 0 10 0 0 0 1 /end COMPU_METHOD
/begin COMPU_METHOD PresAC_hPa "" RAT_FUNC "%6.2" "hPa" COEFFS 0 0.5 0 0 0 1 /end COMPU_METHOD
/begin COMPU_METHOD PreshPa_FnReso "" RAT_FUNC "%6.3" "hPa" COEFFS 0 10 0 0 0 1 /end COMPU_METHOD
/begin COMPU_METHOD PreshPa_HiRes "" RAT_FUNC "%6.4" "hPa" COEFFS 0 100 0 0 0 1 /end COMPU_METHOD
/begin COMPU_METHOD PresInv_hPa "" RAT_FUNC "%10.9" "1/hPa" COEFFS 0 10000000 0 0 0 1 /end COMPU_METHOD
/begin COMPU_METHOD PresRail_sec "" RAT_FUNC "%6.0" "hPa/s" COEFFS 0 0.0025 0 0 0 1 /end COMPU_METHOD
/begin COMPU_METHOD PresRail_Sec_HiRes_COMPU "" RAT_FUNC "%7.0" "hPa/s" COEFFS 0 0.000166666666666667 0 0 0 1 /end COMPU_METHOD
/begin COMPU_METHOD Pres_LoRes_COMPU "" RAT_FUNC "%6.4" "MPa" COEFFS 0 100 0 0 0 1 /end COMPU_METHOD
/begin COMPU_METHOD Pres_Rail "" RAT_FUNC "%6.0" "hPa" COEFFS 0 0.01 0 0 0 1 /end COMPU_METHOD
/begin COMPU_METHOD Pres_SI "" RAT_FUNC "%6.0" "Pa" COEFFS 0 0.01 0 0 0 1 /end COMPU_METHOD
/begin COMPU_METHOD PSC_Fact "" RAT_FUNC "%7.6" "-" COEFFS 0 32767 0 0 0 1 /end COMPU_METHOD
/begin COMPU_METHOD PSSC0MSEPF_SC_Compu "" TAB_VERB "%6.3" "" COMPU_TAB_REF PSSC0MSEPF_SC_Compu /end COMPU_METHOD
/begin COMPU_VTAB PSSC0MSEPF_SC_Compu "" TAB_VERB 2 0 "0" 1 "1" /end COMPU_VTAB
/begin COMPU_METHOD PSSC684VRNTSELN_SY_Compu "" TAB_VERB "%6.3" "" COMPU_TAB_REF PSSC684VRNTSELN_SY_Compu /end COMPU_METHOD
/begin COMPU_VTAB PSSC684VRNTSELN_SY_Compu "" TAB_VERB 2 0 "No_Variant" 1 "Common" /end COMPU_VTAB
/begin COMPU_METHOD PTO_SY_Compu "" TAB_VERB "%6.3" "" COMPU_TAB_REF PTO_SY_Compu /end COMPU_METHOD
/begin COMPU_VTAB PTO_SY_Compu "" TAB_VERB 2 0 "False" 1 "True" /end COMPU_VTAB
/begin COMPU_METHOD Pwr "" RAT_FUNC "%6.2" "W" COEFFS 0 0.10610329539459 0 0 0 1 /end COMPU_METHOD
/begin COMPU_METHOD Pwr1 "" RAT_FUNC "%6.3" "W" COEFFS 0 10 0 0 0 1 /end COMPU_METHOD
/begin COMPU_METHOD Pwr2 "" RAT_FUNC "%6.1" "W" COEFFS 0 0.0530516476972949 0 0 0 1 /end COMPU_METHOD
/begin COMPU_METHOD Pwr2Temp_q0p001 "" RAT_FUNC "%6.4" "W/K" COEFFS 0 100 0 0 0 1 /end COMPU_METHOD
/begin COMPU_METHOD Pwr2Temp_q0p1 "" RAT_FUNC "%6.3" "W/K" COEFFS 0 10 0 0 0 1 /end COMPU_METHOD
/begin COMPU_METHOD PwrSq2TempSq_q0p01 "" RAT_FUNC "%6.4" "W^2/K^2" COEFFS 0 100 0 0 0 1 /end COMPU_METHOD
/begin COMPU_METHOD Pwr_kW "" RAT_FUNC "%6.4" "kW" COEFFS 0 100 0 0 0 1 /end COMPU_METHOD
/begin COMPU_METHOD Pwr_q1 "" RAT_FUNC "%6.2" "W" COEFFS 0 1 0 0 0 1 /end COMPU_METHOD
/begin COMPU_METHOD Pwr_W_q4p0_COMPU "" RAT_FUNC "%6.2" "W" COEFFS 0 1 0 0 0 4 /end COMPU_METHOD
/begin COMPU_METHOD P_hPa_q0p078125_COMPU "" RAT_FUNC "%6.4" "hPa" COEFFS 0 12.8 0 0 0 1 /end COMPU_METHOD
/begin COMPU_METHOD QntR "" RAT_FUNC "%6.5" "-" COEFFS 0 1024 0 0 0 1 /end COMPU_METHOD
/begin COMPU_METHOD Qp_mm3_sec "" RAT_FUNC "%6.1" "mm3/s" COEFFS 0 0.1 0 0 0 1 /end COMPU_METHOD
/begin COMPU_METHOD QUICKSHIFT_SC_Compu "" TAB_VERB "%6.3" "" COMPU_TAB_REF QUICKSHIFT_SC_Compu /end COMPU_METHOD
/begin COMPU_VTAB QUICKSHIFT_SC_Compu "" TAB_VERB 2 0 "False" 1 "True" /end COMPU_VTAB
/begin COMPU_METHOD RailHrsEngOn "" RAT_FUNC "%6.0" "h" COEFFS 0 0.01 0 0 0 1 /end COMPU_METHOD
/begin COMPU_METHOD RatAirMass "" RAT_FUNC "%6.4" "-" COEFFS 0 100 0 0 0 1 /end COMPU_METHOD
/begin COMPU_METHOD RatAirMassHigh "" RAT_FUNC "%6.5" "-" COEFFS 0 1000 0 0 0 1 /end COMPU_METHOD
/begin COMPU_METHOD RatAirMassPerTime_COMPU "" RAT_FUNC "%6.3" "1/s" COEFFS 0 10 0 0 0 1 /end COMPU_METHOD
/begin COMPU_METHOD RatAirPres_COMPU "" RAT_FUNC "%6.5" "-" COEFFS 0 1000 0 0 0 1 /end COMPU_METHOD
/begin COMPU_METHOD RatCOMass "" RAT_FUNC "%9.8" "-" COEFFS 0 1000000 0 0 0 1 /end COMPU_METHOD
/begin COMPU_METHOD RatFuelMass "" RAT_FUNC "%6.4" "-" COEFFS 0 100 0 0 0 1 /end COMPU_METHOD
/begin COMPU_METHOD RatHiRes_COMPU "" RAT_FUNC "%6.5" "-" COEFFS 0 1000 0 0 0 1 /end COMPU_METHOD
/begin COMPU_METHOD RatHiRes_CPP_COMPU "" RAT_FUNC "%7.6" "-" COEFFS 0 10000 0 0 0 1 /end COMPU_METHOD
/begin COMPU_METHOD RatNOxMass "" RAT_FUNC "%10.9" "-" COEFFS 0 10000000 0 0 0 1 /end COMPU_METHOD
/begin COMPU_METHOD RatSotSot "" RAT_FUNC "%6.5" "-" COEFFS 0 4000 0 0 0 1 /end COMPU_METHOD
/begin COMPU_METHOD RatSOxMass "" RAT_FUNC "%11.10" "-" COEFFS 0 100000000 0 0 0 1 /end COMPU_METHOD
/begin COMPU_METHOD RBA_SWTRACEENA_SC_Compu "" TAB_VERB "%6.3" "" COMPU_TAB_REF RBA_SWTRACEENA_SC_Compu /end COMPU_METHOD
/begin COMPU_VTAB RBA_SWTRACEENA_SC_Compu "" TAB_VERB 2 0 "False" 1 "True" /end COMPU_VTAB
/begin COMPU_METHOD RBPtCel_a_1p0_1 "" RAT_FUNC "%6.2" "m/s^2" COEFFS 0 1 0 0 0 1 /end COMPU_METHOD
/begin COMPU_METHOD RBPtCel_dst_1p0_4 "" RAT_FUNC "%6.2" "km" COEFFS 0 1 0 0 0 1 /end COMPU_METHOD
/begin COMPU_METHOD RBPtCel_fac_1p0_8 "" RAT_FUNC "%6.2" "%/s" COEFFS 0 1 0 0 0 1 /end COMPU_METHOD
/begin COMPU_METHOD RBPtCel_fPerp_1p0_1 "" RAT_FUNC "%6.2" "N/Bar" COEFFS 0 1 0 0 0 1 /end COMPU_METHOD
/begin COMPU_METHOD RBPtCel_frq_1p0_1 "" RAT_FUNC "%6.2" "1/s" COEFFS 0 1 0 0 0 1 /end COMPU_METHOD
/begin COMPU_METHOD RBPtCel_fti_1p0_1 "" RAT_FUNC "%6.2" "Ns" COEFFS 0 1 0 0 0 1 /end COMPU_METHOD
/begin COMPU_METHOD RBPtCel_f_1p0_1 "" RAT_FUNC "%6.2" "N" COEFFS 0 1 0 0 0 1 /end COMPU_METHOD
/begin COMPU_METHOD RBPtCel_i_1p0_1 "" RAT_FUNC "%6.2" "mA" COEFFS 0 1 0 0 0 1 /end COMPU_METHOD
/begin COMPU_METHOD RBPtCel_i_1p0_2 "" RAT_FUNC "%6.2" "A" COEFFS 0 1 0 0 0 1 /end COMPU_METHOD
/begin COMPU_METHOD RBPtCel_nGrdt_1p0_1 "" RAT_FUNC "%6.2" "rpm/s" COEFFS 0 1 0 0 0 1 /end COMPU_METHOD
/begin COMPU_METHOD RBPtCel_n_1p0_1 "" RAT_FUNC "%6.2" "rpm" COEFFS 0 1 0 0 0 1 /end COMPU_METHOD
/begin COMPU_METHOD RBPtCel_Perc_1p0_1 "" RAT_FUNC "%6.2" "%" COEFFS 0 1 0 0 0 1 /end COMPU_METHOD
/begin COMPU_METHOD RBPtCel_p_1p0_2 "" RAT_FUNC "%6.2" "Bar" COEFFS 0 1 0 0 0 1 /end COMPU_METHOD
/begin COMPU_METHOD RBPtCel_ti_0p4_1 "" RAT_FUNC "%6.3" "us" COEFFS 0 5 0 0 0 2 /end COMPU_METHOD
/begin COMPU_METHOD RBPtCel_ti_1p0_2 "" RAT_FUNC "%6.2" "s" COEFFS 0 1 0 0 0 1 /end COMPU_METHOD
/begin COMPU_METHOD RBPtCel_tq_1p0_1 "" RAT_FUNC "%6.2" "Nm" COEFFS 0 1 0 0 0 1 /end COMPU_METHOD
/begin COMPU_METHOD RBPtCel_t_1p0_3 "" RAT_FUNC "%6.2" "Deg C" COEFFS 0 1 0 0 0 1 /end COMPU_METHOD
/begin COMPU_METHOD RBPtCel_u_1p0_1 "" RAT_FUNC "%6.2" "V" COEFFS 0 1 0 0 0 1 /end COMPU_METHOD
/begin COMPU_METHOD RBPtCel_vf_1p0_2 "" RAT_FUNC "%6.2" "l/min" COEFFS 0 1 0 0 0 1 /end COMPU_METHOD
/begin COMPU_METHOD RBPtCel_v_1p0_1 "" RAT_FUNC "%6.2" "km/h" COEFFS 0 1 0 0 0 1 /end COMPU_METHOD
/begin COMPU_METHOD rel_q9p31323Em8 "" RAT_FUNC "%10.9" "%" COEFFS 0 10737418.24 0 0 0 1 /end COMPU_METHOD
/begin COMPU_METHOD rel_ub_b99p6 "" RAT_FUNC "%6.3" "%" COEFFS 0 256 0 0 0 100 /end COMPU_METHOD
/begin COMPU_METHOD rel_uw_b100 "" RAT_FUNC "%6.4" "%" COEFFS 0 65536 0 0 0 100 /end COMPU_METHOD
/begin COMPU_METHOD rel_uw_q0p001 "" RAT_FUNC "%6.5" "%" COEFFS 0 1000 0 0 0 1 /end COMPU_METHOD
/begin COMPU_METHOD Resist "" RAT_FUNC "%6.3" "Ohm" COEFFS 0 10 0 0 0 1 /end COMPU_METHOD
/begin COMPU_METHOD ResPerMass_hPaHrPerCM "" RAT_FUNC "%7.6" "(hPa(m^3/h))/g" COEFFS 0 10000 0 0 0 1 /end COMPU_METHOD
/begin COMPU_METHOD Res_hPaHrPerCM "" RAT_FUNC "%7.6" "hPa/(m^3/h)" COEFFS 0 10000 0 0 0 1 /end COMPU_METHOD
/begin COMPU_METHOD Res_hPaSPerCM "" RAT_FUNC "%6.5" "hPa/(m^3*s/h)" COEFFS 0 1000 0 0 0 1 /end COMPU_METHOD
/begin COMPU_METHOD spg_q0p00977 "" RAT_FUNC "%6.4" "V" COEFFS 0 256 0 0 0 2.5 /end COMPU_METHOD
/begin COMPU_METHOD spg_q4p88_mV "" RAT_FUNC "%6.2" "mV" COEFFS 0 1024 0 0 0 5000 /end COMPU_METHOD
/begin COMPU_METHOD spg_uw_q0p00488 "" RAT_FUNC "%6.4" "V" COEFFS 0 1024 0 0 0 5 /end COMPU_METHOD
/begin COMPU_METHOD t1msxs_b65p535 "" RAT_FUNC "%6.5" "s" COEFFS 0 65535 0 0 0 65.535 /end COMPU_METHOD
/begin COMPU_METHOD t20ms_ub_b5100 "" RAT_FUNC "%7.2" "ms" COEFFS 0 1 0 0 0 20 /end COMPU_METHOD
/begin COMPU_METHOD Temp_Cels "" RAT_FUNC "%6.1" "deg C" COEFFS 0 10 2731.4 0 0 1 /end COMPU_METHOD
/begin COMPU_METHOD tsquant_l "" RAT_FUNC "%6.4" "us" COEFFS 0 20 0 0 0 1 /end COMPU_METHOD
/begin COMPU_METHOD t_q0p1 "" RAT_FUNC "%6.3" "s" COEFFS 0 10 0 0 0 1 /end COMPU_METHOD
/begin COMPU_METHOD Vel "" RAT_FUNC "%6.4" "km/h" COEFFS 0 100 0 0 0 1 /end COMPU_METHOD
/begin COMPU_METHOD vfzg_uw_b90_m_DIV_s "" RAT_FUNC "%6.4" "m/s" COEFFS 0 65536 0 0 0 90.278 /end COMPU_METHOD
/begin COMPU_METHOD default "" RAT_FUNC "%6.2" "" COEFFS 0 1 0 0 0 1 /end COMPU_METHOD
/begin RECORD_LAYOUT RB_Axis_S16 NO_AXIS_PTS_X 1 SWORD AXIS_PTS_X 2 SWORD INDEX_INCR DIRECT /end RECORD_LAYOUT
/begin RECORD_LAYOUT RB_Axis_U16 NO_AXIS_PTS_X 1 UWORD AXIS_PTS_X 2 UWORD INDEX_INCR DIRECT /end RECORD_LAYOUT
/begin RECORD_LAYOUT RB_CurveGroup_S16 FNC_VALUES 1 SWORD COLUMN_DIR DIRECT /end RECORD_LAYOUT
/begin RECORD_LAYOUT RB_Curve_S16_S16 NO_AXIS_PTS_X 1 SWORD AXIS_PTS_X 2 SWORD INDEX_INCR DIRECT FNC_VALUES 3 SWORD COLUMN_DIR DIRECT /end RECORD_LAYOUT
/begin RECORD_LAYOUT RB_Curve_S16_U16_Static NO_AXIS_PTS_X 1 SWORD AXIS_PTS_X 2 SWORD INDEX_INCR DIRECT FNC_VALUES 3 UWORD COLUMN_DIR DIRECT STATIC_RECORD_LAYOUT /end RECORD_LAYOUT
/begin RECORD_LAYOUT RB_Curve_U16_U16 NO_AXIS_PTS_X 1 UWORD AXIS_PTS_X 2 UWORD INDEX_INCR DIRECT FNC_VALUES 3 UWORD COLUMN_DIR DIRECT /end RECORD_LAYOUT
/begin RECORD_LAYOUT RB_MapGroup_S16 FNC_VALUES 1 SWORD COLUMN_DIR DIRECT /end RECORD_LAYOUT
/begin RECORD_LAYOUT RB_Map_S16U16_U8 NO_AXIS_PTS_X 1 SWORD NO_AXIS_PTS_Y 2 SWORD AXIS_PTS_X 3 SWORD INDEX_INCR DIRECT AXIS_PTS_Y 4 UWORD INDEX_INCR DIRECT FNC_VALUES 5 UBYTE ROW_DIR DIRECT /end RECORD_LAYOUT
/begin RECORD_LAYOUT RB_Map_U16S16_U16 NO_AXIS_PTS_X 1 UWORD NO_AXIS_PTS_Y 2 UWORD AXIS_PTS_X 3 UWORD INDEX_INCR DIRECT AXIS_PTS_Y 4 SWORD INDEX_INCR DIRECT FNC_VALUES 5 UWORD COLUMN_DIR DIRECT /end RECORD_LAYOUT
/begin RECORD_LAYOUT RB_ValA_Ws16 FNC_VALUES 1 SWORD COLUMN_DIR DIRECT /end RECORD_LAYOUT
/begin RECORD_LAYOUT RB_ValA_Wu16 FNC_VALUES 1 UWORD COLUMN_DIR DIRECT /end RECORD_LAYOUT
/begin RECORD_LAYOUT RB_Val_Ws16 FNC_VALUES 1 SWORD COLUMN_DIR DIRECT /end RECORD_LAYOUT
/begin RECORD_LAYOUT RB_Val_Ws8 FNC_VALUES 1 SBYTE COLUMN_DIR DIRECT /end RECORD_LAYOUT
/begin RECORD_LAYOUT RB_Val_Wu16 FNC_VALUES 1 UWORD COLUMN_DIR DIRECT /end RECORD_LAYOUT
/begin RECORD_LAYOUT RB_Val_Wu8 FNC_VALUES 1 UBYTE COLUMN_DIR DIRECT /end RECORD_LAYOUT
/begin RECORD_LAYOUT ValA_Wu16 FNC_VALUES 1 UWORD COLUMN_DIR DIRECT /end RECORD_LAYOUT
/begin RECORD_LAYOUT Val_Ws16 FNC_VALUES 1 SWORD COLUMN_DIR DIRECT /end RECORD_LAYOUT
/begin RECORD_LAYOUT Val_Wu16 FNC_VALUES 1 UWORD COLUMN_DIR DIRECT /end RECORD_LAYOUT
/begin RECORD_LAYOUT Val_Wu8 FNC_VALUES 1 UBYTE COLUMN_DIR DIRECT /end RECORD_LAYOUT
/end MODULE
/end PROJECT
