ASAP2_VERSION 1 60
/begin PROJECT MSE2_BJ10_0038_00 "MDG1"
/begin HEADER "" VERSION "MSE2_BJ10_0038_00" PROJECT_NO MSE2_BJ10_0038_00 /end HEADER
/begin MODULE DIM ""
/begin MOD_COMMON "" BYTE_ORDER MSB_FIRST ALIGNMENT_BYTE 1 ALIGNMENT_WORD 2 ALIGNMENT_LONG 4 ALIGNMENT_INT64 4 ALIGNMENT_FLOAT32_IEEE 4 ALIGNMENT_FLOAT64_IEEE 4 /end MOD_COMMON
/begin CHARACTERISTIC CLSTRTYPSEL "Cluster type selection - PWM based or non-PWM based" VALUE 0x9089B36 KwWU8 255.0 dez 0.00 255.0 FORMAT "%5.1" /end CHARACTERISTIC
/begin CHARACTERISTIC CWFUELCONS "Codeword to select ouput of instantaneous or average fuel consumption to cluster" VALUE 0x9089B37 KwWU8 255.0 dez 0.00 255.0 FORMAT "%5.1" /end CHARACTERISTIC
/begin CHARACTERISTIC CWFUELDUTY "Codeword for calculating the fuel consumption" VALUE 0x9089B38 KwWU16 655.3500 rel_uw_q0p01 0.00 655.3500 FORMAT "%8.4" /end CHARACTERISTIC
/begin CHARACTERISTIC CWMILEAGE "Codeword for calculating the fuel consumption" VALUE 0x9089B3A KwWU8 25.50 fak_q0p1 0.00 25.50 FORMAT "%5.2" /end CHARACTERISTIC
/begin CHARACTERISTIC CWNMAXMD "codeword engine speed limitation" VALUE 0x90899B6 KwWU8 255.0 dez 0.00 255.0 FORMAT "%5.1" /end CHARACTERISTIC
/begin CHARACTERISTIC CWPNSELFCCT_C "Code word for pin selection for Fuel consumption output or Coolant temperature Indication" VALUE 0x9089B3B KwWU8 255.0 dez 0.00 255.0 FORMAT "%5.1" /end CHARACTERISTIC
/begin CHARACTERISTIC CWPSSTRTR "Codeword to enable starter powerstage diagnosis" VALUE 0x9089C98 KwWU8 255.0 dez 0.00 255.0 FORMAT "%5.1" /end CHARACTERISTIC
/begin CHARACTERISTIC CWROLLDETN "Codeword for rollover detection activation." VALUE 0x9089C6A KwWU8 255.0 dez 0.00 255.0 FORMAT "%5.1" /end CHARACTERISTIC
/begin CHARACTERISTIC DDRC_DebArCounter.DFC_RBA_IOEXTLIB_KEEPALIVE_DRV.isJmpUpActv_C "Parameters of ArCounter debouncing / DFC_RBA_IOEXTLIB_KEEPALIVE_DRV / Jump at change from ""Passed"" to ""Failed"" debouncing" VALUE 0x9081464 RB_Val_Wu8 1.000 OneToOne 0.00 1.000 FORMAT "%5.3" EXTENDED_LIMITS 0.00 255.0 /end CHARACTERISTIC
/begin CHARACTERISTIC DDRC_DebArCounter.DFC_RBA_IOEXTLIB_KEEPALIVE_DRV.isJmpDwnActv_C "Parameters of ArCounter debouncing / DFC_RBA_IOEXTLIB_KEEPALIVE_DRV / Jump at change from ""Failed"" to ""Passed"" debouncing" VALUE 0x9081465 RB_Val_Wu8 1.000 OneToOne 0.00 1.000 FORMAT "%5.3" EXTENDED_LIMITS 0.00 255.0 /end CHARACTERISTIC
/begin CHARACTERISTIC DDRC_DebArCounter.DFC_RBA_IOEXTLIB_KEEPALIVE_DRV.limPassd_C "Parameters of ArCounter debouncing / DFC_RBA_IOEXTLIB_KEEPALIVE_DRV / ""Passed"" limit" VALUE 0x9081466 RB_Val_Ws16 32767.00 OneToOne -32768.00 -1.000000 FORMAT "%8.2" EXTENDED_LIMITS -32768.00 32767.00 /end CHARACTERISTIC
/begin CHARACTERISTIC DDRC_DebArCounter.DFC_RBA_IOEXTLIB_KEEPALIVE_DRV.limFaild_C "Parameters of ArCounter debouncing / DFC_RBA_IOEXTLIB_KEEPALIVE_DRV / ""Failed"" limit" VALUE 0x9081468 RB_Val_Ws16 32766.00 OneToOne 1.000000 32767.00 FORMAT "%8.2" EXTENDED_LIMITS -32768.00 32767.00 /end CHARACTERISTIC
/begin CHARACTERISTIC DDRC_DebArCounter.DFC_RBA_IOEXTLIB_KEEPALIVE_DRV.stepUp_C "Parameters of ArCounter debouncing / DFC_RBA_IOEXTLIB_KEEPALIVE_DRV / Stepsize of ""Failed"" direction" VALUE 0x908146A RB_Val_Ws16 32766.00 OneToOne 1.000000 32767.00 FORMAT "%8.2" EXTENDED_LIMITS -32768.00 32767.00 /end CHARACTERISTIC
/begin CHARACTERISTIC DDRC_DebArCounter.DFC_RBA_IOEXTLIB_KEEPALIVE_DRV.stepDwn_C "Parameters of ArCounter debouncing / DFC_RBA_IOEXTLIB_KEEPALIVE_DRV / Stepsize of ""Passed"" direction" VALUE 0x908146C RB_Val_Ws16 32767.00 OneToOne -32768.00 -1.000000 FORMAT "%8.2" EXTENDED_LIMITS -32768.00 32767.00 /end CHARACTERISTIC
/begin CHARACTERISTIC DDRC_DebArCounter.DFC_RBA_IOEXTLIB_KEEPALIVE_DRV.jmpUpVal_C "Parameters of ArCounter debouncing / DFC_RBA_IOEXTLIB_KEEPALIVE_DRV / Jumppoint direction ""Failed""" VALUE 0x908146E RB_Val_Ws16 65535.00 OneToOne -32768.00 32767.00 FORMAT "%8.2" /end CHARACTERISTIC
/begin CHARACTERISTIC DDRC_DebArCounter.DFC_RBA_IOEXTLIB_KEEPALIVE_DRV.jmpDwnVal_C "Parameters of ArCounter debouncing / DFC_RBA_IOEXTLIB_KEEPALIVE_DRV / Jumppoint direction ""Passed""" VALUE 0x9081470 RB_Val_Ws16 65535.00 OneToOne -32768.00 32767.00 FORMAT "%8.2" /end CHARACTERISTIC
/begin CHARACTERISTIC DDRC_DebArCounter.DFC_RBA_IOEXTLIB_KEEPALIVE_INI.isJmpUpActv_C "Parameters of ArCounter debouncing / DFC_RBA_IOEXTLIB_KEEPALIVE_INI / Jump at change from ""Passed"" to ""Failed"" debouncing" VALUE 0x9081474 RB_Val_Wu8 1.000 OneToOne 0.00 1.000 FORMAT "%5.3" EXTENDED_LIMITS 0.00 255.0 /end CHARACTERISTIC
/begin CHARACTERISTIC DDRC_DebArCounter.DFC_RBA_IOEXTLIB_KEEPALIVE_INI.isJmpDwnActv_C "Parameters of ArCounter debouncing / DFC_RBA_IOEXTLIB_KEEPALIVE_INI / Jump at change from ""Failed"" to ""Passed"" debouncing" VALUE 0x9081475 RB_Val_Wu8 1.000 OneToOne 0.00 1.000 FORMAT "%5.3" EXTENDED_LIMITS 0.00 255.0 /end CHARACTERISTIC
/begin CHARACTERISTIC DDRC_DebArCounter.DFC_RBA_IOEXTLIB_KEEPALIVE_INI.limPassd_C "Parameters of ArCounter debouncing / DFC_RBA_IOEXTLIB_KEEPALIVE_INI / ""Passed"" limit" VALUE 0x9081476 RB_Val_Ws16 32767.00 OneToOne -32768.00 -1.000000 FORMAT "%8.2" EXTENDED_LIMITS -32768.00 32767.00 /end CHARACTERISTIC
/begin CHARACTERISTIC DDRC_DebArCounter.DFC_RBA_IOEXTLIB_KEEPALIVE_INI.limFaild_C "Parameters of ArCounter debouncing / DFC_RBA_IOEXTLIB_KEEPALIVE_INI / ""Failed"" limit" VALUE 0x9081478 RB_Val_Ws16 32766.00 OneToOne 1.000000 32767.00 FORMAT "%8.2" EXTENDED_LIMITS -32768.00 32767.00 /end CHARACTERISTIC
/begin CHARACTERISTIC DDRC_DebArCounter.DFC_RBA_IOEXTLIB_KEEPALIVE_INI.stepUp_C "Parameters of ArCounter debouncing / DFC_RBA_IOEXTLIB_KEEPALIVE_INI / Stepsize of ""Failed"" direction" VALUE 0x908147A RB_Val_Ws16 32766.00 OneToOne 1.000000 32767.00 FORMAT "%8.2" EXTENDED_LIMITS -32768.00 32767.00 /end CHARACTERISTIC
/begin CHARACTERISTIC DDRC_DebArCounter.DFC_RBA_IOEXTLIB_KEEPALIVE_INI.stepDwn_C "Parameters of ArCounter debouncing / DFC_RBA_IOEXTLIB_KEEPALIVE_INI / Stepsize of ""Passed"" direction" VALUE 0x908147C RB_Val_Ws16 32767.00 OneToOne -32768.00 -1.000000 FORMAT "%8.2" EXTENDED_LIMITS -32768.00 32767.00 /end CHARACTERISTIC
/begin CHARACTERISTIC DDRC_DebArCounter.DFC_RBA_IOEXTLIB_KEEPALIVE_INI.jmpUpVal_C "Parameters of ArCounter debouncing / DFC_RBA_IOEXTLIB_KEEPALIVE_INI / Jumppoint direction ""Failed""" VALUE 0x908147E RB_Val_Ws16 65535.00 OneToOne -32768.00 32767.00 FORMAT "%8.2" /end CHARACTERISTIC
/begin CHARACTERISTIC DDRC_DebArCounter.DFC_RBA_IOEXTLIB_KEEPALIVE_INI.jmpDwnVal_C "Parameters of ArCounter debouncing / DFC_RBA_IOEXTLIB_KEEPALIVE_INI / Jumppoint direction ""Passed""" VALUE 0x9081480 RB_Val_Ws16 65535.00 OneToOne -32768.00 32767.00 FORMAT "%8.2" /end CHARACTERISTIC
/begin CHARACTERISTIC DDRC_DebArCounter.DFC_rba_IoSigRtc_StopCounter.isJmpUpActv_C "Parameters of ArCounter debouncing / DFC_rba_IoSigRtc_StopCounter / Jump at change from ""Passed"" to ""Failed"" debouncing" VALUE 0x9081484 RB_Val_Wu8 1.000 OneToOne 0.00 1.000 FORMAT "%5.3" EXTENDED_LIMITS 0.00 255.0 /end CHARACTERISTIC
/begin CHARACTERISTIC DDRC_DebArCounter.DFC_rba_IoSigRtc_StopCounter.isJmpDwnActv_C "Parameters of ArCounter debouncing / DFC_rba_IoSigRtc_StopCounter / Jump at change from ""Failed"" to ""Passed"" debouncing" VALUE 0x9081485 RB_Val_Wu8 1.000 OneToOne 0.00 1.000 FORMAT "%5.3" EXTENDED_LIMITS 0.00 255.0 /end CHARACTERISTIC
/begin CHARACTERISTIC DDRC_DebArCounter.DFC_rba_IoSigRtc_StopCounter.limPassd_C "Parameters of ArCounter debouncing / DFC_rba_IoSigRtc_StopCounter / ""Passed"" limit" VALUE 0x9081486 RB_Val_Ws16 32767.00 OneToOne -32768.00 -1.000000 FORMAT "%8.2" EXTENDED_LIMITS -32768.00 32767.00 /end CHARACTERISTIC
/begin CHARACTERISTIC DDRC_DebArCounter.DFC_rba_IoSigRtc_StopCounter.limFaild_C "Parameters of ArCounter debouncing / DFC_rba_IoSigRtc_StopCounter / ""Failed"" limit" VALUE 0x9081488 RB_Val_Ws16 32766.00 OneToOne 1.000000 32767.00 FORMAT "%8.2" EXTENDED_LIMITS -32768.00 32767.00 /end CHARACTERISTIC
/begin CHARACTERISTIC DDRC_DebArCounter.DFC_rba_IoSigRtc_StopCounter.stepUp_C "Parameters of ArCounter debouncing / DFC_rba_IoSigRtc_StopCounter / Stepsize of ""Failed"" direction" VALUE 0x908148A RB_Val_Ws16 32766.00 OneToOne 1.000000 32767.00 FORMAT "%8.2" EXTENDED_LIMITS -32768.00 32767.00 /end CHARACTERISTIC
/begin CHARACTERISTIC DDRC_DebArCounter.DFC_rba_IoSigRtc_StopCounter.stepDwn_C "Parameters of ArCounter debouncing / DFC_rba_IoSigRtc_StopCounter / Stepsize of ""Passed"" direction" VALUE 0x908148C RB_Val_Ws16 32767.00 OneToOne -32768.00 -1.000000 FORMAT "%8.2" EXTENDED_LIMITS -32768.00 32767.00 /end CHARACTERISTIC
/begin CHARACTERISTIC DDRC_DebArCounter.DFC_rba_IoSigRtc_StopCounter.jmpUpVal_C "Parameters of ArCounter debouncing / DFC_rba_IoSigRtc_StopCounter / Jumppoint direction ""Failed""" VALUE 0x908148E RB_Val_Ws16 65535.00 OneToOne -32768.00 32767.00 FORMAT "%8.2" /end CHARACTERISTIC
/begin CHARACTERISTIC DDRC_DebArCounter.DFC_rba_IoSigRtc_StopCounter.jmpDwnVal_C "Parameters of ArCounter debouncing / DFC_rba_IoSigRtc_StopCounter / Jumppoint direction ""Passed""" VALUE 0x9081490 RB_Val_Ws16 65535.00 OneToOne -32768.00 32767.00 FORMAT "%8.2" /end CHARACTERISTIC
/begin CHARACTERISTIC DDRC_DebArTime.DFC_SSpMon1.tiLimFaild_C "Parameters of ArTime debouncing /  / ""Failed"" limit" VALUE 0x90814A4 RB_Val_Ws16 327660.0 DDRCTime_ms 10.00000 327670.0 FORMAT "%8.1" EXTENDED_LIMITS -327680.0 327670.0 /end CHARACTERISTIC
/begin CHARACTERISTIC DDRC_DebArTime.DFC_SSpMon1.tiLimPassd_C "Parameters of ArTime debouncing /  / ""Passed"" limit" VALUE 0x90814A6 RB_Val_Ws16 327670.0 DDRCTime_ms -327680.0 -10.00000 FORMAT "%8.1" EXTENDED_LIMITS -327680.0 327670.0 /end CHARACTERISTIC
/begin CHARACTERISTIC DDRC_DebArTime.DFC_SSpMon1OT.tiLimFaild_C "Parameters of ArTime debouncing /  / ""Failed"" limit" VALUE 0x90814AA RB_Val_Ws16 327660.0 DDRCTime_ms 10.00000 327670.0 FORMAT "%8.1" EXTENDED_LIMITS -327680.0 327670.0 /end CHARACTERISTIC
/begin CHARACTERISTIC DDRC_DebArTime.DFC_SSpMon1OT.tiLimPassd_C "Parameters of ArTime debouncing /  / ""Passed"" limit" VALUE 0x90814AC RB_Val_Ws16 327670.0 DDRCTime_ms -327680.0 -10.00000 FORMAT "%8.1" EXTENDED_LIMITS -327680.0 327670.0 /end CHARACTERISTIC
/begin CHARACTERISTIC DDRC_DebArTime.DFC_SSpMon1OV.tiLimFaild_C "Parameters of ArTime debouncing /  / ""Failed"" limit" VALUE 0x90814B0 RB_Val_Ws16 327660.0 DDRCTime_ms 10.00000 327670.0 FORMAT "%8.1" EXTENDED_LIMITS -327680.0 327670.0 /end CHARACTERISTIC
/begin CHARACTERISTIC DDRC_DebArTime.DFC_SSpMon1OV.tiLimPassd_C "Parameters of ArTime debouncing /  / ""Passed"" limit" VALUE 0x90814B2 RB_Val_Ws16 327670.0 DDRCTime_ms -327680.0 -10.00000 FORMAT "%8.1" EXTENDED_LIMITS -327680.0 327670.0 /end CHARACTERISTIC
/begin CHARACTERISTIC DDRC_DebArTime.DFC_SSpMon1SCG.tiLimFaild_C "Parameters of ArTime debouncing /  / ""Failed"" limit" VALUE 0x90814B6 RB_Val_Ws16 327660.0 DDRCTime_ms 10.00000 327670.0 FORMAT "%8.1" EXTENDED_LIMITS -327680.0 327670.0 /end CHARACTERISTIC
/begin CHARACTERISTIC DDRC_DebArTime.DFC_SSpMon1SCG.tiLimPassd_C "Parameters of ArTime debouncing /  / ""Passed"" limit" VALUE 0x90814B8 RB_Val_Ws16 327670.0 DDRCTime_ms -327680.0 -10.00000 FORMAT "%8.1" EXTENDED_LIMITS -327680.0 327670.0 /end CHARACTERISTIC
/begin CHARACTERISTIC DDRC_DebArTime.DFC_SSpMon1UV.tiLimFaild_C "Parameters of ArTime debouncing /  / ""Failed"" limit" VALUE 0x90814BC RB_Val_Ws16 327660.0 DDRCTime_ms 10.00000 327670.0 FORMAT "%8.1" EXTENDED_LIMITS -327680.0 327670.0 /end CHARACTERISTIC
/begin CHARACTERISTIC DDRC_DebArTime.DFC_SSpMon1UV.tiLimPassd_C "Parameters of ArTime debouncing /  / ""Passed"" limit" VALUE 0x90814BE RB_Val_Ws16 327670.0 DDRCTime_ms -327680.0 -10.00000 FORMAT "%8.1" EXTENDED_LIMITS -327680.0 327670.0 /end CHARACTERISTIC
/begin CHARACTERISTIC DDRC_DebArTime.DFC_SSpMon2.tiLimFaild_C "Parameters of ArTime debouncing /  / ""Failed"" limit" VALUE 0x90814C2 RB_Val_Ws16 327660.0 DDRCTime_ms 10.00000 327670.0 FORMAT "%8.1" EXTENDED_LIMITS -327680.0 327670.0 /end CHARACTERISTIC
/begin CHARACTERISTIC DDRC_DebArTime.DFC_SSpMon2.tiLimPassd_C "Parameters of ArTime debouncing /  / ""Passed"" limit" VALUE 0x90814C4 RB_Val_Ws16 327670.0 DDRCTime_ms -327680.0 -10.00000 FORMAT "%8.1" EXTENDED_LIMITS -327680.0 327670.0 /end CHARACTERISTIC
/begin CHARACTERISTIC DDRC_DebArTime.DFC_SSpMon2OT.tiLimFaild_C "Parameters of ArTime debouncing /  / ""Failed"" limit" VALUE 0x90814C8 RB_Val_Ws16 327660.0 DDRCTime_ms 10.00000 327670.0 FORMAT "%8.1" EXTENDED_LIMITS -327680.0 327670.0 /end CHARACTERISTIC
/begin CHARACTERISTIC DDRC_DebArTime.DFC_SSpMon2OT.tiLimPassd_C "Parameters of ArTime debouncing /  / ""Passed"" limit" VALUE 0x90814CA RB_Val_Ws16 327670.0 DDRCTime_ms -327680.0 -10.00000 FORMAT "%8.1" EXTENDED_LIMITS -327680.0 327670.0 /end CHARACTERISTIC
/begin CHARACTERISTIC DDRC_DebArTime.DFC_SSpMon2OV.tiLimFaild_C "Parameters of ArTime debouncing /  / ""Failed"" limit" VALUE 0x90814CE RB_Val_Ws16 327660.0 DDRCTime_ms 10.00000 327670.0 FORMAT "%8.1" EXTENDED_LIMITS -327680.0 327670.0 /end CHARACTERISTIC
/begin CHARACTERISTIC DDRC_DebArTime.DFC_SSpMon2OV.tiLimPassd_C "Parameters of ArTime debouncing /  / ""Passed"" limit" VALUE 0x90814D0 RB_Val_Ws16 327670.0 DDRCTime_ms -327680.0 -10.00000 FORMAT "%8.1" EXTENDED_LIMITS -327680.0 327670.0 /end CHARACTERISTIC
/begin CHARACTERISTIC DDRC_DebArTime.DFC_SSpMon2SCG.tiLimFaild_C "Parameters of ArTime debouncing /  / ""Failed"" limit" VALUE 0x90814D4 RB_Val_Ws16 327660.0 DDRCTime_ms 10.00000 327670.0 FORMAT "%8.1" EXTENDED_LIMITS -327680.0 327670.0 /end CHARACTERISTIC
/begin CHARACTERISTIC DDRC_DebArTime.DFC_SSpMon2SCG.tiLimPassd_C "Parameters of ArTime debouncing /  / ""Passed"" limit" VALUE 0x90814D6 RB_Val_Ws16 327670.0 DDRCTime_ms -327680.0 -10.00000 FORMAT "%8.1" EXTENDED_LIMITS -327680.0 327670.0 /end CHARACTERISTIC
/begin CHARACTERISTIC DDRC_DebArTime.DFC_SSpMon2UV.tiLimFaild_C "Parameters of ArTime debouncing /  / ""Failed"" limit" VALUE 0x90814DA RB_Val_Ws16 327660.0 DDRCTime_ms 10.00000 327670.0 FORMAT "%8.1" EXTENDED_LIMITS -327680.0 327670.0 /end CHARACTERISTIC
/begin CHARACTERISTIC DDRC_DebArTime.DFC_SSpMon2UV.tiLimPassd_C "Parameters of ArTime debouncing /  / ""Passed"" limit" VALUE 0x90814DC RB_Val_Ws16 327670.0 DDRCTime_ms -327680.0 -10.00000 FORMAT "%8.1" EXTENDED_LIMITS -327680.0 327670.0 /end CHARACTERISTIC
/begin CHARACTERISTIC DDRC_DurDeb.Strt_tiOLDebOk_C "debouncing parameter / Duration of healing debouncing for check DFC_StrtOL" VALUE 0x908035C Val_Wu16 655350.0 DDRCTime_ms 0.00 655350.0 FORMAT "%8.1" /end CHARACTERISTIC
/begin CHARACTERISTIC DDRC_DurDeb.Strt_tiOLDebDef_C "debouncing parameter / Duration of defect debouncing for check DFC_StrtOL" VALUE 0x908035E Val_Wu16 655350.0 DDRCTime_ms 0.00 655350.0 FORMAT "%8.1" /end CHARACTERISTIC
/begin CHARACTERISTIC DDRC_DurDeb.Strt_tiOvrTempDebOk_C "debouncing parameter / Duration of healing debouncing for check DFC_StrtOvrTemp" VALUE 0x9080360 Val_Wu16 655350.0 DDRCTime_ms 0.00 655350.0 FORMAT "%8.1" /end CHARACTERISTIC
/begin CHARACTERISTIC DDRC_DurDeb.Strt_tiOvrTempDebDef_C "debouncing parameter / Duration of defect debouncing for check DFC_StrtOvrTemp" VALUE 0x9080362 Val_Wu16 655350.0 DDRCTime_ms 0.00 655350.0 FORMAT "%8.1" /end CHARACTERISTIC
/begin CHARACTERISTIC DDRC_DurDeb.Strt_tiSCBDebOk_C "debouncing parameter / Duration of healing debouncing for check DFC_StrtSCB" VALUE 0x9080364 Val_Wu16 655350.0 DDRCTime_ms 0.00 655350.0 FORMAT "%8.1" /end CHARACTERISTIC
/begin CHARACTERISTIC DDRC_DurDeb.Strt_tiSCBDebDef_C "debouncing parameter / Duration of defect debouncing for check DFC_StrtSCB" VALUE 0x9080366 Val_Wu16 655350.0 DDRCTime_ms 0.00 655350.0 FORMAT "%8.1" /end CHARACTERISTIC
/begin CHARACTERISTIC DDRC_DurDeb.Strt_tiSCGDebOk_C "debouncing parameter / Duration of healing debouncing for check DFC_StrtSCG" VALUE 0x9080368 Val_Wu16 655350.0 DDRCTime_ms 0.00 655350.0 FORMAT "%8.1" /end CHARACTERISTIC
/begin CHARACTERISTIC DDRC_DurDeb.Strt_tiSCGDebDef_C "debouncing parameter / Duration of defect debouncing for check DFC_StrtSCG" VALUE 0x908036A Val_Wu16 655350.0 DDRCTime_ms 0.00 655350.0 FORMAT "%8.1" /end CHARACTERISTIC
/begin CHARACTERISTIC DDRC_RatDeb.Strt_tiOLUDRat_C "Ratioof up-down debouncing / Defect / Heal Ratio for check DFC_StrtOL" VALUE 0x9080D5D Val_Wu8 3.00000000000 DDRC_Ratio 1.00000000000 4.00000000000 FORMAT "%13.11" /end CHARACTERISTIC
/begin CHARACTERISTIC DDRC_RatDeb.Strt_tiOvrTempUDRat_C "Ratioof up-down debouncing / Defect / Heal Ratio for check DFC_StrtOvrTemp" VALUE 0x9080D5E Val_Wu8 3.00000000000 DDRC_Ratio 1.00000000000 4.00000000000 FORMAT "%13.11" /end CHARACTERISTIC
/begin CHARACTERISTIC DDRC_RatDeb.Strt_tiSCBUDRat_C "Ratioof up-down debouncing / Defect / Heal Ratio for check DFC_StrtSCB" VALUE 0x9080D5F Val_Wu8 3.00000000000 DDRC_Ratio 1.00000000000 4.00000000000 FORMAT "%13.11" /end CHARACTERISTIC
/begin CHARACTERISTIC DDRC_RatDeb.Strt_tiSCGUDRat_C "Ratioof up-down debouncing / Defect / Heal Ratio for check DFC_StrtSCG" VALUE 0x9080D60 Val_Wu8 3.00000000000 DDRC_Ratio 1.00000000000 4.00000000000 FORMAT "%13.11" /end CHARACTERISTIC
/begin CHARACTERISTIC DFC_CtlMsk2.DFC_StrtOL_C "Behaviour control mask / Behaviour control masks of check DFC_StrtOL" VALUE 0x908039F Val_Wu8 255.0 DFES_OneToOne 0.00 255.0 FORMAT "%5.1" /end CHARACTERISTIC
/begin CHARACTERISTIC DFC_CtlMsk2.DFC_StrtOvrTemp_C "Behaviour control mask / Behaviour control masks of check DFC_StrtOvrTemp" VALUE 0x90803A0 Val_Wu8 255.0 DFES_OneToOne 0.00 255.0 FORMAT "%5.1" /end CHARACTERISTIC
/begin CHARACTERISTIC DFC_CtlMsk2.DFC_StrtSCB_C "Behaviour control mask / Behaviour control masks of check DFC_StrtSCB" VALUE 0x90803A1 Val_Wu8 255.0 DFES_OneToOne 0.00 255.0 FORMAT "%5.1" /end CHARACTERISTIC
/begin CHARACTERISTIC DFC_CtlMsk2.DFC_StrtSCG_C "Behaviour control mask / Behaviour control masks of check DFC_StrtSCG" VALUE 0x90803A2 Val_Wu8 255.0 DFES_OneToOne 0.00 255.0 FORMAT "%5.1" /end CHARACTERISTIC
/begin CHARACTERISTIC DFC_CtlMsk2.DFC_SSpMon1_C "Behaviour control mask / Behaviour control masks of check DFC_SSpMon1" VALUE 0x90803AF Val_Wu8 255.0 DFES_OneToOne 0.00 255.0 FORMAT "%5.1" /end CHARACTERISTIC
/begin CHARACTERISTIC DFC_CtlMsk2.DFC_SSpMon1OT_C "Behaviour control mask / Behaviour control masks of check DFC_SSpMon1OT" VALUE 0x90803B0 Val_Wu8 255.0 DFES_OneToOne 0.00 255.0 FORMAT "%5.1" /end CHARACTERISTIC
/begin CHARACTERISTIC DFC_CtlMsk2.DFC_SSpMon1OV_C "Behaviour control mask / Behaviour control masks of check DFC_SSpMon1OV" VALUE 0x90803B1 Val_Wu8 255.0 DFES_OneToOne 0.00 255.0 FORMAT "%5.1" /end CHARACTERISTIC
/begin CHARACTERISTIC DFC_CtlMsk2.DFC_SSpMon1SCG_C "Behaviour control mask / Behaviour control masks of check DFC_SSpMon1SCG" VALUE 0x90803B2 Val_Wu8 255.0 DFES_OneToOne 0.00 255.0 FORMAT "%5.1" /end CHARACTERISTIC
/begin CHARACTERISTIC DFC_CtlMsk2.DFC_SSpMon1UV_C "Behaviour control mask / Behaviour control masks of check DFC_SSpMon1UV" VALUE 0x90803B3 Val_Wu8 255.0 DFES_OneToOne 0.00 255.0 FORMAT "%5.1" /end CHARACTERISTIC
/begin CHARACTERISTIC DFC_CtlMsk2.DFC_SSpMon2_C "Behaviour control mask / Behaviour control masks of check DFC_SSpMon2" VALUE 0x90803B4 Val_Wu8 255.0 DFES_OneToOne 0.00 255.0 FORMAT "%5.1" /end CHARACTERISTIC
/begin CHARACTERISTIC DFC_CtlMsk2.DFC_SSpMon2OT_C "Behaviour control mask / Behaviour control masks of check DFC_SSpMon2OT" VALUE 0x90803B5 Val_Wu8 255.0 DFES_OneToOne 0.00 255.0 FORMAT "%5.1" /end CHARACTERISTIC
/begin CHARACTERISTIC DFC_CtlMsk2.DFC_SSpMon2OV_C "Behaviour control mask / Behaviour control masks of check DFC_SSpMon2OV" VALUE 0x90803B6 Val_Wu8 255.0 DFES_OneToOne 0.00 255.0 FORMAT "%5.1" /end CHARACTERISTIC
/begin CHARACTERISTIC DFC_CtlMsk2.DFC_SSpMon2SCG_C "Behaviour control mask / Behaviour control masks of check DFC_SSpMon2SCG" VALUE 0x90803B7 Val_Wu8 255.0 DFES_OneToOne 0.00 255.0 FORMAT "%5.1" /end CHARACTERISTIC
/begin CHARACTERISTIC DFC_CtlMsk2.DFC_SSpMon2UV_C "Behaviour control mask / Behaviour control masks of check DFC_SSpMon2UV" VALUE 0x90803B8 Val_Wu8 255.0 DFES_OneToOne 0.00 255.0 FORMAT "%5.1" /end CHARACTERISTIC
/begin CHARACTERISTIC DFC_CtlMsk2.DFC_RBA_IOEXTLIB_KEEPALIVE_DRV_C "Behaviour control mask / Behaviour control masks of check DFC_RBA_IOEXTLIB_KEEPALIVE_DRV" VALUE 0x90803C8 Val_Wu8 255.0 DFES_OneToOne 0.00 255.0 FORMAT "%5.1" /end CHARACTERISTIC
/begin CHARACTERISTIC DFC_CtlMsk2.DFC_RBA_IOEXTLIB_KEEPALIVE_INI_C "Behaviour control mask / Behaviour control masks of check DFC_RBA_IOEXTLIB_KEEPALIVE_INI" VALUE 0x90803C9 Val_Wu8 255.0 DFES_OneToOne 0.00 255.0 FORMAT "%5.1" /end CHARACTERISTIC
/begin CHARACTERISTIC DFC_CtlMsk2.DFC_rba_IoSigRtc_StopCounter_C "Behaviour control mask / Behaviour control masks of check DFC_rba_IoSigRtc_StopCounter" VALUE 0x90803CA Val_Wu8 255.0 DFES_OneToOne 0.00 255.0 FORMAT "%5.1" /end CHARACTERISTIC
/begin CHARACTERISTIC DFC_CtlMsk2.DFC_MoFSidst_C "Behaviour control mask / Behaviour control masks of check DFC_MoFSidst" VALUE 0x9080421 Val_Wu8 255.0 DFES_OneToOne 0.00 255.0 FORMAT "%5.1" /end CHARACTERISTIC
/begin CHARACTERISTIC DFC_CtlMsk2.DFC_OCWDACom_C "Behaviour control mask / Behaviour control masks of check DFC_OCWDACom" VALUE 0x9080422 Val_Wu8 255.0 DFES_OneToOne 0.00 255.0 FORMAT "%5.1" /end CHARACTERISTIC
/begin CHARACTERISTIC DFC_CtlMsk2.DFC_OilPPSSwtMax_C "Behaviour control mask / Behaviour control masks of check DFC_OilPPSSwtMax" VALUE 0x9080423 Val_Wu8 255.0 DFES_OneToOne 0.00 255.0 FORMAT "%5.1" /end CHARACTERISTIC
/begin CHARACTERISTIC DFC_CtlMsk2.DFC_OilPPSSwtMin_C "Behaviour control mask / Behaviour control masks of check DFC_OilPPSSwtMin" VALUE 0x9080424 Val_Wu8 255.0 DFES_OneToOne 0.00 255.0 FORMAT "%5.1" /end CHARACTERISTIC
/begin CHARACTERISTIC DFC_CtlMsk2.DFC_OilPPSSwtSig_C "Behaviour control mask / Behaviour control masks of check DFC_OilPPSSwtSig" VALUE 0x9080425 Val_Wu8 255.0 DFES_OneToOne 0.00 255.0 FORMAT "%5.1" /end CHARACTERISTIC
/begin CHARACTERISTIC DFC_CtlMsk2.DFC_OvHEngSpdLimr_C "Behaviour control mask / Behaviour control masks of check DFC_OvHEngSpdLimr" VALUE 0x9080426 Val_Wu8 255.0 DFES_OneToOne 0.00 255.0 FORMAT "%5.1" /end CHARACTERISTIC
/begin CHARACTERISTIC DFC_CtlMsk2.DFC_RoVComVld_C "Behaviour control mask / Behaviour control masks of check DFC_RoVComVld" VALUE 0x9080427 Val_Wu8 255.0 DFES_OneToOne 0.00 255.0 FORMAT "%5.1" /end CHARACTERISTIC
/begin CHARACTERISTIC DFC_CtlMsk2.DFC_RoVSNpl_C "Behaviour control mask / Behaviour control masks of check DFC_RoVSNpl" VALUE 0x9080428 Val_Wu8 255.0 DFES_OneToOne 0.00 255.0 FORMAT "%5.1" /end CHARACTERISTIC
/begin CHARACTERISTIC DFC_CtlMsk2.DFC_RoVSOL_C "Behaviour control mask / Behaviour control masks of check DFC_RoVSOL" VALUE 0x9080429 Val_Wu8 255.0 DFES_OneToOne 0.00 255.0 FORMAT "%5.1" /end CHARACTERISTIC
/begin CHARACTERISTIC DFC_CtlMsk2.DFC_RoVSSCB_C "Behaviour control mask / Behaviour control masks of check DFC_RoVSSCB" VALUE 0x908042A Val_Wu8 255.0 DFES_OneToOne 0.00 255.0 FORMAT "%5.1" /end CHARACTERISTIC
/begin CHARACTERISTIC DFC_CtlMsk2.DFC_RoVSSCG_C "Behaviour control mask / Behaviour control masks of check DFC_RoVSSCG" VALUE 0x908042B Val_Wu8 255.0 DFES_OneToOne 0.00 255.0 FORMAT "%5.1" /end CHARACTERISTIC
/begin CHARACTERISTIC DFC_DisblMsk2.DFC_StrtOL_C "disable mask / Disable masks of check DFC_StrtOL" VALUE 0x9080D6F Val_Wu8 255.0 DFES_OneToOne 0.00 255.0 FORMAT "%5.1" /end CHARACTERISTIC
/begin CHARACTERISTIC DFC_DisblMsk2.DFC_StrtOvrTemp_C "disable mask / Disable masks of check DFC_StrtOvrTemp" VALUE 0x9080D70 Val_Wu8 255.0 DFES_OneToOne 0.00 255.0 FORMAT "%5.1" /end CHARACTERISTIC
/begin CHARACTERISTIC DFC_DisblMsk2.DFC_StrtSCB_C "disable mask / Disable masks of check DFC_StrtSCB" VALUE 0x9080D71 Val_Wu8 255.0 DFES_OneToOne 0.00 255.0 FORMAT "%5.1" /end CHARACTERISTIC
/begin CHARACTERISTIC DFC_DisblMsk2.DFC_StrtSCG_C "disable mask / Disable masks of check DFC_StrtSCG" VALUE 0x9080D72 Val_Wu8 255.0 DFES_OneToOne 0.00 255.0 FORMAT "%5.1" /end CHARACTERISTIC
/begin CHARACTERISTIC DFC_DisblMsk2.DFC_SSpMon1_C "disable mask / Disable masks of check DFC_SSpMon1" VALUE 0x9080D7F Val_Wu8 255.0 DFES_OneToOne 0.00 255.0 FORMAT "%5.1" /end CHARACTERISTIC
/begin CHARACTERISTIC DFC_DisblMsk2.DFC_SSpMon1OT_C "disable mask / Disable masks of check DFC_SSpMon1OT" VALUE 0x9080D80 Val_Wu8 255.0 DFES_OneToOne 0.00 255.0 FORMAT "%5.1" /end CHARACTERISTIC
/begin CHARACTERISTIC DFC_DisblMsk2.DFC_SSpMon1OV_C "disable mask / Disable masks of check DFC_SSpMon1OV" VALUE 0x9080D81 Val_Wu8 255.0 DFES_OneToOne 0.00 255.0 FORMAT "%5.1" /end CHARACTERISTIC
/begin CHARACTERISTIC DFC_DisblMsk2.DFC_SSpMon1SCG_C "disable mask / Disable masks of check DFC_SSpMon1SCG" VALUE 0x9080D82 Val_Wu8 255.0 DFES_OneToOne 0.00 255.0 FORMAT "%5.1" /end CHARACTERISTIC
/begin CHARACTERISTIC DFC_DisblMsk2.DFC_SSpMon1UV_C "disable mask / Disable masks of check DFC_SSpMon1UV" VALUE 0x9080D83 Val_Wu8 255.0 DFES_OneToOne 0.00 255.0 FORMAT "%5.1" /end CHARACTERISTIC
/begin CHARACTERISTIC DFC_DisblMsk2.DFC_SSpMon2_C "disable mask / Disable masks of check DFC_SSpMon2" VALUE 0x9080D84 Val_Wu8 255.0 DFES_OneToOne 0.00 255.0 FORMAT "%5.1" /end CHARACTERISTIC
/begin CHARACTERISTIC DFC_DisblMsk2.DFC_SSpMon2OT_C "disable mask / Disable masks of check DFC_SSpMon2OT" VALUE 0x9080D85 Val_Wu8 255.0 DFES_OneToOne 0.00 255.0 FORMAT "%5.1" /end CHARACTERISTIC
/begin CHARACTERISTIC DFC_DisblMsk2.DFC_SSpMon2OV_C "disable mask / Disable masks of check DFC_SSpMon2OV" VALUE 0x9080D86 Val_Wu8 255.0 DFES_OneToOne 0.00 255.0 FORMAT "%5.1" /end CHARACTERISTIC
/begin CHARACTERISTIC DFC_DisblMsk2.DFC_SSpMon2SCG_C "disable mask / Disable masks of check DFC_SSpMon2SCG" VALUE 0x9080D87 Val_Wu8 255.0 DFES_OneToOne 0.00 255.0 FORMAT "%5.1" /end CHARACTERISTIC
/begin CHARACTERISTIC DFC_DisblMsk2.DFC_SSpMon2UV_C "disable mask / Disable masks of check DFC_SSpMon2UV" VALUE 0x9080D88 Val_Wu8 255.0 DFES_OneToOne 0.00 255.0 FORMAT "%5.1" /end CHARACTERISTIC
/begin CHARACTERISTIC DFC_DisblMsk2.DFC_RBA_IOEXTLIB_KEEPALIVE_DRV_C "disable mask / Disable masks of check DFC_RBA_IOEXTLIB_KEEPALIVE_DRV" VALUE 0x9080D98 Val_Wu8 255.0 DFES_OneToOne 0.00 255.0 FORMAT "%5.1" /end CHARACTERISTIC
/begin CHARACTERISTIC DFC_DisblMsk2.DFC_RBA_IOEXTLIB_KEEPALIVE_INI_C "disable mask / Disable masks of check DFC_RBA_IOEXTLIB_KEEPALIVE_INI" VALUE 0x9080D99 Val_Wu8 255.0 DFES_OneToOne 0.00 255.0 FORMAT "%5.1" /end CHARACTERISTIC
/begin CHARACTERISTIC DFC_DisblMsk2.DFC_rba_IoSigRtc_StopCounter_C "disable mask / Disable masks of check DFC_rba_IoSigRtc_StopCounter" VALUE 0x9080D9A Val_Wu8 255.0 DFES_OneToOne 0.00 255.0 FORMAT "%5.1" /end CHARACTERISTIC
/begin CHARACTERISTIC DFC_DisblMsk2.DFC_MoFSidst_C "disable mask / Disable masks of check DFC_MoFSidst" VALUE 0x9080DF1 Val_Wu8 255.0 DFES_OneToOne 0.00 255.0 FORMAT "%5.1" /end CHARACTERISTIC
/begin CHARACTERISTIC DFC_DisblMsk2.DFC_OCWDACom_C "disable mask / Disable masks of check DFC_OCWDACom" VALUE 0x9080DF2 Val_Wu8 255.0 DFES_OneToOne 0.00 255.0 FORMAT "%5.1" /end CHARACTERISTIC
/begin CHARACTERISTIC DFC_DisblMsk2.DFC_OilPPSSwtMax_C "disable mask / Disable masks of check DFC_OilPPSSwtMax" VALUE 0x9080DF3 Val_Wu8 255.0 DFES_OneToOne 0.00 255.0 FORMAT "%5.1" /end CHARACTERISTIC
/begin CHARACTERISTIC DFC_DisblMsk2.DFC_OilPPSSwtMin_C "disable mask / Disable masks of check DFC_OilPPSSwtMin" VALUE 0x9080DF4 Val_Wu8 255.0 DFES_OneToOne 0.00 255.0 FORMAT "%5.1" /end CHARACTERISTIC
/begin CHARACTERISTIC DFC_DisblMsk2.DFC_OilPPSSwtSig_C "disable mask / Disable masks of check DFC_OilPPSSwtSig" VALUE 0x9080DF5 Val_Wu8 255.0 DFES_OneToOne 0.00 255.0 FORMAT "%5.1" /end CHARACTERISTIC
/begin CHARACTERISTIC DFC_DisblMsk2.DFC_OvHEngSpdLimr_C "disable mask / Disable masks of check DFC_OvHEngSpdLimr" VALUE 0x9080DF6 Val_Wu8 255.0 DFES_OneToOne 0.00 255.0 FORMAT "%5.1" /end CHARACTERISTIC
/begin CHARACTERISTIC DFC_DisblMsk2.DFC_RoVComVld_C "disable mask / Disable masks of check DFC_RoVComVld" VALUE 0x9080DF7 Val_Wu8 255.0 DFES_OneToOne 0.00 255.0 FORMAT "%5.1" /end CHARACTERISTIC
/begin CHARACTERISTIC DFC_DisblMsk2.DFC_RoVSNpl_C "disable mask / Disable masks of check DFC_RoVSNpl" VALUE 0x9080DF8 Val_Wu8 255.0 DFES_OneToOne 0.00 255.0 FORMAT "%5.1" /end CHARACTERISTIC
/begin CHARACTERISTIC DFC_DisblMsk2.DFC_RoVSOL_C "disable mask / Disable masks of check DFC_RoVSOL" VALUE 0x9080DF9 Val_Wu8 255.0 DFES_OneToOne 0.00 255.0 FORMAT "%5.1" /end CHARACTERISTIC
/begin CHARACTERISTIC DFC_DisblMsk2.DFC_RoVSSCB_C "disable mask / Disable masks of check DFC_RoVSSCB" VALUE 0x9080DFA Val_Wu8 255.0 DFES_OneToOne 0.00 255.0 FORMAT "%5.1" /end CHARACTERISTIC
/begin CHARACTERISTIC DFC_DisblMsk2.DFC_RoVSSCG_C "disable mask / Disable masks of check DFC_RoVSSCG" VALUE 0x9080DFB Val_Wu8 255.0 DFES_OneToOne 0.00 255.0 FORMAT "%5.1" /end CHARACTERISTIC
/begin CHARACTERISTIC Eep_ClrWrCounter_CW "Codeword to clear write counters" VALUE 0x908028E Val_Wu8 255.0 OneToOne 0.00 255.0 FORMAT "%5.1" /end CHARACTERISTIC
/begin CHARACTERISTIC Eep_EnFirstInit_CW "Codeword to start a first initialization in EEP" VALUE 0x908028D Val_Wu8 255.0 OneToOne 0.00 255.0 FORMAT "%5.1" /end CHARACTERISTIC
/begin CHARACTERISTIC Eep_EnvRamClr_CW "Codeword to clear contents of ENVRAM" VALUE 0x908028C Val_Wu8 255.0 OneToOne 0.00 255.0 FORMAT "%5.1" /end CHARACTERISTIC
/begin CHARACTERISTIC ENGDUTY_C "Duty cycle of engine speed PWM signal to tachometer" CURVE 0x9089B3C KlAUwSstUwWUw 655.3500 rel_uw_q0p01 0.00 655.3500 FORMAT "%8.4"
 /begin AXIS_DESCR STD_AXIS nmot_w nmot_uw_q0p25 25 0.00 16383.75 FORMAT "%8.2" DEPOSIT ABSOLUTE /end AXIS_DESCR
/end CHARACTERISTIC
/begin CHARACTERISTIC ENGPERIOD_C "Frequency of engine speed PWM signal to tachometer" CURVE 0x9089BA2 KlAUwSstUwWUw 6.553500 t_q0p0001_ms 0.00 6.553500 FORMAT "%8.6"
 /begin AXIS_DESCR STD_AXIS nmot_w nmot_uw_q0p25 25 0.00 16383.75 FORMAT "%8.2" DEPOSIT ABSOLUTE /end AXIS_DESCR
/end CHARACTERISTIC
/begin CHARACTERISTIC FLCONPERIOD_C "Fuel consumption PWM signal time period" VALUE 0x9089C08 KwWU16 655.3500 t_q0p01 0.00 655.3500 FORMAT "%8.4" /end CHARACTERISTIC
/begin CHARACTERISTIC KLFINMAX "curve: gain of integral controller for engine speed limitation" CURVE 0x90899B7 KlAxU8SstxU8WU8 4.864 relnmot_q0p01907 0.00 4.864 FORMAT "%5.3"
 /begin AXIS_DESCR STD_AXIS gangi dez 8 0.00 255.0 FORMAT "%5.1" DEPOSIT ABSOLUTE /end AXIS_DESCR
/end CHARACTERISTIC
/begin CHARACTERISTIC KLFNMAXINI "Factor for initialization of integral controller for engine speed limitation" CURVE 0x90899C8 KlAxU8SstxU8WU8 0.2550 NMAXMD_relnmot_q0p001 0.00 0.2550 FORMAT "%6.4"
 /begin AXIS_DESCR STD_AXIS gangi dez 8 0.00 255.0 FORMAT "%5.1" DEPOSIT ABSOLUTE /end AXIS_DESCR
/end CHARACTERISTIC
/begin CHARACTERISTIC KLFPNMAX "curve: gain of proportional controller for engine speed limitation" CURVE 0x90899DA KlAxU8SstxU8WU16_Static 3.112793 relnmot_q0p003052 0.00 3.112793 FORMAT "%8.6" EXTENDED_LIMITS 0.00 199.9969
 /begin AXIS_DESCR STD_AXIS gangi dez 8 0.00 255.0 FORMAT "%5.1" DEPOSIT ABSOLUTE /end AXIS_DESCR
/end CHARACTERISTIC
/begin CHARACTERISTIC MoFSidst_cntrDebSidstL2_C "Threshold for debounce side stand L2" VALUE 0x90802A9 Val_Wu8 255.0 OneToOne 0.00 255.0 FORMAT "%5.1" /end CHARACTERISTIC
/begin CHARACTERISTIC MoFSidst_cntrDeb_C "Threshold for debouncing sidestand status" VALUE 0x90802AA Val_Wu8 255.0 OneToOne 0.00 255.0 FORMAT "%5.1" /end CHARACTERISTIC
/begin CHARACTERISTIC MoFSidst_cntrErrICOIgnDeb_C "Threshold for Ignition cut-off in case of Sidestand error" VALUE 0x90802AB Val_Wu8 255.0 OneToOne 0.00 255.0 FORMAT "%5.1" /end CHARACTERISTIC
/begin CHARACTERISTIC MoFSidst_cntrErrICOIgnThd_C "Debounce level for a correct calibrated function of error counter MoFSidst_cntrErrICOIgnDeb" VALUE 0x90802AC Val_Wu8 255.0 OneToOne 0.00 255.0 FORMAT "%5.1" /end CHARACTERISTIC
/begin CHARACTERISTIC MoFSidst_cntrErrICOInjDeb_C "Threshold for Injection cut-off in case of Sidestand error" VALUE 0x90802AD Val_Wu8 255.0 OneToOne 0.00 255.0 FORMAT "%5.1" /end CHARACTERISTIC
/begin CHARACTERISTIC MoFSidst_cntrErrICOInjThd_C "Debounce level for a correct calibrated function of error counter MoFSidst_cntrErrICOInjDeb" VALUE 0x90802AE Val_Wu8 255.0 OneToOne 0.00 255.0 FORMAT "%5.1" /end CHARACTERISTIC
/begin CHARACTERISTIC MoFSidst_cntrThd_C "Debounce level for a correct calibrated function of error counter MoFSidst_cntrErrDeb" VALUE 0x90802AF Val_Wu8 255.0 OneToOne 0.00 255.0 FORMAT "%5.1" /end CHARACTERISTIC
/begin CHARACTERISTIC MoFSidst_cntrTst_C "Debounce steps for setting the testflag in sidestand error diagnose." VALUE 0x90802B0 Val_Wu8 255.0 OneToOne 0.00 255.0 FORMAT "%5.1" /end CHARACTERISTIC
/begin CHARACTERISTIC MoFSidst_stSidst_C "Status of Sidestand in case of errors" VALUE 0x90802B1 Val_Wu8 255.0 OneToOne 0.00 255.0 FORMAT "%5.1" /end CHARACTERISTIC
/begin CHARACTERISTIC MoFSidst_swtSRCChkEna_C "Switch to enable ADC voltage signal range check" VALUE 0x90802B2 Val_Wu8 255.0 OneToOne 0.00 255.0 FORMAT "%5.1" /end CHARACTERISTIC
/begin CHARACTERISTIC MoFSidst_uOffMax_C "Upper threshold for Sidestand OFF" VALUE 0x9080326 Val_Wu16 319.9951 spg_uw_q0p00488 0.00 319.9951 FORMAT "%8.4" /end CHARACTERISTIC
/begin CHARACTERISTIC MoFSidst_uOffMin_C "Lower threshold for Sidestand OFF" VALUE 0x9080328 Val_Wu16 319.9951 spg_uw_q0p00488 0.00 319.9951 FORMAT "%8.4" /end CHARACTERISTIC
/begin CHARACTERISTIC MoFSidst_uOnMax_C "Upper threshold for Sidestand ON" VALUE 0x908032A Val_Wu16 319.9951 spg_uw_q0p00488 0.00 319.9951 FORMAT "%8.4" /end CHARACTERISTIC
/begin CHARACTERISTIC MoFSidst_uOnMin_C "Lower threshold for Sidestand ON." VALUE 0x908032C Val_Wu16 319.9951 spg_uw_q0p00488 0.00 319.9951 FORMAT "%8.4" /end CHARACTERISTIC
/begin CHARACTERISTIC MoFSidst_uSRCMax_C "Threshold voltage for short circuit to batt" VALUE 0x908032E Val_Wu16 319.9951 spg_uw_q0p00488 0.00 319.9951 FORMAT "%8.4" /end CHARACTERISTIC
/begin CHARACTERISTIC MoFSidst_uSRCMin_C "Threshold voltage for short circuit to ground" VALUE 0x9080330 Val_Wu16 319.9951 spg_uw_q0p00488 0.00 319.9951 FORMAT "%8.4" /end CHARACTERISTIC
/begin CHARACTERISTIC MoFSidst_vErrMin_C "Minimum vehicle speeed to detect sidestand error" VALUE 0x9080332 Val_Ws16 655.3500 Mo_v_kmh_q0p01 -327.6800 327.6700 FORMAT "%8.4" /end CHARACTERISTIC
/begin CHARACTERISTIC MoFVSS_cntrNplErr_C "Threshold for Npl error in function monitoring" VALUE 0x90802B3 Val_Wu8 255.0 dez 0.00 255.0 FORMAT "%5.1" /end CHARACTERISTIC
/begin CHARACTERISTIC MoFVSS_cntrSRCMaxErr_C "Threshold for debouncing gear sensor SCB error in function monitoring" VALUE 0x90802B4 Val_Wu8 255.0 dez 0.00 255.0 FORMAT "%5.1" /end CHARACTERISTIC
/begin CHARACTERISTIC MoFVSS_cntrSRCMinErr_C "Threshold for debouncing gear sensor SCG error in function monitoring" VALUE 0x90802B5 Val_Wu8 255.0 dez 0.00 255.0 FORMAT "%5.1" /end CHARACTERISTIC
/begin CHARACTERISTIC MoFVSS_dstPerPls_C "distance per pulse of the hardwired vehicle speed signal" VALUE 0x9080334 Val_Wu16 9.320533 s_q1p422Em4 0.00 9.320533 FORMAT "%8.6" /end CHARACTERISTIC
/begin CHARACTERISTIC MoFVSS_swtSig_C "Software switch to enable/disable vehicle speed signal acquisition over CAN (for monitoring functions)" VALUE 0x90802B6 Val_Wu8 255.0 OneToOne 0.00 255.0 FORMAT "%5.1" /end CHARACTERISTIC
/begin CHARACTERISTIC MoFVSS_vDfl_C "Default value of vehicle speed in case of errors" VALUE 0x9080336 Val_Ws16 655.3500 vel_q0p01 -327.6800 327.6700 FORMAT "%8.4" /end CHARACTERISTIC
/begin CHARACTERISTIC Mo_cwMstSlave_C "Codeword master-slave configuration in function monitoring" VALUE 0x90802B7 Val_Wu8 255.0 OneToOne 0.00 255.0 FORMAT "%5.1" /end CHARACTERISTIC
/begin CHARACTERISTIC Mo_stSwtHyb_C "code word for hybrid vehicle in the function monitoring" VALUE 0x90802B8 Val_Wu8 255.0 OneToOne 0.00 255.0 FORMAT "%5.1" /end CHARACTERISTIC
/begin CHARACTERISTIC Mo_swtClrCntrMax_C "Condition reset drag counter in function monitoring" VALUE 0x9080353 Val_Wu8 255.0 OneToOne 0.00 255.0 FORMAT "%5.1" /end CHARACTERISTIC
/begin CHARACTERISTIC Mo_swtCyclCalUpdt_C "Switch to update level 2 calibration messages for level 1" VALUE 0x90802B9 Val_Wu8 255.0 OneToOne 0.00 255.0 FORMAT "%5.1" /end CHARACTERISTIC
/begin CHARACTERISTIC Mo_swtSelVehCfg_C "Switch to select vehicle configuration in function monitoring" VALUE 0x90802BA Val_Wu8 255.0 OneToOne 0.00 255.0 FORMAT "%5.1" /end CHARACTERISTIC
/begin CHARACTERISTIC Mo_trqIdcMax_C "Maximum of inner engine torque from ECU monitoring package." VALUE 0x9080338 Val_Ws16 3276.600 md_q0p1 0.1000000 3276.700 FORMAT "%8.3" EXTENDED_LIMITS -3276.800 3276.700 /end CHARACTERISTIC
/begin CHARACTERISTIC NMAXGA "Maximum permissible engine speed (stationary)" CURVE 0x90899F4 KlAxU8SstxU8WU16_Static 16383.75 nmot_uw_q0p25 0.00 16383.75 FORMAT "%8.2"
 /begin AXIS_DESCR STD_AXIS gangi dez 8 0.00 255.0 FORMAT "%5.1" DEPOSIT ABSOLUTE /end AXIS_DESCR
/end CHARACTERISTIC
/begin CHARACTERISTIC NMAXMD_facPredEngSpd_C "Engine speed predictor factot" VALUE 0x9089A0E KwWU8 8.945 fak_ub_b10 1.016 9.961 FORMAT "%5.3" EXTENDED_LIMITS 0.00 9.961 /end CHARACTERISTIC
/begin CHARACTERISTIC NMAXMD_nSpHiLimDelta1_C "Delta RPM for resetting the first Engine speed limit Status" VALUE 0x9089A10 KwWU16 16383.75 nmot_uw_q0p25 0.00 16383.75 FORMAT "%8.2" /end CHARACTERISTIC
/begin CHARACTERISTIC NMAXMD_nSpHiLimDelta2_C "Delta RPM for resetting the second Engine speed limit Status" VALUE 0x9089A12 KwWU16 16383.75 nmot_uw_q0p25 0.00 16383.75 FORMAT "%8.2" /end CHARACTERISTIC
/begin CHARACTERISTIC NMAXMD_nSpHiLimnRunngMilg_T "Desired Engine Speed based on kilometers driven" CURVE 0x9089A14 KlAxU8SstxU16WU16 16383.75 nmot_uw_q0p25 0.00 16383.75 FORMAT "%8.2"
 /begin AXIS_DESCR STD_AXIS NMAXMD_milg OneToOne 6 0.00 65535.00 FORMAT "%8.2" DEPOSIT ABSOLUTE /end AXIS_DESCR
/end CHARACTERISTIC
/begin CHARACTERISTIC NMAXMD_nSpHiLimnRunngTi_T "Desired Engine Speed based on operating hours" CURVE 0x9089A2E KlAxU8SstxU16WU16 16383.75 nmot_uw_q0p25 0.00 16383.75 FORMAT "%8.2"
 /begin AXIS_DESCR STD_AXIS NMAXMD_tiEngRunng tmin_uw_q1 6 0.00 65535.00 FORMAT "%8.2" DEPOSIT ABSOLUTE /end AXIS_DESCR
/end CHARACTERISTIC
/begin CHARACTERISTIC NMAXMD_nSpHiLimOffs1_T "Offset for first engine speed limitation from the Maximum engine speed." CURVE 0x9089A48 KlAxU8SstxU8WU16_Static 16383.75 nmot_uw_q0p25 0.00 16383.75 FORMAT "%8.2"
 /begin AXIS_DESCR STD_AXIS gangi dez 8 0.00 255.0 FORMAT "%5.1" DEPOSIT ABSOLUTE /end AXIS_DESCR
/end CHARACTERISTIC
/begin CHARACTERISTIC NMAXMD_nSpHiLimOffs2_T "Offset for second engine speed limitation from the Maximum engine speed." CURVE 0x9089A62 KlAxU8SstxU8WU16_Static 16383.75 nmot_uw_q0p25 0.00 16383.75 FORMAT "%8.2"
 /begin AXIS_DESCR STD_AXIS gangi dez 8 0.00 255.0 FORMAT "%5.1" DEPOSIT ABSOLUTE /end AXIS_DESCR
/end CHARACTERISTIC
/begin CHARACTERISTIC NMAXMD_nSpHiOffs_T "curve to calulate high set point speed offset" CURVE 0x9089A7C KlAxU8SstxU8WU16_Static 16383.75 nmot_uw_q0p25 0.00 16383.75 FORMAT "%8.2"
 /begin AXIS_DESCR STD_AXIS gangi OneToOne 16 0.00 255.0 FORMAT "%5.1" DEPOSIT ABSOLUTE /end AXIS_DESCR
/end CHARACTERISTIC
/begin CHARACTERISTIC NMAXMD_nSpLoOffs_T "curve to calculate low speed set point offset" CURVE 0x9089AAE KlAxU8SstxU8WU16_Static 16383.75 nmot_uw_q0p25 0.00 16383.75 FORMAT "%8.2"
 /begin AXIS_DESCR STD_AXIS gangi OneToOne 16 0.00 255.0 FORMAT "%5.1" DEPOSIT ABSOLUTE /end AXIS_DESCR
/end CHARACTERISTIC
/begin CHARACTERISTIC NMAXMD_swtGrdtSpdFild_C "Switch for gradient filtered speed" VALUE 0x9089AE0 KwWU8 1.00000000000 B_TRUE 0.00 1.00000000000 FORMAT "%13.11" /end CHARACTERISTIC
/begin CHARACTERISTIC NMAXMD_tiEngSpdGrdtPtEngd_C "Time for engine speed gradient when powertrain is engaged" VALUE 0x9089AE2 KwWU16 655.3400 t_q0p01 0.01000000 655.3500 FORMAT "%8.4" EXTENDED_LIMITS 0.00 655.3500 /end CHARACTERISTIC
/begin CHARACTERISTIC NMAXMD_tiEngSpdGrdtPtOpn_C "Time for engine speed gradient when powertrain is opened" VALUE 0x9089AE4 KwWU16 655.3400 t_q0p01 0.01000000 655.3500 FORMAT "%8.4" EXTENDED_LIMITS 0.00 655.3500 /end CHARACTERISTIC
/begin CHARACTERISTIC NMAXMD_tiNEngSpLoLim1_C "Time duration for first engine speed limitation." VALUE 0x9089AE6 KwWU16 655.3500 t_q0p01 0.00 655.3500 FORMAT "%8.4" /end CHARACTERISTIC
/begin CHARACTERISTIC NMAXMD_tiNEngSpLoLim2_C "Time duration for second engine speed limitation." VALUE 0x9089AE8 KwWU16 655.3500 t_q0p01 0.00 655.3500 FORMAT "%8.4" /end CHARACTERISTIC
/begin CHARACTERISTIC NMAXMD_tiPredEngSpdAirPth_C "Time parameter for predicated engine speed on air path" VALUE 0x9089AEA KwWU8 2.550 t_q0p01 0.00 2.550 FORMAT "%5.3" /end CHARACTERISTIC
/begin CHARACTERISTIC NMAXMD_tiPredEngSpdIgnPth_C "Time parameter for predicated engine speed on ignition path" VALUE 0x9089AEB KwWU8 2.550 t_q0p01 0.00 2.550 FORMAT "%5.3" /end CHARACTERISTIC
/begin CHARACTERISTIC NMAXMD_tiTogActv_C "Calibration factor for toggle active" VALUE 0x9089AEC KwWU16 655.3500 t_q0p01 0.00 655.3500 FORMAT "%8.4" /end CHARACTERISTIC
/begin CHARACTERISTIC NMAXMD_tiTog_T "Calibration factor for controller toggle based on gear information" CURVE 0x9089AEE KlAxU8SstxU8WU16_Static 655.3500 t_q0p01 0.00 655.3500 FORMAT "%8.4"
 /begin AXIS_DESCR STD_AXIS gangi dez 8 0.00 255.0 FORMAT "%5.1" DEPOSIT ABSOLUTE /end AXIS_DESCR
/end CHARACTERISTIC
/begin CHARACTERISTIC NMAXOH "Maximum engine speed when the engine speed limiter is active" VALUE 0x9089B08 KwWU16 16383.75 nmot_uw_q0p25 0.00 16383.75 FORMAT "%8.2" /end CHARACTERISTIC
/begin CHARACTERISTIC NMAXTMM "engine speed limit at high engine temperature." CURVE 0x9089B0A KlAxU8SstxS16WU16_Static 16383.75 nmot_uw_q0p25 0.00 16383.75 FORMAT "%8.2"
 /begin AXIS_DESCR STD_AXIS EngDa_tEng Temp_Cels 8 -3549.940 3003.560 FORMAT "%8.3" DEPOSIT ABSOLUTE /end AXIS_DESCR
/end CHARACTERISTIC
/begin CHARACTERISTIC OCWDA_ctDebActvErr_C "Debouncing time of Error active condition" VALUE 0x908A0F8 Val_Wu8 255.0 OneToOne 0.00 255.0 FORMAT "%5.1" /end CHARACTERISTIC
/begin CHARACTERISTIC OCWDA_swtOffRst_C "Deactivation of error reaction (reset), if signal gets inactive once it was recognized as active." VALUE 0x908A0F9 Val_Wu8 1.00000000000 OCWDA_swtOffRst_C_compu 0.00 1.00000000000 FORMAT "%13.11" /end CHARACTERISTIC
/begin CHARACTERISTIC OilPPSSwt_nEngMax_C "Maximum Engine speed threshold for Low Oil Pressure evaluation" VALUE 0x9083674 RB_Val_Ws16 32767.50 EngN -16384.00 16383.50 FORMAT "%8.2" /end CHARACTERISTIC
/begin CHARACTERISTIC OilPPSSwt_nEngMin_C "Minimum Engine speed threshold for Low Oil Pressure evaluation" VALUE 0x9083676 RB_Val_Ws16 32767.50 EngN -16384.00 16383.50 FORMAT "%8.2" /end CHARACTERISTIC
/begin CHARACTERISTIC OilPPSSwt_percWdkbaMax_C "Maximum throttle opening threshold for Low Oil Pressure evaluation" VALUE 0x9083678 RB_Val_Ws16 1599.976 relDK_q0p02441 -800.0000 799.9756 FORMAT "%8.4" /end CHARACTERISTIC
/begin CHARACTERISTIC OilPPSSwt_percWdkbaMin_C "Minimum throttle opening threshold for Low Oil Pressure evaluation" VALUE 0x908367A RB_Val_Ws16 1599.976 relDK_q0p02441 -800.0000 799.9756 FORMAT "%8.4" /end CHARACTERISTIC
/begin CHARACTERISTIC OilPPSSwt_swtCfg_C "Low Oil Pressure Switch function Configuration" VALUE 0x908367C RB_Val_Wu8 255.0 dez 0.00 255.0 FORMAT "%5.1" /end CHARACTERISTIC
/begin CHARACTERISTIC OilPPSSwt_tEngMax_C "Maximum Engine temperature threshold for Low Oil Pressure evaluation" VALUE 0x908367E RB_Val_Ws16 6553.500 Temp_Cels -3549.940 3003.560 FORMAT "%8.3" /end CHARACTERISTIC
/begin CHARACTERISTIC OilPPSSwt_tEngMin_C "Minimum Engine temperature threshold for Low Oil Pressure evaluation" VALUE 0x9083680 RB_Val_Ws16 6553.500 Temp_Cels -3549.940 3003.560 FORMAT "%8.3" /end CHARACTERISTIC
/begin CHARACTERISTIC OilPPSSwt_tiDlyBattU_C "Debounce time for Battery Status check" VALUE 0x9083682 RB_Val_Wu16 6553.500 t_q0p1 0.00 6553.500 FORMAT "%8.3" /end CHARACTERISTIC
/begin CHARACTERISTIC OilPPSSwt_tiEngOnThd_C "Debounce time for engine on check" VALUE 0x9083684 RB_Val_Wu16 6553.500 t100msxs_uw_b6553p5 0.00 6553.500 FORMAT "%8.3" /end CHARACTERISTIC
/begin CHARACTERISTIC OilPPSSwt_tiLPLimpModeDly_C "Debounce time for enabling Limp-Home mode" VALUE 0x9083686 RB_Val_Wu16 6553.500 t_q0p1 0.00 6553.500 FORMAT "%8.3" /end CHARACTERISTIC
/begin CHARACTERISTIC OilPPSSwt_tiLPWarnLampDly_C "Debounce time for turning on Low oil pressure switch warning lamp" VALUE 0x9083688 RB_Val_Wu16 6553.500 t_q0p1 0.00 6553.500 FORMAT "%8.3" /end CHARACTERISTIC
/begin CHARACTERISTIC OilPPSSwt_tiT15EROffDly_C "TIme for Low Oil pressure switch warning lamp check at T15 On" VALUE 0x908368A RB_Val_Wu16 6553.500 t_q0p1 0.00 6553.500 FORMAT "%8.3" /end CHARACTERISTIC
/begin CHARACTERISTIC OilPPSSwt_uBattThdHi_C "Maximum Battery threshold for Low Oil Pressure Warning lamp Diagnosis" VALUE 0x908368C RB_Val_Ws16 655340.0 Volt_Batt 0.00 655340.0 FORMAT "%8.1" EXTENDED_LIMITS -655360.0 655340.0 /end CHARACTERISTIC
/begin CHARACTERISTIC OilPPSSwt_uBattThdLo_C "Minimum Battery threshold for Low Oil Pressure Warning lamp Diagnosis" VALUE 0x908368E RB_Val_Ws16 655340.0 Volt_Batt 0.00 655340.0 FORMAT "%8.1" EXTENDED_LIMITS -655360.0 655340.0 /end CHARACTERISTIC
/begin CHARACTERISTIC Oil_tiDebHighLow_C "Debounce time for High to Low signal transition" VALUE 0x9083670 RB_Val_Wu16 6553.500 t_q0p1 0.00 6553.500 FORMAT "%8.3" /end CHARACTERISTIC
/begin CHARACTERISTIC Oil_tiDebLowHigh_C "Debounce time for Low to High signal transition" VALUE 0x9083672 RB_Val_Wu16 6553.500 t_q0p1 0.00 6553.500 FORMAT "%8.3" /end CHARACTERISTIC
/begin CHARACTERISTIC OVHOFFDUTY_C "Overheat lamp turn OFF duty cycle" VALUE 0x9089C0A KwWU16 655.3500 rel_uw_q0p01 0.00 655.3500 FORMAT "%8.4" READ_ONLY /end CHARACTERISTIC
/begin CHARACTERISTIC OVHONDUTY_C "Overheat lamp turn ON duty cycle" VALUE 0x9089C0C KwWU16 655.3500 rel_uw_q0p01 0.00 655.3500 FORMAT "%8.4" READ_ONLY /end CHARACTERISTIC
/begin CHARACTERISTIC RDEBDIAG "Debounce time for roll over sensor to be active" VALUE 0x9089C6B KwWU8 25.50 t_q0p1 0.00 25.50 FORMAT "%5.2" /end CHARACTERISTIC
/begin CHARACTERISTIC ROACTMAX "Max. voltage limit for Roll-over switch functionality to be active" VALUE 0x9089C6C KwWU16 319.9951 spg_uw_q0p00488 0.00 319.9951 FORMAT "%8.4" /end CHARACTERISTIC
/begin CHARACTERISTIC ROACTMIN "Min. voltage limit for Roll-over switch functionality to be active" VALUE 0x9089C6E KwWU16 319.9951 spg_uw_q0p00488 0.00 319.9951 FORMAT "%8.4" /end CHARACTERISTIC
/begin CHARACTERISTIC ROINACTMAX "Max. voltage limit for Roll-over switch functionality to be inactive" VALUE 0x9089C70 KwWU16 319.9951 spg_uw_q0p00488 0.00 319.9951 FORMAT "%8.4" /end CHARACTERISTIC
/begin CHARACTERISTIC ROINACTMIN "Min. voltage limit for Roll-over switch functionality to be inactive" VALUE 0x9089C72 KwWU16 319.9951 spg_uw_q0p00488 0.00 319.9951 FORMAT "%8.4" /end CHARACTERISTIC
/begin CHARACTERISTIC ROSHBATMAX "Maximum voltage limit for short circuit to battery" VALUE 0x9089C74 KwWU16 319.9951 spg_uw_q0p00488 0.00 319.9951 FORMAT "%8.4" /end CHARACTERISTIC
/begin CHARACTERISTIC ROSHBATMIN "Minimum voltage limit for short circuit to battery" VALUE 0x9089C76 KwWU16 319.9951 spg_uw_q0p00488 0.00 319.9951 FORMAT "%8.4" /end CHARACTERISTIC
/begin CHARACTERISTIC ROSHGNDMAX "Maximum voltage limit for short circuit to ground" VALUE 0x9089C78 KwWU16 319.9951 spg_uw_q0p00488 0.00 319.9951 FORMAT "%8.4" /end CHARACTERISTIC
/begin CHARACTERISTIC ROSHGNDMIN "Minimum voltage limit for short circuit to ground" VALUE 0x9089C7A KwWU16 319.9951 spg_uw_q0p00488 0.00 319.9951 FORMAT "%8.4" /end CHARACTERISTIC
/begin CHARACTERISTIC ROSNOPNMAX "Maximum voltage limit for open sensor condition" VALUE 0x9089C7C KwWU16 319.9951 spg_uw_q0p00488 0.00 319.9951 FORMAT "%8.4" /end CHARACTERISTIC
/begin CHARACTERISTIC ROSNOPNMIN "Minimum voltage limit for open sensor condition" VALUE 0x9089C7E KwWU16 319.9951 spg_uw_q0p00488 0.00 319.9951 FORMAT "%8.4" /end CHARACTERISTIC
/begin CHARACTERISTIC Signals_Mode1Pid_CA "Array containing all configured PID numbers for Signals (read-only for GS)." VAL_BLK 0x908A0FA ValA_Wu8 255.0 OneToOne 0.00 255.0 FORMAT "%5.1" READ_ONLY NUMBER 27 /end CHARACTERISTIC
/begin CHARACTERISTIC Signals_Mode1SigNum_CA "Array containing the Signal numbers that correspond to Signals_Mode1Pid_CA (read-only for GS)." VAL_BLK 0x908A116 ValA_Wu16 91.0000000000 Signals_IntSigNumVerb 0.00 91.0000000000 FORMAT "%13.10" READ_ONLY NUMBER 27 /end CHARACTERISTIC
/begin CHARACTERISTIC Signals_stSrv01SuppPid_CA "Array containing all configured PID numbers for Signals (only GS)." VAL_BLK 0x908A14C ValA_Wu16 78.0000000000 Signals_PidVerbSupp 0.00 78.0000000000 FORMAT "%13.10" NUMBER 27 /end CHARACTERISTIC
/begin CHARACTERISTIC SprkSeatT_facCoolgTMdl_T "Vehicle speed correction factor for spark seat Temperature" CURVE 0x90836A0 RB_Curve_S16_U16_Static 3.906250 fak_ub_b1 0.00 3.906250 FORMAT "%8.6" EXTENDED_LIMITS 0.00 255.9961
 /begin AXIS_DESCR STD_AXIS VehV_v Vel 8 -327.6800 327.6700 FORMAT "%8.4" DEPOSIT ABSOLUTE /end AXIS_DESCR
/end CHARACTERISTIC
/begin CHARACTERISTIC SprkSeatT_facHeatgTMdl_M "Spark seat temperature factor based on Engine speed adn load" MAP 0x90836C2 RB_Map_S16U16_U16 3.906250 fak_ub_b1 0.00 3.906250 FORMAT "%8.6" EXTENDED_LIMITS 0.00 255.9961
 /begin AXIS_DESCR STD_AXIS Epm_nEng EngN 8 -16384.00 16383.50 FORMAT "%8.2" DEPOSIT ABSOLUTE /end AXIS_DESCR
 /begin AXIS_DESCR STD_AXIS rl_w rel_uw_q0p0234 8 0.00 1535.977 FORMAT "%8.3" DEPOSIT ABSOLUTE /end AXIS_DESCR
/end CHARACTERISTIC
/begin CHARACTERISTIC SprkSeatT_tDftMdl_C "Default value of Spark seat temperature incase of errors." VALUE 0x9083766 RB_Val_Ws16 3669.900 Temp_Cels -3549.940 119.9600 FORMAT "%8.3" EXTENDED_LIMITS -3549.940 3003.560 /end CHARACTERISTIC
/begin CHARACTERISTIC SprkSeatT_tEngCorrn_T "Engine temerature correction factors for sparkseat temperature" CURVE 0x9083768 RB_Curve_S16_S16 6553.500 Temp_Cels -3549.940 3003.560 FORMAT "%8.3"
 /begin AXIS_DESCR STD_AXIS EngDa_tEng Temp_Cels 8 -3549.940 3003.560 FORMAT "%8.3" DEPOSIT ABSOLUTE /end AXIS_DESCR
/end CHARACTERISTIC
/begin CHARACTERISTIC SprkSeatT_tiPT1MdlFCO_C "Time constant for PT1 filter Spark seat temperature during fuel cut off" VALUE 0x908378C RB_Val_Ws32 4294.9672940000000 TimeDelay_s 0.000002000000001 4294.9672959999998 FORMAT "%19.14" /end CHARACTERISTIC
/begin CHARACTERISTIC SprkSeatT_tiPT1Mdl_C "Time constant for PT1 filter Spark seat temperature" VALUE 0x9083790 RB_Val_Ws32 4294.9672940000000 TimeDelay_s 0.000002000000001 4294.9672959999998 FORMAT "%19.14" /end CHARACTERISTIC
/begin CHARACTERISTIC SprkSeatT_tLamCorrn_T "Lambda correction for Sparkseat temperature modelling" CURVE 0x9083794 RB_Curve_U8_S16_Static 6553.500 Temp_Cels -3549.940 3003.560 FORMAT "%8.3"
 /begin AXIS_DESCR STD_AXIS lamsol fak_q0p0039_op0p5 6 0.5000 1.496 FORMAT "%5.3" DEPOSIT ABSOLUTE /end AXIS_DESCR
/end CHARACTERISTIC
/begin CHARACTERISTIC SprkSeat_tIgnEffCorrn_M "Ignition efficiency correction Map for Spark seat temperature modelling" MAP 0x90837A8 RB_Map_U16U8_S16 6553.500 Temp_Cels -3549.940 3003.560 FORMAT "%8.3"
 /begin AXIS_DESCR STD_AXIS ml_w m_uw_b6553p5 6 0.00 6553.500 FORMAT "%8.3" DEPOSIT ABSOLUTE /end AXIS_DESCR
 /begin AXIS_DESCR STD_AXIS etazwimt rel_ub_b127p5 6 0.00 127.5 FORMAT "%5.1" DEPOSIT ABSOLUTE /end AXIS_DESCR
/end CHARACTERISTIC
/begin CHARACTERISTIC StrtCtl_nStrtRlsMax_C "maximum speed for starter release" VALUE 0x9089C82 KwWS16 16383.50 EngN 0.00 16383.50 FORMAT "%8.2" EXTENDED_LIMITS -16384.00 16383.50 /end CHARACTERISTIC
/begin CHARACTERISTIC Strt_ATS.LimitTypeMsk_C "Actuator test Strt_ATS / Tester demand monitoring enable mask for actuators" VALUE 0x9089EC0 Val_Wu8 255.0 OneToOne 0.00 255.0 FORMAT "%5.1" /end CHARACTERISTIC
/begin CHARACTERISTIC Strt_ATS.CnvNorm_C "Actuator test Strt_ATS / Conversion norm used for conversion to/from internal scaling" VALUE 0x9089EC1 Val_Wu8 255.0 OneToOne 0.00 255.0 FORMAT "%5.1" /end CHARACTERISTIC
/begin CHARACTERISTIC Strt_ATS.LowLim_C "Actuator test Strt_ATS / Lower limit for monitoring" VALUE 0x9089EC2 Val_Ws16 65535.00 OneToOne -32768.00 32767.00 FORMAT "%8.2" /end CHARACTERISTIC
/begin CHARACTERISTIC Strt_ATS.UpLim_C "Actuator test Strt_ATS / Upper limit for monitoring" VALUE 0x9089EC4 Val_Ws16 65535.00 OneToOne -32768.00 32767.00 FORMAT "%8.2" /end CHARACTERISTIC
/begin CHARACTERISTIC Strt_ATS.CnvFac_C "Actuator test Strt_ATS / Factor used for conversion to/from internal scaling" VALUE 0x9089EC8 Val_Ws32 4294967295.00 OneToOne -2147483648.00 2147483647.00 FORMAT "%13.2" /end CHARACTERISTIC
/begin CHARACTERISTIC Strt_ATS.CnvOfs_C "Actuator test Strt_ATS / Offset used for conversion to/from internal scaling" VALUE 0x9089ECC Val_Ws16 65535.00 OneToOne -32768.00 32767.00 FORMAT "%8.2" /end CHARACTERISTIC
/begin CHARACTERISTIC Strt_ATS.DfltVal_C "Actuator test Strt_ATS / Default value for standbytest" VALUE 0x9089ECE Val_Ws16 65535.00 OneToOne -32768.00 32767.00 FORMAT "%8.2" /end CHARACTERISTIC
/begin CHARACTERISTIC Strt_nMaxStrt_C "Max. engine speed for detection starter = active" VALUE 0x908134A Val_Ws16 32767.50 EngN -16384.00 16383.50 FORMAT "%8.2" /end CHARACTERISTIC
/begin CHARACTERISTIC Strt_uDiffMaxStrt_C "Max. voltage difference for detection starter = active" VALUE 0x908134C Val_Ws16 30000.00 Volt_Batt 0.00 30000.00 FORMAT "%8.2" EXTENDED_LIMITS -655360.0 655340.0 /end CHARACTERISTIC
/begin CHARACTERISTIC StSys_cntrStrtFailMaxThd_C "Maximum consecutive fail start threshold" VALUE 0x9089C84 KwWU16 65535.00 OneToOne 0.00 65535.00 FORMAT "%8.2" /end CHARACTERISTIC
/begin CHARACTERISTIC StSys_nMaxStrtAtmpt_C "Max start attemp allowed in current driving cycle" VALUE 0x9089C86 KwWU8 255.0 dez 0.00 255.0 FORMAT "%5.1" /end CHARACTERISTIC
/begin CHARACTERISTIC StSys_nStrtCtlMax_C "engine speed limit to switch off start-relay" VALUE 0x9089C88 KwWS16 32767.50 EngN -16384.00 16383.50 FORMAT "%8.2" /end CHARACTERISTIC
/begin CHARACTERISTIC StSys_prcWdkbaMax_C "Max throttle opening allowed during start" VALUE 0x9089C8A KwWS16 1599.976 relDK_q0p02441 -800.0000 799.9756 FORMAT "%8.4" /end CHARACTERISTIC
/begin CHARACTERISTIC StSys_RstCdnMsk_C "Reset condition mask for starter inhibition" VALUE 0x9089C8C KwWU16 65535.00 OneToOne 0.00 65535.00 FORMAT "%8.2" /end CHARACTERISTIC
/begin CHARACTERISTIC StSys_tiMaxStrtRest_C "Maximum Rest duration allowed for starter" VALUE 0x9089C8E KwWU16 1310.700 t_q0p02 0.00 1310.700 FORMAT "%8.3" /end CHARACTERISTIC
/begin CHARACTERISTIC StSys_tiMinStrtrRest_C "Minimum starter rest time after activation for max.duration" VALUE 0x9089C90 KwWU16 1310.700 t_q0p02 0.00 1310.700 FORMAT "%8.3" /end CHARACTERISTIC
/begin CHARACTERISTIC StSys_tiStrtCtlMax_C "locktime of starter-control" VALUE 0x9089C92 KwWU16 1310.700 t_q0p02 0.00 1310.700 FORMAT "%8.3" /end CHARACTERISTIC
/begin CHARACTERISTIC StSys_uStrtCtlMin_C "deactivation of start-control if battery voltage is less than StSys_uStrtCtlMin_C" VALUE 0x9089C96 KwWU8 25.50 spg_q0p1 0.00 25.50 FORMAT "%5.2" /end CHARACTERISTIC
/begin CHARACTERISTIC TCOMVLD "Debounce time to valid the com message" VALUE 0x9089C80 KwWU8 5.100 t_q0p02 0.00 5.100 FORMAT "%5.3" /end CHARACTERISTIC
/begin CHARACTERISTIC TDOVHSHDWN "time delay to shutdown the engine" VALUE 0x9089B2C KwWU8 25.50 t100msxs_ub_b25p5 0.00 25.50 FORMAT "%5.2" /end CHARACTERISTIC
/begin CHARACTERISTIC TDOVHSPLIM "time delay to limit the speed" VALUE 0x9089B2D KwWU8 25.50 t100msxs_ub_b25p5 0.00 25.50 FORMAT "%5.2" /end CHARACTERISTIC
/begin CHARACTERISTIC TENGLIMPHI "coolant temperature high threshold to limit the engine speed" VALUE 0x9089B2E KwWS16 6553.500 Temp_Cels -3549.940 3003.560 FORMAT "%8.3" /end CHARACTERISTIC
/begin CHARACTERISTIC TENGLIMPLO "coolant temperature low threshold to limit the engine speed" VALUE 0x9089B30 KwWS16 6553.500 Temp_Cels -3549.940 3003.560 FORMAT "%8.3" /end CHARACTERISTIC
/begin CHARACTERISTIC TENGSHDNHI "coolant temperature high threshold to shutdown the engine" VALUE 0x9089B32 KwWS16 6553.500 Temp_Cels -3549.940 3003.560 FORMAT "%8.3" /end CHARACTERISTIC
/begin CHARACTERISTIC TENGSHDNLO "coolant temperature low threshold to shutdown the engine" VALUE 0x9089B34 KwWS16 6553.500 Temp_Cels -3549.940 3003.560 FORMAT "%8.3" /end CHARACTERISTIC
/begin CHARACTERISTIC TMOTDUTY_C "Duty cycle of engine temperature PWM signal to tachometer" CURVE 0x9089C0E KlAUwSstUwWUw 655.3500 rel_uw_q0p01 0.00 655.3500 FORMAT "%8.4"
 /begin AXIS_DESCR STD_AXIS tmot Temp_Cels 11 -273.1400 6280.360 FORMAT "%8.3" DEPOSIT ABSOLUTE /end AXIS_DESCR
/end CHARACTERISTIC
/begin CHARACTERISTIC TMOTPERIOD_C "Frequency of engine temperature PWM signal to tachometer" CURVE 0x9089C3C KlAUwSstUwWUw 6.553500 t_q0p0001_ms 0.00 6.553500 FORMAT "%8.6"
 /begin AXIS_DESCR STD_AXIS tmot Temp_Cels 11 -273.1400 6280.360 FORMAT "%8.3" DEPOSIT ABSOLUTE /end AXIS_DESCR
/end CHARACTERISTIC
/begin CHARACTERISTIC TVTLT "Debounce time for tilt" VALUE 0x9089C81 KwWU8 5.100 t_q0p02 0.00 5.100 FORMAT "%5.3" /end CHARACTERISTIC
/begin MEASUREMENT B_hr_msg "condition main relay on" UBYTE B_TRUE 1 100 0.00 1.00000000000 BIT_MASK 0x1 FORMAT "%13.11" ECU_ADDRESS 0x4000638F
 /begin IF_DATA XCPplus 0x0102
  /begin DAQ_EVENT VARIABLE /begin AVAILABLE_EVENT_LIST EVENT 0 EVENT 1 EVENT 2 EVENT 3 /end AVAILABLE_EVENT_LIST /begin DEFAULT_EVENT_LIST EVENT 1 /end DEFAULT_EVENT_LIST /end DAQ_EVENT
 /end IF_DATA
/end MEASUREMENT
/begin MEASUREMENT B_nmax "Condition engine speed limitation active" UBYTE B_TRUE 1 100 0.00 1.00000000000 BIT_MASK 0x1 FORMAT "%13.11" ECU_ADDRESS 0x4000879F
 /begin IF_DATA XCPplus 0x0102
  /begin DAQ_EVENT VARIABLE /begin AVAILABLE_EVENT_LIST EVENT 0 EVENT 1 EVENT 2 EVENT 3 /end AVAILABLE_EVENT_LIST /begin DEFAULT_EVENT_LIST EVENT 1 /end DEFAULT_EVENT_LIST /end DAQ_EVENT
 /end IF_DATA
/end MEASUREMENT
/begin MEASUREMENT B_OvHEngShDwn "Engine shutdown active" UBYTE B_TRUE 1 100 0.00 1.00000000000 BIT_MASK 0x1 FORMAT "%13.11" ECU_ADDRESS 0x400087AA
 /begin IF_DATA XCPplus 0x0102
  /begin DAQ_EVENT VARIABLE /begin AVAILABLE_EVENT_LIST EVENT 0 EVENT 1 EVENT 2 EVENT 3 /end AVAILABLE_EVENT_LIST /begin DEFAULT_EVENT_LIST EVENT 2 /end DEFAULT_EVENT_LIST /end DAQ_EVENT
 /end IF_DATA
/end MEASUREMENT
/begin MEASUREMENT B_OvHEngSpdLimr "Engine speed limiter active" UBYTE B_TRUE 1 100 0.00 1.00000000000 BIT_MASK 0x2 FORMAT "%13.11" ECU_ADDRESS 0x400087AA
 /begin IF_DATA XCPplus 0x0102
  /begin DAQ_EVENT VARIABLE /begin AVAILABLE_EVENT_LIST EVENT 0 EVENT 1 EVENT 2 EVENT 3 /end AVAILABLE_EVENT_LIST /begin DEFAULT_EVENT_LIST EVENT 2 /end DEFAULT_EVENT_LIST /end DAQ_EVENT
 /end IF_DATA
/end MEASUREMENT
/begin MEASUREMENT B_tltsig "Condition:tilt has occured" UBYTE B_TRUE 1 100 0.00 1.00000000000 BIT_MASK 0x1 FORMAT "%13.11" ECU_ADDRESS 0x4000C703
 /begin IF_DATA XCPplus 0x0102
  /begin DAQ_EVENT VARIABLE /begin AVAILABLE_EVENT_LIST EVENT 0 EVENT 1 EVENT 2 EVENT 3 /end AVAILABLE_EVENT_LIST /begin DEFAULT_EVENT_LIST EVENT 2 /end DEFAULT_EVENT_LIST /end DAQ_EVENT
 /end IF_DATA
/end MEASUREMENT
/begin MEASUREMENT dnsi_w "Difference between engine speed limit and actual engine speed" SWORD nmot_sw_q0p25 1 100 -8192.000 8191.750 FORMAT "%8.3" ECU_ADDRESS 0x4000836C
 /begin IF_DATA XCPplus 0x0102
  /begin DAQ_EVENT VARIABLE /begin AVAILABLE_EVENT_LIST EVENT 0 EVENT 1 EVENT 2 EVENT 3 /end AVAILABLE_EVENT_LIST /begin DEFAULT_EVENT_LIST EVENT 1 /end DEFAULT_EVENT_LIST /end DAQ_EVENT
 /end IF_DATA
/end MEASUREMENT
/begin MEASUREMENT Eep_ctAbsCallWrFkt "16-bit-counter which counts the function calls to Eep_Write and Eep_Init over all driving cycles" UWORD OneToOne 1 100 0.00 65535.00 FORMAT "%8.2" ECU_ADDRESS 0x4000C6EE /end MEASUREMENT
/begin MEASUREMENT Eep_ctCallWrFkt "Counter which counts the function calls to Eep_Write and Eep_Init during one driving cycle" UWORD OneToOne 1 100 0.00 65535.00 FORMAT "%8.2" ECU_ADDRESS 0x4000B440 /end MEASUREMENT
/begin MEASUREMENT Eep_ctMaxCallWrFkt "Maximum value of Eep_ctCallWrFkt" UWORD OneToOne 1 100 0.00 65535.00 FORMAT "%8.2" ECU_ADDRESS 0x4000C6F0 /end MEASUREMENT
/begin MEASUREMENT Eep_EnvRamHist "History state ENVRAM(Emulated Non Volatile Random Access Memory)" UBYTE OneToOne 1 100 0.00 255.0 FORMAT "%5.1" ECU_ADDRESS 0x40006553 /end MEASUREMENT
/begin MEASUREMENT Eep_EnvRamInvld "Invalidity state ENVRAM(Emulated Non Volatile Random Access Memory)" UBYTE OneToOne 1 100 0.00 255.0 FORMAT "%5.1" ECU_ADDRESS 0x40006554 /end MEASUREMENT
/begin MEASUREMENT Eep_stBlk "Status array with status of each EEP block" UWORD OneToOne 1 100 0.00 65535.00 FORMAT "%8.2" ARRAY_SIZE 9 ECU_ADDRESS 0x400060F8 /end MEASUREMENT
/begin MEASUREMENT Eep_stMain "Main state of EEP" SLONG Eep_MainStates_Verb 1 100 0.00 14.0000000000 FORMAT "%13.10" ECU_ADDRESS 0x40005678 /end MEASUREMENT
/begin MEASUREMENT Eep_stPostDrv "Status of EEP process in PostDrive / PreDrive" UBYTE Eep_PostDrvState_Verb 1 100 0.00 4.00000000000 FORMAT "%13.11" ECU_ADDRESS 0x40006551 /end MEASUREMENT
/begin MEASUREMENT engdutycycle "Engine speed duty cycle to cluster" UWORD rel_uw_q0p01 1 100 0.00 100.0000 FORMAT "%8.4" ECU_ADDRESS 0x40008382 /end MEASUREMENT
/begin MEASUREMENT engperiod "Frequency of engine speed PWM signal to tachometer" ULONG t_q0p0001_ms 1 100 0.00 429496.729500 FORMAT "%13.6" ECU_ADDRESS 0x40008E1C /end MEASUREMENT
/begin MEASUREMENT flcondutycycle "Fuel Consumption Duty Cycle Output to Cluster" UWORD rel_uw_q0p01 1 100 0.00 655.3500 FORMAT "%8.4" ECU_ADDRESS 0x4000837A /end MEASUREMENT
/begin MEASUREMENT flconperiod "Fuel consumption PWM signal time period" UWORD t_q0p01 1 100 0.00 655.3500 FORMAT "%8.4" ECU_ADDRESS 0x40008380 /end MEASUREMENT
/begin MEASUREMENT flconsum "Fuel consumption based on average mileage" UBYTE dez 1 100 0.00 255.0 FORMAT "%5.1" ECU_ADDRESS 0x400087AB /end MEASUREMENT
/begin MEASUREMENT minmxi "I-component of NMAX-Controller (Ignition-path)" ULONG rel_q4p76837Em5 1 100 0.00 99.9984741211 FORMAT "%13.10" ECU_ADDRESS 0x40008E14
 /begin IF_DATA XCPplus 0x0102
  /begin DAQ_EVENT VARIABLE /begin AVAILABLE_EVENT_LIST EVENT 0 EVENT 1 EVENT 2 EVENT 3 /end AVAILABLE_EVENT_LIST /begin DEFAULT_EVENT_LIST EVENT 1 /end DEFAULT_EVENT_LIST /end DAQ_EVENT
 /end IF_DATA
/end MEASUREMENT
/begin MEASUREMENT minmx_w "Torque request by engine speed limitation" UWORD rel_uw_b100 1 100 0.00 99.99847 FORMAT "%8.5" ECU_ADDRESS 0x40008352
 /begin IF_DATA XCPplus 0x0102
  /begin DAQ_EVENT VARIABLE /begin AVAILABLE_EVENT_LIST EVENT 0 EVENT 1 EVENT 2 EVENT 3 /end AVAILABLE_EVENT_LIST /begin DEFAULT_EVENT_LIST EVENT 1 /end DEFAULT_EVENT_LIST /end DAQ_EVENT
 /end IF_DATA
/end MEASUREMENT
/begin MEASUREMENT MoFSidst_bbOutCpl "RAM data redundancy for MoFSidst_bbOut" UBYTE OneToOne 1 100 0.00 255.0 FORMAT "%5.1" ECU_ADDRESS 0x40009F67
 /begin IF_DATA XCPplus 0x0102
  /begin DAQ_EVENT VARIABLE /begin AVAILABLE_EVENT_LIST EVENT 0 EVENT 1 EVENT 2 EVENT 3 /end AVAILABLE_EVENT_LIST /begin DEFAULT_EVENT_LIST EVENT 1 /end DEFAULT_EVENT_LIST /end DAQ_EVENT
 /end IF_DATA
/end MEASUREMENT
/begin MEASUREMENT MoFSidst_cntrDeb "Debounce counter for Sidestand signal in Function monitoring" UBYTE OneToOne 1 100 0.00 255.0 FORMAT "%5.1" ECU_ADDRESS 0x4000A0E9
 /begin IF_DATA XCPplus 0x0102
  /begin DAQ_EVENT VARIABLE /begin AVAILABLE_EVENT_LIST EVENT 0 EVENT 1 EVENT 2 EVENT 3 /end AVAILABLE_EVENT_LIST /begin DEFAULT_EVENT_LIST EVENT 1 /end DEFAULT_EVENT_LIST /end DAQ_EVENT
 /end IF_DATA
/end MEASUREMENT
/begin MEASUREMENT MoFSidst_cntrDebCpl "RAM data redundancy for MoFSidst_cntrDeb" UBYTE OneToOne 1 100 0.00 255.0 FORMAT "%5.1" ECU_ADDRESS 0x40009F66
 /begin IF_DATA XCPplus 0x0102
  /begin DAQ_EVENT VARIABLE /begin AVAILABLE_EVENT_LIST EVENT 0 EVENT 1 EVENT 2 EVENT 3 /end AVAILABLE_EVENT_LIST /begin DEFAULT_EVENT_LIST EVENT 1 /end DEFAULT_EVENT_LIST /end DAQ_EVENT
 /end IF_DATA
/end MEASUREMENT
/begin MEASUREMENT MoFSidst_cntrDebExcddThdNv "Counter for exceedance of the debounce level of a correct calibrated of error counter MoFSidst_cntrErrDeb" UBYTE OneToOne 1 100 0.00 255.0 FORMAT "%5.1" ECU_ADDRESS 0x4000CD47
 /begin IF_DATA XCPplus 0x0102
  /begin DAQ_EVENT VARIABLE /begin AVAILABLE_EVENT_LIST EVENT 0 EVENT 1 EVENT 2 EVENT 3 /end AVAILABLE_EVENT_LIST /begin DEFAULT_EVENT_LIST EVENT 1 /end DEFAULT_EVENT_LIST /end DAQ_EVENT
 /end IF_DATA
/end MEASUREMENT
/begin MEASUREMENT MoFSidst_cntrDebMaxNv "MaxValueIndicator for debouncing counter of error counter MoFSidst_cntrErrDeb" UBYTE OneToOne 1 100 0.00 255.0 FORMAT "%5.1" ECU_ADDRESS 0x4000CD46
 /begin IF_DATA XCPplus 0x0102
  /begin DAQ_EVENT VARIABLE /begin AVAILABLE_EVENT_LIST EVENT 0 EVENT 1 EVENT 2 EVENT 3 /end AVAILABLE_EVENT_LIST /begin DEFAULT_EVENT_LIST EVENT 1 /end DEFAULT_EVENT_LIST /end DAQ_EVENT
 /end IF_DATA
/end MEASUREMENT
/begin MEASUREMENT MoFSidst_cntrDebSidstL2 "Debounce counter for side stand in level2" UBYTE OneToOne 1 100 0.00 255.0 FORMAT "%5.1" ECU_ADDRESS 0x4000A0E8
 /begin IF_DATA XCPplus 0x0102
  /begin DAQ_EVENT VARIABLE /begin AVAILABLE_EVENT_LIST EVENT 0 EVENT 1 EVENT 2 EVENT 3 /end AVAILABLE_EVENT_LIST /begin DEFAULT_EVENT_LIST EVENT 1 /end DEFAULT_EVENT_LIST /end DAQ_EVENT
 /end IF_DATA
/end MEASUREMENT
/begin MEASUREMENT MoFSidst_cntrDebSidstL2Cpl "RAM data redundancy for MoFSidst_cntrDebSidstL2" UBYTE OneToOne 1 100 0.00 255.0 FORMAT "%5.1" ECU_ADDRESS 0x40009F65
 /begin IF_DATA XCPplus 0x0102
  /begin DAQ_EVENT VARIABLE /begin AVAILABLE_EVENT_LIST EVENT 0 EVENT 1 EVENT 2 EVENT 3 /end AVAILABLE_EVENT_LIST /begin DEFAULT_EVENT_LIST EVENT 1 /end DEFAULT_EVENT_LIST /end DAQ_EVENT
 /end IF_DATA
/end MEASUREMENT
/begin MEASUREMENT MoFSidst_cntrDebTst "Error counter for testing the sidestand" UBYTE OneToOne 1 100 0.00 255.0 FORMAT "%5.1" ECU_ADDRESS 0x4000A0E4
 /begin IF_DATA XCPplus 0x0102
  /begin DAQ_EVENT VARIABLE /begin AVAILABLE_EVENT_LIST EVENT 0 EVENT 1 EVENT 2 EVENT 3 /end AVAILABLE_EVENT_LIST /begin DEFAULT_EVENT_LIST EVENT 1 /end DEFAULT_EVENT_LIST /end DAQ_EVENT
 /end IF_DATA
/end MEASUREMENT
/begin MEASUREMENT MoFSidst_cntrDebTstCpl "RAM data redundancy for MoFSidst_cntrDebTst" UBYTE OneToOne 1 100 0.00 255.0 FORMAT "%5.1" ECU_ADDRESS 0x40009F64
 /begin IF_DATA XCPplus 0x0102
  /begin DAQ_EVENT VARIABLE /begin AVAILABLE_EVENT_LIST EVENT 0 EVENT 1 EVENT 2 EVENT 3 /end AVAILABLE_EVENT_LIST /begin DEFAULT_EVENT_LIST EVENT 1 /end DEFAULT_EVENT_LIST /end DAQ_EVENT
 /end IF_DATA
/end MEASUREMENT
/begin MEASUREMENT MoFSidst_cntrErrICOIgnDeb "Debounce counter for Ignition cut-off in case of Sidestand error" UBYTE OneToOne 1 100 0.00 255.0 FORMAT "%5.1" ECU_ADDRESS 0x4000A0E7
 /begin IF_DATA XCPplus 0x0102
  /begin DAQ_EVENT VARIABLE /begin AVAILABLE_EVENT_LIST EVENT 0 EVENT 1 EVENT 2 EVENT 3 /end AVAILABLE_EVENT_LIST /begin DEFAULT_EVENT_LIST EVENT 1 /end DEFAULT_EVENT_LIST /end DAQ_EVENT
 /end IF_DATA
/end MEASUREMENT
/begin MEASUREMENT MoFSidst_cntrErrICOIgnDebCpl "RAM data redundancy for MoFSidst_cntrErrICOIgnDeb" UBYTE OneToOne 1 100 0.00 255.0 FORMAT "%5.1" ECU_ADDRESS 0x40009F63
 /begin IF_DATA XCPplus 0x0102
  /begin DAQ_EVENT VARIABLE /begin AVAILABLE_EVENT_LIST EVENT 0 EVENT 1 EVENT 2 EVENT 3 /end AVAILABLE_EVENT_LIST /begin DEFAULT_EVENT_LIST EVENT 1 /end DEFAULT_EVENT_LIST /end DAQ_EVENT
 /end IF_DATA
/end MEASUREMENT
/begin MEASUREMENT MoFSidst_cntrErrICOIgnDebOld "Old value of the debounce counter of error counter MoFSidst_cntrErrICOIgnDeb" UBYTE OneToOne 1 100 0.00 255.0 FORMAT "%5.1" ECU_ADDRESS 0x40009F62
 /begin IF_DATA XCPplus 0x0102
  /begin DAQ_EVENT VARIABLE /begin AVAILABLE_EVENT_LIST EVENT 0 EVENT 1 EVENT 2 EVENT 3 /end AVAILABLE_EVENT_LIST /begin DEFAULT_EVENT_LIST EVENT 1 /end DEFAULT_EVENT_LIST /end DAQ_EVENT
 /end IF_DATA
/end MEASUREMENT
/begin MEASUREMENT MoFSidst_cntrErrICOInjDeb "Debounce counter for Injection cut-off in case of Sidestand error" UBYTE OneToOne 1 100 0.00 255.0 FORMAT "%5.1" ECU_ADDRESS 0x4000A0E6
 /begin IF_DATA XCPplus 0x0102
  /begin DAQ_EVENT VARIABLE /begin AVAILABLE_EVENT_LIST EVENT 0 EVENT 1 EVENT 2 EVENT 3 /end AVAILABLE_EVENT_LIST /begin DEFAULT_EVENT_LIST EVENT 1 /end DEFAULT_EVENT_LIST /end DAQ_EVENT
 /end IF_DATA
/end MEASUREMENT
/begin MEASUREMENT MoFSidst_cntrErrICOInjDebCpl "RAM data redundancy for MoFSidst_cntrErrICOInjDeb" UBYTE OneToOne 1 100 0.00 255.0 FORMAT "%5.1" ECU_ADDRESS 0x40009F61
 /begin IF_DATA XCPplus 0x0102
  /begin DAQ_EVENT VARIABLE /begin AVAILABLE_EVENT_LIST EVENT 0 EVENT 1 EVENT 2 EVENT 3 /end AVAILABLE_EVENT_LIST /begin DEFAULT_EVENT_LIST EVENT 1 /end DEFAULT_EVENT_LIST /end DAQ_EVENT
 /end IF_DATA
/end MEASUREMENT
/begin MEASUREMENT MoFSidst_cntrErrICOInjDebOld "Old value of the debounce counter of error counter MoFSidst_cntrErrICOInjDeb" UBYTE OneToOne 1 100 0.00 255.0 FORMAT "%5.1" ECU_ADDRESS 0x40009F60
 /begin IF_DATA XCPplus 0x0102
  /begin DAQ_EVENT VARIABLE /begin AVAILABLE_EVENT_LIST EVENT 0 EVENT 1 EVENT 2 EVENT 3 /end AVAILABLE_EVENT_LIST /begin DEFAULT_EVENT_LIST EVENT 1 /end DEFAULT_EVENT_LIST /end DAQ_EVENT
 /end IF_DATA
/end MEASUREMENT
/begin MEASUREMENT MoFSidst_cntrErrIgnDebExcddThdNv "Counter for exceedance of the debounce level of a correct calibrated of error counter MoFSidst_cntrErrICOIgnDeb" UBYTE OneToOne 1 100 0.00 255.0 FORMAT "%5.1" ECU_ADDRESS 0x4000CD45
 /begin IF_DATA XCPplus 0x0102
  /begin DAQ_EVENT VARIABLE /begin AVAILABLE_EVENT_LIST EVENT 0 EVENT 1 EVENT 2 EVENT 3 /end AVAILABLE_EVENT_LIST /begin DEFAULT_EVENT_LIST EVENT 1 /end DEFAULT_EVENT_LIST /end DAQ_EVENT
 /end IF_DATA
/end MEASUREMENT
/begin MEASUREMENT MoFSidst_cntrErrIgnDebMaxNv "MaxValueIndicator for debouncing counter of error counter MoFSidst_cntrErrICOIgnDeb" UBYTE OneToOne 1 100 0.00 255.0 FORMAT "%5.1" ECU_ADDRESS 0x4000CD44
 /begin IF_DATA XCPplus 0x0102
  /begin DAQ_EVENT VARIABLE /begin AVAILABLE_EVENT_LIST EVENT 0 EVENT 1 EVENT 2 EVENT 3 /end AVAILABLE_EVENT_LIST /begin DEFAULT_EVENT_LIST EVENT 1 /end DEFAULT_EVENT_LIST /end DAQ_EVENT
 /end IF_DATA
/end MEASUREMENT
/begin MEASUREMENT MoFSidst_cntrErrInjDebExcddThdNv "Counter for exceedance of the debounce level of a correct calibrated of error counter MoFSidst_cntrErrICOInjDeb" UBYTE OneToOne 1 100 0.00 255.0 FORMAT "%5.1" ECU_ADDRESS 0x4000CD43
 /begin IF_DATA XCPplus 0x0102
  /begin DAQ_EVENT VARIABLE /begin AVAILABLE_EVENT_LIST EVENT 0 EVENT 1 EVENT 2 EVENT 3 /end AVAILABLE_EVENT_LIST /begin DEFAULT_EVENT_LIST EVENT 1 /end DEFAULT_EVENT_LIST /end DAQ_EVENT
 /end IF_DATA
/end MEASUREMENT
/begin MEASUREMENT MoFSidst_cntrErrInjDebMaxNv "MaxValueIndicator for debouncing counter of error counter MoFSidst_cntrErrICOInjDeb" UBYTE OneToOne 1 100 0.00 255.0 FORMAT "%5.1" ECU_ADDRESS 0x4000CD42
 /begin IF_DATA XCPplus 0x0102
  /begin DAQ_EVENT VARIABLE /begin AVAILABLE_EVENT_LIST EVENT 0 EVENT 1 EVENT 2 EVENT 3 /end AVAILABLE_EVENT_LIST /begin DEFAULT_EVENT_LIST EVENT 1 /end DEFAULT_EVENT_LIST /end DAQ_EVENT
 /end IF_DATA
/end MEASUREMENT
/begin MEASUREMENT MoFSidst_cntrOld "Old value of the debounce counter of error counter MoFSidst_cntrErrDeb" UBYTE OneToOne 1 100 0.00 255.0 FORMAT "%5.1" ECU_ADDRESS 0x40009F5F
 /begin IF_DATA XCPplus 0x0102
  /begin DAQ_EVENT VARIABLE /begin AVAILABLE_EVENT_LIST EVENT 0 EVENT 1 EVENT 2 EVENT 3 /end AVAILABLE_EVENT_LIST /begin DEFAULT_EVENT_LIST EVENT 1 /end DEFAULT_EVENT_LIST /end DAQ_EVENT
 /end IF_DATA
/end MEASUREMENT
/begin MEASUREMENT MoFSidst_flgClr "Diagnosis fault clear bit for the diagnosis monitoring" UBYTE B_TRUE 1 100 0.00 1.00000000000 BIT_MASK 0x1 FORMAT "%13.11" ECU_ADDRESS 0x4000636C
 /begin IF_DATA XCPplus 0x0102
  /begin DAQ_EVENT VARIABLE /begin AVAILABLE_EVENT_LIST EVENT 0 EVENT 1 EVENT 2 EVENT 3 /end AVAILABLE_EVENT_LIST /begin DEFAULT_EVENT_LIST EVENT 1 /end DEFAULT_EVENT_LIST /end DAQ_EVENT
 /end IF_DATA
/end MEASUREMENT
/begin MEASUREMENT MoFSidst_flgImpsErr "Sidestand sensor voltage in non plausible range" UBYTE B_TRUE 1 100 0.00 1.00000000000 BIT_MASK 0x2 FORMAT "%13.11" ECU_ADDRESS 0x4000A0EA
 /begin IF_DATA XCPplus 0x0102
  /begin DAQ_EVENT VARIABLE /begin AVAILABLE_EVENT_LIST EVENT 0 EVENT 1 EVENT 2 EVENT 3 /end AVAILABLE_EVENT_LIST /begin DEFAULT_EVENT_LIST EVENT 1 /end DEFAULT_EVENT_LIST /end DAQ_EVENT
 /end IF_DATA
/end MEASUREMENT
/begin MEASUREMENT MoFSidst_flgIrvErrSidstMsg "Irreversible error of sidestand in function monitoring" UBYTE B_TRUE 1 100 0.00 1.00000000000 BIT_MASK 0x1 FORMAT "%13.11" ECU_ADDRESS 0x4000636B
 /begin IF_DATA XCPplus 0x0102
  /begin DAQ_EVENT VARIABLE /begin AVAILABLE_EVENT_LIST EVENT 0 EVENT 1 EVENT 2 EVENT 3 /end AVAILABLE_EVENT_LIST /begin DEFAULT_EVENT_LIST EVENT 1 /end DEFAULT_EVENT_LIST /end DAQ_EVENT
 /end IF_DATA
/end MEASUREMENT
/begin MEASUREMENT MoFSidst_flgScbErr "Sidestand sensor short circuit to batt" UBYTE B_TRUE 1 100 0.00 1.00000000000 BIT_MASK 0x4 FORMAT "%13.11" ECU_ADDRESS 0x4000A0EA
 /begin IF_DATA XCPplus 0x0102
  /begin DAQ_EVENT VARIABLE /begin AVAILABLE_EVENT_LIST EVENT 0 EVENT 1 EVENT 2 EVENT 3 /end AVAILABLE_EVENT_LIST /begin DEFAULT_EVENT_LIST EVENT 1 /end DEFAULT_EVENT_LIST /end DAQ_EVENT
 /end IF_DATA
/end MEASUREMENT
/begin MEASUREMENT MoFSidst_flgScgErr "Sidestand sensor short circuit to ground" UBYTE B_TRUE 1 100 0.00 1.00000000000 BIT_MASK 0x8 FORMAT "%13.11" ECU_ADDRESS 0x4000A0EA
 /begin IF_DATA XCPplus 0x0102
  /begin DAQ_EVENT VARIABLE /begin AVAILABLE_EVENT_LIST EVENT 0 EVENT 1 EVENT 2 EVENT 3 /end AVAILABLE_EVENT_LIST /begin DEFAULT_EVENT_LIST EVENT 1 /end DEFAULT_EVENT_LIST /end DAQ_EVENT
 /end IF_DATA
/end MEASUREMENT
/begin MEASUREMENT MoFSidst_flgSidst "Status of Sidestant in function monitoring" UBYTE B_TRUE 1 100 0.00 1.00000000000 BIT_MASK 0x1 FORMAT "%13.11" ECU_ADDRESS 0x4000A0EA
 /begin IF_DATA XCPplus 0x0102
  /begin DAQ_EVENT VARIABLE /begin AVAILABLE_EVENT_LIST EVENT 0 EVENT 1 EVENT 2 EVENT 3 /end AVAILABLE_EVENT_LIST /begin DEFAULT_EVENT_LIST EVENT 1 /end DEFAULT_EVENT_LIST /end DAQ_EVENT
 /end IF_DATA
/end MEASUREMENT
/begin MEASUREMENT MoFSidst_flgSidstErr "Status of Sidestand error in function monitoring" UBYTE B_TRUE 1 100 0.00 1.00000000000 BIT_MASK 0x10 FORMAT "%13.11" ECU_ADDRESS 0x4000A0EA
 /begin IF_DATA XCPplus 0x0102
  /begin DAQ_EVENT VARIABLE /begin AVAILABLE_EVENT_LIST EVENT 0 EVENT 1 EVENT 2 EVENT 3 /end AVAILABLE_EVENT_LIST /begin DEFAULT_EVENT_LIST EVENT 1 /end DEFAULT_EVENT_LIST /end DAQ_EVENT
 /end IF_DATA
/end MEASUREMENT
/begin MEASUREMENT MoFSidst_flgSidstErrMsg "Status of Sidestand error status for L1 from L2" UBYTE B_TRUE 1 100 0.00 1.00000000000 BIT_MASK 0x1 FORMAT "%13.11" ECU_ADDRESS 0x4000636A
 /begin IF_DATA XCPplus 0x0102
  /begin DAQ_EVENT VARIABLE /begin AVAILABLE_EVENT_LIST EVENT 0 EVENT 1 EVENT 2 EVENT 3 /end AVAILABLE_EVENT_LIST /begin DEFAULT_EVENT_LIST EVENT 1 /end DEFAULT_EVENT_LIST /end DAQ_EVENT
 /end IF_DATA
/end MEASUREMENT
/begin MEASUREMENT MoFSidst_flgTstMsg "Identification for release condition of the fault test for diagnosis" UBYTE B_TRUE 1 100 0.00 1.00000000000 BIT_MASK 0x1 FORMAT "%13.11" ECU_ADDRESS 0x40006369
 /begin IF_DATA XCPplus 0x0102
  /begin DAQ_EVENT VARIABLE /begin AVAILABLE_EVENT_LIST EVENT 0 EVENT 1 EVENT 2 EVENT 3 /end AVAILABLE_EVENT_LIST /begin DEFAULT_EVENT_LIST EVENT 1 /end DEFAULT_EVENT_LIST /end DAQ_EVENT
 /end IF_DATA
/end MEASUREMENT
/begin MEASUREMENT MoFSidst_stSidstOld "Previous raster value of Sidestand status in L2" UBYTE OneToOne 1 100 0.00 255.0 FORMAT "%5.1" ECU_ADDRESS 0x4000A0E5
 /begin IF_DATA XCPplus 0x0102
  /begin DAQ_EVENT VARIABLE /begin AVAILABLE_EVENT_LIST EVENT 0 EVENT 1 EVENT 2 EVENT 3 /end AVAILABLE_EVENT_LIST /begin DEFAULT_EVENT_LIST EVENT 1 /end DEFAULT_EVENT_LIST /end DAQ_EVENT
 /end IF_DATA
/end MEASUREMENT
/begin MEASUREMENT MoFSidst_stSidstOldCpl "RAM data redundancy for MoFSidst_stSidstOld" UBYTE OneToOne 1 100 0.00 255.0 FORMAT "%5.1" ECU_ADDRESS 0x40009F5E
 /begin IF_DATA XCPplus 0x0102
  /begin DAQ_EVENT VARIABLE /begin AVAILABLE_EVENT_LIST EVENT 0 EVENT 1 EVENT 2 EVENT 3 /end AVAILABLE_EVENT_LIST /begin DEFAULT_EVENT_LIST EVENT 1 /end DEFAULT_EVENT_LIST /end DAQ_EVENT
 /end IF_DATA
/end MEASUREMENT
/begin MEASUREMENT MoFSidst_uSidstRaw "Side stand raw value in function monitoring" UWORD spg_uw_q0p00488 1 100 0.00 319.9951 FORMAT "%8.4" ECU_ADDRESS 0x4000A0E2
 /begin IF_DATA XCPplus 0x0102
  /begin DAQ_EVENT VARIABLE /begin AVAILABLE_EVENT_LIST EVENT 0 EVENT 1 EVENT 2 EVENT 3 /end AVAILABLE_EVENT_LIST /begin DEFAULT_EVENT_LIST EVENT 1 /end DEFAULT_EVENT_LIST /end DAQ_EVENT
 /end IF_DATA
/end MEASUREMENT
/begin MEASUREMENT MoFSidst_uSidstRawCpl "RAM data redundancy for MoFSidst_uSidstRaw" UWORD OneToOne 1 100 0.00 65535.00 FORMAT "%8.2" ECU_ADDRESS 0x40009F5C
 /begin IF_DATA XCPplus 0x0102
  /begin DAQ_EVENT VARIABLE /begin AVAILABLE_EVENT_LIST EVENT 0 EVENT 1 EVENT 2 EVENT 3 /end AVAILABLE_EVENT_LIST /begin DEFAULT_EVENT_LIST EVENT 1 /end DEFAULT_EVENT_LIST /end DAQ_EVENT
 /end IF_DATA
/end MEASUREMENT
/begin MEASUREMENT MoFSidst_uSidst_MP "MP for raw value of sidestand signal" UWORD spg_uw_q0p00488 1 100 0.00 319.9951 FORMAT "%8.4" ECU_ADDRESS 0x40009E54
 /begin IF_DATA XCPplus 0x0102
  /begin DAQ_EVENT VARIABLE /begin AVAILABLE_EVENT_LIST EVENT 0 EVENT 1 EVENT 2 EVENT 3 /end AVAILABLE_EVENT_LIST /begin DEFAULT_EVENT_LIST EVENT 1 /end DEFAULT_EVENT_LIST /end DAQ_EVENT
 /end IF_DATA
/end MEASUREMENT
/begin MEASUREMENT MoFVSSCo_bbLocCpl "Complement variable for MoFVSSCo_bbLoc" UBYTE OneToOne 1 100 0.00 255.0 FORMAT "%5.1" ECU_ADDRESS 0x40009F5A /end MEASUREMENT
/begin MEASUREMENT MoFVSS_bbOutCpl "RAM data redundancy for MoFVSS_bbOut" UBYTE OneToOne 1 100 0.00 255.0 FORMAT "%5.1" ECU_ADDRESS 0x40009F59 /end MEASUREMENT
/begin MEASUREMENT MoFVSS_cntrNplErr "Counter to debounce Npl error in function monitoirng" UBYTE dez 1 100 0.00 255.0 FORMAT "%5.1" ECU_ADDRESS 0x4000A0DE /end MEASUREMENT
/begin MEASUREMENT MoFVSS_cntrNplErrCpl "RAM data redundancy for MoFVSS_cntrNplErr" UBYTE OneToOne 1 100 0.00 255.0 FORMAT "%5.1" ECU_ADDRESS 0x40009F58 /end MEASUREMENT
/begin MEASUREMENT MoFVSS_cntrSRCMaxErr "Counter for debouncing gear sensor SCB error in function monitoring" UBYTE dez 1 100 0.00 255.0 FORMAT "%5.1" ECU_ADDRESS 0x4000A0DD /end MEASUREMENT
/begin MEASUREMENT MoFVSS_cntrSRCMaxErrCpl "RAM data redundancy for MoFVSS_cntrSRCMaxErr" UBYTE OneToOne 1 100 0.00 255.0 FORMAT "%5.1" ECU_ADDRESS 0x40009F57 /end MEASUREMENT
/begin MEASUREMENT MoFVSS_cntrSRCMinErr "Counter for debouncing gear sensor SCG error in function monitoring" UBYTE dez 1 100 0.00 255.0 FORMAT "%5.1" ECU_ADDRESS 0x4000A0DC /end MEASUREMENT
/begin MEASUREMENT MoFVSS_cntrSRCMinErrCpl "RAM data redundancy for MoFVSS_cntrSRCMinErr" UBYTE OneToOne 1 100 0.00 255.0 FORMAT "%5.1" ECU_ADDRESS 0x40009F56 /end MEASUREMENT
/begin MEASUREMENT MoFVSS_flgABSDispFrntwhlSpdVld "Flag to indicate validity of front wheel speed" UBYTE B_TRUE 1 100 0.00 1.00000000000 BIT_MASK 0x4 FORMAT "%13.11" ECU_ADDRESS 0x4000A0E0 /end MEASUREMENT
/begin MEASUREMENT MoFVSS_flgABSDispRewhlSpdVld "Flag to indicate validity of rear wheel speed" UBYTE B_TRUE 1 100 0.00 1.00000000000 BIT_MASK 0x8 FORMAT "%13.11" ECU_ADDRESS 0x4000A0E0 /end MEASUREMENT
/begin MEASUREMENT MoFVSS_flgChkSumOK_MP "Measurement point to indicate the status of PWM checksum error" UBYTE B_TRUE 1 100 0.00 1.00000000000 BIT_MASK 0x1 FORMAT "%13.11" ECU_ADDRESS 0x40009E52 /end MEASUREMENT
/begin MEASUREMENT MoFVSS_flgNplErr_MP "Vehicle speed sensor Npl error in function monitoring" UBYTE B_TRUE 1 100 0.00 1.00000000000 BIT_MASK 0x1 FORMAT "%13.11" ECU_ADDRESS 0x40009E51 /end MEASUREMENT
/begin MEASUREMENT MoFVSS_flgPwmErr "Error flag that shows PWM error." UBYTE B_TRUE 1 100 0.00 1.00000000000 BIT_MASK 0x1 FORMAT "%13.11" ECU_ADDRESS 0x4000A0DF /end MEASUREMENT
/begin MEASUREMENT MoFVSS_flgSRCMaxErr "vehicle speed sensor SCB error in function monitoring" UBYTE B_TRUE 1 100 0.00 1.00000000000 BIT_MASK 0x4 FORMAT "%13.11" ECU_ADDRESS 0x4000A0DF /end MEASUREMENT
/begin MEASUREMENT MoFVSS_flgSRCMinErr "Vehicle speed sensor SCG error in function monitoring" UBYTE B_TRUE 1 100 0.00 1.00000000000 BIT_MASK 0x2 FORMAT "%13.11" ECU_ADDRESS 0x4000A0DF /end MEASUREMENT
/begin MEASUREMENT MoFVSS_stSignal_mp "Status signal of PWM." UBYTE OneToOne 1 100 0.00 255.0 FORMAT "%5.1" ECU_ADDRESS 0x40009E50 /end MEASUREMENT
/begin MEASUREMENT MoFVSS_tiHighDur_mp "ON time of PWM signal." ULONG InJTimeHiRes_us 1 100 0.00 214748364.750 FORMAT "%13.3" ECU_ADDRESS 0x40009E4C /end MEASUREMENT
/begin MEASUREMENT MoFVSS_tiPerAvrg_mp "Average time period of PWM signal." ULONG InJTimeHiRes_us 1 100 0.00 214748364.750 FORMAT "%13.3" ECU_ADDRESS 0x40009E48 /end MEASUREMENT
/begin MEASUREMENT MoFVSS_v "Vehicle speed for function monitoring" SWORD Mo_v_kmh_q0p01 1 100 -327.6800 327.6700 FORMAT "%8.4" ECU_ADDRESS 0x4000A0D6 /end MEASUREMENT
/begin MEASUREMENT MoFVSS_vABSDispFrntWhlSpd "ABS display front wheel speed" UWORD vfzg_q0p05625_km_DIV_h 1 100 0.00 3686.344 FORMAT "%8.3" ECU_ADDRESS 0x4000A0DA /end MEASUREMENT
/begin MEASUREMENT MoFVSS_vABSDispFrntWhlSpdCpl "Double storagr for ABS display front wheel speed" UWORD OneToOne 1 100 0.00 65535.00 FORMAT "%8.2" ECU_ADDRESS 0x40009F54 /end MEASUREMENT
/begin MEASUREMENT MoFVSS_vABSDispFrntWhlSpd_Mp "Measurement point for ABS display front wheel speed" UWORD vfzg_q0p05625_km_DIV_h 1 100 0.00 3686.344 FORMAT "%8.3" ECU_ADDRESS 0x40009E44 /end MEASUREMENT
/begin MEASUREMENT MoFVSS_vABSDispReWhlSpd "ABS display Rear wheel speed" UWORD vfzg_q0p05625_km_DIV_h 1 100 0.00 3686.344 FORMAT "%8.3" ECU_ADDRESS 0x4000A0D8 /end MEASUREMENT
/begin MEASUREMENT MoFVSS_vABSDispReWhlSpdCpl "Double storage for ABS display Rear wheel speed" UWORD OneToOne 1 100 0.00 65535.00 FORMAT "%8.2" ECU_ADDRESS 0x40009F52 /end MEASUREMENT
/begin MEASUREMENT MoFVSS_vABSDispReWhlSpd_Mp "Measurement point for ABS display Rear wheel speed" UWORD vfzg_q0p05625_km_DIV_h 1 100 0.00 3686.344 FORMAT "%8.3" ECU_ADDRESS 0x40009E42 /end MEASUREMENT
/begin MEASUREMENT MoFVSS_vCpl "Double storage of meassurement point for vehicle speed over CAN" UWORD OneToOne 1 100 0.00 65535.00 FORMAT "%8.2" ECU_ADDRESS 0x40009F50 /end MEASUREMENT
/begin MEASUREMENT MoGlbl_bbLocExtdTskCpl "duplicate storage for MoGlbl_bbLocExtdTskCpl" UBYTE OneToOne 1 100 0.00 255.0 FORMAT "%5.1" ECU_ADDRESS 0x40009F4E /end MEASUREMENT
/begin MEASUREMENT Mo_bAddConPFC "Generation of additional Response Contributions to program Folw Check" UBYTE B_TRUE 1 100 0.00 1.00000000000 BIT_MASK 0x80 FORMAT "%13.11" ECU_ADDRESS 0x4000A0D2 /end MEASUREMENT
/begin MEASUREMENT Mo_bAddConPFCExtdTsk "Generation of additional Response Contributions to program Folw Check in the extended task" UBYTE B_TRUE 1 100 0.00 1.00000000000 BIT_MASK 0x80 FORMAT "%13.11" ECU_ADDRESS 0x4000A0D1 /end MEASUREMENT
/begin MEASUREMENT Mo_bAddDisblPreICORst "Additional condition disable Pre-ICO reset in function monitoring" UBYTE B_TRUE 1 100 0.00 1.00000000000 BIT_MASK 0x8 FORMAT "%13.11" ECU_ADDRESS 0x4000A0D2 /end MEASUREMENT
/begin MEASUREMENT Mo_bAddDisblPreICORstExtdTsk "Additional condition disable Pre-ICO reset in function monitoring in the extended task" UBYTE B_TRUE 1 100 0.00 1.00000000000 BIT_MASK 0x8 FORMAT "%13.11" ECU_ADDRESS 0x4000A0D1 /end MEASUREMENT
/begin MEASUREMENT Mo_bCplChk "Fault reaction requirement from cyclic RAM safeguarding in function monitoring" UBYTE B_TRUE 1 100 0.00 1.00000000000 BIT_MASK 0x1 FORMAT "%13.11" ECU_ADDRESS 0x4000A0D4 /end MEASUREMENT
/begin MEASUREMENT Mo_bCplChkExtdTsk "Fault reaction requirement from cyclic RAM safeguarding in function monitoring in the extended task" UBYTE B_TRUE 1 100 0.00 1.00000000000 BIT_MASK 0x1 FORMAT "%13.11" ECU_ADDRESS 0x4000A0D3 /end MEASUREMENT
/begin MEASUREMENT Mo_bEmgcyAir "Request standby air driving from level1 in function monitoring" UBYTE B_TRUE 1 100 0.00 1.00000000000 BIT_MASK 0x20 FORMAT "%13.11" ECU_ADDRESS 0x4000A0D2 /end MEASUREMENT
/begin MEASUREMENT Mo_bICOL1 "Injection Cut Off demand from Level 1" UBYTE B_TRUE 1 100 0.00 1.00000000000 BIT_MASK 0x2 FORMAT "%13.11" ECU_ADDRESS 0x4000A0D2 /end MEASUREMENT
/begin MEASUREMENT Mo_bICOL2 "Injection Cut Off demand from Level 2" UBYTE B_TRUE 1 100 0.00 1.00000000000 BIT_MASK 0x1 FORMAT "%13.11" ECU_ADDRESS 0x4000A0D2 /end MEASUREMENT
/begin MEASUREMENT Mo_bICOL2ExtdTsk "Injection Cut Off demand from Level 2 in the extended task" UBYTE B_TRUE 1 100 0.00 1.00000000000 BIT_MASK 0x1 FORMAT "%13.11" ECU_ADDRESS 0x4000A0D1 /end MEASUREMENT
/begin MEASUREMENT Mo_bIrvElMIdl "irreversible idle request for the electric motor" UBYTE B_TRUE 1 100 0.00 1.00000000000 BIT_MASK 0x20 FORMAT "%13.11" ECU_ADDRESS 0x4000A0D5 /end MEASUREMENT
/begin MEASUREMENT Mo_bIrvHybLimpL1 "Irreversible hybrid-limp-home mode requested from level 1" UBYTE B_TRUE 1 100 0.00 1.00000000000 BIT_MASK 0x2 FORMAT "%13.11" ECU_ADDRESS 0x4000A0D5 /end MEASUREMENT
/begin MEASUREMENT Mo_bIrvHybLimpL2 "Irreversible hybrid-limp-home mode requested from level 2" UBYTE B_TRUE 1 100 0.00 1.00000000000 BIT_MASK 0x1 FORMAT "%13.11" ECU_ADDRESS 0x4000A0D5 /end MEASUREMENT
/begin MEASUREMENT Mo_bIrvHybP1LimpL2 "Irreversible limp home mode P1 hybrid from level 2 in function monitoring" UBYTE B_TRUE 1 100 0.00 1.00000000000 BIT_MASK 0x10 FORMAT "%13.11" ECU_ADDRESS 0x4000A0D5 /end MEASUREMENT
/begin MEASUREMENT Mo_bIrvTrqLimL1 "Irreversible torque limitation from level 1 in function monitoring" UBYTE B_TRUE 1 100 0.00 1.00000000000 BIT_MASK 0x8 FORMAT "%13.11" ECU_ADDRESS 0x4000A0D5 /end MEASUREMENT
/begin MEASUREMENT Mo_bIrvTrqLimL2 "Irreversible torque limitation from level 2 in function monitoring" UBYTE B_TRUE 1 100 0.00 1.00000000000 BIT_MASK 0x4 FORMAT "%13.11" ECU_ADDRESS 0x4000A0D5 /end MEASUREMENT
/begin MEASUREMENT Mo_bLoVltg "Battery voltage not OK, undervoltage shut-off active" UBYTE B_TRUE 1 100 0.00 1.00000000000 BIT_MASK 0x4 FORMAT "%13.11" ECU_ADDRESS 0x4000A0D2 /end MEASUREMENT
/begin MEASUREMENT Mo_bNlh "irreversible demand of non-lean operation mode from function monitoring" UBYTE B_TRUE 1 100 0.00 1.00000000000 BIT_MASK 0x10 FORMAT "%13.11" ECU_ADDRESS 0x4000A0D2 /end MEASUREMENT
/begin MEASUREMENT Mo_bRamErr "RAM error occured in cyclic check" UBYTE B_TRUE 1 100 0.00 1.00000000000 BIT_MASK 0x2 FORMAT "%13.11" ECU_ADDRESS 0x4000A0D4 /end MEASUREMENT
/begin MEASUREMENT Mo_bRamErrExtdTsk "RAM error occured in cyclic check" UBYTE B_TRUE 1 100 0.00 1.00000000000 BIT_MASK 0x2 FORMAT "%13.11" ECU_ADDRESS 0x4000A0D3 /end MEASUREMENT
/begin MEASUREMENT Mo_bRomErr "ROM error occured in cyclic check" UBYTE B_TRUE 1 100 0.00 1.00000000000 BIT_MASK 0x4 FORMAT "%13.11" ECU_ADDRESS 0x4000A0D4 /end MEASUREMENT
/begin MEASUREMENT Mo_bSyncLos "condition loss of synchronization in function monitoring" UBYTE B_TRUE 1 100 0.00 1.00000000000 BIT_MASK 0x40 FORMAT "%13.11" ECU_ADDRESS 0x4000A0D2 /end MEASUREMENT
/begin MEASUREMENT Mo_ctRst "Reset counter" UBYTE OneToOne 1 100 0.00 255.0 FORMAT "%5.1" ECU_ADDRESS 0x4000B5A9
 /begin IF_DATA XCPplus 0x0102
  /begin DAQ_EVENT VARIABLE /begin AVAILABLE_EVENT_LIST EVENT 0 EVENT 1 EVENT 2 EVENT 3 /end AVAILABLE_EVENT_LIST /begin DEFAULT_EVENT_LIST EVENT 1 /end DEFAULT_EVENT_LIST /end DAQ_EVENT
 /end IF_DATA
/end MEASUREMENT
/begin MEASUREMENT Mo_ctRstCpl "RAM data redundancy of Mo_ctRst" UBYTE OneToOne 1 100 0.00 255.0 FORMAT "%5.1" ECU_ADDRESS 0x4000B5A8
 /begin IF_DATA XCPplus 0x0102
  /begin DAQ_EVENT VARIABLE /begin AVAILABLE_EVENT_LIST EVENT 0 EVENT 1 EVENT 2 EVENT 3 /end AVAILABLE_EVENT_LIST /begin DEFAULT_EVENT_LIST EVENT 1 /end DEFAULT_EVENT_LIST /end DAQ_EVENT
 /end IF_DATA
/end MEASUREMENT
/begin MEASUREMENT Mo_flgICOMsg "flag for layer 1: error reaction injection quantities limitation from the monitoring" UBYTE B_TRUE 1 100 0.00 1.00000000000 BIT_MASK 0x1 FORMAT "%13.11" ECU_ADDRESS 0x40006398
 /begin IF_DATA XCPplus 0x0102
  /begin DAQ_EVENT VARIABLE /begin AVAILABLE_EVENT_LIST EVENT 0 EVENT 1 EVENT 2 EVENT 3 /end AVAILABLE_EVENT_LIST /begin DEFAULT_EVENT_LIST EVENT 1 /end DEFAULT_EVENT_LIST /end DAQ_EVENT
 /end IF_DATA
/end MEASUREMENT
/begin MEASUREMENT Mo_stCplChk "Complementcheck failed" ULONG OneToOne 1 100 0.00 4294967295.00 FORMAT "%13.2" ECU_ADDRESS 0x40009F44
 /begin IF_DATA XCPplus 0x0102
  /begin DAQ_EVENT VARIABLE /begin AVAILABLE_EVENT_LIST EVENT 0 EVENT 1 EVENT 2 EVENT 3 /end AVAILABLE_EVENT_LIST /begin DEFAULT_EVENT_LIST EVENT 1 /end DEFAULT_EVENT_LIST /end DAQ_EVENT
 /end IF_DATA
/end MEASUREMENT
/begin MEASUREMENT Mo_stErrHyb "Status Bits for demands of error reaction hybrid system in function monitoring" UBYTE OneToOne 1 100 0.00 255.0 FORMAT "%5.1" ECU_ADDRESS 0x4000A0D5 /end MEASUREMENT
/begin MEASUREMENT Mo_stErrHybCpl "RAM data redundancy of Mo_stErrHyb" UBYTE OneToOne 1 100 0.00 255.0 FORMAT "%5.1" ECU_ADDRESS 0x40009F4D /end MEASUREMENT
/begin MEASUREMENT Mo_stMoC "Status Bits for demands of error reaction in controller monitoring" UBYTE OneToOne 1 100 0.00 255.0 FORMAT "%5.1" ECU_ADDRESS 0x4000A0D4
 /begin IF_DATA XCPplus 0x0102
  /begin DAQ_EVENT VARIABLE /begin AVAILABLE_EVENT_LIST EVENT 0 EVENT 1 EVENT 2 EVENT 3 /end AVAILABLE_EVENT_LIST /begin DEFAULT_EVENT_LIST EVENT 1 /end DEFAULT_EVENT_LIST /end DAQ_EVENT
 /end IF_DATA
/end MEASUREMENT
/begin MEASUREMENT Mo_stMoCCpl "RAM data redundancy of Mo_stMoC" UBYTE OneToOne 1 100 0.00 255.0 FORMAT "%5.1" ECU_ADDRESS 0x40009F4C
 /begin IF_DATA XCPplus 0x0102
  /begin DAQ_EVENT VARIABLE /begin AVAILABLE_EVENT_LIST EVENT 0 EVENT 1 EVENT 2 EVENT 3 /end AVAILABLE_EVENT_LIST /begin DEFAULT_EVENT_LIST EVENT 1 /end DEFAULT_EVENT_LIST /end DAQ_EVENT
 /end IF_DATA
/end MEASUREMENT
/begin MEASUREMENT Mo_stMoCExtdTsk "Status bits for the error reaction request in the monitoring processor" UBYTE OneToOne 1 100 0.00 255.0 FORMAT "%5.1" ECU_ADDRESS 0x4000A0D3 /end MEASUREMENT
/begin MEASUREMENT Mo_stMoCExtdTskCpl "Complement value for Mo_stMoCExtdTsk" UBYTE OneToOne 1 100 0.00 255.0 FORMAT "%5.1" ECU_ADDRESS 0x40009F4B /end MEASUREMENT
/begin MEASUREMENT Mo_stMoF "Status Bits for demands of error reaction in function monitoring" UBYTE OneToOne 1 100 0.00 255.0 FORMAT "%5.1" ECU_ADDRESS 0x4000A0D2
 /begin IF_DATA XCPplus 0x0102
  /begin DAQ_EVENT VARIABLE /begin AVAILABLE_EVENT_LIST EVENT 0 EVENT 1 EVENT 2 EVENT 3 /end AVAILABLE_EVENT_LIST /begin DEFAULT_EVENT_LIST EVENT 1 /end DEFAULT_EVENT_LIST /end DAQ_EVENT
 /end IF_DATA
/end MEASUREMENT
/begin MEASUREMENT Mo_stMoFCpl "RAM data redundancy of Mo_stMoF" UBYTE OneToOne 1 100 0.00 255.0 FORMAT "%5.1" ECU_ADDRESS 0x40009F4A
 /begin IF_DATA XCPplus 0x0102
  /begin DAQ_EVENT VARIABLE /begin AVAILABLE_EVENT_LIST EVENT 0 EVENT 1 EVENT 2 EVENT 3 /end AVAILABLE_EVENT_LIST /begin DEFAULT_EVENT_LIST EVENT 1 /end DEFAULT_EVENT_LIST /end DAQ_EVENT
 /end IF_DATA
/end MEASUREMENT
/begin MEASUREMENT Mo_stMoFExtdTsk "Status Bits for demands of error reaction in function monitoring in the extended task" UBYTE OneToOne 1 100 0.00 255.0 FORMAT "%5.1" ECU_ADDRESS 0x4000A0D1 /end MEASUREMENT
/begin MEASUREMENT Mo_stMoFExtdTskCpl "RAM data redundancy of Mo_stMoFExtdTsk" UBYTE OneToOne 1 100 0.00 255.0 FORMAT "%5.1" ECU_ADDRESS 0x40009F49 /end MEASUREMENT
/begin MEASUREMENT Mo_stProtRAM "status of Prot RAM initialisation of error monitoring" UBYTE OneToOne 1 100 0.00 255.0 FORMAT "%5.1" ECU_ADDRESS 0x4000B5AA
 /begin IF_DATA XCPplus 0x0102
  /begin DAQ_EVENT VARIABLE /begin AVAILABLE_EVENT_LIST EVENT 0 EVENT 1 EVENT 2 EVENT 3 /end AVAILABLE_EVENT_LIST /begin DEFAULT_EVENT_LIST EVENT 1 /end DEFAULT_EVENT_LIST /end DAQ_EVENT
 /end IF_DATA
/end MEASUREMENT
/begin MEASUREMENT Mo_stVldR32Chk "status to determine if the ValidR32 check failed" ULONG OneToOne 1 100 0.00 4294967295.00 FORMAT "%13.2" ECU_ADDRESS 0x40009F40 /end MEASUREMENT
/begin MEASUREMENT Mo_swtSelVehCfg "Vehicle configuration info in function monitoring" UBYTE OneToOne 1 100 0.00 255.0 FORMAT "%5.1" ECU_ADDRESS 0x4000A0D0
 /begin IF_DATA XCPplus 0x0102
  /begin DAQ_EVENT VARIABLE /begin AVAILABLE_EVENT_LIST EVENT 0 EVENT 1 EVENT 2 EVENT 3 /end AVAILABLE_EVENT_LIST /begin DEFAULT_EVENT_LIST EVENT 1 /end DEFAULT_EVENT_LIST /end DAQ_EVENT
 /end IF_DATA
/end MEASUREMENT
/begin MEASUREMENT Mo_swtSelVehCfgCpl "RAM data redundancy for Mo_swtSelVehCfg" UBYTE OneToOne 1 100 0.00 255.0 FORMAT "%5.1" ECU_ADDRESS 0x40009F48
 /begin IF_DATA XCPplus 0x0102
  /begin DAQ_EVENT VARIABLE /begin AVAILABLE_EVENT_LIST EVENT 0 EVENT 1 EVENT 2 EVENT 3 /end AVAILABLE_EVENT_LIST /begin DEFAULT_EVENT_LIST EVENT 1 /end DEFAULT_EVENT_LIST /end DAQ_EVENT
 /end IF_DATA
/end MEASUREMENT
/begin MEASUREMENT MRly_ctErlyOpng "Errorcounter-message to detect early opening of the main relay" UBYTE OneToOne 1 100 0.00 255.0 FORMAT "%5.1" ECU_ADDRESS 0x400063C8 /end MEASUREMENT
/begin MEASUREMENT MRly_st "Request to switch on and off the main relay" UBYTE OneToOne 1 100 0.00 255.0 BIT_MASK 0x1 FORMAT "%5.1" ECU_ADDRESS 0x400063A5 /end MEASUREMENT
/begin MEASUREMENT MRly_stAct "Status of main relay" UBYTE OneToOne 1 100 0.00 255.0 FORMAT "%5.1" ECU_ADDRESS 0x400063C7 /end MEASUREMENT
/begin MEASUREMENT NMAXMD_bActvCtrlrIgnPth "Controller activation via ignition path" UBYTE B_TRUE 1 100 0.00 1.00000000000 BIT_MASK 0x1 FORMAT "%13.11" ECU_ADDRESS 0x400087A5
 /begin IF_DATA XCPplus 0x0102
  /begin DAQ_EVENT VARIABLE /begin AVAILABLE_EVENT_LIST EVENT 0 EVENT 1 EVENT 2 EVENT 3 /end AVAILABLE_EVENT_LIST /begin DEFAULT_EVENT_LIST EVENT 1 /end DEFAULT_EVENT_LIST /end DAQ_EVENT
 /end IF_DATA
/end MEASUREMENT
/begin MEASUREMENT NMAXMD_bCtrlrEna "controller Enabler" UBYTE B_TRUE 1 100 0.00 1.00000000000 BIT_MASK 0x1 FORMAT "%13.11" ECU_ADDRESS 0x400087A6
 /begin IF_DATA XCPplus 0x0102
  /begin DAQ_EVENT VARIABLE /begin AVAILABLE_EVENT_LIST EVENT 0 EVENT 1 EVENT 2 EVENT 3 /end AVAILABLE_EVENT_LIST /begin DEFAULT_EVENT_LIST EVENT 1 /end DEFAULT_EVENT_LIST /end DAQ_EVENT
 /end IF_DATA
/end MEASUREMENT
/begin MEASUREMENT NMAXMD_dnGrdtEngSpdFild "Predicted Engine Speed gradient after filteration" SWORD EngNGrd 1 100 -16384.00 16383.50 FORMAT "%8.2" ECU_ADDRESS 0x40008370
 /begin IF_DATA XCPplus 0x0102
  /begin DAQ_EVENT VARIABLE /begin AVAILABLE_EVENT_LIST EVENT 0 EVENT 1 EVENT 2 EVENT 3 /end AVAILABLE_EVENT_LIST /begin DEFAULT_EVENT_LIST EVENT 1 /end DEFAULT_EVENT_LIST /end DAQ_EVENT
 /end IF_DATA
/end MEASUREMENT
/begin MEASUREMENT NMAXMD_flgActvCtrlrIgnPth "Flag of activate controller via ignition path" UBYTE B_TRUE 1 100 0.00 1.00000000000 BIT_MASK 0x1 FORMAT "%13.11" ECU_ADDRESS 0x400087A4
 /begin IF_DATA XCPplus 0x0102
  /begin DAQ_EVENT VARIABLE /begin AVAILABLE_EVENT_LIST EVENT 0 EVENT 1 EVENT 2 EVENT 3 /end AVAILABLE_EVENT_LIST /begin DEFAULT_EVENT_LIST EVENT 1 /end DEFAULT_EVENT_LIST /end DAQ_EVENT
 /end IF_DATA
/end MEASUREMENT
/begin MEASUREMENT NMAXMD_flgCdnTogActv "Flag for toggle active condition on ignition path" UBYTE B_TRUE 1 100 0.00 1.00000000000 BIT_MASK 0x1 FORMAT "%13.11" ECU_ADDRESS 0x4000879E
 /begin IF_DATA XCPplus 0x0102
  /begin DAQ_EVENT VARIABLE /begin AVAILABLE_EVENT_LIST EVENT 0 EVENT 1 EVENT 2 EVENT 3 /end AVAILABLE_EVENT_LIST /begin DEFAULT_EVENT_LIST EVENT 1 /end DEFAULT_EVENT_LIST /end DAQ_EVENT
 /end IF_DATA
/end MEASUREMENT
/begin MEASUREMENT NMAXMD_flgCtrlrActv "Flag for Controller Active" UBYTE B_TRUE 1 100 0.00 1.00000000000 BIT_MASK 0x1 FORMAT "%13.11" ECU_ADDRESS 0x4000879D
 /begin IF_DATA XCPplus 0x0102
  /begin DAQ_EVENT VARIABLE /begin AVAILABLE_EVENT_LIST EVENT 0 EVENT 1 EVENT 2 EVENT 3 /end AVAILABLE_EVENT_LIST /begin DEFAULT_EVENT_LIST EVENT 1 /end DEFAULT_EVENT_LIST /end DAQ_EVENT
 /end IF_DATA
/end MEASUREMENT
/begin MEASUREMENT NMAXMD_flgIntegIniIgnPth "Flag for integrator initailization on ignition path" UBYTE B_TRUE 1 100 0.00 1.00000000000 BIT_MASK 0x1 FORMAT "%13.11" ECU_ADDRESS 0x400087A3
 /begin IF_DATA XCPplus 0x0102
  /begin DAQ_EVENT VARIABLE /begin AVAILABLE_EVENT_LIST EVENT 0 EVENT 1 EVENT 2 EVENT 3 /end AVAILABLE_EVENT_LIST /begin DEFAULT_EVENT_LIST EVENT 1 /end DEFAULT_EVENT_LIST /end DAQ_EVENT
 /end IF_DATA
/end MEASUREMENT
/begin MEASUREMENT NMAXMD_flgIntegInit "Integrator initiallization flag" UBYTE B_TRUE 1 100 0.00 1.00000000000 BIT_MASK 0x1 FORMAT "%13.11" ECU_ADDRESS 0x400087A7
 /begin IF_DATA XCPplus 0x0102
  /begin DAQ_EVENT VARIABLE /begin AVAILABLE_EVENT_LIST EVENT 0 EVENT 1 EVENT 2 EVENT 3 /end AVAILABLE_EVENT_LIST /begin DEFAULT_EVENT_LIST EVENT 1 /end DEFAULT_EVENT_LIST /end DAQ_EVENT
 /end IF_DATA
/end MEASUREMENT
/begin MEASUREMENT NMAXMD_flgNEngHiLim1 "Status for first limit of Maximum engine speed" UBYTE B_TRUE 1 100 0.00 1.00000000000 BIT_MASK 0x1 FORMAT "%13.11" ECU_ADDRESS 0x400087A0
 /begin IF_DATA XCPplus 0x0102
  /begin DAQ_EVENT VARIABLE /begin AVAILABLE_EVENT_LIST EVENT 0 EVENT 1 EVENT 2 EVENT 3 /end AVAILABLE_EVENT_LIST /begin DEFAULT_EVENT_LIST EVENT 1 /end DEFAULT_EVENT_LIST /end DAQ_EVENT
 /end IF_DATA
/end MEASUREMENT
/begin MEASUREMENT NMAXMD_flgNEngHiLim2 "Status for second limit of Maximum engine speed" UBYTE B_TRUE 1 100 0.00 1.00000000000 BIT_MASK 0x1 FORMAT "%13.11" ECU_ADDRESS 0x400087A1
 /begin IF_DATA XCPplus 0x0102
  /begin DAQ_EVENT VARIABLE /begin AVAILABLE_EVENT_LIST EVENT 0 EVENT 1 EVENT 2 EVENT 3 /end AVAILABLE_EVENT_LIST /begin DEFAULT_EVENT_LIST EVENT 1 /end DEFAULT_EVENT_LIST /end DAQ_EVENT
 /end IF_DATA
/end MEASUREMENT
/begin MEASUREMENT NMAXMD_flgRst "Controller activation Reset flag" UBYTE B_TRUE 1 100 0.00 1.00000000000 BIT_MASK 0x1 FORMAT "%13.11" ECU_ADDRESS 0x400087A2
 /begin IF_DATA XCPplus 0x0102
  /begin DAQ_EVENT VARIABLE /begin AVAILABLE_EVENT_LIST EVENT 0 EVENT 1 EVENT 2 EVENT 3 /end AVAILABLE_EVENT_LIST /begin DEFAULT_EVENT_LIST EVENT 1 /end DEFAULT_EVENT_LIST /end DAQ_EVENT
 /end IF_DATA
/end MEASUREMENT
/begin MEASUREMENT NMAXMD_flgTog "Controller activation Toggle flag" UBYTE B_TRUE 1 100 0.00 1.00000000000 BIT_MASK 0x1 FORMAT "%13.11" ECU_ADDRESS 0x400087A9
 /begin IF_DATA XCPplus 0x0102
  /begin DAQ_EVENT VARIABLE /begin AVAILABLE_EVENT_LIST EVENT 0 EVENT 1 EVENT 2 EVENT 3 /end AVAILABLE_EVENT_LIST /begin DEFAULT_EVENT_LIST EVENT 1 /end DEFAULT_EVENT_LIST /end DAQ_EVENT
 /end IF_DATA
/end MEASUREMENT
/begin MEASUREMENT NMAXMD_milg "Kilometers driven for limiting engine speed" UWORD OneToOne 1 100 0.00 65535.00 FORMAT "%8.2" ECU_ADDRESS 0x40008356
 /begin IF_DATA XCPplus 0x0102
  /begin DAQ_EVENT VARIABLE /begin AVAILABLE_EVENT_LIST EVENT 0 EVENT 1 EVENT 2 EVENT 3 /end AVAILABLE_EVENT_LIST /begin DEFAULT_EVENT_LIST EVENT 2 /end DEFAULT_EVENT_LIST /end DAQ_EVENT
 /end IF_DATA
/end MEASUREMENT
/begin MEASUREMENT NMAXMD_nEngTDpdt "Engine temperature dependent desired engine speed" UWORD nmot_uw_q0p25 1 100 0.00 16383.75 FORMAT "%8.2" ECU_ADDRESS 0x40008354
 /begin IF_DATA XCPplus 0x0102
  /begin DAQ_EVENT VARIABLE /begin AVAILABLE_EVENT_LIST EVENT 0 EVENT 1 EVENT 2 EVENT 3 /end AVAILABLE_EVENT_LIST /begin DEFAULT_EVENT_LIST EVENT 2 /end DEFAULT_EVENT_LIST /end DAQ_EVENT
 /end IF_DATA
/end MEASUREMENT
/begin MEASUREMENT NMAXMD_nPredEngSpdIgnPth "Predictive engine speed on ignition path" UWORD nmot_uw_q0p25 1 100 0.00 16383.75 FORMAT "%8.2" ECU_ADDRESS 0x4000836E
 /begin IF_DATA XCPplus 0x0102
  /begin DAQ_EVENT VARIABLE /begin AVAILABLE_EVENT_LIST EVENT 0 EVENT 1 EVENT 2 EVENT 3 /end AVAILABLE_EVENT_LIST /begin DEFAULT_EVENT_LIST EVENT 1 /end DEFAULT_EVENT_LIST /end DAQ_EVENT
 /end IF_DATA
/end MEASUREMENT
/begin MEASUREMENT NMAXMD_nSpDesMax "Current Maximum desired engine speed" UWORD nmot_uw_q0p25 1 100 0.00 16383.75 FORMAT "%8.2" ECU_ADDRESS 0x40008364
 /begin IF_DATA XCPplus 0x0102
  /begin DAQ_EVENT VARIABLE /begin AVAILABLE_EVENT_LIST EVENT 0 EVENT 1 EVENT 2 EVENT 3 /end AVAILABLE_EVENT_LIST /begin DEFAULT_EVENT_LIST EVENT 1 /end DEFAULT_EVENT_LIST /end DAQ_EVENT
 /end IF_DATA
/end MEASUREMENT
/begin MEASUREMENT NMAXMD_nSpDesMaxLim1 "Engine speed for first Limitation before reaching maximum RPM" UWORD nmot_uw_q0p25 1 100 0.00 16383.75 FORMAT "%8.2" ECU_ADDRESS 0x40008360
 /begin IF_DATA XCPplus 0x0102
  /begin DAQ_EVENT VARIABLE /begin AVAILABLE_EVENT_LIST EVENT 0 EVENT 1 EVENT 2 EVENT 3 /end AVAILABLE_EVENT_LIST /begin DEFAULT_EVENT_LIST EVENT 1 /end DEFAULT_EVENT_LIST /end DAQ_EVENT
 /end IF_DATA
/end MEASUREMENT
/begin MEASUREMENT NMAXMD_nSpDesMaxLim2 "Engine speed for second Limitation before reaching maximum RPM" UWORD nmot_uw_q0p25 1 100 0.00 16383.75 FORMAT "%8.2" ECU_ADDRESS 0x40008362
 /begin IF_DATA XCPplus 0x0102
  /begin DAQ_EVENT VARIABLE /begin AVAILABLE_EVENT_LIST EVENT 0 EVENT 1 EVENT 2 EVENT 3 /end AVAILABLE_EVENT_LIST /begin DEFAULT_EVENT_LIST EVENT 1 /end DEFAULT_EVENT_LIST /end DAQ_EVENT
 /end IF_DATA
/end MEASUREMENT
/begin MEASUREMENT NMAXMD_nSpDesMaxloc "Maximum desired engine speed before limitation" UWORD nmot_uw_q0p25 1 100 0.00 16383.75 FORMAT "%8.2" ECU_ADDRESS 0x4000835E
 /begin IF_DATA XCPplus 0x0102
  /begin DAQ_EVENT VARIABLE /begin AVAILABLE_EVENT_LIST EVENT 0 EVENT 1 EVENT 2 EVENT 3 /end AVAILABLE_EVENT_LIST /begin DEFAULT_EVENT_LIST EVENT 1 /end DEFAULT_EVENT_LIST /end DAQ_EVENT
 /end IF_DATA
/end MEASUREMENT
/begin MEASUREMENT NMAXMD_nSpHi "High engine speed set point" UWORD nmot_uw_q0p25 1 100 0.00 16383.75 FORMAT "%8.2" ECU_ADDRESS 0x40008366
 /begin IF_DATA XCPplus 0x0102
  /begin DAQ_EVENT VARIABLE /begin AVAILABLE_EVENT_LIST EVENT 0 EVENT 1 EVENT 2 EVENT 3 /end AVAILABLE_EVENT_LIST /begin DEFAULT_EVENT_LIST EVENT 1 /end DEFAULT_EVENT_LIST /end DAQ_EVENT
 /end IF_DATA
/end MEASUREMENT
/begin MEASUREMENT NMAXMD_nSpHiLimnRunngMilg "Engine speed limitation based on kilometers driven" UWORD nmot_uw_q0p25 1 100 0.00 16383.75 FORMAT "%8.2" ECU_ADDRESS 0x40008358
 /begin IF_DATA XCPplus 0x0102
  /begin DAQ_EVENT VARIABLE /begin AVAILABLE_EVENT_LIST EVENT 0 EVENT 1 EVENT 2 EVENT 3 /end AVAILABLE_EVENT_LIST /begin DEFAULT_EVENT_LIST EVENT 2 /end DEFAULT_EVENT_LIST /end DAQ_EVENT
 /end IF_DATA
/end MEASUREMENT
/begin MEASUREMENT NMAXMD_nSpHiLimnRunngTi "Engine speed limitation based on engine operating hours" UWORD nmot_uw_q0p25 1 100 0.00 16383.75 FORMAT "%8.2" ECU_ADDRESS 0x4000835C
 /begin IF_DATA XCPplus 0x0102
  /begin DAQ_EVENT VARIABLE /begin AVAILABLE_EVENT_LIST EVENT 0 EVENT 1 EVENT 2 EVENT 3 /end AVAILABLE_EVENT_LIST /begin DEFAULT_EVENT_LIST EVENT 2 /end DEFAULT_EVENT_LIST /end DAQ_EVENT
 /end IF_DATA
/end MEASUREMENT
/begin MEASUREMENT NMAXMD_nSpHiOffs "Maximum high set point threshold for rpm control to initiate fuel cutoff" UWORD nmot_uw_q0p25 1 100 0.00 16383.75 FORMAT "%8.2" ECU_ADDRESS 0x4000836A
 /begin IF_DATA XCPplus 0x0102
  /begin DAQ_EVENT VARIABLE /begin AVAILABLE_EVENT_LIST EVENT 0 EVENT 1 EVENT 2 EVENT 3 /end AVAILABLE_EVENT_LIST /begin DEFAULT_EVENT_LIST EVENT 1 /end DEFAULT_EVENT_LIST /end DAQ_EVENT
 /end IF_DATA
/end MEASUREMENT
/begin MEASUREMENT NMAXMD_nSpLoOffs "Minimum low set point threshold for rpm control to deactivate engine speed controller limitation." UWORD nmot_uw_q0p25 1 100 0.00 16383.75 FORMAT "%8.2" ECU_ADDRESS 0x40008368
 /begin IF_DATA XCPplus 0x0102
  /begin DAQ_EVENT VARIABLE /begin AVAILABLE_EVENT_LIST EVENT 0 EVENT 1 EVENT 2 EVENT 3 /end AVAILABLE_EVENT_LIST /begin DEFAULT_EVENT_LIST EVENT 1 /end DEFAULT_EVENT_LIST /end DAQ_EVENT
 /end IF_DATA
/end MEASUREMENT
/begin MEASUREMENT NMAXMD_quoPIDesTq "Quotient Desired torque of proportional and integrator controller" UBYTE fak_ub_q0p01 1 100 0.00 2.550 FORMAT "%5.3" ECU_ADDRESS 0x400087A8
 /begin IF_DATA XCPplus 0x0102
  /begin DAQ_EVENT VARIABLE /begin AVAILABLE_EVENT_LIST EVENT 0 EVENT 1 EVENT 2 EVENT 3 /end AVAILABLE_EVENT_LIST /begin DEFAULT_EVENT_LIST EVENT 1 /end DEFAULT_EVENT_LIST /end DAQ_EVENT
 /end IF_DATA
/end MEASUREMENT
/begin MEASUREMENT NMAXMD_relTqICtrlr "Torque from I controller for limitation" ULONG rel_q4p76837Em5 1 100 0.00 99.9984741211 FORMAT "%13.10" ECU_ADDRESS 0x40008E18
 /begin IF_DATA XCPplus 0x0102
  /begin DAQ_EVENT VARIABLE /begin AVAILABLE_EVENT_LIST EVENT 0 EVENT 1 EVENT 2 EVENT 3 /end AVAILABLE_EVENT_LIST /begin DEFAULT_EVENT_LIST EVENT 1 /end DEFAULT_EVENT_LIST /end DAQ_EVENT
 /end IF_DATA
/end MEASUREMENT
/begin MEASUREMENT NMAXMD_relTqPCtrlr "Torque from P controller for limitation" SWORD rel_sw_b100 1 100 -100.0000 99.99695 FORMAT "%8.4" ECU_ADDRESS 0x40008372
 /begin IF_DATA XCPplus 0x0102
  /begin DAQ_EVENT VARIABLE /begin AVAILABLE_EVENT_LIST EVENT 0 EVENT 1 EVENT 2 EVENT 3 /end AVAILABLE_EVENT_LIST /begin DEFAULT_EVENT_LIST EVENT 1 /end DEFAULT_EVENT_LIST /end DAQ_EVENT
 /end IF_DATA
/end MEASUREMENT
/begin MEASUREMENT NMAXMD_relTqPICtrlr "Relative torque of proportional and integrator controller" UWORD rel_uw_b100 1 100 0.00 99.99847 FORMAT "%8.5" ECU_ADDRESS 0x40008374
 /begin IF_DATA XCPplus 0x0102
  /begin DAQ_EVENT VARIABLE /begin AVAILABLE_EVENT_LIST EVENT 0 EVENT 1 EVENT 2 EVENT 3 /end AVAILABLE_EVENT_LIST /begin DEFAULT_EVENT_LIST EVENT 1 /end DEFAULT_EVENT_LIST /end DAQ_EVENT
 /end IF_DATA
/end MEASUREMENT
/begin MEASUREMENT NMAXMD_tiEngRunng "Engine operating hours for limiting engine speed" UWORD tmin_uw_q1 1 100 0.00 65535.00 FORMAT "%8.2" ECU_ADDRESS 0x4000835A
 /begin IF_DATA XCPplus 0x0102
  /begin DAQ_EVENT VARIABLE /begin AVAILABLE_EVENT_LIST EVENT 0 EVENT 1 EVENT 2 EVENT 3 /end AVAILABLE_EVENT_LIST /begin DEFAULT_EVENT_LIST EVENT 2 /end DEFAULT_EVENT_LIST /end DAQ_EVENT
 /end IF_DATA
/end MEASUREMENT
/begin MEASUREMENT NMAXMD_tiTog "Time parameter for controller toggle" SWORD t_q0p01 1 100 0.00 327.6700 FORMAT "%8.4" ECU_ADDRESS 0x40008378
 /begin IF_DATA XCPplus 0x0102
  /begin DAQ_EVENT VARIABLE /begin AVAILABLE_EVENT_LIST EVENT 0 EVENT 1 EVENT 2 EVENT 3 /end AVAILABLE_EVENT_LIST /begin DEFAULT_EVENT_LIST EVENT 1 /end DEFAULT_EVENT_LIST /end DAQ_EVENT
 /end IF_DATA
/end MEASUREMENT
/begin MEASUREMENT NMAXMD_tiTogHi "Time parameter for toggle set point" UWORD t_q0p01 1 100 0.00 655.3500 FORMAT "%8.4" ECU_ADDRESS 0x40008376
 /begin IF_DATA XCPplus 0x0102
  /begin DAQ_EVENT VARIABLE /begin AVAILABLE_EVENT_LIST EVENT 0 EVENT 1 EVENT 2 EVENT 3 /end AVAILABLE_EVENT_LIST /begin DEFAULT_EVENT_LIST EVENT 1 /end DEFAULT_EVENT_LIST /end DAQ_EVENT
 /end IF_DATA
/end MEASUREMENT
/begin MEASUREMENT nsber_w "Desired engine speed for rpm control" UWORD nmot_uw_q0p25 1 100 0.00 16383.75 FORMAT "%8.2" ECU_ADDRESS 0x40008350
 /begin IF_DATA XCPplus 0x0102
  /begin DAQ_EVENT VARIABLE /begin AVAILABLE_EVENT_LIST EVENT 0 EVENT 1 EVENT 2 EVENT 3 /end AVAILABLE_EVENT_LIST /begin DEFAULT_EVENT_LIST EVENT 1 /end DEFAULT_EVENT_LIST /end DAQ_EVENT
 /end IF_DATA
/end MEASUREMENT
/begin MEASUREMENT OCWDA_cntrPostDrvLeaveOld "Local drive cycle counter which is incremented when system state SyC_PostDrive is left" UBYTE OneToOne 1 100 0.00 255.0 FORMAT "%5.1" ECU_ADDRESS 0x400063C5
 /begin IF_DATA XCPplus 0x0102
  /begin DAQ_EVENT VARIABLE /begin AVAILABLE_EVENT_LIST EVENT 0 EVENT 1 EVENT 2 EVENT 3 /end AVAILABLE_EVENT_LIST /begin DEFAULT_EVENT_LIST EVENT 1 /end DEFAULT_EVENT_LIST /end DAQ_EVENT
 /end IF_DATA
/end MEASUREMENT
/begin MEASUREMENT OCWDA_ctDebActvErr "Debounce counter for Error Pin, WDA, ABE active" UBYTE OneToOne 1 100 0.00 255.0 FORMAT "%5.1" ECU_ADDRESS 0x400063C4
 /begin IF_DATA XCPplus 0x0102
  /begin DAQ_EVENT VARIABLE /begin AVAILABLE_EVENT_LIST EVENT 0 EVENT 1 EVENT 2 EVENT 3 /end AVAILABLE_EVENT_LIST /begin DEFAULT_EVENT_LIST EVENT 1 /end DEFAULT_EVENT_LIST /end DAQ_EVENT
 /end IF_DATA
/end MEASUREMENT
/begin MEASUREMENT OCWDA_ctDebErrNotActv "Debounce counter for healing inactive Error Pin, WDA, ABE" UBYTE OneToOne 1 100 0.00 255.0 FORMAT "%5.1" ECU_ADDRESS 0x400063C3
 /begin IF_DATA XCPplus 0x0102
  /begin DAQ_EVENT VARIABLE /begin AVAILABLE_EVENT_LIST EVENT 0 EVENT 1 EVENT 2 EVENT 3 /end AVAILABLE_EVENT_LIST /begin DEFAULT_EVENT_LIST EVENT 1 /end DEFAULT_EVENT_LIST /end DAQ_EVENT
 /end IF_DATA
/end MEASUREMENT
/begin MEASUREMENT OCWDA_ctTstOCWDA "Debounce counter for setting of test- or errorflags" UBYTE OneToOne 1 100 0.00 255.0 FORMAT "%5.1" ECU_ADDRESS 0x40007F65
 /begin IF_DATA XCPplus 0x0102
  /begin DAQ_EVENT VARIABLE /begin AVAILABLE_EVENT_LIST EVENT 0 EVENT 1 EVENT 2 EVENT 3 /end AVAILABLE_EVENT_LIST /begin DEFAULT_EVENT_LIST EVENT 1 /end DEFAULT_EVENT_LIST /end DAQ_EVENT
 /end IF_DATA
/end MEASUREMENT
/begin MEASUREMENT OCWDA_flgClrDebDFC "Flag bit to indicate request to clear fault memory" UBYTE OneToOne 1 100 0.00 255.0 FORMAT "%5.1" ECU_ADDRESS 0x40006288
 /begin IF_DATA XCPplus 0x0102
  /begin DAQ_EVENT VARIABLE /begin AVAILABLE_EVENT_LIST EVENT 0 EVENT 1 EVENT 2 EVENT 3 /end AVAILABLE_EVENT_LIST /begin DEFAULT_EVENT_LIST EVENT 1 /end DEFAULT_EVENT_LIST /end DAQ_EVENT
 /end IF_DATA
/end MEASUREMENT
/begin MEASUREMENT OCWDA_stCheckState "Variable contains the current state of the WDA diagnosis task" ULONG OneToOne 1 100 0.00 4294967295.00 FORMAT "%13.2" ECU_ADDRESS 0x400048B8
 /begin IF_DATA XCPplus 0x0102
  /begin DAQ_EVENT VARIABLE /begin AVAILABLE_EVENT_LIST EVENT 0 EVENT 1 EVENT 2 EVENT 3 /end AVAILABLE_EVENT_LIST /begin DEFAULT_EVENT_LIST EVENT 1 /end DEFAULT_EVENT_LIST /end DAQ_EVENT
 /end IF_DATA
/end MEASUREMENT
/begin MEASUREMENT OCWDA_stErrMonPtt "Status information for diagnosis process to set failure entry" ULONG OneToOne 1 100 0.00 4294967295.00 FORMAT "%13.2" ECU_ADDRESS 0x400048B4
 /begin IF_DATA XCPplus 0x0102
  /begin DAQ_EVENT VARIABLE /begin AVAILABLE_EVENT_LIST EVENT 0 EVENT 1 EVENT 2 EVENT 3 /end AVAILABLE_EVENT_LIST /begin DEFAULT_EVENT_LIST EVENT 1 /end DEFAULT_EVENT_LIST /end DAQ_EVENT
 /end IF_DATA
/end MEASUREMENT
/begin MEASUREMENT OCWDA_stWDAActv "Internal WDA status" UBYTE OneToOne 1 100 0.00 255.0 FORMAT "%5.1" ECU_ADDRESS 0x400063C2
 /begin IF_DATA XCPplus 0x0102
  /begin DAQ_EVENT VARIABLE /begin AVAILABLE_EVENT_LIST EVENT 0 EVENT 1 EVENT 2 EVENT 3 /end AVAILABLE_EVENT_LIST /begin DEFAULT_EVENT_LIST EVENT 1 /end DEFAULT_EVENT_LIST /end DAQ_EVENT
 /end IF_DATA
/end MEASUREMENT
/begin MEASUREMENT OilPPSSwt_bPSDiagActv "Status bit to indicate Low Oil Pressure switch Powerstage diagnosis is active" UBYTE B_TRUE 1 100 0.00 1.00000000000 BIT_MASK 0x1 FORMAT "%13.11" ECU_ADDRESS 0x40006287
 /begin IF_DATA XCPplus 0x0102
  /begin DAQ_EVENT VARIABLE /begin AVAILABLE_EVENT_LIST EVENT 0 EVENT 1 EVENT 2 EVENT 3 /end AVAILABLE_EVENT_LIST /begin DEFAULT_EVENT_LIST EVENT 2 /end DEFAULT_EVENT_LIST /end DAQ_EVENT
 /end IF_DATA
/end MEASUREMENT
/begin MEASUREMENT OilPPSSwt_bPSDiagEna "Status bit to indicate Low Oil Pressure switch Powerstage diagnosis is enabled" UBYTE B_TRUE 1 100 0.00 1.00000000000 BIT_MASK 0x1 FORMAT "%13.11" ECU_ADDRESS 0x40006368
 /begin IF_DATA XCPplus 0x0102
  /begin DAQ_EVENT VARIABLE /begin AVAILABLE_EVENT_LIST EVENT 0 EVENT 1 EVENT 2 EVENT 3 /end AVAILABLE_EVENT_LIST /begin DEFAULT_EVENT_LIST EVENT 2 /end DEFAULT_EVENT_LIST /end DAQ_EVENT
 /end IF_DATA
/end MEASUREMENT
/begin MEASUREMENT OilPPSSwt_flgBattUOK "Status bit to indicate Battery Voltage is fine for Diagnosis." UBYTE B_TRUE 1 100 0.00 1.00000000000 BIT_MASK 0x1 FORMAT "%13.11" ECU_ADDRESS 0x40006286
 /begin IF_DATA XCPplus 0x0102
  /begin DAQ_EVENT VARIABLE /begin AVAILABLE_EVENT_LIST EVENT 0 EVENT 1 EVENT 2 EVENT 3 /end AVAILABLE_EVENT_LIST /begin DEFAULT_EVENT_LIST EVENT 2 /end DEFAULT_EVENT_LIST /end DAQ_EVENT
 /end IF_DATA
/end MEASUREMENT
/begin MEASUREMENT OilPPSSwt_flgLPLimpMode "Status bit to enable Limp-Home mode duw to Low oil pressure" UBYTE B_TRUE 1 100 0.00 1.00000000000 BIT_MASK 0x1 FORMAT "%13.11" ECU_ADDRESS 0x40006367
 /begin IF_DATA XCPplus 0x0102
  /begin DAQ_EVENT VARIABLE /begin AVAILABLE_EVENT_LIST EVENT 0 EVENT 1 EVENT 2 EVENT 3 /end AVAILABLE_EVENT_LIST /begin DEFAULT_EVENT_LIST EVENT 2 /end DEFAULT_EVENT_LIST /end DAQ_EVENT
 /end IF_DATA
/end MEASUREMENT
/begin MEASUREMENT OilPPSSwt_flgLPSt "Status of Low Oil Pressure Warning Lamp" UBYTE B_TRUE 1 100 0.00 1.00000000000 BIT_MASK 0x1 FORMAT "%13.11" ECU_ADDRESS 0x40006285
 /begin IF_DATA XCPplus 0x0102
  /begin DAQ_EVENT VARIABLE /begin AVAILABLE_EVENT_LIST EVENT 0 EVENT 1 EVENT 2 EVENT 3 /end AVAILABLE_EVENT_LIST /begin DEFAULT_EVENT_LIST EVENT 2 /end DEFAULT_EVENT_LIST /end DAQ_EVENT
 /end IF_DATA
/end MEASUREMENT
/begin MEASUREMENT OilPPSSwt_flgLPWarnLamp "Low Oil Pressure Warning Lamp status" UBYTE B_TRUE 1 100 0.00 1.00000000000 BIT_MASK 0x1 FORMAT "%13.11" ECU_ADDRESS 0x40006366
 /begin IF_DATA XCPplus 0x0102
  /begin DAQ_EVENT VARIABLE /begin AVAILABLE_EVENT_LIST EVENT 0 EVENT 1 EVENT 2 EVENT 3 /end AVAILABLE_EVENT_LIST /begin DEFAULT_EVENT_LIST EVENT 2 /end DEFAULT_EVENT_LIST /end DAQ_EVENT
 /end IF_DATA
/end MEASUREMENT
/begin MEASUREMENT OilPPSSwt_flgLPWarnLampChk "Low Oil Pressure Warning Lamp check at T15 On" UBYTE B_TRUE 1 100 0.00 1.00000000000 BIT_MASK 0x1 FORMAT "%13.11" ECU_ADDRESS 0x40006284
 /begin IF_DATA XCPplus 0x0102
  /begin DAQ_EVENT VARIABLE /begin AVAILABLE_EVENT_LIST EVENT 0 EVENT 1 EVENT 2 EVENT 3 /end AVAILABLE_EVENT_LIST /begin DEFAULT_EVENT_LIST EVENT 2 /end DEFAULT_EVENT_LIST /end DAQ_EVENT
 /end IF_DATA
/end MEASUREMENT
/begin MEASUREMENT OilPPSSwt_flgLPWarnLamploc "Low Oil Pressure Warning Lamp status based on enable condition." UBYTE B_TRUE 1 100 0.00 1.00000000000 BIT_MASK 0x1 FORMAT "%13.11" ECU_ADDRESS 0x40006283
 /begin IF_DATA XCPplus 0x0102
  /begin DAQ_EVENT VARIABLE /begin AVAILABLE_EVENT_LIST EVENT 0 EVENT 1 EVENT 2 EVENT 3 /end AVAILABLE_EVENT_LIST /begin DEFAULT_EVENT_LIST EVENT 2 /end DEFAULT_EVENT_LIST /end DAQ_EVENT
 /end IF_DATA
/end MEASUREMENT
/begin MEASUREMENT OilPPSSwt_stPSwt "Status bits of Low Oil Pressure Switch functions." UBYTE OneToOne 1 100 0.00 255.0 FORMAT "%5.1" ECU_ADDRESS 0x40006354
 /begin IF_DATA XCPplus 0x0102
  /begin DAQ_EVENT VARIABLE /begin AVAILABLE_EVENT_LIST EVENT 0 EVENT 1 EVENT 2 EVENT 3 /end AVAILABLE_EVENT_LIST /begin DEFAULT_EVENT_LIST EVENT 2 /end DEFAULT_EVENT_LIST /end DAQ_EVENT
 /end IF_DATA
/end MEASUREMENT
/begin MEASUREMENT Oil_bSensLPSwmp "low pressure switch on ECU pin" UBYTE B_TRUE 1 100 0.00 1.00000000000 BIT_MASK 0x1 FORMAT "%13.11" ECU_ADDRESS 0x40006365
 /begin IF_DATA XCPplus 0x0102
  /begin DAQ_EVENT VARIABLE /begin AVAILABLE_EVENT_LIST EVENT 0 EVENT 1 EVENT 2 EVENT 3 /end AVAILABLE_EVENT_LIST /begin DEFAULT_EVENT_LIST EVENT 2 /end DEFAULT_EVENT_LIST /end DAQ_EVENT
 /end IF_DATA
/end MEASUREMENT
/begin MEASUREMENT Rollovr_stRollovrDiagcErr "Rollover sensor error status,Rollovr sensor FId for reporting fault" UBYTE B_TRUE 1 100 0.00 1.00000000000 BIT_MASK 0x1 FORMAT "%13.11" ECU_ADDRESS 0x400087AC
 /begin IF_DATA XCPplus 0x0102
  /begin DAQ_EVENT VARIABLE /begin AVAILABLE_EVENT_LIST EVENT 0 EVENT 1 EVENT 2 EVENT 3 /end AVAILABLE_EVENT_LIST /begin DEFAULT_EVENT_LIST EVENT 2 /end DEFAULT_EVENT_LIST /end DAQ_EVENT
 /end IF_DATA
/end MEASUREMENT
/begin MEASUREMENT SprkSeatT_flgTMdlVld "Status flag of Sparkseat temperature model" UBYTE B_TRUE 1 100 0.00 1.00000000000 BIT_MASK 0x1 FORMAT "%13.11" ECU_ADDRESS 0x40006364
 /begin IF_DATA XCPplus 0x0102
  /begin DAQ_EVENT VARIABLE /begin AVAILABLE_EVENT_LIST EVENT 0 EVENT 1 EVENT 2 EVENT 3 /end AVAILABLE_EVENT_LIST /begin DEFAULT_EVENT_LIST EVENT 3 /end DEFAULT_EVENT_LIST /end DAQ_EVENT
 /end IF_DATA
/end MEASUREMENT
/begin MEASUREMENT SprkSeatT_tMdl "Spark Seat Temperature modelled value" SWORD Temp_Cels 1 100 -3549.940 3003.560 FORMAT "%8.3" ECU_ADDRESS 0x40005D74
 /begin IF_DATA XCPplus 0x0102
  /begin DAQ_EVENT VARIABLE /begin AVAILABLE_EVENT_LIST EVENT 0 EVENT 1 EVENT 2 EVENT 3 /end AVAILABLE_EVENT_LIST /begin DEFAULT_EVENT_LIST EVENT 3 /end DEFAULT_EVENT_LIST /end DAQ_EVENT
 /end IF_DATA
/end MEASUREMENT
/begin MEASUREMENT SprkSeatT_tMdlloc "Spark seat temperature local value without correction factors" SWORD Temp_Cels 1 100 -3549.940 3003.560 FORMAT "%8.3" ECU_ADDRESS 0x40005C20
 /begin IF_DATA XCPplus 0x0102
  /begin DAQ_EVENT VARIABLE /begin AVAILABLE_EVENT_LIST EVENT 0 EVENT 1 EVENT 2 EVENT 3 /end AVAILABLE_EVENT_LIST /begin DEFAULT_EVENT_LIST EVENT 3 /end DEFAULT_EVENT_LIST /end DAQ_EVENT
 /end IF_DATA
/end MEASUREMENT
/begin MEASUREMENT SprkSeatT_tMdllocFltd "Spark seat temperature filtered value local" SWORD Temp_Cels 1 100 -3549.940 3003.560 FORMAT "%8.3" ECU_ADDRESS 0x40005C1E
 /begin IF_DATA XCPplus 0x0102
  /begin DAQ_EVENT VARIABLE /begin AVAILABLE_EVENT_LIST EVENT 0 EVENT 1 EVENT 2 EVENT 3 /end AVAILABLE_EVENT_LIST /begin DEFAULT_EVENT_LIST EVENT 3 /end DEFAULT_EVENT_LIST /end DAQ_EVENT
 /end IF_DATA
/end MEASUREMENT
/begin MEASUREMENT SprkSeatT_tMdlUnFltd "Spark seat tempearature unfiltered modelled value" SWORD Temp_Cels 1 100 -3549.940 3003.560 FORMAT "%8.3" ECU_ADDRESS 0x40005C1C
 /begin IF_DATA XCPplus 0x0102
  /begin DAQ_EVENT VARIABLE /begin AVAILABLE_EVENT_LIST EVENT 0 EVENT 1 EVENT 2 EVENT 3 /end AVAILABLE_EVENT_LIST /begin DEFAULT_EVENT_LIST EVENT 3 /end DEFAULT_EVENT_LIST /end DAQ_EVENT
 /end IF_DATA
/end MEASUREMENT
/begin MEASUREMENT Strt_st "Status activation starter relay" UBYTE OneToOne 1 100 0.00 255.0 FORMAT "%5.1" ECU_ADDRESS 0x40006394
 /begin IF_DATA XCPplus 0x0102
  /begin DAQ_EVENT VARIABLE /begin AVAILABLE_EVENT_LIST EVENT 0 EVENT 1 EVENT 2 EVENT 3 /end AVAILABLE_EVENT_LIST /begin DEFAULT_EVENT_LIST EVENT 2 /end DEFAULT_EVENT_LIST /end DAQ_EVENT
 /end IF_DATA
/end MEASUREMENT
/begin MEASUREMENT Strt_stPs "The output of the starter to the powerstage" UBYTE OneToOne 1 100 0.00 255.0 FORMAT "%5.1" ECU_ADDRESS 0x40006393
 /begin IF_DATA XCPplus 0x0102
  /begin DAQ_EVENT VARIABLE /begin AVAILABLE_EVENT_LIST EVENT 0 EVENT 1 EVENT 2 EVENT 3 /end AVAILABLE_EVENT_LIST /begin DEFAULT_EVENT_LIST EVENT 2 /end DEFAULT_EVENT_LIST /end DAQ_EVENT
 /end IF_DATA
/end MEASUREMENT
/begin MEASUREMENT Strt_stStaActv "State starter=active" UBYTE OneToOne 1 100 0.00 1.000 FORMAT "%5.3" ECU_ADDRESS 0x400063C1
 /begin IF_DATA XCPplus 0x0102
  /begin DAQ_EVENT VARIABLE /begin AVAILABLE_EVENT_LIST EVENT 0 EVENT 1 EVENT 2 EVENT 3 /end AVAILABLE_EVENT_LIST /begin DEFAULT_EVENT_LIST EVENT 1 /end DEFAULT_EVENT_LIST /end DAQ_EVENT
 /end IF_DATA
/end MEASUREMENT
/begin MEASUREMENT Strt_uIniMinStrt "The minimum voltage, above which no active starter is detected" SWORD Volt_Batt 1 100 -655360.0 655340.0 FORMAT "%8.1" ECU_ADDRESS 0x40005D90 /end MEASUREMENT
/begin MEASUREMENT StSys_cntrStrtFail "Counter: Consecutive Fail start" UBYTE OneToOne 1 100 0.00 255.0 FORMAT "%5.1" ECU_ADDRESS 0x4000C706
 /begin IF_DATA XCPplus 0x0102
  /begin DAQ_EVENT VARIABLE /begin AVAILABLE_EVENT_LIST EVENT 0 EVENT 1 EVENT 2 EVENT 3 /end AVAILABLE_EVENT_LIST /begin DEFAULT_EVENT_LIST EVENT 2 /end DEFAULT_EVENT_LIST /end DAQ_EVENT
 /end IF_DATA
/end MEASUREMENT
/begin MEASUREMENT StSys_flgRstCdnMsk "Starter control reset condition flag" UBYTE B_TRUE 1 100 0.00 1.00000000000 BIT_MASK 0x1 FORMAT "%13.11" ECU_ADDRESS 0x400087AD
 /begin IF_DATA XCPplus 0x0102
  /begin DAQ_EVENT VARIABLE /begin AVAILABLE_EVENT_LIST EVENT 0 EVENT 1 EVENT 2 EVENT 3 /end AVAILABLE_EVENT_LIST /begin DEFAULT_EVENT_LIST EVENT 2 /end DEFAULT_EVENT_LIST /end DAQ_EVENT
 /end IF_DATA
/end MEASUREMENT
/begin MEASUREMENT StSys_flgStrtFail "Flag: Starter failed" UBYTE B_TRUE 1 100 0.00 1.00000000000 BIT_MASK 0x1 FORMAT "%13.11" ECU_ADDRESS 0x4000C705
 /begin IF_DATA XCPplus 0x0102
  /begin DAQ_EVENT VARIABLE /begin AVAILABLE_EVENT_LIST EVENT 0 EVENT 1 EVENT 2 EVENT 3 /end AVAILABLE_EVENT_LIST /begin DEFAULT_EVENT_LIST EVENT 2 /end DEFAULT_EVENT_LIST /end DAQ_EVENT
 /end IF_DATA
/end MEASUREMENT
/begin MEASUREMENT StSys_flgStrtrStk "Flag to indicate starter stuck" UBYTE B_TRUE 1 100 0.00 1.00000000000 BIT_MASK 0x1 FORMAT "%13.11" ECU_ADDRESS 0x400087AE
 /begin IF_DATA XCPplus 0x0102
  /begin DAQ_EVENT VARIABLE /begin AVAILABLE_EVENT_LIST EVENT 0 EVENT 1 EVENT 2 EVENT 3 /end AVAILABLE_EVENT_LIST /begin DEFAULT_EVENT_LIST EVENT 2 /end DEFAULT_EVENT_LIST /end DAQ_EVENT
 /end IF_DATA
/end MEASUREMENT
/begin MEASUREMENT StSys_nMaxStrtAtmpt "Max start attemp allowed in current driving cycle" SWORD dez 1 100 0.00 255.0000 FORMAT "%8.4" ECU_ADDRESS 0x40008386
 /begin IF_DATA XCPplus 0x0102
  /begin DAQ_EVENT VARIABLE /begin AVAILABLE_EVENT_LIST EVENT 0 EVENT 1 EVENT 2 EVENT 3 /end AVAILABLE_EVENT_LIST /begin DEFAULT_EVENT_LIST EVENT 2 /end DEFAULT_EVENT_LIST /end DAQ_EVENT
 /end IF_DATA
/end MEASUREMENT
/begin MEASUREMENT StSys_stResCond "Starter reset condition" UWORD OneToOne 1 100 0.00 65535.00 FORMAT "%8.2" ECU_ADDRESS 0x40008384
 /begin IF_DATA XCPplus 0x0102
  /begin DAQ_EVENT VARIABLE /begin AVAILABLE_EVENT_LIST EVENT 0 EVENT 1 EVENT 2 EVENT 3 /end AVAILABLE_EVENT_LIST /begin DEFAULT_EVENT_LIST EVENT 2 /end DEFAULT_EVENT_LIST /end DAQ_EVENT
 /end IF_DATA
/end MEASUREMENT
/begin MEASUREMENT StSys_stStrtRest "Status: Starter Rest" UBYTE B_TRUE 1 100 0.00 1.00000000000 BIT_MASK 0x1 FORMAT "%13.11" ECU_ADDRESS 0x4000C704
 /begin IF_DATA XCPplus 0x0102
  /begin DAQ_EVENT VARIABLE /begin AVAILABLE_EVENT_LIST EVENT 0 EVENT 1 EVENT 2 EVENT 3 /end AVAILABLE_EVENT_LIST /begin DEFAULT_EVENT_LIST EVENT 2 /end DEFAULT_EVENT_LIST /end DAQ_EVENT
 /end IF_DATA
/end MEASUREMENT
/begin MEASUREMENT StSys_tiStrtRest "Time elapsed after starter is put to rest" UWORD t_q0p02 1 100 0.00 1310.700 FORMAT "%8.3" ECU_ADDRESS 0x4000C6B4
 /begin IF_DATA XCPplus 0x0102
  /begin DAQ_EVENT VARIABLE /begin AVAILABLE_EVENT_LIST EVENT 0 EVENT 1 EVENT 2 EVENT 3 /end AVAILABLE_EVENT_LIST /begin DEFAULT_EVENT_LIST EVENT 2 /end DEFAULT_EVENT_LIST /end DAQ_EVENT
 /end IF_DATA
/end MEASUREMENT
/begin MEASUREMENT tmotdutycycle "Duty cycle of engine temperature PWM signal to tachometer" UWORD rel_uw_q0p01 1 100 0.00 100.0000 FORMAT "%8.4" ECU_ADDRESS 0x4000837E /end MEASUREMENT
/begin MEASUREMENT tmotperiod "Frequency of engine temperature PWM signal to tachometer" UWORD t_q0p0001_ms 1 100 0.00 6.553500 FORMAT "%8.6" ECU_ADDRESS 0x4000837C /end MEASUREMENT
/begin FUNCTION MoFSidst_Co "386.0.1   Function Monitoring: Sidestand"
 /begin DEF_CHARACTERISTIC DFC_CtlMsk2.DFC_MoFSidst_C DFC_DisblMsk2.DFC_MoFSidst_C MoFSidst_cntrDebSidstL2_C MoFSidst_cntrDeb_C MoFSidst_cntrErrICOIgnDeb_C MoFSidst_cntrErrICOIgnThd_C MoFSidst_cntrErrICOInjDeb_C MoFSidst_cntrErrICOInjThd_C MoFSidst_cntrThd_C MoFSidst_cntrTst_C MoFSidst_stSidst_C MoFSidst_swtSRCChkEna_C MoFSidst_uOffMax_C MoFSidst_uOffMin_C MoFSidst_uOnMax_C MoFSidst_uOnMin_C MoFSidst_uSRCMax_C MoFSidst_uSRCMin_C MoFSidst_vErrMin_C /end DEF_CHARACTERISTIC
 /begin REF_CHARACTERISTIC Mo_swtClrCntrMax_C /end REF_CHARACTERISTIC
 /begin IN_MEASUREMENT B_sdstact MoFGearLvr_flgNeutGear MoFIn_stICOInjL1 MoFIn_stIgnFadeOutMskL1 MoFVSS_v Mo_stCplChk Mo_stMoC Mo_stMoCCpl Mo_stMoF Mo_stMoFCpl Mo_swtSelVehCfg /end IN_MEASUREMENT
 /begin OUT_MEASUREMENT MoFSidst_cntrDebTst MoFSidst_flgClr MoFSidst_flgIrvErrSidstMsg MoFSidst_flgSidstErrMsg MoFSidst_flgTstMsg /end OUT_MEASUREMENT
 /begin LOC_MEASUREMENT MoFSidst_bbOutCpl MoFSidst_cntrDeb MoFSidst_cntrDebCpl MoFSidst_cntrDebExcddThdNv MoFSidst_cntrDebMaxNv MoFSidst_cntrDebSidstL2 MoFSidst_cntrDebSidstL2Cpl MoFSidst_cntrDebTstCpl MoFSidst_cntrErrICOIgnDeb MoFSidst_cntrErrICOIgnDebCpl MoFSidst_cntrErrICOIgnDebOld MoFSidst_cntrErrICOInjDeb MoFSidst_cntrErrICOInjDebCpl MoFSidst_cntrErrICOInjDebOld MoFSidst_cntrErrIgnDebExcddThdNv MoFSidst_cntrErrIgnDebMaxNv MoFSidst_cntrErrInjDebExcddThdNv MoFSidst_cntrErrInjDebMaxNv MoFSidst_cntrOld MoFSidst_flgImpsErr MoFSidst_flgScbErr MoFSidst_flgScgErr MoFSidst_flgSidst MoFSidst_flgSidstErr MoFSidst_stSidstOld MoFSidst_stSidstOldCpl MoFSidst_uSidstRaw MoFSidst_uSidstRawCpl MoFSidst_uSidst_MP /end LOC_MEASUREMENT
 FUNCTION_VERSION "386.0.1" /end FUNCTION
/begin FUNCTION MoFSrv_Lib "24.8.1    Function Monitoring: Service library" /begin IN_MEASUREMENT Mo_stCplChk Mo_stMoC Mo_stMoCCpl /end IN_MEASUREMENT FUNCTION_VERSION "24.8.1" /end FUNCTION
/begin FUNCTION MoFVSS_Co "386.0.0   Function Monitoring: Vehicle speed"
 /begin DEF_CHARACTERISTIC MoFVSS_cntrNplErr_C MoFVSS_cntrSRCMaxErr_C MoFVSS_cntrSRCMinErr_C MoFVSS_dstPerPls_C MoFVSS_swtSig_C MoFVSS_vDfl_C /end DEF_CHARACTERISTIC
 /begin IN_MEASUREMENT Mo_stCplChk Mo_stMoC Mo_stMoCCpl /end IN_MEASUREMENT
 /begin OUT_MEASUREMENT MoFVSS_v /end OUT_MEASUREMENT
 /begin LOC_MEASUREMENT MoFVSSCo_bbLocCpl MoFVSS_bbOutCpl MoFVSS_cntrNplErr MoFVSS_cntrNplErrCpl MoFVSS_cntrSRCMaxErr MoFVSS_cntrSRCMaxErrCpl MoFVSS_cntrSRCMinErr MoFVSS_cntrSRCMinErrCpl MoFVSS_flgABSDispFrntwhlSpdVld MoFVSS_flgABSDispRewhlSpdVld MoFVSS_flgChkSumOK_MP MoFVSS_flgNplErr_MP MoFVSS_flgPwmErr MoFVSS_flgSRCMaxErr MoFVSS_flgSRCMinErr MoFVSS_stSignal_mp MoFVSS_tiHighDur_mp MoFVSS_tiPerAvrg_mp MoFVSS_vABSDispFrntWhlSpd MoFVSS_vABSDispFrntWhlSpdCpl MoFVSS_vABSDispFrntWhlSpd_Mp MoFVSS_vABSDispReWhlSpd MoFVSS_vABSDispReWhlSpdCpl MoFVSS_vABSDispReWhlSpd_Mp MoFVSS_vCpl /end LOC_MEASUREMENT
 FUNCTION_VERSION "386.0.0" /end FUNCTION
/begin FUNCTION MoFWDA_Co "9101.0.0  Function Monitoring: Fault reaction from function monitoring via WDA" /begin IN_MEASUREMENT MoCSOP_stRdy Mo_stMoF /end IN_MEASUREMENT FUNCTION_VERSION "9101.0.0" /end FUNCTION
/begin FUNCTION Mo_Glbl "9104.1.0  Monitoring: Global definitions"
 /begin DEF_CHARACTERISTIC Mo_cwMstSlave_C Mo_stSwtHyb_C Mo_swtClrCntrMax_C Mo_swtCyclCalUpdt_C Mo_swtSelVehCfg_C Mo_trqIdcMax_C /end DEF_CHARACTERISTIC
 /begin IN_MEASUREMENT SyC_stSub /end IN_MEASUREMENT
 /begin OUT_MEASUREMENT Mo_ctRst Mo_ctRstCpl Mo_flgICOMsg Mo_stCplChk Mo_stErrHyb Mo_stErrHybCpl Mo_stMoC Mo_stMoCCpl Mo_stMoCExtdTsk Mo_stMoCExtdTskCpl Mo_stMoF Mo_stMoFCpl Mo_stMoFExtdTsk Mo_stMoFExtdTskCpl Mo_stVldR32Chk Mo_swtSelVehCfg Mo_swtSelVehCfgCpl /end OUT_MEASUREMENT
 /begin LOC_MEASUREMENT MoGlbl_bbLocExtdTskCpl Mo_bAddConPFC Mo_bAddConPFCExtdTsk Mo_bAddDisblPreICORst Mo_bAddDisblPreICORstExtdTsk Mo_bCplChk Mo_bCplChkExtdTsk Mo_bEmgcyAir Mo_bICOL1 Mo_bICOL2 Mo_bICOL2ExtdTsk Mo_bIrvElMIdl Mo_bIrvHybLimpL1 Mo_bIrvHybLimpL2 Mo_bIrvHybP1LimpL2 Mo_bIrvTrqLimL1 Mo_bIrvTrqLimL2 Mo_bLoVltg Mo_bNlh Mo_bRamErr Mo_bRamErrExtdTsk Mo_bRomErr Mo_bSyncLos Mo_stProtRAM /end LOC_MEASUREMENT
 FUNCTION_VERSION "9104.1.0" /end FUNCTION
/begin FUNCTION MRly2MED "10.3.0_1.0.0Interface Adapter MRly to MED" /begin IN_MEASUREMENT MRly_st /end IN_MEASUREMENT /begin OUT_MEASUREMENT B_hr_msg /end OUT_MEASUREMENT FUNCTION_VERSION "10.3.0_1.0.0" /end FUNCTION
/begin FUNCTION MRly_Vld2Lcy "1.2.0     SW Adapter Main Relay Component Package: Mapping Valid to Legacy Interface Elements" /begin OUT_MEASUREMENT MRly_ctErlyOpng MRly_st MRly_stAct /end OUT_MEASUREMENT FUNCTION_VERSION "1.2.0" /end FUNCTION
/begin FUNCTION NMAXMD "9000.11.0_386.2.0Engine speed limitation"
 /begin DEF_CHARACTERISTIC CWNMAXMD KLFINMAX KLFNMAXINI KLFPNMAX NMAXGA NMAXMD_facPredEngSpd_C NMAXMD_nSpHiLimDelta1_C NMAXMD_nSpHiLimDelta2_C NMAXMD_nSpHiLimnRunngMilg_T NMAXMD_nSpHiLimnRunngTi_T NMAXMD_nSpHiLimOffs1_T NMAXMD_nSpHiLimOffs2_T NMAXMD_nSpHiOffs_T NMAXMD_nSpLoOffs_T NMAXMD_swtGrdtSpdFild_C NMAXMD_tiEngSpdGrdtPtEngd_C NMAXMD_tiEngSpdGrdtPtOpn_C NMAXMD_tiNEngSpLoLim1_C NMAXMD_tiNEngSpLoLim2_C NMAXMD_tiPredEngSpdAirPth_C NMAXMD_tiPredEngSpdIgnPth_C NMAXMD_tiTogActv_C NMAXMD_tiTog_T NMAXOH NMAXTMM /end DEF_CHARACTERISTIC
 /begin IN_MEASUREMENT B_OvHEngSpdLimr B_pwtrop EngDa_tEng Epm_dnEngFlt Epm_dnEngSma gangi IgCtl_flgCoil1DiagErr IgCtl_flgCoil2DiagErr kmstand_l mdverl_w mibas_w mifal_w mifa_w mizsoloa_w nmot_w OilPPSSwt_flgLPLimpMode SyC_stSub topre1m_l /end IN_MEASUREMENT
 /begin OUT_MEASUREMENT B_nmax minmx_w NMAXMD_flgCdnTogActv NMAXMD_flgCtrlrActv nsber_w /end OUT_MEASUREMENT
 /begin LOC_MEASUREMENT dnsi_w minmxi NMAXMD_bActvCtrlrIgnPth NMAXMD_bCtrlrEna NMAXMD_dnGrdtEngSpdFild NMAXMD_flgActvCtrlrIgnPth NMAXMD_flgIntegIniIgnPth NMAXMD_flgIntegInit NMAXMD_flgNEngHiLim1 NMAXMD_flgNEngHiLim2 NMAXMD_flgRst NMAXMD_flgTog NMAXMD_milg NMAXMD_nEngTDpdt NMAXMD_nPredEngSpdIgnPth NMAXMD_nSpDesMax NMAXMD_nSpDesMaxLim1 NMAXMD_nSpDesMaxLim2 NMAXMD_nSpDesMaxloc NMAXMD_nSpHi NMAXMD_nSpHiLimnRunngMilg NMAXMD_nSpHiLimnRunngTi NMAXMD_nSpHiOffs NMAXMD_nSpLoOffs NMAXMD_quoPIDesTq NMAXMD_relTqICtrlr NMAXMD_relTqPCtrlr NMAXMD_relTqPICtrlr NMAXMD_tiEngRunng NMAXMD_tiTog NMAXMD_tiTogHi /end LOC_MEASUREMENT
 FUNCTION_VERSION "9000.11.0_386.2.0" /end FUNCTION
/begin FUNCTION OCWDA_Co "85.0.0    Extended Monitoring: Operation conditions of WDA/ABE shut off"
 /begin DEF_CHARACTERISTIC DFC_CtlMsk2.DFC_OCWDACom_C DFC_DisblMsk2.DFC_OCWDACom_C OCWDA_ctDebActvErr_C OCWDA_swtOffRst_C /end DEF_CHARACTERISTIC
 /begin IN_MEASUREMENT MoCCom_ctErrFC MoCCom_ctErrMM MoCSOP_stActMsg SyC_ctPostDrvLeave /end IN_MEASUREMENT
 /begin OUT_MEASUREMENT OCWDA_stErrMonPtt /end OUT_MEASUREMENT
 /begin LOC_MEASUREMENT OCWDA_cntrPostDrvLeaveOld OCWDA_ctDebActvErr OCWDA_ctDebErrNotActv OCWDA_ctTstOCWDA OCWDA_flgClrDebDFC OCWDA_stCheckState OCWDA_stWDAActv /end LOC_MEASUREMENT
 FUNCTION_VERSION "85.0.0" /end FUNCTION
/begin FUNCTION OilPPSSwt_DD "35000.0.0 Device Driver: Oil Pump Pressure Selection Switch" /begin DEF_CHARACTERISTIC Oil_tiDebHighLow_C Oil_tiDebLowHigh_C /end DEF_CHARACTERISTIC /begin IN_MEASUREMENT Oil_bRawLPSwmp /end IN_MEASUREMENT /begin OUT_MEASUREMENT Oil_bSensLPSwmp /end OUT_MEASUREMENT FUNCTION_VERSION "35000.0.0" /end FUNCTION
/begin FUNCTION OilPPSSwt_VD "35000.1.0 Virtual Device: Oil Pump Pressure Selection Switch"
 /begin DEF_CHARACTERISTIC DFC_CtlMsk2.DFC_OilPPSSwtMax_C DFC_CtlMsk2.DFC_OilPPSSwtMin_C DFC_CtlMsk2.DFC_OilPPSSwtSig_C DFC_DisblMsk2.DFC_OilPPSSwtMax_C DFC_DisblMsk2.DFC_OilPPSSwtMin_C DFC_DisblMsk2.DFC_OilPPSSwtSig_C OilPPSSwt_nEngMax_C OilPPSSwt_nEngMin_C OilPPSSwt_percWdkbaMax_C OilPPSSwt_percWdkbaMin_C OilPPSSwt_swtCfg_C OilPPSSwt_tEngMax_C OilPPSSwt_tEngMin_C OilPPSSwt_tiDlyBattU_C OilPPSSwt_tiEngOnThd_C OilPPSSwt_tiLPLimpModeDly_C OilPPSSwt_tiLPWarnLampDly_C OilPPSSwt_tiT15EROffDly_C OilPPSSwt_uBattThdHi_C OilPPSSwt_uBattThdLo_C /end DEF_CHARACTERISTIC
 /begin REF_CHARACTERISTIC TVP /end REF_CHARACTERISTIC
 /begin IN_MEASUREMENT BattU_u B_kl15 EngDa_tEng Epm_nEng Oil_bRawLPSwmp Oil_bSensLPSwmp tnse_w wdkba_w /end IN_MEASUREMENT
 /begin OUT_MEASUREMENT OilPPSSwt_bPSDiagEna OilPPSSwt_flgLPLimpMode OilPPSSwt_flgLPWarnLamp OilPPSSwt_stPSwt /end OUT_MEASUREMENT
 /begin LOC_MEASUREMENT OilPPSSwt_bPSDiagActv OilPPSSwt_flgBattUOK OilPPSSwt_flgLPSt OilPPSSwt_flgLPWarnLampChk OilPPSSwt_flgLPWarnLamploc /end LOC_MEASUREMENT
 FUNCTION_VERSION "35000.1.0" /end FUNCTION
/begin FUNCTION OVH "9000.2.0  Overheating Protection."
 /begin DEF_CHARACTERISTIC DFC_CtlMsk2.DFC_OvHEngSpdLimr_C DFC_DisblMsk2.DFC_OvHEngSpdLimr_C TDOVHSHDWN TDOVHSPLIM TENGLIMPHI TENGLIMPLO TENGSHDNHI TENGSHDNLO /end DEF_CHARACTERISTIC
 /begin IN_MEASUREMENT EngDa_tEng SyC_stSub /end IN_MEASUREMENT
 /begin OUT_MEASUREMENT B_OvHEngShDwn B_OvHEngSpdLimr /end OUT_MEASUREMENT
 FUNCTION_VERSION "9000.2.0" /end FUNCTION
/begin FUNCTION Pwm_Conf "BJ_386.0.0_0039_00PWM configuration"
 /begin DEF_CHARACTERISTIC CLSTRTYPSEL CWFUELCONS CWFUELDUTY CWMILEAGE CWPNSELFCCT_C ENGDUTY_C ENGPERIOD_C FLCONPERIOD_C OVHOFFDUTY_C OVHONDUTY_C TMOTDUTY_C TMOTPERIOD_C /end DEF_CHARACTERISTIC
 /begin IN_MEASUREMENT B_kl15 B_nmotrevlim B_OvHLamp InjSys_mlgVeh InjSys_mlgVehAvrgDrvgCyc_a NmotRevLim_flgLampChk nmot_w OilPPSSwt_flgLPWarnLamp tmot /end IN_MEASUREMENT
 /begin OUT_MEASUREMENT flcondutycycle flconsum /end OUT_MEASUREMENT
 /begin LOC_MEASUREMENT engdutycycle engperiod flconperiod tmotdutycycle tmotperiod /end LOC_MEASUREMENT
 FUNCTION_VERSION "BJ_386.0.0_0039_00" /end FUNCTION
/begin FUNCTION rba_BypAdapt "1.24.0    Adapter to the DGS Bypass functionality" FUNCTION_VERSION "1.24.0" /end FUNCTION
/begin FUNCTION rba_EepAdaptDGS "1.24.3    Eep adapter" /begin DEF_CHARACTERISTIC Eep_ClrWrCounter_CW Eep_EnFirstInit_CW Eep_EnvRamClr_CW /end DEF_CHARACTERISTIC /begin OUT_MEASUREMENT Eep_EnvRamHist Eep_EnvRamInvld /end OUT_MEASUREMENT
 /begin LOC_MEASUREMENT Eep_ctAbsCallWrFkt Eep_ctCallWrFkt Eep_ctMaxCallWrFkt Eep_stBlk Eep_stMain Eep_stPostDrv /end LOC_MEASUREMENT
 FUNCTION_VERSION "1.24.3" /end FUNCTION
/begin FUNCTION rba_IoDiagPwr "1.8.1     IO Diagnose Power"
 /begin DEF_CHARACTERISTIC DDRC_DebArTime.DFC_SSpMon1.tiLimFaild_C DDRC_DebArTime.DFC_SSpMon1.tiLimPassd_C DDRC_DebArTime.DFC_SSpMon1OT.tiLimFaild_C DDRC_DebArTime.DFC_SSpMon1OT.tiLimPassd_C DDRC_DebArTime.DFC_SSpMon1OV.tiLimFaild_C DDRC_DebArTime.DFC_SSpMon1OV.tiLimPassd_C DDRC_DebArTime.DFC_SSpMon1SCG.tiLimFaild_C DDRC_DebArTime.DFC_SSpMon1SCG.tiLimPassd_C DDRC_DebArTime.DFC_SSpMon1UV.tiLimFaild_C DDRC_DebArTime.DFC_SSpMon1UV.tiLimPassd_C DDRC_DebArTime.DFC_SSpMon2.tiLimFaild_C DDRC_DebArTime.DFC_SSpMon2.tiLimPassd_C DDRC_DebArTime.DFC_SSpMon2OT.tiLimFaild_C DDRC_DebArTime.DFC_SSpMon2OT.tiLimPassd_C DDRC_DebArTime.DFC_SSpMon2OV.tiLimFaild_C DDRC_DebArTime.DFC_SSpMon2OV.tiLimPassd_C DDRC_DebArTime.DFC_SSpMon2SCG.tiLimFaild_C DDRC_DebArTime.DFC_SSpMon2SCG.tiLimPassd_C DDRC_DebArTime.DFC_SSpMon2UV.tiLimFaild_C DDRC_DebArTime.DFC_SSpMon2UV.tiLimPassd_C DFC_CtlMsk2.DFC_SSpMon1_C DFC_CtlMsk2.DFC_SSpMon1OT_C DFC_CtlMsk2.DFC_SSpMon1OV_C DFC_CtlMsk2.DFC_SSpMon1SCG_C DFC_CtlMsk2.DFC_SSpMon1UV_C DFC_CtlMsk2.DFC_SSpMon2_C DFC_CtlMsk2.DFC_SSpMon2OT_C DFC_CtlMsk2.DFC_SSpMon2OV_C DFC_CtlMsk2.DFC_SSpMon2SCG_C DFC_CtlMsk2.DFC_SSpMon2UV_C DFC_DisblMsk2.DFC_SSpMon1_C DFC_DisblMsk2.DFC_SSpMon1OT_C DFC_DisblMsk2.DFC_SSpMon1OV_C DFC_DisblMsk2.DFC_SSpMon1SCG_C DFC_DisblMsk2.DFC_SSpMon1UV_C DFC_DisblMsk2.DFC_SSpMon2_C DFC_DisblMsk2.DFC_SSpMon2OT_C DFC_DisblMsk2.DFC_SSpMon2OV_C DFC_DisblMsk2.DFC_SSpMon2SCG_C DFC_DisblMsk2.DFC_SSpMon2UV_C /end DEF_CHARACTERISTIC
 FUNCTION_VERSION "1.8.1" /end FUNCTION
/begin FUNCTION rba_IoExtLib "1.14.0    Library for external devices"
 /begin DEF_CHARACTERISTIC DDRC_DebArCounter.DFC_RBA_IOEXTLIB_KEEPALIVE_DRV.isJmpUpActv_C DDRC_DebArCounter.DFC_RBA_IOEXTLIB_KEEPALIVE_DRV.isJmpDwnActv_C DDRC_DebArCounter.DFC_RBA_IOEXTLIB_KEEPALIVE_DRV.limPassd_C DDRC_DebArCounter.DFC_RBA_IOEXTLIB_KEEPALIVE_DRV.limFaild_C DDRC_DebArCounter.DFC_RBA_IOEXTLIB_KEEPALIVE_DRV.stepUp_C DDRC_DebArCounter.DFC_RBA_IOEXTLIB_KEEPALIVE_DRV.stepDwn_C DDRC_DebArCounter.DFC_RBA_IOEXTLIB_KEEPALIVE_DRV.jmpUpVal_C DDRC_DebArCounter.DFC_RBA_IOEXTLIB_KEEPALIVE_DRV.jmpDwnVal_C DDRC_DebArCounter.DFC_RBA_IOEXTLIB_KEEPALIVE_INI.isJmpUpActv_C DDRC_DebArCounter.DFC_RBA_IOEXTLIB_KEEPALIVE_INI.isJmpDwnActv_C DDRC_DebArCounter.DFC_RBA_IOEXTLIB_KEEPALIVE_INI.limPassd_C DDRC_DebArCounter.DFC_RBA_IOEXTLIB_KEEPALIVE_INI.limFaild_C DDRC_DebArCounter.DFC_RBA_IOEXTLIB_KEEPALIVE_INI.stepUp_C DDRC_DebArCounter.DFC_RBA_IOEXTLIB_KEEPALIVE_INI.stepDwn_C DDRC_DebArCounter.DFC_RBA_IOEXTLIB_KEEPALIVE_INI.jmpUpVal_C DDRC_DebArCounter.DFC_RBA_IOEXTLIB_KEEPALIVE_INI.jmpDwnVal_C DFC_CtlMsk2.DFC_RBA_IOEXTLIB_KEEPALIVE_DRV_C DFC_CtlMsk2.DFC_RBA_IOEXTLIB_KEEPALIVE_INI_C DFC_DisblMsk2.DFC_RBA_IOEXTLIB_KEEPALIVE_DRV_C DFC_DisblMsk2.DFC_RBA_IOEXTLIB_KEEPALIVE_INI_C /end DEF_CHARACTERISTIC
 FUNCTION_VERSION "1.14.0" /end FUNCTION
/begin FUNCTION rba_IoSigRtc "1.16.2    IO Signals: Real Time Clocks"
 /begin DEF_CHARACTERISTIC DDRC_DebArCounter.DFC_rba_IoSigRtc_StopCounter.isJmpUpActv_C DDRC_DebArCounter.DFC_rba_IoSigRtc_StopCounter.isJmpDwnActv_C DDRC_DebArCounter.DFC_rba_IoSigRtc_StopCounter.limPassd_C DDRC_DebArCounter.DFC_rba_IoSigRtc_StopCounter.limFaild_C DDRC_DebArCounter.DFC_rba_IoSigRtc_StopCounter.stepUp_C DDRC_DebArCounter.DFC_rba_IoSigRtc_StopCounter.stepDwn_C DDRC_DebArCounter.DFC_rba_IoSigRtc_StopCounter.jmpUpVal_C DDRC_DebArCounter.DFC_rba_IoSigRtc_StopCounter.jmpDwnVal_C DFC_CtlMsk2.DFC_rba_IoSigRtc_StopCounter_C DFC_DisblMsk2.DFC_rba_IoSigRtc_StopCounter_C /end DEF_CHARACTERISTIC
 FUNCTION_VERSION "1.16.2" /end FUNCTION
/begin FUNCTION rba_SrvMT_Num "200.1.0   rba Numeric MathTec Services" FUNCTION_VERSION "200.1.0" /end FUNCTION
/begin FUNCTION Rollovr_Detn "386.0.0   Detection of vehicle roll over"
 /begin DEF_CHARACTERISTIC CWROLLDETN DFC_CtlMsk2.DFC_RoVComVld_C DFC_CtlMsk2.DFC_RoVSNpl_C DFC_CtlMsk2.DFC_RoVSOL_C DFC_CtlMsk2.DFC_RoVSSCB_C DFC_CtlMsk2.DFC_RoVSSCG_C DFC_DisblMsk2.DFC_RoVComVld_C DFC_DisblMsk2.DFC_RoVSNpl_C DFC_DisblMsk2.DFC_RoVSOL_C DFC_DisblMsk2.DFC_RoVSSCB_C DFC_DisblMsk2.DFC_RoVSSCG_C RDEBDIAG ROACTMAX ROACTMIN ROINACTMAX ROINACTMIN ROSHBATMAX ROSHBATMIN ROSHGNDMAX ROSHGNDMIN ROSNOPNMAX ROSNOPNMIN TCOMVLD TVTLT /end DEF_CHARACTERISTIC
 /begin IN_MEASUREMENT B_kl15 Com_bABSRollOver Com_bABSRollOverValidity SyC_stSub urovs_w /end IN_MEASUREMENT
 /begin OUT_MEASUREMENT B_tltsig Rollovr_stRollovrDiagcErr /end OUT_MEASUREMENT
 FUNCTION_VERSION "386.0.0" /end FUNCTION
/begin FUNCTION Rte "2.2.0     Run Time Environment" FUNCTION_VERSION "2.2.0" /end FUNCTION
/begin FUNCTION SignalsExtd_Std "30000.0.0 Interface for readout of ECU internal measurement values extended" FUNCTION_VERSION "30000.0.0" /end FUNCTION
/begin FUNCTION Signals_Std "30000.34.0_1.3.0Interface for readout of ECU internal measurement values"
 /begin DEF_CHARACTERISTIC Signals_Mode1Pid_CA Signals_Mode1SigNum_CA Signals_stSrv01SuppPid_CA /end DEF_CHARACTERISTIC
 FUNCTION_VERSION "30000.34.0_1.3.0" /end FUNCTION
/begin FUNCTION SprkSeatT_VdMdl "9000.1.0  Spark seat temperature model"
 /begin DEF_CHARACTERISTIC SprkSeatT_facCoolgTMdl_T SprkSeatT_facHeatgTMdl_M SprkSeatT_tDftMdl_C SprkSeatT_tEngCorrn_T SprkSeatT_tiPT1MdlFCO_C SprkSeatT_tiPT1Mdl_C SprkSeatT_tLamCorrn_T SprkSeat_tIgnEffCorrn_M /end DEF_CHARACTERISTIC
 /begin IN_MEASUREMENT B_bevab B_stendes EngDa_tEng Epm_nEng ESC_tiSampling etazwimt lamsol ml_w rl_w SyC_stSub taikrm tans VehV_v /end IN_MEASUREMENT
 /begin OUT_MEASUREMENT SprkSeatT_flgTMdlVld SprkSeatT_tMdl /end OUT_MEASUREMENT
 /begin LOC_MEASUREMENT SprkSeatT_tMdlloc SprkSeatT_tMdllocFltd SprkSeatT_tMdlUnFltd /end LOC_MEASUREMENT
 FUNCTION_VERSION "9000.1.0" /end FUNCTION
/begin FUNCTION SrvB "200.13.0  Basic Services" FUNCTION_VERSION "200.13.0" /end FUNCTION
/begin FUNCTION SrvF "200.15.1  Float Services" FUNCTION_VERSION "200.15.1" /end FUNCTION
/begin FUNCTION SrvX "200.17.1  Extended Services" FUNCTION_VERSION "200.17.1" /end FUNCTION
/begin FUNCTION Strt_DD "35000.0.0 Starter Relay Device Driver"
 /begin DEF_CHARACTERISTIC CWPSSTRTR DDRC_DurDeb.Strt_tiOLDebOk_C DDRC_DurDeb.Strt_tiOLDebDef_C DDRC_DurDeb.Strt_tiOvrTempDebOk_C DDRC_DurDeb.Strt_tiOvrTempDebDef_C DDRC_DurDeb.Strt_tiSCBDebOk_C DDRC_DurDeb.Strt_tiSCBDebDef_C DDRC_DurDeb.Strt_tiSCGDebOk_C DDRC_DurDeb.Strt_tiSCGDebDef_C DDRC_RatDeb.Strt_tiOLUDRat_C DDRC_RatDeb.Strt_tiOvrTempUDRat_C DDRC_RatDeb.Strt_tiSCBUDRat_C DDRC_RatDeb.Strt_tiSCGUDRat_C DFC_CtlMsk2.DFC_StrtOL_C DFC_CtlMsk2.DFC_StrtOvrTemp_C DFC_CtlMsk2.DFC_StrtSCB_C DFC_CtlMsk2.DFC_StrtSCG_C DFC_DisblMsk2.DFC_StrtOL_C DFC_DisblMsk2.DFC_StrtOvrTemp_C DFC_DisblMsk2.DFC_StrtSCB_C DFC_DisblMsk2.DFC_StrtSCG_C Strt_ATS.LimitTypeMsk_C Strt_ATS.CnvNorm_C Strt_ATS.LowLim_C Strt_ATS.UpLim_C Strt_ATS.CnvFac_C Strt_ATS.CnvOfs_C Strt_ATS.DfltVal_C /end DEF_CHARACTERISTIC
 /begin REF_CHARACTERISTIC TVP /end REF_CHARACTERISTIC
 /begin IN_MEASUREMENT Strt_st SyC_stSub /end IN_MEASUREMENT
 FUNCTION_VERSION "35000.0.0" /end FUNCTION
/begin FUNCTION Strt_VDModel "4.3.0     Starter Actuator Virtual Device Model" /begin DEF_CHARACTERISTIC Strt_nMaxStrt_C Strt_uDiffMaxStrt_C /end DEF_CHARACTERISTIC /begin IN_MEASUREMENT BattU_u Epm_nEng /end IN_MEASUREMENT /begin OUT_MEASUREMENT Strt_stStaActv Strt_uIniMinStrt /end OUT_MEASUREMENT FUNCTION_VERSION "4.3.0" /end FUNCTION
/begin FUNCTION StSys_StrtCtl "35000.2.0_386.1.1Switching on and off of the starter"
 /begin DEF_CHARACTERISTIC StrtCtl_nStrtRlsMax_C StSys_cntrStrtFailMaxThd_C StSys_nMaxStrtAtmpt_C StSys_nStrtCtlMax_C StSys_prcWdkbaMax_C StSys_RstCdnMsk_C StSys_tiMaxStrtRest_C StSys_tiMinStrtrRest_C StSys_tiStrtCtlMax_C StSys_uStrtCtlMin_C /end DEF_CHARACTERISTIC
 /begin IN_MEASUREMENT B_kuppl B_lrnstpfgrly B_neutgear B_nmot B_poweron B_sdstact B_stend B_stendes Epm_nEng SyC_stSub T15_st ubsq wdkba_w /end IN_MEASUREMENT
 /begin OUT_MEASUREMENT Strt_st Strt_stPs StSys_cntrStrtFail StSys_flgRstCdnMsk StSys_flgStrtFail StSys_stResCond StSys_stStrtRest StSys_tiStrtRest /end OUT_MEASUREMENT
 /begin LOC_MEASUREMENT StSys_flgStrtrStk StSys_nMaxStrtAtmpt /end LOC_MEASUREMENT
 FUNCTION_VERSION "35000.2.0_386.1.1" /end FUNCTION
/begin COMPU_METHOD B_TRUE "" TAB_VERB "%6.3" "" COMPU_TAB_REF B_TRUE /end COMPU_METHOD
/begin COMPU_VTAB B_TRUE "" TAB_VERB 2 0 "FALSE" 1 "TRUE" /end COMPU_VTAB
/begin COMPU_METHOD DDRCTime_ms "" RAT_FUNC "%6.1" "ms" COEFFS 0 1 0 0 0 10 /end COMPU_METHOD
/begin COMPU_METHOD DDRC_Ratio "" TAB_VERB "%6.3" "-" COMPU_TAB_REF DDRC_Ratio /end COMPU_METHOD
/begin COMPU_VTAB DDRC_Ratio "" TAB_VERB 4 1 "Ratio1" 2 "Ratio2" 3 "Ratio3" 4 "Ratio4" /end COMPU_VTAB
/begin COMPU_METHOD dez "" RAT_FUNC "%6.2" "" COEFFS 0 1 0 0 0 1 /end COMPU_METHOD
/begin COMPU_METHOD DFES_OneToOne "" RAT_FUNC "%6.2" "-" COEFFS 0 1 0 0 0 1 /end COMPU_METHOD
/begin COMPU_METHOD Eep_MainStates_Verb "" TAB_VERB "%6.3" "" COMPU_TAB_REF Eep_MainStates_Verb /end COMPU_METHOD
/begin COMPU_VTAB Eep_MainStates_Verb "" TAB_VERB 15 0 "EEP_SHUTDWN_RUN" 1 "EEP_INI_RUN" 2 "EEP_MIGRATION_RUN" 3 "EEP_INI_INTERNAL" 4 "EEP_NORMAL_RUN" 5 "EEP_BEGPD_REQUEST" 6 "EEP_BEGPD_RUN" 7 "EEP_ENDPD_REQUEST" 8 "EEP_ENDPD_RUN" 9 "EEP_PREDRV_REQUEST" 10 "EEP_PREDRV_RUN" 11 "EEP_FIRSTINIT_INI" 12 "EEP_RAM_INI" 13 "EEP_ENVRAM_INI" 14 "EEP_REINIT_INI" /end COMPU_VTAB
/begin COMPU_METHOD Eep_PostDrvState_Verb "" TAB_VERB "%6.3" "" COMPU_TAB_REF Eep_PostDrvState_Verb /end COMPU_METHOD
/begin COMPU_VTAB Eep_PostDrvState_Verb "" TAB_VERB 5 0 "EEP_POSTDRV_INI" 1 "EEP_POSTDRV_SEARCHBLKIDX" 2 "EEP_POSTDRV_SAVEBLK" 3 "EEP_POSTDRV_SAVEBLK_PENDING" 4 "EEP_POSTDRV_WAIT" /end COMPU_VTAB
/begin COMPU_METHOD EngN "" RAT_FUNC "%6.3" "rpm" COEFFS 0 2 0 0 0 1 /end COMPU_METHOD
/begin COMPU_METHOD EngNGrd "" RAT_FUNC "%6.3" "rpm/s" COEFFS 0 2 0 0 0 1 /end COMPU_METHOD
/begin COMPU_METHOD fak_q0p0039_op0p5 "" RAT_FUNC "%6.3" "" COEFFS 0 256 -128 0 0 1 /end COMPU_METHOD
/begin COMPU_METHOD fak_q0p1 "" RAT_FUNC "%6.3" "-" COEFFS 0 1 0 0 0 0.1 /end COMPU_METHOD
/begin COMPU_METHOD fak_ub_b1 "" RAT_FUNC "%6.4" "-" COEFFS 0 256 0 0 0 1 /end COMPU_METHOD
/begin COMPU_METHOD fak_ub_b10 "" RAT_FUNC "%6.4" "-" COEFFS 0 256 0 0 0 10 /end COMPU_METHOD
/begin COMPU_METHOD fak_ub_q0p01 "" RAT_FUNC "%6.4" "-" COEFFS 0 1 0 0 0 0.01 /end COMPU_METHOD
/begin COMPU_METHOD InJTimeHiRes_us "" RAT_FUNC "%6.4" "us" COEFFS 0 20 0 0 0 1 /end COMPU_METHOD
/begin COMPU_METHOD md_q0p1 "" RAT_FUNC "%6.3" "Nm" COEFFS 0 10 0 0 0 1 /end COMPU_METHOD
/begin COMPU_METHOD Mo_v_kmh_q0p01 "" RAT_FUNC "%6.4" "km/h" COEFFS 0 100 0 0 0 1 /end COMPU_METHOD
/begin COMPU_METHOD m_uw_b6553p5 "" RAT_FUNC "%6.3" "kg/h" COEFFS 0 1 0 0 0 0.1 /end COMPU_METHOD
/begin COMPU_METHOD NMAXMD_relnmot_q0p001 "" RAT_FUNC "%6.5" "%/(U/min)" COEFFS 0 1000 0 0 0 1 /end COMPU_METHOD
/begin COMPU_METHOD nmot_sw_q0p25 "" RAT_FUNC "%6.3" "1/min" COEFFS 0 1 0 0 0 0.25 /end COMPU_METHOD
/begin COMPU_METHOD nmot_uw_q0p25 "" RAT_FUNC "%6.3" "1/min" COEFFS 0 1 0 0 0 0.25 /end COMPU_METHOD
/begin COMPU_METHOD OCWDA_swtOffRst_C_compu "" TAB_VERB "%6.3" "" COMPU_TAB_REF OCWDA_swtOffRst_C_compu /end COMPU_METHOD
/begin COMPU_VTAB OCWDA_swtOffRst_C_compu "" TAB_VERB 2 0 "OCWDA_RESET_ACTIVE" 1 "OCWDA_RESET_INACTIVE" /end COMPU_VTAB
/begin COMPU_METHOD OneToOne "" RAT_FUNC "%6.2" "-" COEFFS 0 1 0 0 0 1 /end COMPU_METHOD
/begin COMPU_METHOD relDK_q0p02441 "" RAT_FUNC "%6.4" "%DK" COEFFS 0 65536 0 0 0 1600 /end COMPU_METHOD
/begin COMPU_METHOD relnmot_q0p003052 "" RAT_FUNC "%6.4" "%/(U/min)" COEFFS 0 8192 0 0 0 25 /end COMPU_METHOD
/begin COMPU_METHOD relnmot_q0p01907 "" RAT_FUNC "%6.4" "%/(U/min)/s" COEFFS 0 32768 0 0 0 625 /end COMPU_METHOD
/begin COMPU_METHOD rel_q4p76837Em5 "" RAT_FUNC "%7.6" "%" COEFFS 0 20971.52 0 0 0 1 /end COMPU_METHOD
/begin COMPU_METHOD rel_sw_b100 "" RAT_FUNC "%6.4" "%" COEFFS 0 32768 0 0 0 100 /end COMPU_METHOD
/begin COMPU_METHOD rel_ub_b127p5 "" RAT_FUNC "%6.3" "%" COEFFS 0 2 0 0 0 1 /end COMPU_METHOD
/begin COMPU_METHOD rel_uw_b100 "" RAT_FUNC "%6.4" "%" COEFFS 0 65536 0 0 0 100 /end COMPU_METHOD
/begin COMPU_METHOD rel_uw_q0p01 "" RAT_FUNC "%6.4" "%" COEFFS 0 1 0 0 0 0.01 /end COMPU_METHOD
/begin COMPU_METHOD rel_uw_q0p0234 "" RAT_FUNC "%6.4" "%" COEFFS 0 32 0 0 0 0.75 /end COMPU_METHOD
/begin COMPU_METHOD ReynoldsNum "" RAT_FUNC "%6.0" "-" COEFFS 0 0.01 0 0 0 1 /end COMPU_METHOD
/begin COMPU_METHOD ReynoldsNum1 "" RAT_FUNC "%7.0" "-" COEFFS 0 0.001 0 0 0 1 /end COMPU_METHOD
/begin COMPU_METHOD RhoFuel "" RAT_FUNC "%6.3" "kg/m^3" COEFFS 0 10 0 0 0 1 /end COMPU_METHOD
/begin COMPU_METHOD rhoOilAsh_g_p_l "" RAT_FUNC "%6.3" "g/l" COEFFS 0 10 0 0 0 1 /end COMPU_METHOD
/begin COMPU_METHOD Rho_q0p001_COMPU "" RAT_FUNC "%6.5" "Kg/m^3" COEFFS 0 1000 0 0 0 1 /end COMPU_METHOD
/begin COMPU_METHOD Rmp "" RAT_FUNC "%6.4" "1/s" COEFFS 0 65.536 0 0 0 1 /end COMPU_METHOD
/begin COMPU_METHOD RmpDtyCyc "" RAT_FUNC "%6.5" "%/s" COEFFS 0 6553.6 0 0 0 1 /end COMPU_METHOD
/begin COMPU_METHOD RmpPrc "" RAT_FUNC "%6.5" "%/s" COEFFS 0 5368.70912 0 0 0 1 /end COMPU_METHOD
/begin COMPU_METHOD RmpTrq "" RAT_FUNC "%6.4" "Nm/s" COEFFS 0 655.36 0 0 0 1 /end COMPU_METHOD
/begin COMPU_METHOD Rmp_1 "" RAT_FUNC "%6.5" "1/s" COEFFS 0 1000 0 0 0 1 /end COMPU_METHOD
/begin COMPU_METHOD SCRM_kg_q0p001_COMPU "" RAT_FUNC "%6.5" "kg" COEFFS 0 1000 0 0 0 1 /end COMPU_METHOD
/begin COMPU_METHOD SCR_DmStp0001 "" RAT_FUNC "%6.5" "mg/Step" COEFFS 0 1000 0 0 0 1 /end COMPU_METHOD
/begin COMPU_METHOD SCR_kPa_10 "" RAT_FUNC "%6.1" "kPa" COEFFS 0 0.1 0 0 0 1 /end COMPU_METHOD
/begin COMPU_METHOD SCR_kPa_100 "" RAT_FUNC "%6.0" "kPa" COEFFS 0 0.01 0 0 0 1 /end COMPU_METHOD
/begin COMPU_METHOD SCR_Mass01 "" RAT_FUNC "%6.3" "mg" COEFFS 0 10 0 0 0 1 /end COMPU_METHOD
/begin COMPU_METHOD SCR_Volt_q0p0001227 "" RAT_FUNC "%6.5" "V" COEFFS 0 8192 0 0 0 1 /end COMPU_METHOD
/begin COMPU_METHOD SD_SC_Compu "" TAB_VERB "%6.3" "" COMPU_TAB_REF SD_SC_Compu /end COMPU_METHOD
/begin COMPU_VTAB SD_SC_Compu "" TAB_VERB 2 0 "INACTIVE" 1 "ACTIVE" /end COMPU_VTAB
/begin COMPU_METHOD SECULIBS_VAR_SY_Compu "" TAB_VERB "%6.3" "" COMPU_TAB_REF SECULIBS_VAR_SY_Compu /end COMPU_METHOD
/begin COMPU_VTAB SECULIBS_VAR_SY_Compu "" TAB_VERB 3 3 "VWW" 5 "AUD" 999 "ALL" /end COMPU_VTAB
/begin COMPU_METHOD SENT_SC_Compu "" TAB_VERB "%6.3" "" COMPU_TAB_REF SENT_SC_Compu /end COMPU_METHOD
/begin COMPU_VTAB SENT_SC_Compu "" TAB_VERB 2 0 "False" 1 "True" /end COMPU_VTAB
/begin COMPU_METHOD SIDSTSWT_MON_SC_Compu "" TAB_VERB "%6.3" "" COMPU_TAB_REF SIDSTSWT_MON_SC_Compu /end COMPU_METHOD
/begin COMPU_VTAB SIDSTSWT_MON_SC_Compu "" TAB_VERB 2 0 "False" 1 "True" /end COMPU_VTAB
/begin COMPU_METHOD Signals_IntSigNumVerb "" TAB_VERB "%6.3" "" COMPU_TAB_REF Signals_IntSigNumVerb /end COMPU_METHOD
/begin COMPU_VTAB Signals_IntSigNumVerb "" TAB_VERB 92 0 "SIGNALS_Signals_Default" 1 "SIGNALS_EngDa_tEng_s" 2 "SIGNALS_EpmCrS_stSigMode_s" 3 "SIGNALS_Epm_nEng" 4 "SIGNALS_Epm_nEng_s" 5 "SIGNALS_Epm_stOpMode" 6 "SIGNALS_MILLmp_stMIL_s" 7 "SIGNALS_PID01h" 8 "SIGNALS_PID04h" 9 "SIGNALS_PID07h_0" 10 "SIGNALS_PID11h" 11 "SIGNALS_PID13h" 12 "SIGNALS_PID1Ch" 13 "SIGNALS_PID21h" 14 "SIGNALS_PID30h" 15 "SIGNALS_PID31h" 16 "SIGNALS_PID43h" 17 "SIGNALS_PID45h" 18 "SIGNALS_PID4Dh" 19 "SIGNALS_PID4Eh" 20 "SIGNALS_PID_FILLSIG_1BIT" 21 "SIGNALS_PID_FILLSIG_1BITNZ" 22 "SIGNALS_PID_FILLSIG_1BYTE" 23 "SIGNALS_PID_FILLSIG_1BYTENZ" 24 "SIGNALS_PID_FILLSIG_2BIT" 25 "SIGNALS_PID_FILLSIG_2BITNZ" 26 "SIGNALS_PID_FILLSIG_2BYTE" 27 "SIGNALS_PID_FILLSIG_2BYTENZ" 28 "SIGNALS_PID_FILLSIG_3BIT" 29 "SIGNALS_PID_FILLSIG_3BITNZ" 30 "SIGNALS_PID_FILLSIG_4BIT" 31 "SIGNALS_PID_FILLSIG_4BITNZ" 32 "SIGNALS_PID_FILLSIG_4BYTE" 33 "SIGNALS_PID_FILLSIG_4BYTENZ" 34 "SIGNALS_PID_FILLSIG_5BIT" 35 "SIGNALS_PID_FILLSIG_5BITNZ" 36 "SIGNALS_PID_FILLSIG_6BIT" 37 "SIGNALS_PID_FILLSIG_6BITNZ" 38 "SIGNALS_PID_FILLSIG_7BIT" 39 "SIGNALS_PID_FILLSIG_7BITNZ" 40 "SIGNALS_VehV_v_s" 41 "SIGNALS_avgmlg_s" 42 "SIGNALS_avgvfzg_0__s" 43 "SIGNALS_engcmbstevnt_l_s" 44 "SIGNALS_engrevcntr_l_s" 45 "SIGNALS_fr_w_s" 46 "SIGNALS_fra_w_s" 47 "SIGNALS_frm_w_s" 48 "SIGNALS_gangi_s" 49 "SIGNALS_kmstand_l_s" 50 "SIGNALS_ml_w_s" 51 "SIGNALS_ofmsdkq_w_s" 52 "SIGNALS_olls_w_s" 53 "SIGNALS_psdss_w_s" 54 "SIGNALS_rka_w_s" 55 "SIGNALS_rl_s" 56 "SIGNALS_sdstactcntr_l_s" 57 "SIGNALS_szout_w_s" 58 "SIGNALS_tans_s" 59 "SIGNALS_tateout_w_s" 60 "SIGNALS_tieff_w_s" 61 "SIGNALS_tltcntr_l_s" 62 "SIGNALS_topre1m_l_s" 63 "SIGNALS_ubsq_s" 64 "SIGNALS_udss_w_s" 65 "SIGNALS_urovs_w_s" 66 "SIGNALS_usdst_w_s" 67 "SIGNALS_usvkl_s" 68 "SIGNALS_uwdk_w_s" 69 "SIGNALS_vmlg_nonavg_s" 70 "SIGNALS_wdkba_s" 71 "SIGNALS_wtans_s" 72 "SIGNALS_wubcntr_l_s" 73 "SIGNALS_zwout1_s" 74 "SIGNALS_zwout_s" 75 "SIGNALS_PID03h" 76 "SIGNALS_PID05h" 77 "SIGNALS_PID06h" 78 "SIGNALS_PID07h" 79 "SIGNALS_PID0Bh" 80 "SIGNALS_PID0Dh" 81 "SIGNALS_PID0Eh" 82 "SIGNALS_PID0Fh" 83 "SIGNALS_PID14h_a" 84 "SIGNALS_PID14h_b" 85 "SIGNALS_PID1Fh" 86 "SIGNALS_PID2Eh" 87 "SIGNALS_PID33H" 88 "SIGNALS_PID42h" 89 "SIGNALS_Virtual_B_atmtpa_s" 90 "SIGNALS_Virtual_B_bm_s" 91 "SIGNALS_Virtual_DcmDspUds_DID_0110_Engine_status_s" /end COMPU_VTAB
/begin COMPU_METHOD Signals_OneToOne "" RAT_FUNC "%6.2" "" COEFFS 0 1 0 0 0 1 /end COMPU_METHOD
/begin COMPU_METHOD Signals_PidVerbSupp "" TAB_VERB "%6.3" "" COMPU_TAB_REF Signals_PidVerbSupp /end COMPU_METHOD
/begin COMPU_VTAB Signals_PidVerbSupp "" TAB_VERB 26 0 "PID_NOT_SUPPORTED" 3 "PID_0x03" 4 "PID_0x04" 5 "PID_0x05" 6 "PID_0x06" 7 "PID_0x07" 11 "PID_0x0B" 12 "PID_0x0C" 13 "PID_0x0D" 14 "PID_0x0E" 15 "PID_0x0F" 17 "PID_0x11" 19 "PID_0x13" 20 "PID_0x14" 28 "PID_0x1C" 31 "PID_0x1F" 33 "PID_0x21" 46 "PID_0x2E" 48 "PID_0x30" 49 "PID_0x31" 51 "PID_0x33" 66 "PID_0x42" 67 "PID_0x43" 69 "PID_0x45" 77 "PID_0x4D" 78 "PID_0x4E" /end COMPU_VTAB
/begin COMPU_METHOD Sig_I15031_LeanAppl_SY_Compu "" RAT_FUNC "%6.2" "" COEFFS 0 1 0 0 0 1 /end COMPU_METHOD
/begin COMPU_METHOD Soot_gPerLtr "" RAT_FUNC "%6.4" "g/l" COEFFS 0 100 0 0 0 1 /end COMPU_METHOD
/begin COMPU_METHOD SotMassPerDist "" RAT_FUNC "%7.6" "g/km" COEFFS 0 10000 0 0 0 1 /end COMPU_METHOD
/begin COMPU_METHOD SotMassPerSec "" RAT_FUNC "%6.3" "g/s" COEFFS 0 10 0 0 0 1 /end COMPU_METHOD
/begin COMPU_METHOD SotMassPerTime "" RAT_FUNC "%6.4" "mg/s" COEFFS 0 100 0 0 0 1 /end COMPU_METHOD
/begin COMPU_METHOD SotMsPerkm_COMPU "" RAT_FUNC "%6.5" "g/km" COEFFS 0 8192 0 0 0 1 /end COMPU_METHOD
/begin COMPU_METHOD SotMs_KgPrSec_COMPU "" RAT_FUNC "%6.2" "kg/s" COEFFS 0 1 0 0 0 1 /end COMPU_METHOD
/begin COMPU_METHOD SOxMassPerTime "" RAT_FUNC "%7.6" "mg/s" COEFFS 0 10000 0 0 0 1 /end COMPU_METHOD
/begin COMPU_METHOD SpaVel "" RAT_FUNC "%6.1" "l/h" COEFFS 0 0.1 0 0 0 1 /end COMPU_METHOD
/begin COMPU_METHOD SPDCTL_DETPTST_SC_Compu "" TAB_VERB "%6.3" "" COMPU_TAB_REF SPDCTL_DETPTST_SC_Compu /end COMPU_METHOD
/begin COMPU_VTAB SPDCTL_DETPTST_SC_Compu "" TAB_VERB 2 0 "B_kuppl_B_neutgear" 1 "B_kuppl_B_neutgear_vfzg_w_B_ll" /end COMPU_VTAB
/begin COMPU_METHOD SpecHeatFine "" RAT_FUNC "%6.3" "J/Kg/K" COEFFS 0 5 0 0 0 1 /end COMPU_METHOD
/begin COMPU_METHOD SpecificHeat "" RAT_FUNC "%7.6" "J/g/K" COEFFS 0 10000 0 0 0 1 /end COMPU_METHOD
/begin COMPU_METHOD spg_q0p1 "" RAT_FUNC "%6.3" "V" COEFFS 0 1 0 0 0 0.1 /end COMPU_METHOD
/begin COMPU_METHOD spg_uw_q0p00488 "" RAT_FUNC "%6.4" "V" COEFFS 0 1024 0 0 0 5 /end COMPU_METHOD
/begin COMPU_METHOD SPRKSEATTMDL_SC_Compu "" TAB_VERB "%6.3" "" COMPU_TAB_REF SPRKSEATTMDL_SC_Compu /end COMPU_METHOD
/begin COMPU_VTAB SPRKSEATTMDL_SC_Compu "" TAB_VERB 2 0 "disable" 1 "enable" /end COMPU_VTAB
/begin COMPU_METHOD SqrVltg_s "" RAT_FUNC "%6.3" "V^2s" COEFFS 0 10 0 0 0 1 /end COMPU_METHOD
/begin COMPU_METHOD STAACTVDET_SY_Compu "" TAB_VERB "%6.3" "" COMPU_TAB_REF STAACTVDET_SY_Compu /end COMPU_METHOD
/begin COMPU_VTAB STAACTVDET_SY_Compu "" TAB_VERB 5 0 "STAACTDET_MDL" 1 "STAACTDET_PS" 2 "STAACTDET_T50" 3 "STAACTDET_MD or STAACTVDET_T50" 4 "STAACTVDET_SY" /end COMPU_VTAB
/begin COMPU_METHOD STM_SY_Compu "" TAB_VERB "%6.3" "" COMPU_TAB_REF STM_SY_Compu /end COMPU_METHOD
/begin COMPU_VTAB STM_SY_Compu "" TAB_VERB 2 0 "STM not used" 1 "STM used" /end COMPU_VTAB
/begin COMPU_METHOD STNETH_SY_Compu "" TAB_VERB "%6.3" "" COMPU_TAB_REF STNETH_SY_Compu /end COMPU_METHOD
/begin COMPU_VTAB STNETH_SY_Compu "" TAB_VERB 3 0 "ZERO" 1 "ONE" 2 "TWO" /end COMPU_VTAB
/begin COMPU_METHOD stroke_pml "" RAT_FUNC "%6.3" "1/ml" COEFFS 0 10 0 0 0 1 /end COMPU_METHOD
/begin COMPU_METHOD STRTCTL_SC_Compu "" TAB_VERB "%6.3" "" COMPU_TAB_REF STRTCTL_SC_Compu /end COMPU_METHOD
/begin COMPU_VTAB STRTCTL_SC_Compu "" TAB_VERB 5 0 "NOSTARTER" 1 "STRTCTLEXT" 2 "STRTCTLCOMMON" 3 "STRTCTLDS" 4 "STRTCTLGS" /end COMPU_VTAB
/begin COMPU_METHOD STSP_SY_Compu "" TAB_VERB "%6.3" "" COMPU_TAB_REF STSP_SY_Compu /end COMPU_METHOD
/begin COMPU_VTAB STSP_SY_Compu "" TAB_VERB 2 0 "FALSE" 1 "TRUE" /end COMPU_VTAB
/begin COMPU_METHOD SVCrnt_mA_COMPU "" RAT_FUNC "%6.1" "mA" COEFFS 0 0.0341 0 0 0 1 /end COMPU_METHOD
/begin COMPU_METHOD SVS_SY_Compu "" TAB_VERB "%6.3" "" COMPU_TAB_REF SVS_SY_Compu /end COMPU_METHOD
/begin COMPU_VTAB SVS_SY_Compu "" TAB_VERB 2 0 "False" 1 "True" /end COMPU_VTAB
/begin COMPU_METHOD SYC_AFTRUNDIAG_SC_Compu "" TAB_VERB "%6.3" "" COMPU_TAB_REF SYC_AFTRUNDIAG_SC_Compu /end COMPU_METHOD
/begin COMPU_VTAB SYC_AFTRUNDIAG_SC_Compu "" TAB_VERB 2 0 "False" 1 "True" /end COMPU_VTAB
/begin COMPU_METHOD SYC_CAL_PERMSPLYSYS_SY_Compu "" TAB_VERB "%6.3" "" COMPU_TAB_REF SYC_CAL_PERMSPLYSYS_SY_Compu /end COMPU_METHOD
/begin COMPU_VTAB SYC_CAL_PERMSPLYSYS_SY_Compu "" TAB_VERB 2 0 "False" 1 "True" /end COMPU_VTAB
/begin COMPU_METHOD SYC_CNTPOSTDRV_SC_Compu "" TAB_VERB "%6.3" "" COMPU_TAB_REF SYC_CNTPOSTDRV_SC_Compu /end COMPU_METHOD
/begin COMPU_VTAB SYC_CNTPOSTDRV_SC_Compu "" TAB_VERB 2 0 "False" 1 "True" /end COMPU_VTAB
/begin COMPU_METHOD SYC_COORD_SC_Compu "" TAB_VERB "%6.3" "" COMPU_TAB_REF SYC_COORD_SC_Compu /end COMPU_METHOD
/begin COMPU_VTAB SYC_COORD_SC_Compu "" TAB_VERB 2 0 "False" 1 "True" /end COMPU_VTAB
/begin COMPU_METHOD SYC_ENALCYPROLG_SC_Compu "" TAB_VERB "%6.3" "" COMPU_TAB_REF SYC_ENALCYPROLG_SC_Compu /end COMPU_METHOD
/begin COMPU_VTAB SYC_ENALCYPROLG_SC_Compu "" TAB_VERB 2 0 "False" 1 "True" /end COMPU_VTAB
/begin COMPU_METHOD SYC_PROLGPREDRV_SC_Compu "" TAB_VERB "%6.3" "" COMPU_TAB_REF SYC_PROLGPREDRV_SC_Compu /end COMPU_METHOD
/begin COMPU_VTAB SYC_PROLGPREDRV_SC_Compu "" TAB_VERB 2 0 "False" 1 "True" /end COMPU_VTAB
/begin COMPU_METHOD SY_2PGRD1E_Compu "" TAB_VERB "%6.3" "" COMPU_TAB_REF SY_2PGRD1E_Compu /end COMPU_METHOD
/begin COMPU_VTAB SY_2PGRD1E_Compu "" TAB_VERB 4 0 "0" 1 "1" 2 "2" 3 "3" /end COMPU_VTAB
/begin COMPU_METHOD SY_2PGRD4E_Compu "" TAB_VERB "%6.3" "" COMPU_TAB_REF SY_2PGRD4E_Compu /end COMPU_METHOD
/begin COMPU_VTAB SY_2PGRD4E_Compu "" TAB_VERB 2 0 "0" 1 "1" /end COMPU_VTAB
/begin COMPU_METHOD SY_2SG_Compu "" TAB_VERB "%6.3" "" COMPU_TAB_REF SY_2SG_Compu /end COMPU_METHOD
/begin COMPU_VTAB SY_2SG_Compu "" TAB_VERB 2 0 "1 Steuergerät" 1 "2 Steuergeräte" /end COMPU_VTAB
/begin COMPU_METHOD SY_ACPAC_Compu "" TAB_VERB "%6.3" "" COMPU_TAB_REF SY_ACPAC_Compu /end COMPU_METHOD
/begin COMPU_VTAB SY_ACPAC_Compu "" TAB_VERB 2 0 "ohne druck sensor" 1 "A/C mit drucksensor" /end COMPU_VTAB
/begin COMPU_METHOD SY_AFIMVAR_Compu "" TAB_VERB "%6.3" "" COMPU_TAB_REF SY_AFIMVAR_Compu /end COMPU_METHOD
/begin COMPU_VTAB SY_AFIMVAR_Compu "" TAB_VERB 6 0 "NOAFIM" 1 "AFIMDIS" 2 "AFIMEZLA" 3 "AFIMMFK" 4 "AFIMEZFRQ" 5 "AFIMCILCN" /end COMPU_VTAB
/begin COMPU_METHOD SY_AGR2_Compu "" TAB_VERB "%6.3" "" COMPU_TAB_REF SY_AGR2_Compu /end COMPU_METHOD
/begin COMPU_VTAB SY_AGR2_Compu "" TAB_VERB 2 0 "FALSE" 1 "TRUE" /end COMPU_VTAB
/begin COMPU_METHOD SY_AGR_Compu "" TAB_VERB "%6.3" "" COMPU_TAB_REF SY_AGR_Compu /end COMPU_METHOD
/begin COMPU_VTAB SY_AGR_Compu "" TAB_VERB 2 0 "FALSE" 1 "TRUE" /end COMPU_VTAB
/begin COMPU_METHOD SY_AIRBAG_Compu "" TAB_VERB "%6.3" "" COMPU_TAB_REF SY_AIRBAG_Compu /end COMPU_METHOD
/begin COMPU_VTAB SY_AIRBAG_Compu "" TAB_VERB 2 0 "kein Airbagsignal verfügbar" 1 "Airbagsignal verfügbar" /end COMPU_VTAB
/begin COMPU_METHOD SY_ALE_Compu "" TAB_VERB "%6.3" "" COMPU_TAB_REF SY_ALE_Compu /end COMPU_METHOD
/begin COMPU_VTAB SY_ALE_Compu "" TAB_VERB 2 0 "False" 1 "True" /end COMPU_VTAB
/begin COMPU_METHOD SY_APP_Compu "" TAB_VERB "%6.3" "" COMPU_TAB_REF SY_APP_Compu /end COMPU_METHOD
/begin COMPU_VTAB SY_APP_Compu "" TAB_VERB 2 0 "False" 1 "True" /end COMPU_VTAB
/begin COMPU_METHOD SY_ASR_Compu "" TAB_VERB "%6.3" "" COMPU_TAB_REF SY_ASR_Compu /end COMPU_METHOD
/begin COMPU_VTAB SY_ASR_Compu "" TAB_VERB 2 0 "keine ASR vorhanden" 1 "ASR vorhanden" /end COMPU_VTAB
/begin COMPU_METHOD SY_ASVAR_Compu "" RAT_FUNC "%6.2" "" COEFFS 0 1 0 0 0 1 /end COMPU_METHOD
/begin COMPU_METHOD SY_AUFLAD_Compu "" TAB_VERB "%6.3" "" COMPU_TAB_REF SY_AUFLAD_Compu /end COMPU_METHOD
/begin COMPU_VTAB SY_AUFLAD_Compu "" TAB_VERB 2 0 "no_supercharging" 1 "supercharging" /end COMPU_VTAB
/begin COMPU_METHOD SY_BDE_Compu "" TAB_VERB "%6.3" "" COMPU_TAB_REF SY_BDE_Compu /end COMPU_METHOD
/begin COMPU_VTAB SY_BDE_Compu "" TAB_VERB 2 0 "Saugrohreinspritzer" 1 "Benzindirekteinspritzer" /end COMPU_VTAB
/begin COMPU_METHOD SY_BKVSRV_Compu "" TAB_VERB "%6.3" "" COMPU_TAB_REF SY_BKVSRV_Compu /end COMPU_METHOD
/begin COMPU_VTAB SY_BKVSRV_Compu "" TAB_VERB 2 0 "ohne Verbindung" 1 "mit Verbindung" /end COMPU_VTAB
/begin COMPU_METHOD SY_BPEZEK_Compu "" TAB_VERB "%6.3" "" COMPU_TAB_REF SY_BPEZEK_Compu /end COMPU_METHOD
/begin COMPU_VTAB SY_BPEZEK_Compu "" TAB_VERB 2 0 "False" 1 "True" /end COMPU_VTAB
/begin COMPU_METHOD SY_CANVFZ_Compu "" TAB_VERB "%6.3" "" COMPU_TAB_REF SY_CANVFZ_Compu /end COMPU_METHOD
/begin COMPU_VTAB SY_CANVFZ_Compu "" TAB_VERB 3 0 "NO_CAN" 1 "ERRORPATH" 2 "No_ERRORPATH" /end COMPU_VTAB
/begin COMPU_METHOD SY_CASLIMP_Compu "" TAB_VERB "%6.3" "" COMPU_TAB_REF SY_CASLIMP_Compu /end COMPU_METHOD
/begin COMPU_VTAB SY_CASLIMP_Compu "" TAB_VERB 2 0 "False" 1 "True" /end COMPU_VTAB
/begin COMPU_METHOD SY_CMPTSTIGN_Compu "" TAB_VERB "%6.3" "" COMPU_TAB_REF SY_CMPTSTIGN_Compu /end COMPU_METHOD
/begin COMPU_VTAB SY_CMPTSTIGN_Compu "" TAB_VERB 2 0 "False" 1 "True" /end COMPU_VTAB
/begin COMPU_METHOD SY_CNG_Compu "" TAB_VERB "%6.3" "" COMPU_TAB_REF SY_CNG_Compu /end COMPU_METHOD
/begin COMPU_VTAB SY_CNG_Compu "" TAB_VERB 6 0 "Kein System mit CNG" 1 "System mit CNG" 2 "System mit CNG und EOBD" 3 "System mit CNG Fehlerpfade ASV1...5" 4 "System mit CNG Plattform" 5 "System with customer options on CNG platform" /end COMPU_VTAB
/begin COMPU_METHOD SY_CVT_Compu "" TAB_VERB "%6.3" "" COMPU_TAB_REF SY_CVT_Compu /end COMPU_METHOD
/begin COMPU_VTAB SY_CVT_Compu "" TAB_VERB 2 0 "no CVT Gear installed" 1 "CVT Gear installed" /end COMPU_VTAB
/begin COMPU_METHOD SY_DAPRID_Compu "" TAB_VERB "%6.3" "" COMPU_TAB_REF SY_DAPRID_Compu /end COMPU_METHOD
/begin COMPU_VTAB SY_DAPRID_Compu "" TAB_VERB 11 0 "keine Zuordnung" 1 "ME 9.7 NGV" 2 "ME 17.7 UHP" 3 "MED 17.7.1 MoVE" 4 "MED 17.7.2 M270/M274" 5 "M276Desla" 6 "MED 17.7.4 M177/M178" 7 "ME17.7.20 M281 Smart" 8 "ME17.7.20 M281 REX" 9 "kein MED17 Projekt" 10 "MED17.7.7 M260/M264" /end COMPU_VTAB
/begin COMPU_METHOD SY_DCPV_Compu "" TAB_VERB "%6.3" "" COMPU_TAB_REF SY_DCPV_Compu /end COMPU_METHOD
/begin COMPU_VTAB SY_DCPV_Compu "" TAB_VERB 9 0 "00_No_CPV_Diag" 1 "01_DTEV_based" 2 "02_DTEV_wothout_PassiveCheck" 11 "11_Using_TankPSensor" 12 "12_TankPSensor_based+DTEV_Workshop_AddOn" 16 "16_CPV-check_with_DTESP" 21 "21_using_DMTL_pump" 22 "22_CPV_Diag_Selectable_DMTL_or_DTEV" 30 "30_CPV-check_with_cross_correlation" /end COMPU_VTAB
/begin COMPU_METHOD SY_DG23I_Compu "" TAB_VERB "%6.3" "" COMPU_TAB_REF SY_DG23I_Compu /end COMPU_METHOD
/begin COMPU_VTAB SY_DG23I_Compu "" TAB_VERB 2 0 "False" 1 "True" /end COMPU_VTAB
/begin COMPU_METHOD SY_DIGBT_Compu "" TAB_VERB "%6.3" "" COMPU_TAB_REF SY_DIGBT_Compu /end COMPU_METHOD
/begin COMPU_VTAB SY_DIGBT_Compu "" TAB_VERB 8 0 "0" 1 "1" 2 "2" 3 "3" 4 "4" 5 "5" 6 "6" 7 "7" /end COMPU_VTAB
/begin COMPU_METHOD SY_DKATZP_Compu "" TAB_VERB "%6.3" "" COMPU_TAB_REF SY_DKATZP_Compu /end COMPU_METHOD
/begin COMPU_VTAB SY_DKATZP_Compu "" TAB_VERB 2 0 "no DKAT integrated" 1 "DKAT integrated" /end COMPU_VTAB
/begin COMPU_METHOD SY_DKNOTVVT_Compu "" TAB_VERB "%6.3" "" COMPU_TAB_REF SY_DKNOTVVT_Compu /end COMPU_METHOD
/begin COMPU_VTAB SY_DKNOTVVT_Compu "" TAB_VERB 2 0 "False" 1 "True" /end COMPU_VTAB
/begin COMPU_METHOD SY_DKZEROP_Compu "" TAB_VERB "%6.3" "" COMPU_TAB_REF SY_DKZEROP_Compu /end COMPU_METHOD
/begin COMPU_VTAB SY_DKZEROP_Compu "" TAB_VERB 2 0 "kein Anfahren des UMA im Betrieb möglich" 1 "Anfahren des UMA im Betrieb möglich" /end COMPU_VTAB
/begin COMPU_METHOD SY_DLDP_Compu "" TAB_VERB "%6.3" "" COMPU_TAB_REF SY_DLDP_Compu /end COMPU_METHOD
/begin COMPU_VTAB SY_DLDP_Compu "" TAB_VERB 2 0 "kein DLDP System" 1 "DLDP System" /end COMPU_VTAB
/begin COMPU_METHOD SY_DMDBTGT_Compu "" TAB_VERB "%6.3" "" COMPU_TAB_REF SY_DMDBTGT_Compu /end COMPU_METHOD
/begin COMPU_VTAB SY_DMDBTGT_Compu "" TAB_VERB 2 0 "NO_DMD_GearTypeSpecificBaseThreshold" 1 "DMD_GearTypeSpecificBaseThreshold" /end COMPU_VTAB
/begin COMPU_METHOD SY_DMDCYLID_Compu "" TAB_VERB "%6.3" "" COMPU_TAB_REF SY_DMDCYLID_Compu /end COMPU_METHOD
/begin COMPU_VTAB SY_DMDCYLID_Compu "" TAB_VERB 2 0 "False" 1 "True" /end COMPU_VTAB
/begin COMPU_METHOD SY_DMDFCER_Compu "" TAB_VERB "%6.3" "" COMPU_TAB_REF SY_DMDFCER_Compu /end COMPU_METHOD
/begin COMPU_VTAB SY_DMDFCER_Compu "" TAB_VERB 2 0 "False" 1 "True" /end COMPU_VTAB
/begin COMPU_METHOD SY_DMDPAT_Compu "" TAB_VERB "%6.3" "" COMPU_TAB_REF SY_DMDPAT_Compu /end COMPU_METHOD
/begin COMPU_VTAB SY_DMDPAT_Compu "" TAB_VERB 5 0 "No algorithm is activated" 1 "Activates additional algorithm" 2 "Activates additional algorithm(plausability check)" 3 "pat_algo_wo_id" 4 "PatDetnByFrqEvln" /end COMPU_VTAB
/begin COMPU_METHOD SY_DMDSTQ_Compu "" RAT_FUNC "%6.2" "" COEFFS 0 1 0 0 0 1 /end COMPU_METHOD
/begin COMPU_METHOD SY_DMDTAL_Compu "" TAB_VERB "%6.3" "" COMPU_TAB_REF SY_DMDTAL_Compu /end COMPU_METHOD
/begin COMPU_VTAB SY_DMDTAL_Compu "" TAB_VERB 2 0 "keine Unterdrückung MIL an bei leerem Tank" 1 "Unterdrückung MIL an bei leerem Tank" /end COMPU_VTAB
/begin COMPU_METHOD SY_DMDVAR_Compu "" TAB_VERB "%6.3" "" COMPU_TAB_REF SY_DMDVAR_Compu /end COMPU_METHOD
/begin COMPU_VTAB SY_DMDVAR_Compu "" TAB_VERB 4 0 "keine Aussetzererkennung" 1 "Aussetzererkennung im Background" 2 "Aussetzererkennung im Synchro" 3 "Aussetzererkennung im Synchro (handcodiert)" /end COMPU_VTAB
/begin COMPU_METHOD SY_DMDZAG_Compu "" TAB_VERB "%6.3" "" COMPU_TAB_REF SY_DMDZAG_Compu /end COMPU_METHOD
/begin COMPU_VTAB SY_DMDZAG_Compu "" TAB_VERB 3 0 "Misfire generation with DMDZAG not available" 1 "Misfire generation with DMDZAG available, case 1" 2 "Misfire generation with DMDZAG available, case 2" /end COMPU_VTAB
/begin COMPU_METHOD SY_DMDZMS_Compu "" TAB_VERB "%6.3" "" COMPU_TAB_REF SY_DMDZMS_Compu /end COMPU_METHOD
/begin COMPU_VTAB SY_DMDZMS_Compu "" TAB_VERB 2 0 "False" 1 "True" /end COMPU_VTAB
/begin COMPU_METHOD SY_DMTL_Compu "" TAB_VERB "%6.3" "" COMPU_TAB_REF SY_DMTL_Compu /end COMPU_METHOD
/begin COMPU_VTAB SY_DMTL_Compu "" TAB_VERB 2 0 "DMTL_NotAvailable" 1 "DMTL_Available" /end COMPU_VTAB
/begin COMPU_METHOD SY_DOPZW_Compu "" TAB_VERB "%6.3" "" COMPU_TAB_REF SY_DOPZW_Compu /end COMPU_METHOD
/begin COMPU_VTAB SY_DOPZW_Compu "" TAB_VERB 2 0 "keine doppelte Zündausgabe aktiv" 1 "doppelte Zündausgabe aktiv" /end COMPU_VTAB
/begin COMPU_METHOD SY_DSPACE_Compu "" TAB_VERB "%6.3" "" COMPU_TAB_REF SY_DSPACE_Compu /end COMPU_METHOD
/begin COMPU_VTAB SY_DSPACE_Compu "" TAB_VERB 2 0 "False" 1 "True" /end COMPU_VTAB
/begin COMPU_METHOD SY_DSS2_Compu "" TAB_VERB "%6.3" "" COMPU_TAB_REF SY_DSS2_Compu /end COMPU_METHOD
/begin COMPU_VTAB SY_DSS2_Compu "" TAB_VERB 2 0 "kein zweiter Drucksensor im Saugrohr verbaut" 1 "zweiter Drucksensor im Saugrohr verbaut" /end COMPU_VTAB
/begin COMPU_METHOD SY_DSS_Compu "" TAB_VERB "%6.3" "" COMPU_TAB_REF SY_DSS_Compu /end COMPU_METHOD
/begin COMPU_VTAB SY_DSS_Compu "" TAB_VERB 2 0 "kein Drucksensor im Saugrohr verbaut" 1 "Drucksensor im Saugrohr verbaut" /end COMPU_VTAB
/begin COMPU_METHOD SY_DSU_Compu "" TAB_VERB "%6.3" "" COMPU_TAB_REF SY_DSU_Compu /end COMPU_METHOD
/begin COMPU_VTAB SY_DSU_Compu "" TAB_VERB 2 0 "kein Umgebungsdrucksensor verbaut" 1 "Umgebungsdrucksensor verbaut" /end COMPU_VTAB
/begin COMPU_METHOD SY_DSVDK_Compu "" TAB_VERB "%6.3" "" COMPU_TAB_REF SY_DSVDK_Compu /end COMPU_METHOD
/begin COMPU_VTAB SY_DSVDK_Compu "" TAB_VERB 2 0 "FALSE" 1 "TRUE" /end COMPU_VTAB
/begin COMPU_METHOD s_q1p422Em4 "" RAT_FUNC "%6.5" "m" COEFFS 0 28125 0 0 0 4 /end COMPU_METHOD
/begin COMPU_METHOD t100msxs_ub_b25p5 "" RAT_FUNC "%6.3" "s" COEFFS 0 1 0 0 0 0.1 /end COMPU_METHOD
/begin COMPU_METHOD t100msxs_uw_b6553p5 "" RAT_FUNC "%6.3" "s" COEFFS 0 1 0 0 0 0.1 /end COMPU_METHOD
/begin COMPU_METHOD Temp_Cels "" RAT_FUNC "%6.1" "deg C" COEFFS 0 10 2731.4 0 0 1 /end COMPU_METHOD
/begin COMPU_METHOD TimeDelay_s "" RAT_FUNC "%6.1" "s" COEFFS 0 0 1 0 0.00023283064365387 0 /end COMPU_METHOD
/begin COMPU_METHOD tmin_uw_q1 "" RAT_FUNC "%6.2" "min" COEFFS 0 1 0 0 0 1 /end COMPU_METHOD
/begin COMPU_METHOD t_q0p0001_ms "" RAT_FUNC "%7.6" "ms" COEFFS 0 10000 0 0 0 1 /end COMPU_METHOD
/begin COMPU_METHOD t_q0p01 "" RAT_FUNC "%6.4" "s" COEFFS 0 100 0 0 0 1 /end COMPU_METHOD
/begin COMPU_METHOD t_q0p02 "" RAT_FUNC "%6.4" "s" COEFFS 0 100 0 0 0 2 /end COMPU_METHOD
/begin COMPU_METHOD t_q0p1 "" RAT_FUNC "%6.3" "s" COEFFS 0 10 0 0 0 1 /end COMPU_METHOD
/begin COMPU_METHOD Vel "" RAT_FUNC "%6.4" "km/h" COEFFS 0 100 0 0 0 1 /end COMPU_METHOD
/begin COMPU_METHOD vel_q0p01 "" RAT_FUNC "%6.4" "km/h" COEFFS 0 100 0 0 0 1 /end COMPU_METHOD
/begin COMPU_METHOD vfzg_q0p05625_km_DIV_h "" RAT_FUNC "%6.4" "km/h" COEFFS 0 100000 0 0 0 5625 /end COMPU_METHOD
/begin COMPU_METHOD Volt_Batt "" RAT_FUNC "%6.1" "mV" COEFFS 0 0.05 0 0 0 1 /end COMPU_METHOD
/begin RECORD_LAYOUT KlAUwSstUwWUw NO_AXIS_PTS_X 1 UWORD AXIS_PTS_X 2 UWORD INDEX_INCR DIRECT FNC_VALUES 3 UWORD COLUMN_DIR DIRECT /end RECORD_LAYOUT
/begin RECORD_LAYOUT KlAxU8SstxS16WU16_Static NO_AXIS_PTS_X 1 UWORD AXIS_PTS_X 2 SWORD INDEX_INCR DIRECT FNC_VALUES 3 UWORD COLUMN_DIR DIRECT STATIC_RECORD_LAYOUT /end RECORD_LAYOUT
/begin RECORD_LAYOUT KlAxU8SstxU16WU16 NO_AXIS_PTS_X 1 UWORD AXIS_PTS_X 2 UWORD INDEX_INCR DIRECT FNC_VALUES 3 UWORD COLUMN_DIR DIRECT /end RECORD_LAYOUT
/begin RECORD_LAYOUT KlAxU8SstxU8WU16_Static NO_AXIS_PTS_X 1 UBYTE AXIS_PTS_X 2 UBYTE INDEX_INCR DIRECT FNC_VALUES 3 UWORD COLUMN_DIR DIRECT STATIC_RECORD_LAYOUT /end RECORD_LAYOUT
/begin RECORD_LAYOUT KlAxU8SstxU8WU8 NO_AXIS_PTS_X 1 UBYTE AXIS_PTS_X 2 UBYTE INDEX_INCR DIRECT FNC_VALUES 3 UBYTE COLUMN_DIR DIRECT /end RECORD_LAYOUT
/begin RECORD_LAYOUT KwWS16 FNC_VALUES 1 SWORD COLUMN_DIR DIRECT /end RECORD_LAYOUT
/begin RECORD_LAYOUT KwWU16 FNC_VALUES 1 UWORD COLUMN_DIR DIRECT /end RECORD_LAYOUT
/begin RECORD_LAYOUT KwWU8 FNC_VALUES 1 UBYTE COLUMN_DIR DIRECT /end RECORD_LAYOUT
/begin RECORD_LAYOUT RB_Curve_S16_S16 NO_AXIS_PTS_X 1 SWORD AXIS_PTS_X 2 SWORD INDEX_INCR DIRECT FNC_VALUES 3 SWORD COLUMN_DIR DIRECT /end RECORD_LAYOUT
/begin RECORD_LAYOUT RB_Curve_S16_U16_Static NO_AXIS_PTS_X 1 SWORD AXIS_PTS_X 2 SWORD INDEX_INCR DIRECT FNC_VALUES 3 UWORD COLUMN_DIR DIRECT STATIC_RECORD_LAYOUT /end RECORD_LAYOUT
/begin RECORD_LAYOUT RB_Curve_U8_S16_Static NO_AXIS_PTS_X 1 UBYTE AXIS_PTS_X 2 UBYTE INDEX_INCR DIRECT FNC_VALUES 3 SWORD COLUMN_DIR DIRECT STATIC_RECORD_LAYOUT /end RECORD_LAYOUT
/begin RECORD_LAYOUT RB_Map_S16U16_U16 NO_AXIS_PTS_X 1 SWORD NO_AXIS_PTS_Y 2 SWORD AXIS_PTS_X 3 SWORD INDEX_INCR DIRECT AXIS_PTS_Y 4 UWORD INDEX_INCR DIRECT FNC_VALUES 5 UWORD ROW_DIR DIRECT /end RECORD_LAYOUT
/begin RECORD_LAYOUT RB_Map_U16U8_S16 NO_AXIS_PTS_X 1 UWORD NO_AXIS_PTS_Y 2 UWORD AXIS_PTS_X 3 UWORD INDEX_INCR DIRECT AXIS_PTS_Y 4 UBYTE INDEX_INCR DIRECT FNC_VALUES 5 SWORD COLUMN_DIR DIRECT /end RECORD_LAYOUT
/begin RECORD_LAYOUT RB_Val_Ws16 FNC_VALUES 1 SWORD COLUMN_DIR DIRECT /end RECORD_LAYOUT
/begin RECORD_LAYOUT RB_Val_Ws32 FNC_VALUES 1 SLONG COLUMN_DIR DIRECT /end RECORD_LAYOUT
/begin RECORD_LAYOUT RB_Val_Wu16 FNC_VALUES 1 UWORD COLUMN_DIR DIRECT /end RECORD_LAYOUT
/begin RECORD_LAYOUT RB_Val_Wu8 FNC_VALUES 1 UBYTE COLUMN_DIR DIRECT /end RECORD_LAYOUT
/begin RECORD_LAYOUT ValA_Wu16 FNC_VALUES 1 UWORD COLUMN_DIR DIRECT /end RECORD_LAYOUT
/begin RECORD_LAYOUT ValA_Wu8 FNC_VALUES 1 UBYTE COLUMN_DIR DIRECT /end RECORD_LAYOUT
/begin RECORD_LAYOUT Val_Ws16 FNC_VALUES 1 SWORD COLUMN_DIR DIRECT /end RECORD_LAYOUT
/begin RECORD_LAYOUT Val_Ws32 FNC_VALUES 1 SLONG COLUMN_DIR DIRECT /end RECORD_LAYOUT
/begin RECORD_LAYOUT Val_Wu16 FNC_VALUES 1 UWORD COLUMN_DIR DIRECT /end RECORD_LAYOUT
/begin RECORD_LAYOUT Val_Wu8 FNC_VALUES 1 UBYTE COLUMN_DIR DIRECT /end RECORD_LAYOUT
/end MODULE
/end PROJECT
