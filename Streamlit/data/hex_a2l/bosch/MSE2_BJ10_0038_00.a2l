ASAP2_VERSION 1 60
/begin PROJECT MSE2_BJ10_0038_00 "MDG1"
/begin HEADER "" VERSION "MSE2_BJ10_0038_00" PROJECT_NO MSE2_BJ10_0038_00 /end HEADER
/begin MODULE DIM ""
/begin MOD_COMMON "" BYTE_ORDER MSB_FIRST ALIGNMENT_BYTE 1 ALIGNMENT_WORD 2 ALIGNMENT_LONG 4 ALIGNMENT_INT64 4 ALIGNMENT_FLOAT32_IEEE 4 ALIGNMENT_FLOAT64_IEEE 4 /end MOD_COMMON
/begin CHARACTERISTIC BypAirActr_cntrOcErrThd_C "Over currrent error threshold" VALUE 0x9084EA6 KwWU8 254.0 OneToOne 1.000 255.0 FORMAT "%5.1" EXTENDED_LIMITS 0.00 255.0 /end CHARACTERISTIC
/begin CHARACTERISTIC BypAirActr_cntrOcHealThd_C "Over currrent heal threshold" VALUE 0x9084EA7 KwWU8 254.0 OneToOne 1.000 255.0 FORMAT "%5.1" EXTENDED_LIMITS 0.00 255.0 /end CHARACTERISTIC
/begin CHARACTERISTIC BypAirActr_cntrOlErrThd_C "Open load error threshold" VALUE 0x9084EA8 KwWU8 254.0 OneToOne 1.000 255.0 FORMAT "%5.1" EXTENDED_LIMITS 0.00 255.0 /end CHARACTERISTIC
/begin CHARACTERISTIC BypAirActr_cntrOlHealThd_C "Open load heal threshold" VALUE 0x9084EA9 KwWU8 254.0 OneToOne 1.000 255.0 FORMAT "%5.1" EXTENDED_LIMITS 0.00 255.0 /end CHARACTERISTIC
/begin CHARACTERISTIC BypAirActr_cntrOtErrThd_C "Over temperature error threshold" VALUE 0x9084EAA KwWU8 254.0 OneToOne 1.000 255.0 FORMAT "%5.1" EXTENDED_LIMITS 0.00 255.0 /end CHARACTERISTIC
/begin CHARACTERISTIC BypAirActr_cntrOtHealThd_C "Over temperature heal threshold" VALUE 0x9084EAB KwWU8 254.0 OneToOne 1.000 255.0 FORMAT "%5.1" EXTENDED_LIMITS 0.00 255.0 /end CHARACTERISTIC
/begin CHARACTERISTIC BypAirActr_cntrScbErrThd_C "Short circuit to battery error threshold" VALUE 0x9084EAC KwWU8 254.0 OneToOne 1.000 255.0 FORMAT "%5.1" EXTENDED_LIMITS 0.00 255.0 /end CHARACTERISTIC
/begin CHARACTERISTIC BypAirActr_cntrScbHealThd_C "Short circuit to battery heal threshold" VALUE 0x9084EAD KwWU8 254.0 OneToOne 1.000 255.0 FORMAT "%5.1" EXTENDED_LIMITS 0.00 255.0 /end CHARACTERISTIC
/begin CHARACTERISTIC BypAirActr_cntrScgErrThd_C "Short circuit to ground error threshold" VALUE 0x9084EAE KwWU8 254.0 OneToOne 1.000 255.0 FORMAT "%5.1" EXTENDED_LIMITS 0.00 255.0 /end CHARACTERISTIC
/begin CHARACTERISTIC BypAirActr_cntrScgHealThd_C "Short circuit to ground heal threshold" VALUE 0x9084EAF KwWU8 254.0 OneToOne 1.000 255.0 FORMAT "%5.1" EXTENDED_LIMITS 0.00 255.0 /end CHARACTERISTIC
/begin CHARACTERISTIC CALDATAVN_CA "Calibration array to write calibration version" ASCII 0x90814E0 ValA_Wu8 255.0 defaultAscii 0.00 255.0 NUMBER 16 /end CHARACTERISTIC
/begin CHARACTERISTIC CALIBID "Calibration ID (Programmstep making) according to SAE J1979 for Mode $09" ASCII 0x9081354 KwbUb 255.0 defaultAscii 0.00 255.0 NUMBER 16 /end CHARACTERISTIC
/begin CHARACTERISTIC CoEng_nThresCranking_C "Threshold of the engine speed for transition from COENG_READY to COENG_CRANKING" VALUE 0x9089F36 Val_Ws16 32767.50 EngN -16384.00 16383.50 FORMAT "%8.2" /end CHARACTERISTIC
/begin CHARACTERISTIC ComDia_uThrRelearnThd_C "max threshold value for enabling throttle mechanical limit adaptation from Tester" VALUE 0x9081370 KwWU16 79.99878 spg_uw_q0p001222 0.00 79.99878 FORMAT "%8.5" /end CHARACTERISTIC
/begin CHARACTERISTIC CWPSEVE "Codeword for power stage diagnosis fuel injectors" VALUE 0x9084F02 KwWU8 255.0 dez 0.00 255.0 FORMAT "%5.1" /end CHARACTERISTIC
/begin CHARACTERISTIC CWSTPR "Code word for Stepper operation" VALUE 0x9084EB0 KwWU8 255.0 dez 0.00 255.0 FORMAT "%5.1" /end CHARACTERISTIC
/begin CHARACTERISTIC DCM_ACTRTMR_C "Actuator Active time Max" VALUE 0x9081366 KwWU16 655.3500 t_q0p01 0.00 655.3500 FORMAT "%8.4" /end CHARACTERISTIC
/begin CHARACTERISTIC DDRC_DebArCounter.DFC_CANIF_E_CTRL_STOPPED_ERROR_VALUE.isJmpUpActv_C "Parameters of ArCounter debouncing / DFC_CANIF_E_CTRL_STOPPED_ERROR_VALUE / Jump at change from ""Passed"" to ""Failed"" debouncing" VALUE 0x9081384 RB_Val_Wu8 1.000 OneToOne 0.00 1.000 FORMAT "%5.3" EXTENDED_LIMITS 0.00 255.0 /end CHARACTERISTIC
/begin CHARACTERISTIC DDRC_DebArCounter.DFC_CANIF_E_CTRL_STOPPED_ERROR_VALUE.isJmpDwnActv_C "Parameters of ArCounter debouncing / DFC_CANIF_E_CTRL_STOPPED_ERROR_VALUE / Jump at change from ""Failed"" to ""Passed"" debouncing" VALUE 0x9081385 RB_Val_Wu8 1.000 OneToOne 0.00 1.000 FORMAT "%5.3" EXTENDED_LIMITS 0.00 255.0 /end CHARACTERISTIC
/begin CHARACTERISTIC DDRC_DebArCounter.DFC_CANIF_E_CTRL_STOPPED_ERROR_VALUE.limPassd_C "Parameters of ArCounter debouncing / DFC_CANIF_E_CTRL_STOPPED_ERROR_VALUE / ""Passed"" limit" VALUE 0x9081386 RB_Val_Ws16 32767.00 OneToOne -32768.00 -1.000000 FORMAT "%8.2" EXTENDED_LIMITS -32768.00 32767.00 /end CHARACTERISTIC
/begin CHARACTERISTIC DDRC_DebArCounter.DFC_CANIF_E_CTRL_STOPPED_ERROR_VALUE.limFaild_C "Parameters of ArCounter debouncing / DFC_CANIF_E_CTRL_STOPPED_ERROR_VALUE / ""Failed"" limit" VALUE 0x9081388 RB_Val_Ws16 32766.00 OneToOne 1.000000 32767.00 FORMAT "%8.2" EXTENDED_LIMITS -32768.00 32767.00 /end CHARACTERISTIC
/begin CHARACTERISTIC DDRC_DebArCounter.DFC_CANIF_E_CTRL_STOPPED_ERROR_VALUE.stepUp_C "Parameters of ArCounter debouncing / DFC_CANIF_E_CTRL_STOPPED_ERROR_VALUE / Stepsize of ""Failed"" direction" VALUE 0x908138A RB_Val_Ws16 32766.00 OneToOne 1.000000 32767.00 FORMAT "%8.2" EXTENDED_LIMITS -32768.00 32767.00 /end CHARACTERISTIC
/begin CHARACTERISTIC DDRC_DebArCounter.DFC_CANIF_E_CTRL_STOPPED_ERROR_VALUE.stepDwn_C "Parameters of ArCounter debouncing / DFC_CANIF_E_CTRL_STOPPED_ERROR_VALUE / Stepsize of ""Passed"" direction" VALUE 0x908138C RB_Val_Ws16 32767.00 OneToOne -32768.00 -1.000000 FORMAT "%8.2" EXTENDED_LIMITS -32768.00 32767.00 /end CHARACTERISTIC
/begin CHARACTERISTIC DDRC_DebArCounter.DFC_CANIF_E_CTRL_STOPPED_ERROR_VALUE.jmpUpVal_C "Parameters of ArCounter debouncing / DFC_CANIF_E_CTRL_STOPPED_ERROR_VALUE / Jumppoint direction ""Failed""" VALUE 0x908138E RB_Val_Ws16 65535.00 OneToOne -32768.00 32767.00 FORMAT "%8.2" /end CHARACTERISTIC
/begin CHARACTERISTIC DDRC_DebArCounter.DFC_CANIF_E_CTRL_STOPPED_ERROR_VALUE.jmpDwnVal_C "Parameters of ArCounter debouncing / DFC_CANIF_E_CTRL_STOPPED_ERROR_VALUE / Jumppoint direction ""Passed""" VALUE 0x9081390 RB_Val_Ws16 65535.00 OneToOne -32768.00 32767.00 FORMAT "%8.2" /end CHARACTERISTIC
/begin CHARACTERISTIC DDRC_DebArCounter.DFC_CANIF_E_INVALID_DLC_ERROR.isJmpUpActv_C "Parameters of ArCounter debouncing / DFC_CANIF_E_INVALID_DLC_ERROR / Jump at change from ""Passed"" to ""Failed"" debouncing" VALUE 0x9081394 RB_Val_Wu8 1.000 OneToOne 0.00 1.000 FORMAT "%5.3" EXTENDED_LIMITS 0.00 255.0 /end CHARACTERISTIC
/begin CHARACTERISTIC DDRC_DebArCounter.DFC_CANIF_E_INVALID_DLC_ERROR.isJmpDwnActv_C "Parameters of ArCounter debouncing / DFC_CANIF_E_INVALID_DLC_ERROR / Jump at change from ""Failed"" to ""Passed"" debouncing" VALUE 0x9081395 RB_Val_Wu8 1.000 OneToOne 0.00 1.000 FORMAT "%5.3" EXTENDED_LIMITS 0.00 255.0 /end CHARACTERISTIC
/begin CHARACTERISTIC DDRC_DebArCounter.DFC_CANIF_E_INVALID_DLC_ERROR.limPassd_C "Parameters of ArCounter debouncing / DFC_CANIF_E_INVALID_DLC_ERROR / ""Passed"" limit" VALUE 0x9081396 RB_Val_Ws16 32767.00 OneToOne -32768.00 -1.000000 FORMAT "%8.2" EXTENDED_LIMITS -32768.00 32767.00 /end CHARACTERISTIC
/begin CHARACTERISTIC DDRC_DebArCounter.DFC_CANIF_E_INVALID_DLC_ERROR.limFaild_C "Parameters of ArCounter debouncing / DFC_CANIF_E_INVALID_DLC_ERROR / ""Failed"" limit" VALUE 0x9081398 RB_Val_Ws16 32766.00 OneToOne 1.000000 32767.00 FORMAT "%8.2" EXTENDED_LIMITS -32768.00 32767.00 /end CHARACTERISTIC
/begin CHARACTERISTIC DDRC_DebArCounter.DFC_CANIF_E_INVALID_DLC_ERROR.stepUp_C "Parameters of ArCounter debouncing / DFC_CANIF_E_INVALID_DLC_ERROR / Stepsize of ""Failed"" direction" VALUE 0x908139A RB_Val_Ws16 32766.00 OneToOne 1.000000 32767.00 FORMAT "%8.2" EXTENDED_LIMITS -32768.00 32767.00 /end CHARACTERISTIC
/begin CHARACTERISTIC DDRC_DebArCounter.DFC_CANIF_E_INVALID_DLC_ERROR.stepDwn_C "Parameters of ArCounter debouncing / DFC_CANIF_E_INVALID_DLC_ERROR / Stepsize of ""Passed"" direction" VALUE 0x908139C RB_Val_Ws16 32767.00 OneToOne -32768.00 -1.000000 FORMAT "%8.2" EXTENDED_LIMITS -32768.00 32767.00 /end CHARACTERISTIC
/begin CHARACTERISTIC DDRC_DebArCounter.DFC_CANIF_E_INVALID_DLC_ERROR.jmpUpVal_C "Parameters of ArCounter debouncing / DFC_CANIF_E_INVALID_DLC_ERROR / Jumppoint direction ""Failed""" VALUE 0x908139E RB_Val_Ws16 65535.00 OneToOne -32768.00 32767.00 FORMAT "%8.2" /end CHARACTERISTIC
/begin CHARACTERISTIC DDRC_DebArCounter.DFC_CANIF_E_INVALID_DLC_ERROR.jmpDwnVal_C "Parameters of ArCounter debouncing / DFC_CANIF_E_INVALID_DLC_ERROR / Jumppoint direction ""Passed""" VALUE 0x90813A0 RB_Val_Ws16 65535.00 OneToOne -32768.00 32767.00 FORMAT "%8.2" /end CHARACTERISTIC
/begin CHARACTERISTIC DDRC_DebArCounter.DFC_CANNM_E_CANIF_TRANSMIT_ERROR.isJmpUpActv_C "Parameters of ArCounter debouncing / DFC_CANNM_E_CANIF_TRANSMIT_ERROR / Jump at change from ""Passed"" to ""Failed"" debouncing" VALUE 0x90813A4 RB_Val_Wu8 1.000 OneToOne 0.00 1.000 FORMAT "%5.3" EXTENDED_LIMITS 0.00 255.0 /end CHARACTERISTIC
/begin CHARACTERISTIC DDRC_DebArCounter.DFC_CANNM_E_CANIF_TRANSMIT_ERROR.isJmpDwnActv_C "Parameters of ArCounter debouncing / DFC_CANNM_E_CANIF_TRANSMIT_ERROR / Jump at change from ""Failed"" to ""Passed"" debouncing" VALUE 0x90813A5 RB_Val_Wu8 1.000 OneToOne 0.00 1.000 FORMAT "%5.3" EXTENDED_LIMITS 0.00 255.0 /end CHARACTERISTIC
/begin CHARACTERISTIC DDRC_DebArCounter.DFC_CANNM_E_CANIF_TRANSMIT_ERROR.limPassd_C "Parameters of ArCounter debouncing / DFC_CANNM_E_CANIF_TRANSMIT_ERROR / ""Passed"" limit" VALUE 0x90813A6 RB_Val_Ws16 32767.00 OneToOne -32768.00 -1.000000 FORMAT "%8.2" EXTENDED_LIMITS -32768.00 32767.00 /end CHARACTERISTIC
/begin CHARACTERISTIC DDRC_DebArCounter.DFC_CANNM_E_CANIF_TRANSMIT_ERROR.limFaild_C "Parameters of ArCounter debouncing / DFC_CANNM_E_CANIF_TRANSMIT_ERROR / ""Failed"" limit" VALUE 0x90813A8 RB_Val_Ws16 32766.00 OneToOne 1.000000 32767.00 FORMAT "%8.2" EXTENDED_LIMITS -32768.00 32767.00 /end CHARACTERISTIC
/begin CHARACTERISTIC DDRC_DebArCounter.DFC_CANNM_E_CANIF_TRANSMIT_ERROR.stepUp_C "Parameters of ArCounter debouncing / DFC_CANNM_E_CANIF_TRANSMIT_ERROR / Stepsize of ""Failed"" direction" VALUE 0x90813AA RB_Val_Ws16 32766.00 OneToOne 1.000000 32767.00 FORMAT "%8.2" EXTENDED_LIMITS -32768.00 32767.00 /end CHARACTERISTIC
/begin CHARACTERISTIC DDRC_DebArCounter.DFC_CANNM_E_CANIF_TRANSMIT_ERROR.stepDwn_C "Parameters of ArCounter debouncing / DFC_CANNM_E_CANIF_TRANSMIT_ERROR / Stepsize of ""Passed"" direction" VALUE 0x90813AC RB_Val_Ws16 32767.00 OneToOne -32768.00 -1.000000 FORMAT "%8.2" EXTENDED_LIMITS -32768.00 32767.00 /end CHARACTERISTIC
/begin CHARACTERISTIC DDRC_DebArCounter.DFC_CANNM_E_CANIF_TRANSMIT_ERROR.jmpUpVal_C "Parameters of ArCounter debouncing / DFC_CANNM_E_CANIF_TRANSMIT_ERROR / Jumppoint direction ""Failed""" VALUE 0x90813AE RB_Val_Ws16 65535.00 OneToOne -32768.00 32767.00 FORMAT "%8.2" /end CHARACTERISTIC
/begin CHARACTERISTIC DDRC_DebArCounter.DFC_CANNM_E_CANIF_TRANSMIT_ERROR.jmpDwnVal_C "Parameters of ArCounter debouncing / DFC_CANNM_E_CANIF_TRANSMIT_ERROR / Jumppoint direction ""Passed""" VALUE 0x90813B0 RB_Val_Ws16 65535.00 OneToOne -32768.00 32767.00 FORMAT "%8.2" /end CHARACTERISTIC
/begin CHARACTERISTIC DDRC_DebArCounter.DFC_CANNM_E_INIT_FAILED.isJmpUpActv_C "Parameters of ArCounter debouncing / DFC_CANNM_E_INIT_FAILED / Jump at change from ""Passed"" to ""Failed"" debouncing" VALUE 0x90813B4 RB_Val_Wu8 1.000 OneToOne 0.00 1.000 FORMAT "%5.3" EXTENDED_LIMITS 0.00 255.0 /end CHARACTERISTIC
/begin CHARACTERISTIC DDRC_DebArCounter.DFC_CANNM_E_INIT_FAILED.isJmpDwnActv_C "Parameters of ArCounter debouncing / DFC_CANNM_E_INIT_FAILED / Jump at change from ""Failed"" to ""Passed"" debouncing" VALUE 0x90813B5 RB_Val_Wu8 1.000 OneToOne 0.00 1.000 FORMAT "%5.3" EXTENDED_LIMITS 0.00 255.0 /end CHARACTERISTIC
/begin CHARACTERISTIC DDRC_DebArCounter.DFC_CANNM_E_INIT_FAILED.limPassd_C "Parameters of ArCounter debouncing / DFC_CANNM_E_INIT_FAILED / ""Passed"" limit" VALUE 0x90813B6 RB_Val_Ws16 32767.00 OneToOne -32768.00 -1.000000 FORMAT "%8.2" EXTENDED_LIMITS -32768.00 32767.00 /end CHARACTERISTIC
/begin CHARACTERISTIC DDRC_DebArCounter.DFC_CANNM_E_INIT_FAILED.limFaild_C "Parameters of ArCounter debouncing / DFC_CANNM_E_INIT_FAILED / ""Failed"" limit" VALUE 0x90813B8 RB_Val_Ws16 32766.00 OneToOne 1.000000 32767.00 FORMAT "%8.2" EXTENDED_LIMITS -32768.00 32767.00 /end CHARACTERISTIC
/begin CHARACTERISTIC DDRC_DebArCounter.DFC_CANNM_E_INIT_FAILED.stepUp_C "Parameters of ArCounter debouncing / DFC_CANNM_E_INIT_FAILED / Stepsize of ""Failed"" direction" VALUE 0x90813BA RB_Val_Ws16 32766.00 OneToOne 1.000000 32767.00 FORMAT "%8.2" EXTENDED_LIMITS -32768.00 32767.00 /end CHARACTERISTIC
/begin CHARACTERISTIC DDRC_DebArCounter.DFC_CANNM_E_INIT_FAILED.stepDwn_C "Parameters of ArCounter debouncing / DFC_CANNM_E_INIT_FAILED / Stepsize of ""Passed"" direction" VALUE 0x90813BC RB_Val_Ws16 32767.00 OneToOne -32768.00 -1.000000 FORMAT "%8.2" EXTENDED_LIMITS -32768.00 32767.00 /end CHARACTERISTIC
/begin CHARACTERISTIC DDRC_DebArCounter.DFC_CANNM_E_INIT_FAILED.jmpUpVal_C "Parameters of ArCounter debouncing / DFC_CANNM_E_INIT_FAILED / Jumppoint direction ""Failed""" VALUE 0x90813BE RB_Val_Ws16 65535.00 OneToOne -32768.00 32767.00 FORMAT "%8.2" /end CHARACTERISTIC
/begin CHARACTERISTIC DDRC_DebArCounter.DFC_CANNM_E_INIT_FAILED.jmpDwnVal_C "Parameters of ArCounter debouncing / DFC_CANNM_E_INIT_FAILED / Jumppoint direction ""Passed""" VALUE 0x90813C0 RB_Val_Ws16 65535.00 OneToOne -32768.00 32767.00 FORMAT "%8.2" /end CHARACTERISTIC
/begin CHARACTERISTIC DDRC_DebArCounter.DFC_CANNM_E_NETWORK_TIMEOUT.isJmpUpActv_C "Parameters of ArCounter debouncing / DFC_CANNM_E_NETWORK_TIMEOUT / Jump at change from ""Passed"" to ""Failed"" debouncing" VALUE 0x90813C4 RB_Val_Wu8 1.000 OneToOne 0.00 1.000 FORMAT "%5.3" EXTENDED_LIMITS 0.00 255.0 /end CHARACTERISTIC
/begin CHARACTERISTIC DDRC_DebArCounter.DFC_CANNM_E_NETWORK_TIMEOUT.isJmpDwnActv_C "Parameters of ArCounter debouncing / DFC_CANNM_E_NETWORK_TIMEOUT / Jump at change from ""Failed"" to ""Passed"" debouncing" VALUE 0x90813C5 RB_Val_Wu8 1.000 OneToOne 0.00 1.000 FORMAT "%5.3" EXTENDED_LIMITS 0.00 255.0 /end CHARACTERISTIC
/begin CHARACTERISTIC DDRC_DebArCounter.DFC_CANNM_E_NETWORK_TIMEOUT.limPassd_C "Parameters of ArCounter debouncing / DFC_CANNM_E_NETWORK_TIMEOUT / ""Passed"" limit" VALUE 0x90813C6 RB_Val_Ws16 32767.00 OneToOne -32768.00 -1.000000 FORMAT "%8.2" EXTENDED_LIMITS -32768.00 32767.00 /end CHARACTERISTIC
/begin CHARACTERISTIC DDRC_DebArCounter.DFC_CANNM_E_NETWORK_TIMEOUT.limFaild_C "Parameters of ArCounter debouncing / DFC_CANNM_E_NETWORK_TIMEOUT / ""Failed"" limit" VALUE 0x90813C8 RB_Val_Ws16 32766.00 OneToOne 1.000000 32767.00 FORMAT "%8.2" EXTENDED_LIMITS -32768.00 32767.00 /end CHARACTERISTIC
/begin CHARACTERISTIC DDRC_DebArCounter.DFC_CANNM_E_NETWORK_TIMEOUT.stepUp_C "Parameters of ArCounter debouncing / DFC_CANNM_E_NETWORK_TIMEOUT / Stepsize of ""Failed"" direction" VALUE 0x90813CA RB_Val_Ws16 32766.00 OneToOne 1.000000 32767.00 FORMAT "%8.2" EXTENDED_LIMITS -32768.00 32767.00 /end CHARACTERISTIC
/begin CHARACTERISTIC DDRC_DebArCounter.DFC_CANNM_E_NETWORK_TIMEOUT.stepDwn_C "Parameters of ArCounter debouncing / DFC_CANNM_E_NETWORK_TIMEOUT / Stepsize of ""Passed"" direction" VALUE 0x90813CC RB_Val_Ws16 32767.00 OneToOne -32768.00 -1.000000 FORMAT "%8.2" EXTENDED_LIMITS -32768.00 32767.00 /end CHARACTERISTIC
/begin CHARACTERISTIC DDRC_DebArCounter.DFC_CANNM_E_NETWORK_TIMEOUT.jmpUpVal_C "Parameters of ArCounter debouncing / DFC_CANNM_E_NETWORK_TIMEOUT / Jumppoint direction ""Failed""" VALUE 0x90813CE RB_Val_Ws16 65535.00 OneToOne -32768.00 32767.00 FORMAT "%8.2" /end CHARACTERISTIC
/begin CHARACTERISTIC DDRC_DebArCounter.DFC_CANNM_E_NETWORK_TIMEOUT.jmpDwnVal_C "Parameters of ArCounter debouncing / DFC_CANNM_E_NETWORK_TIMEOUT / Jumppoint direction ""Passed""" VALUE 0x90813D0 RB_Val_Ws16 65535.00 OneToOne -32768.00 32767.00 FORMAT "%8.2" /end CHARACTERISTIC
/begin CHARACTERISTIC DDRC_DebArCounter.DFC_CAN_E_TIMEOUT.isJmpUpActv_C "Parameters of ArCounter debouncing / DFC_CAN_E_TIMEOUT / Jump at change from ""Passed"" to ""Failed"" debouncing" VALUE 0x90813D4 RB_Val_Wu8 1.000 OneToOne 0.00 1.000 FORMAT "%5.3" EXTENDED_LIMITS 0.00 255.0 /end CHARACTERISTIC
/begin CHARACTERISTIC DDRC_DebArCounter.DFC_CAN_E_TIMEOUT.isJmpDwnActv_C "Parameters of ArCounter debouncing / DFC_CAN_E_TIMEOUT / Jump at change from ""Failed"" to ""Passed"" debouncing" VALUE 0x90813D5 RB_Val_Wu8 1.000 OneToOne 0.00 1.000 FORMAT "%5.3" EXTENDED_LIMITS 0.00 255.0 /end CHARACTERISTIC
/begin CHARACTERISTIC DDRC_DebArCounter.DFC_CAN_E_TIMEOUT.limPassd_C "Parameters of ArCounter debouncing / DFC_CAN_E_TIMEOUT / ""Passed"" limit" VALUE 0x90813D6 RB_Val_Ws16 32767.00 OneToOne -32768.00 -1.000000 FORMAT "%8.2" EXTENDED_LIMITS -32768.00 32767.00 /end CHARACTERISTIC
/begin CHARACTERISTIC DDRC_DebArCounter.DFC_CAN_E_TIMEOUT.limFaild_C "Parameters of ArCounter debouncing / DFC_CAN_E_TIMEOUT / ""Failed"" limit" VALUE 0x90813D8 RB_Val_Ws16 32766.00 OneToOne 1.000000 32767.00 FORMAT "%8.2" EXTENDED_LIMITS -32768.00 32767.00 /end CHARACTERISTIC
/begin CHARACTERISTIC DDRC_DebArCounter.DFC_CAN_E_TIMEOUT.stepUp_C "Parameters of ArCounter debouncing / DFC_CAN_E_TIMEOUT / Stepsize of ""Failed"" direction" VALUE 0x90813DA RB_Val_Ws16 32766.00 OneToOne 1.000000 32767.00 FORMAT "%8.2" EXTENDED_LIMITS -32768.00 32767.00 /end CHARACTERISTIC
/begin CHARACTERISTIC DDRC_DebArCounter.DFC_CAN_E_TIMEOUT.stepDwn_C "Parameters of ArCounter debouncing / DFC_CAN_E_TIMEOUT / Stepsize of ""Passed"" direction" VALUE 0x90813DC RB_Val_Ws16 32767.00 OneToOne -32768.00 -1.000000 FORMAT "%8.2" EXTENDED_LIMITS -32768.00 32767.00 /end CHARACTERISTIC
/begin CHARACTERISTIC DDRC_DebArCounter.DFC_CAN_E_TIMEOUT.jmpUpVal_C "Parameters of ArCounter debouncing / DFC_CAN_E_TIMEOUT / Jumppoint direction ""Failed""" VALUE 0x90813DE RB_Val_Ws16 65535.00 OneToOne -32768.00 32767.00 FORMAT "%8.2" /end CHARACTERISTIC
/begin CHARACTERISTIC DDRC_DebArCounter.DFC_CAN_E_TIMEOUT.jmpDwnVal_C "Parameters of ArCounter debouncing / DFC_CAN_E_TIMEOUT / Jumppoint direction ""Passed""" VALUE 0x90813E0 RB_Val_Ws16 65535.00 OneToOne -32768.00 32767.00 FORMAT "%8.2" /end CHARACTERISTIC
/begin CHARACTERISTIC DDRC_DebArCounter.DFC_COMM_E_NET_START_IND_CHANNEL_0.isJmpUpActv_C "Parameters of ArCounter debouncing / DFC_COMM_E_NET_START_IND_CHANNEL_0 / Jump at change from ""Passed"" to ""Failed"" debouncing" VALUE 0x90813E4 RB_Val_Wu8 1.000 OneToOne 0.00 1.000 FORMAT "%5.3" EXTENDED_LIMITS 0.00 255.0 /end CHARACTERISTIC
/begin CHARACTERISTIC DDRC_DebArCounter.DFC_COMM_E_NET_START_IND_CHANNEL_0.isJmpDwnActv_C "Parameters of ArCounter debouncing / DFC_COMM_E_NET_START_IND_CHANNEL_0 / Jump at change from ""Failed"" to ""Passed"" debouncing" VALUE 0x90813E5 RB_Val_Wu8 1.000 OneToOne 0.00 1.000 FORMAT "%5.3" EXTENDED_LIMITS 0.00 255.0 /end CHARACTERISTIC
/begin CHARACTERISTIC DDRC_DebArCounter.DFC_COMM_E_NET_START_IND_CHANNEL_0.limPassd_C "Parameters of ArCounter debouncing / DFC_COMM_E_NET_START_IND_CHANNEL_0 / ""Passed"" limit" VALUE 0x90813E6 RB_Val_Ws16 32767.00 OneToOne -32768.00 -1.000000 FORMAT "%8.2" EXTENDED_LIMITS -32768.00 32767.00 /end CHARACTERISTIC
/begin CHARACTERISTIC DDRC_DebArCounter.DFC_COMM_E_NET_START_IND_CHANNEL_0.limFaild_C "Parameters of ArCounter debouncing / DFC_COMM_E_NET_START_IND_CHANNEL_0 / ""Failed"" limit" VALUE 0x90813E8 RB_Val_Ws16 32766.00 OneToOne 1.000000 32767.00 FORMAT "%8.2" EXTENDED_LIMITS -32768.00 32767.00 /end CHARACTERISTIC
/begin CHARACTERISTIC DDRC_DebArCounter.DFC_COMM_E_NET_START_IND_CHANNEL_0.stepUp_C "Parameters of ArCounter debouncing / DFC_COMM_E_NET_START_IND_CHANNEL_0 / Stepsize of ""Failed"" direction" VALUE 0x90813EA RB_Val_Ws16 32766.00 OneToOne 1.000000 32767.00 FORMAT "%8.2" EXTENDED_LIMITS -32768.00 32767.00 /end CHARACTERISTIC
/begin CHARACTERISTIC DDRC_DebArCounter.DFC_COMM_E_NET_START_IND_CHANNEL_0.stepDwn_C "Parameters of ArCounter debouncing / DFC_COMM_E_NET_START_IND_CHANNEL_0 / Stepsize of ""Passed"" direction" VALUE 0x90813EC RB_Val_Ws16 32767.00 OneToOne -32768.00 -1.000000 FORMAT "%8.2" EXTENDED_LIMITS -32768.00 32767.00 /end CHARACTERISTIC
/begin CHARACTERISTIC DDRC_DebArCounter.DFC_COMM_E_NET_START_IND_CHANNEL_0.jmpUpVal_C "Parameters of ArCounter debouncing / DFC_COMM_E_NET_START_IND_CHANNEL_0 / Jumppoint direction ""Failed""" VALUE 0x90813EE RB_Val_Ws16 65535.00 OneToOne -32768.00 32767.00 FORMAT "%8.2" /end CHARACTERISTIC
/begin CHARACTERISTIC DDRC_DebArCounter.DFC_COMM_E_NET_START_IND_CHANNEL_0.jmpDwnVal_C "Parameters of ArCounter debouncing / DFC_COMM_E_NET_START_IND_CHANNEL_0 / Jumppoint direction ""Passed""" VALUE 0x90813F0 RB_Val_Ws16 65535.00 OneToOne -32768.00 32767.00 FORMAT "%8.2" /end CHARACTERISTIC
/begin CHARACTERISTIC DDRC_DebArCounter.DFC_COMM_E_NET_START_IND_CHANNEL_1.isJmpUpActv_C "Parameters of ArCounter debouncing / DFC_COMM_E_NET_START_IND_CHANNEL_1 / Jump at change from ""Passed"" to ""Failed"" debouncing" VALUE 0x90813F4 RB_Val_Wu8 1.000 OneToOne 0.00 1.000 FORMAT "%5.3" EXTENDED_LIMITS 0.00 255.0 /end CHARACTERISTIC
/begin CHARACTERISTIC DDRC_DebArCounter.DFC_COMM_E_NET_START_IND_CHANNEL_1.isJmpDwnActv_C "Parameters of ArCounter debouncing / DFC_COMM_E_NET_START_IND_CHANNEL_1 / Jump at change from ""Failed"" to ""Passed"" debouncing" VALUE 0x90813F5 RB_Val_Wu8 1.000 OneToOne 0.00 1.000 FORMAT "%5.3" EXTENDED_LIMITS 0.00 255.0 /end CHARACTERISTIC
/begin CHARACTERISTIC DDRC_DebArCounter.DFC_COMM_E_NET_START_IND_CHANNEL_1.limPassd_C "Parameters of ArCounter debouncing / DFC_COMM_E_NET_START_IND_CHANNEL_1 / ""Passed"" limit" VALUE 0x90813F6 RB_Val_Ws16 32767.00 OneToOne -32768.00 -1.000000 FORMAT "%8.2" EXTENDED_LIMITS -32768.00 32767.00 /end CHARACTERISTIC
/begin CHARACTERISTIC DDRC_DebArCounter.DFC_COMM_E_NET_START_IND_CHANNEL_1.limFaild_C "Parameters of ArCounter debouncing / DFC_COMM_E_NET_START_IND_CHANNEL_1 / ""Failed"" limit" VALUE 0x90813F8 RB_Val_Ws16 32766.00 OneToOne 1.000000 32767.00 FORMAT "%8.2" EXTENDED_LIMITS -32768.00 32767.00 /end CHARACTERISTIC
/begin CHARACTERISTIC DDRC_DebArCounter.DFC_COMM_E_NET_START_IND_CHANNEL_1.stepUp_C "Parameters of ArCounter debouncing / DFC_COMM_E_NET_START_IND_CHANNEL_1 / Stepsize of ""Failed"" direction" VALUE 0x90813FA RB_Val_Ws16 32766.00 OneToOne 1.000000 32767.00 FORMAT "%8.2" EXTENDED_LIMITS -32768.00 32767.00 /end CHARACTERISTIC
/begin CHARACTERISTIC DDRC_DebArCounter.DFC_COMM_E_NET_START_IND_CHANNEL_1.stepDwn_C "Parameters of ArCounter debouncing / DFC_COMM_E_NET_START_IND_CHANNEL_1 / Stepsize of ""Passed"" direction" VALUE 0x90813FC RB_Val_Ws16 32767.00 OneToOne -32768.00 -1.000000 FORMAT "%8.2" EXTENDED_LIMITS -32768.00 32767.00 /end CHARACTERISTIC
/begin CHARACTERISTIC DDRC_DebArCounter.DFC_COMM_E_NET_START_IND_CHANNEL_1.jmpUpVal_C "Parameters of ArCounter debouncing / DFC_COMM_E_NET_START_IND_CHANNEL_1 / Jumppoint direction ""Failed""" VALUE 0x90813FE RB_Val_Ws16 65535.00 OneToOne -32768.00 32767.00 FORMAT "%8.2" /end CHARACTERISTIC
/begin CHARACTERISTIC DDRC_DebArCounter.DFC_COMM_E_NET_START_IND_CHANNEL_1.jmpDwnVal_C "Parameters of ArCounter debouncing / DFC_COMM_E_NET_START_IND_CHANNEL_1 / Jumppoint direction ""Passed""" VALUE 0x9081400 RB_Val_Ws16 65535.00 OneToOne -32768.00 32767.00 FORMAT "%8.2" /end CHARACTERISTIC
/begin CHARACTERISTIC DDRC_DebArCounter.DFC_COMM_E_NET_START_IND_CHANNEL_2.isJmpUpActv_C "Parameters of ArCounter debouncing / DFC_COMM_E_NET_START_IND_CHANNEL_2 / Jump at change from ""Passed"" to ""Failed"" debouncing" VALUE 0x9081404 RB_Val_Wu8 1.000 OneToOne 0.00 1.000 FORMAT "%5.3" EXTENDED_LIMITS 0.00 255.0 /end CHARACTERISTIC
/begin CHARACTERISTIC DDRC_DebArCounter.DFC_COMM_E_NET_START_IND_CHANNEL_2.isJmpDwnActv_C "Parameters of ArCounter debouncing / DFC_COMM_E_NET_START_IND_CHANNEL_2 / Jump at change from ""Failed"" to ""Passed"" debouncing" VALUE 0x9081405 RB_Val_Wu8 1.000 OneToOne 0.00 1.000 FORMAT "%5.3" EXTENDED_LIMITS 0.00 255.0 /end CHARACTERISTIC
/begin CHARACTERISTIC DDRC_DebArCounter.DFC_COMM_E_NET_START_IND_CHANNEL_2.limPassd_C "Parameters of ArCounter debouncing / DFC_COMM_E_NET_START_IND_CHANNEL_2 / ""Passed"" limit" VALUE 0x9081406 RB_Val_Ws16 32767.00 OneToOne -32768.00 -1.000000 FORMAT "%8.2" EXTENDED_LIMITS -32768.00 32767.00 /end CHARACTERISTIC
/begin CHARACTERISTIC DDRC_DebArCounter.DFC_COMM_E_NET_START_IND_CHANNEL_2.limFaild_C "Parameters of ArCounter debouncing / DFC_COMM_E_NET_START_IND_CHANNEL_2 / ""Failed"" limit" VALUE 0x9081408 RB_Val_Ws16 32766.00 OneToOne 1.000000 32767.00 FORMAT "%8.2" EXTENDED_LIMITS -32768.00 32767.00 /end CHARACTERISTIC
/begin CHARACTERISTIC DDRC_DebArCounter.DFC_COMM_E_NET_START_IND_CHANNEL_2.stepUp_C "Parameters of ArCounter debouncing / DFC_COMM_E_NET_START_IND_CHANNEL_2 / Stepsize of ""Failed"" direction" VALUE 0x908140A RB_Val_Ws16 32766.00 OneToOne 1.000000 32767.00 FORMAT "%8.2" EXTENDED_LIMITS -32768.00 32767.00 /end CHARACTERISTIC
/begin CHARACTERISTIC DDRC_DebArCounter.DFC_COMM_E_NET_START_IND_CHANNEL_2.stepDwn_C "Parameters of ArCounter debouncing / DFC_COMM_E_NET_START_IND_CHANNEL_2 / Stepsize of ""Passed"" direction" VALUE 0x908140C RB_Val_Ws16 32767.00 OneToOne -32768.00 -1.000000 FORMAT "%8.2" EXTENDED_LIMITS -32768.00 32767.00 /end CHARACTERISTIC
/begin CHARACTERISTIC DDRC_DebArCounter.DFC_COMM_E_NET_START_IND_CHANNEL_2.jmpUpVal_C "Parameters of ArCounter debouncing / DFC_COMM_E_NET_START_IND_CHANNEL_2 / Jumppoint direction ""Failed""" VALUE 0x908140E RB_Val_Ws16 65535.00 OneToOne -32768.00 32767.00 FORMAT "%8.2" /end CHARACTERISTIC
/begin CHARACTERISTIC DDRC_DebArCounter.DFC_COMM_E_NET_START_IND_CHANNEL_2.jmpDwnVal_C "Parameters of ArCounter debouncing / DFC_COMM_E_NET_START_IND_CHANNEL_2 / Jumppoint direction ""Passed""" VALUE 0x9081410 RB_Val_Ws16 65535.00 OneToOne -32768.00 32767.00 FORMAT "%8.2" /end CHARACTERISTIC
/begin CHARACTERISTIC DDRC_DebArCounter.DFC_COMM_E_NET_START_IND_CHANNEL_3.isJmpUpActv_C "Parameters of ArCounter debouncing / DFC_COMM_E_NET_START_IND_CHANNEL_3 / Jump at change from ""Passed"" to ""Failed"" debouncing" VALUE 0x9081414 RB_Val_Wu8 1.000 OneToOne 0.00 1.000 FORMAT "%5.3" EXTENDED_LIMITS 0.00 255.0 /end CHARACTERISTIC
/begin CHARACTERISTIC DDRC_DebArCounter.DFC_COMM_E_NET_START_IND_CHANNEL_3.isJmpDwnActv_C "Parameters of ArCounter debouncing / DFC_COMM_E_NET_START_IND_CHANNEL_3 / Jump at change from ""Failed"" to ""Passed"" debouncing" VALUE 0x9081415 RB_Val_Wu8 1.000 OneToOne 0.00 1.000 FORMAT "%5.3" EXTENDED_LIMITS 0.00 255.0 /end CHARACTERISTIC
/begin CHARACTERISTIC DDRC_DebArCounter.DFC_COMM_E_NET_START_IND_CHANNEL_3.limPassd_C "Parameters of ArCounter debouncing / DFC_COMM_E_NET_START_IND_CHANNEL_3 / ""Passed"" limit" VALUE 0x9081416 RB_Val_Ws16 32767.00 OneToOne -32768.00 -1.000000 FORMAT "%8.2" EXTENDED_LIMITS -32768.00 32767.00 /end CHARACTERISTIC
/begin CHARACTERISTIC DDRC_DebArCounter.DFC_COMM_E_NET_START_IND_CHANNEL_3.limFaild_C "Parameters of ArCounter debouncing / DFC_COMM_E_NET_START_IND_CHANNEL_3 / ""Failed"" limit" VALUE 0x9081418 RB_Val_Ws16 32766.00 OneToOne 1.000000 32767.00 FORMAT "%8.2" EXTENDED_LIMITS -32768.00 32767.00 /end CHARACTERISTIC
/begin CHARACTERISTIC DDRC_DebArCounter.DFC_COMM_E_NET_START_IND_CHANNEL_3.stepUp_C "Parameters of ArCounter debouncing / DFC_COMM_E_NET_START_IND_CHANNEL_3 / Stepsize of ""Failed"" direction" VALUE 0x908141A RB_Val_Ws16 32766.00 OneToOne 1.000000 32767.00 FORMAT "%8.2" EXTENDED_LIMITS -32768.00 32767.00 /end CHARACTERISTIC
/begin CHARACTERISTIC DDRC_DebArCounter.DFC_COMM_E_NET_START_IND_CHANNEL_3.stepDwn_C "Parameters of ArCounter debouncing / DFC_COMM_E_NET_START_IND_CHANNEL_3 / Stepsize of ""Passed"" direction" VALUE 0x908141C RB_Val_Ws16 32767.00 OneToOne -32768.00 -1.000000 FORMAT "%8.2" EXTENDED_LIMITS -32768.00 32767.00 /end CHARACTERISTIC
/begin CHARACTERISTIC DDRC_DebArCounter.DFC_COMM_E_NET_START_IND_CHANNEL_3.jmpUpVal_C "Parameters of ArCounter debouncing / DFC_COMM_E_NET_START_IND_CHANNEL_3 / Jumppoint direction ""Failed""" VALUE 0x908141E RB_Val_Ws16 65535.00 OneToOne -32768.00 32767.00 FORMAT "%8.2" /end CHARACTERISTIC
/begin CHARACTERISTIC DDRC_DebArCounter.DFC_COMM_E_NET_START_IND_CHANNEL_3.jmpDwnVal_C "Parameters of ArCounter debouncing / DFC_COMM_E_NET_START_IND_CHANNEL_3 / Jumppoint direction ""Passed""" VALUE 0x9081420 RB_Val_Ws16 65535.00 OneToOne -32768.00 32767.00 FORMAT "%8.2" /end CHARACTERISTIC
/begin CHARACTERISTIC DDRC_DebArCounter.DFC_COMM_E_NET_START_IND_CHANNEL_4.isJmpUpActv_C "Parameters of ArCounter debouncing / DFC_COMM_E_NET_START_IND_CHANNEL_4 / Jump at change from ""Passed"" to ""Failed"" debouncing" VALUE 0x9081424 RB_Val_Wu8 1.000 OneToOne 0.00 1.000 FORMAT "%5.3" EXTENDED_LIMITS 0.00 255.0 /end CHARACTERISTIC
/begin CHARACTERISTIC DDRC_DebArCounter.DFC_COMM_E_NET_START_IND_CHANNEL_4.isJmpDwnActv_C "Parameters of ArCounter debouncing / DFC_COMM_E_NET_START_IND_CHANNEL_4 / Jump at change from ""Failed"" to ""Passed"" debouncing" VALUE 0x9081425 RB_Val_Wu8 1.000 OneToOne 0.00 1.000 FORMAT "%5.3" EXTENDED_LIMITS 0.00 255.0 /end CHARACTERISTIC
/begin CHARACTERISTIC DDRC_DebArCounter.DFC_COMM_E_NET_START_IND_CHANNEL_4.limPassd_C "Parameters of ArCounter debouncing / DFC_COMM_E_NET_START_IND_CHANNEL_4 / ""Passed"" limit" VALUE 0x9081426 RB_Val_Ws16 32767.00 OneToOne -32768.00 -1.000000 FORMAT "%8.2" EXTENDED_LIMITS -32768.00 32767.00 /end CHARACTERISTIC
/begin CHARACTERISTIC DDRC_DebArCounter.DFC_COMM_E_NET_START_IND_CHANNEL_4.limFaild_C "Parameters of ArCounter debouncing / DFC_COMM_E_NET_START_IND_CHANNEL_4 / ""Failed"" limit" VALUE 0x9081428 RB_Val_Ws16 32766.00 OneToOne 1.000000 32767.00 FORMAT "%8.2" EXTENDED_LIMITS -32768.00 32767.00 /end CHARACTERISTIC
/begin CHARACTERISTIC DDRC_DebArCounter.DFC_COMM_E_NET_START_IND_CHANNEL_4.stepUp_C "Parameters of ArCounter debouncing / DFC_COMM_E_NET_START_IND_CHANNEL_4 / Stepsize of ""Failed"" direction" VALUE 0x908142A RB_Val_Ws16 32766.00 OneToOne 1.000000 32767.00 FORMAT "%8.2" EXTENDED_LIMITS -32768.00 32767.00 /end CHARACTERISTIC
/begin CHARACTERISTIC DDRC_DebArCounter.DFC_COMM_E_NET_START_IND_CHANNEL_4.stepDwn_C "Parameters of ArCounter debouncing / DFC_COMM_E_NET_START_IND_CHANNEL_4 / Stepsize of ""Passed"" direction" VALUE 0x908142C RB_Val_Ws16 32767.00 OneToOne -32768.00 -1.000000 FORMAT "%8.2" EXTENDED_LIMITS -32768.00 32767.00 /end CHARACTERISTIC
/begin CHARACTERISTIC DDRC_DebArCounter.DFC_COMM_E_NET_START_IND_CHANNEL_4.jmpUpVal_C "Parameters of ArCounter debouncing / DFC_COMM_E_NET_START_IND_CHANNEL_4 / Jumppoint direction ""Failed""" VALUE 0x908142E RB_Val_Ws16 65535.00 OneToOne -32768.00 32767.00 FORMAT "%8.2" /end CHARACTERISTIC
/begin CHARACTERISTIC DDRC_DebArCounter.DFC_COMM_E_NET_START_IND_CHANNEL_4.jmpDwnVal_C "Parameters of ArCounter debouncing / DFC_COMM_E_NET_START_IND_CHANNEL_4 / Jumppoint direction ""Passed""" VALUE 0x9081430 RB_Val_Ws16 65535.00 OneToOne -32768.00 32767.00 FORMAT "%8.2" /end CHARACTERISTIC
/begin CHARACTERISTIC DDRC_DebArCounter.DFC_COMM_E_NET_START_IND_CHANNEL_5.isJmpUpActv_C "Parameters of ArCounter debouncing / DFC_COMM_E_NET_START_IND_CHANNEL_5 / Jump at change from ""Passed"" to ""Failed"" debouncing" VALUE 0x9081434 RB_Val_Wu8 1.000 OneToOne 0.00 1.000 FORMAT "%5.3" EXTENDED_LIMITS 0.00 255.0 /end CHARACTERISTIC
/begin CHARACTERISTIC DDRC_DebArCounter.DFC_COMM_E_NET_START_IND_CHANNEL_5.isJmpDwnActv_C "Parameters of ArCounter debouncing / DFC_COMM_E_NET_START_IND_CHANNEL_5 / Jump at change from ""Failed"" to ""Passed"" debouncing" VALUE 0x9081435 RB_Val_Wu8 1.000 OneToOne 0.00 1.000 FORMAT "%5.3" EXTENDED_LIMITS 0.00 255.0 /end CHARACTERISTIC
/begin CHARACTERISTIC DDRC_DebArCounter.DFC_COMM_E_NET_START_IND_CHANNEL_5.limPassd_C "Parameters of ArCounter debouncing / DFC_COMM_E_NET_START_IND_CHANNEL_5 / ""Passed"" limit" VALUE 0x9081436 RB_Val_Ws16 32767.00 OneToOne -32768.00 -1.000000 FORMAT "%8.2" EXTENDED_LIMITS -32768.00 32767.00 /end CHARACTERISTIC
/begin CHARACTERISTIC DDRC_DebArCounter.DFC_COMM_E_NET_START_IND_CHANNEL_5.limFaild_C "Parameters of ArCounter debouncing / DFC_COMM_E_NET_START_IND_CHANNEL_5 / ""Failed"" limit" VALUE 0x9081438 RB_Val_Ws16 32766.00 OneToOne 1.000000 32767.00 FORMAT "%8.2" EXTENDED_LIMITS -32768.00 32767.00 /end CHARACTERISTIC
/begin CHARACTERISTIC DDRC_DebArCounter.DFC_COMM_E_NET_START_IND_CHANNEL_5.stepUp_C "Parameters of ArCounter debouncing / DFC_COMM_E_NET_START_IND_CHANNEL_5 / Stepsize of ""Failed"" direction" VALUE 0x908143A RB_Val_Ws16 32766.00 OneToOne 1.000000 32767.00 FORMAT "%8.2" EXTENDED_LIMITS -32768.00 32767.00 /end CHARACTERISTIC
/begin CHARACTERISTIC DDRC_DebArCounter.DFC_COMM_E_NET_START_IND_CHANNEL_5.stepDwn_C "Parameters of ArCounter debouncing / DFC_COMM_E_NET_START_IND_CHANNEL_5 / Stepsize of ""Passed"" direction" VALUE 0x908143C RB_Val_Ws16 32767.00 OneToOne -32768.00 -1.000000 FORMAT "%8.2" EXTENDED_LIMITS -32768.00 32767.00 /end CHARACTERISTIC
/begin CHARACTERISTIC DDRC_DebArCounter.DFC_COMM_E_NET_START_IND_CHANNEL_5.jmpUpVal_C "Parameters of ArCounter debouncing / DFC_COMM_E_NET_START_IND_CHANNEL_5 / Jumppoint direction ""Failed""" VALUE 0x908143E RB_Val_Ws16 65535.00 OneToOne -32768.00 32767.00 FORMAT "%8.2" /end CHARACTERISTIC
/begin CHARACTERISTIC DDRC_DebArCounter.DFC_COMM_E_NET_START_IND_CHANNEL_5.jmpDwnVal_C "Parameters of ArCounter debouncing / DFC_COMM_E_NET_START_IND_CHANNEL_5 / Jumppoint direction ""Passed""" VALUE 0x9081440 RB_Val_Ws16 65535.00 OneToOne -32768.00 32767.00 FORMAT "%8.2" /end CHARACTERISTIC
/begin CHARACTERISTIC DDRC_DebArCounter.DFC_PDUR_E_INIT_FAILED.isJmpUpActv_C "Parameters of ArCounter debouncing / DFC_PDUR_E_INIT_FAILED / Jump at change from ""Passed"" to ""Failed"" debouncing" VALUE 0x9081444 RB_Val_Wu8 1.000 OneToOne 0.00 1.000 FORMAT "%5.3" EXTENDED_LIMITS 0.00 255.0 /end CHARACTERISTIC
/begin CHARACTERISTIC DDRC_DebArCounter.DFC_PDUR_E_INIT_FAILED.isJmpDwnActv_C "Parameters of ArCounter debouncing / DFC_PDUR_E_INIT_FAILED / Jump at change from ""Failed"" to ""Passed"" debouncing" VALUE 0x9081445 RB_Val_Wu8 1.000 OneToOne 0.00 1.000 FORMAT "%5.3" EXTENDED_LIMITS 0.00 255.0 /end CHARACTERISTIC
/begin CHARACTERISTIC DDRC_DebArCounter.DFC_PDUR_E_INIT_FAILED.limPassd_C "Parameters of ArCounter debouncing / DFC_PDUR_E_INIT_FAILED / ""Passed"" limit" VALUE 0x9081446 RB_Val_Ws16 32767.00 OneToOne -32768.00 -1.000000 FORMAT "%8.2" EXTENDED_LIMITS -32768.00 32767.00 /end CHARACTERISTIC
/begin CHARACTERISTIC DDRC_DebArCounter.DFC_PDUR_E_INIT_FAILED.limFaild_C "Parameters of ArCounter debouncing / DFC_PDUR_E_INIT_FAILED / ""Failed"" limit" VALUE 0x9081448 RB_Val_Ws16 32766.00 OneToOne 1.000000 32767.00 FORMAT "%8.2" EXTENDED_LIMITS -32768.00 32767.00 /end CHARACTERISTIC
/begin CHARACTERISTIC DDRC_DebArCounter.DFC_PDUR_E_INIT_FAILED.stepUp_C "Parameters of ArCounter debouncing / DFC_PDUR_E_INIT_FAILED / Stepsize of ""Failed"" direction" VALUE 0x908144A RB_Val_Ws16 32766.00 OneToOne 1.000000 32767.00 FORMAT "%8.2" EXTENDED_LIMITS -32768.00 32767.00 /end CHARACTERISTIC
/begin CHARACTERISTIC DDRC_DebArCounter.DFC_PDUR_E_INIT_FAILED.stepDwn_C "Parameters of ArCounter debouncing / DFC_PDUR_E_INIT_FAILED / Stepsize of ""Passed"" direction" VALUE 0x908144C RB_Val_Ws16 32767.00 OneToOne -32768.00 -1.000000 FORMAT "%8.2" EXTENDED_LIMITS -32768.00 32767.00 /end CHARACTERISTIC
/begin CHARACTERISTIC DDRC_DebArCounter.DFC_PDUR_E_INIT_FAILED.jmpUpVal_C "Parameters of ArCounter debouncing / DFC_PDUR_E_INIT_FAILED / Jumppoint direction ""Failed""" VALUE 0x908144E RB_Val_Ws16 65535.00 OneToOne -32768.00 32767.00 FORMAT "%8.2" /end CHARACTERISTIC
/begin CHARACTERISTIC DDRC_DebArCounter.DFC_PDUR_E_INIT_FAILED.jmpDwnVal_C "Parameters of ArCounter debouncing / DFC_PDUR_E_INIT_FAILED / Jumppoint direction ""Passed""" VALUE 0x9081450 RB_Val_Ws16 65535.00 OneToOne -32768.00 32767.00 FORMAT "%8.2" /end CHARACTERISTIC
/begin CHARACTERISTIC DDRC_DebArCounter.DFC_PDUR_E_PDU_INSTANCE_LOST.isJmpUpActv_C "Parameters of ArCounter debouncing / DFC_PDUR_E_PDU_INSTANCE_LOST / Jump at change from ""Passed"" to ""Failed"" debouncing" VALUE 0x9081454 RB_Val_Wu8 1.000 OneToOne 0.00 1.000 FORMAT "%5.3" EXTENDED_LIMITS 0.00 255.0 /end CHARACTERISTIC
/begin CHARACTERISTIC DDRC_DebArCounter.DFC_PDUR_E_PDU_INSTANCE_LOST.isJmpDwnActv_C "Parameters of ArCounter debouncing / DFC_PDUR_E_PDU_INSTANCE_LOST / Jump at change from ""Failed"" to ""Passed"" debouncing" VALUE 0x9081455 RB_Val_Wu8 1.000 OneToOne 0.00 1.000 FORMAT "%5.3" EXTENDED_LIMITS 0.00 255.0 /end CHARACTERISTIC
/begin CHARACTERISTIC DDRC_DebArCounter.DFC_PDUR_E_PDU_INSTANCE_LOST.limPassd_C "Parameters of ArCounter debouncing / DFC_PDUR_E_PDU_INSTANCE_LOST / ""Passed"" limit" VALUE 0x9081456 RB_Val_Ws16 32767.00 OneToOne -32768.00 -1.000000 FORMAT "%8.2" EXTENDED_LIMITS -32768.00 32767.00 /end CHARACTERISTIC
/begin CHARACTERISTIC DDRC_DebArCounter.DFC_PDUR_E_PDU_INSTANCE_LOST.limFaild_C "Parameters of ArCounter debouncing / DFC_PDUR_E_PDU_INSTANCE_LOST / ""Failed"" limit" VALUE 0x9081458 RB_Val_Ws16 32766.00 OneToOne 1.000000 32767.00 FORMAT "%8.2" EXTENDED_LIMITS -32768.00 32767.00 /end CHARACTERISTIC
/begin CHARACTERISTIC DDRC_DebArCounter.DFC_PDUR_E_PDU_INSTANCE_LOST.stepUp_C "Parameters of ArCounter debouncing / DFC_PDUR_E_PDU_INSTANCE_LOST / Stepsize of ""Failed"" direction" VALUE 0x908145A RB_Val_Ws16 32766.00 OneToOne 1.000000 32767.00 FORMAT "%8.2" EXTENDED_LIMITS -32768.00 32767.00 /end CHARACTERISTIC
/begin CHARACTERISTIC DDRC_DebArCounter.DFC_PDUR_E_PDU_INSTANCE_LOST.stepDwn_C "Parameters of ArCounter debouncing / DFC_PDUR_E_PDU_INSTANCE_LOST / Stepsize of ""Passed"" direction" VALUE 0x908145C RB_Val_Ws16 32767.00 OneToOne -32768.00 -1.000000 FORMAT "%8.2" EXTENDED_LIMITS -32768.00 32767.00 /end CHARACTERISTIC
/begin CHARACTERISTIC DDRC_DebArCounter.DFC_PDUR_E_PDU_INSTANCE_LOST.jmpUpVal_C "Parameters of ArCounter debouncing / DFC_PDUR_E_PDU_INSTANCE_LOST / Jumppoint direction ""Failed""" VALUE 0x908145E RB_Val_Ws16 65535.00 OneToOne -32768.00 32767.00 FORMAT "%8.2" /end CHARACTERISTIC
/begin CHARACTERISTIC DDRC_DebArCounter.DFC_PDUR_E_PDU_INSTANCE_LOST.jmpDwnVal_C "Parameters of ArCounter debouncing / DFC_PDUR_E_PDU_INSTANCE_LOST / Jumppoint direction ""Passed""" VALUE 0x9081460 RB_Val_Ws16 65535.00 OneToOne -32768.00 32767.00 FORMAT "%8.2" /end CHARACTERISTIC
/begin CHARACTERISTIC DDRC_DurDeb.InjVvG_numOLDebOk_C "debouncing parameter / Duration of healing debouncing for check DFC_EV1sig" VALUE 0x908037C Val_Wu16 65535.00 OneToOne 0.00 65535.00 FORMAT "%8.2" /end CHARACTERISTIC
/begin CHARACTERISTIC DDRC_DurDeb.InjVvG_numOLDebDef_C "debouncing parameter / Duration of defect debouncing for check DFC_EV1sig" VALUE 0x908037E Val_Wu16 65535.00 OneToOne 0.00 65535.00 FORMAT "%8.2" /end CHARACTERISTIC
/begin CHARACTERISTIC DDRC_DurDeb.InjVvG_numSCBDebOk_C "debouncing parameter / Duration of healing debouncing for check DFC_EV1max" VALUE 0x9080380 Val_Wu16 65535.00 OneToOne 0.00 65535.00 FORMAT "%8.2" /end CHARACTERISTIC
/begin CHARACTERISTIC DDRC_DurDeb.InjVvG_numSCBDebDef_C "debouncing parameter / Duration of defect debouncing for check DFC_EV1max" VALUE 0x9080382 Val_Wu16 65535.00 OneToOne 0.00 65535.00 FORMAT "%8.2" /end CHARACTERISTIC
/begin CHARACTERISTIC DDRC_DurDeb.InjVvG_numSCGDebOk_C "debouncing parameter / Duration of healing debouncing for check DFC_EV1min" VALUE 0x9080384 Val_Wu16 65535.00 OneToOne 0.00 65535.00 FORMAT "%8.2" /end CHARACTERISTIC
/begin CHARACTERISTIC DDRC_DurDeb.InjVvG_numSCGDebDef_C "debouncing parameter / Duration of defect debouncing for check DFC_EV1min" VALUE 0x9080386 Val_Wu16 65535.00 OneToOne 0.00 65535.00 FORMAT "%8.2" /end CHARACTERISTIC
/begin CHARACTERISTIC DDRC_DurDeb.Com_tiDFC_Com_ABSInfo_DLCDebOk_C "debouncing parameter / Duration of healing debouncing for check DFC_Com_ABSInfo_DLC" VALUE 0x908038C Val_Wu16 655350.0 DDRCTime_ms 0.00 655350.0 FORMAT "%8.1" /end CHARACTERISTIC
/begin CHARACTERISTIC DDRC_DurDeb.Com_tiDFC_Com_ABSInfo_DLCDebDef_C "debouncing parameter / Duration of defect debouncing for check DFC_Com_ABSInfo_DLC" VALUE 0x908038E Val_Wu16 655350.0 DDRCTime_ms 0.00 655350.0 FORMAT "%8.1" /end CHARACTERISTIC
/begin CHARACTERISTIC DDRC_DurDeb.Com_tiDFC_Com_ABSInfo_TODebOk_C "debouncing parameter / Duration of healing debouncing for check DFC_Com_ABSInfo_TO" VALUE 0x9080390 Val_Wu16 655350.0 DDRCTime_ms 0.00 655350.0 FORMAT "%8.1" /end CHARACTERISTIC
/begin CHARACTERISTIC DDRC_DurDeb.Com_tiDFC_Com_ABSInfo_TODebDef_C "debouncing parameter / Duration of defect debouncing for check DFC_Com_ABSInfo_TO" VALUE 0x9080392 Val_Wu16 655350.0 DDRCTime_ms 0.00 655350.0 FORMAT "%8.1" /end CHARACTERISTIC
/begin CHARACTERISTIC DDRC_RatDeb.InjVvG_numOLUDRat_C "Ratioof up-down debouncing / Defect / Heal Ratio for check DFC_EV1sig" VALUE 0x9080D65 Val_Wu8 3.00000000000 DDRC_Ratio 1.00000000000 4.00000000000 FORMAT "%13.11" /end CHARACTERISTIC
/begin CHARACTERISTIC DDRC_RatDeb.InjVvG_numSCBUDRat_C "Ratioof up-down debouncing / Defect / Heal Ratio for check DFC_EV1max" VALUE 0x9080D66 Val_Wu8 3.00000000000 DDRC_Ratio 1.00000000000 4.00000000000 FORMAT "%13.11" /end CHARACTERISTIC
/begin CHARACTERISTIC DDRC_RatDeb.InjVvG_numSCGUDRat_C "Ratioof up-down debouncing / Defect / Heal Ratio for check DFC_EV1min" VALUE 0x9080D67 Val_Wu8 3.00000000000 DDRC_Ratio 1.00000000000 4.00000000000 FORMAT "%13.11" /end CHARACTERISTIC
/begin CHARACTERISTIC DELTASTPLRN "number of delta steps to ensure the steps mis synchronization" VALUE 0x9084EB2 KwWU16 65535.00 dez 0.00 65535.00 FORMAT "%8.2" /end CHARACTERISTIC
/begin CHARACTERISTIC DELTFRQRAMP "delta control speed for ramping up towards the close or open speed" VALUE 0x9084EB4 KwWU16 65535.00 pps_uw_q1 0.00 65535.00 FORMAT "%8.2" /end CHARACTERISTIC
/begin CHARACTERISTIC DFC_CtlMsk2.DFC_Com_ABSInfo_DLC_C "Behaviour control mask / Behaviour control masks of check DFC_Com_ABSInfo_DLC" VALUE 0x908039A Val_Wu8 255.0 DFES_OneToOne 0.00 255.0 FORMAT "%5.1" /end CHARACTERISTIC
/begin CHARACTERISTIC DFC_CtlMsk2.DFC_Com_ABSInfo_TO_C "Behaviour control mask / Behaviour control masks of check DFC_Com_ABSInfo_TO" VALUE 0x908039B Val_Wu8 255.0 DFES_OneToOne 0.00 255.0 FORMAT "%5.1" /end CHARACTERISTIC
/begin CHARACTERISTIC DFC_CtlMsk2.DFC_EV1max_C "Behaviour control mask / Behaviour control masks of check DFC_EV1max" VALUE 0x90803A7 Val_Wu8 255.0 DFES_OneToOne 0.00 255.0 FORMAT "%5.1" /end CHARACTERISTIC
/begin CHARACTERISTIC DFC_CtlMsk2.DFC_EV1min_C "Behaviour control mask / Behaviour control masks of check DFC_EV1min" VALUE 0x90803A8 Val_Wu8 255.0 DFES_OneToOne 0.00 255.0 FORMAT "%5.1" /end CHARACTERISTIC
/begin CHARACTERISTIC DFC_CtlMsk2.DFC_EV1sig_C "Behaviour control mask / Behaviour control masks of check DFC_EV1sig" VALUE 0x90803A9 Val_Wu8 255.0 DFES_OneToOne 0.00 255.0 FORMAT "%5.1" /end CHARACTERISTIC
/begin CHARACTERISTIC DFC_CtlMsk2.DFC_EVX_C "Behaviour control mask / Behaviour control masks of check DFC_EVX" VALUE 0x90803AC Val_Wu8 255.0 DFES_OneToOne 0.00 255.0 FORMAT "%5.1" /end CHARACTERISTIC
/begin CHARACTERISTIC DFC_CtlMsk2.DFC_CAN_E_TIMEOUT_C "Behaviour control mask / Behaviour control masks of check DFC_CAN_E_TIMEOUT" VALUE 0x90803BF Val_Wu8 255.0 DFES_OneToOne 0.00 255.0 FORMAT "%5.1" /end CHARACTERISTIC
/begin CHARACTERISTIC DFC_CtlMsk2.DFC_BypAirActrOcCoil1_C "Behaviour control mask / Behaviour control masks of check DFC_BypAirActrOcCoil1" VALUE 0x90803D1 Val_Wu8 255.0 DFES_OneToOne 0.00 255.0 FORMAT "%5.1" /end CHARACTERISTIC
/begin CHARACTERISTIC DFC_CtlMsk2.DFC_BypAirActrOcCoil2_C "Behaviour control mask / Behaviour control masks of check DFC_BypAirActrOcCoil2" VALUE 0x90803D2 Val_Wu8 255.0 DFES_OneToOne 0.00 255.0 FORMAT "%5.1" /end CHARACTERISTIC
/begin CHARACTERISTIC DFC_CtlMsk2.DFC_BypAirActrOlCoil1_C "Behaviour control mask / Behaviour control masks of check DFC_BypAirActrOlCoil1" VALUE 0x90803D3 Val_Wu8 255.0 DFES_OneToOne 0.00 255.0 FORMAT "%5.1" /end CHARACTERISTIC
/begin CHARACTERISTIC DFC_CtlMsk2.DFC_BypAirActrOlCoil2_C "Behaviour control mask / Behaviour control masks of check DFC_BypAirActrOlCoil2" VALUE 0x90803D4 Val_Wu8 255.0 DFES_OneToOne 0.00 255.0 FORMAT "%5.1" /end CHARACTERISTIC
/begin CHARACTERISTIC DFC_CtlMsk2.DFC_BypAirActrOt_C "Behaviour control mask / Behaviour control masks of check DFC_BypAirActrOt" VALUE 0x90803D5 Val_Wu8 255.0 DFES_OneToOne 0.00 255.0 FORMAT "%5.1" /end CHARACTERISTIC
/begin CHARACTERISTIC DFC_CtlMsk2.DFC_BypAirActrScbCoil1_C "Behaviour control mask / Behaviour control masks of check DFC_BypAirActrScbCoil1" VALUE 0x90803D6 Val_Wu8 255.0 DFES_OneToOne 0.00 255.0 FORMAT "%5.1" /end CHARACTERISTIC
/begin CHARACTERISTIC DFC_CtlMsk2.DFC_BypAirActrScbCoil2_C "Behaviour control mask / Behaviour control masks of check DFC_BypAirActrScbCoil2" VALUE 0x90803D7 Val_Wu8 255.0 DFES_OneToOne 0.00 255.0 FORMAT "%5.1" /end CHARACTERISTIC
/begin CHARACTERISTIC DFC_CtlMsk2.DFC_BypAirActrScgCoil1_C "Behaviour control mask / Behaviour control masks of check DFC_BypAirActrScgCoil1" VALUE 0x90803D8 Val_Wu8 255.0 DFES_OneToOne 0.00 255.0 FORMAT "%5.1" /end CHARACTERISTIC
/begin CHARACTERISTIC DFC_CtlMsk2.DFC_BypAirActrScgCoil2_C "Behaviour control mask / Behaviour control masks of check DFC_BypAirActrScgCoil2" VALUE 0x90803D9 Val_Wu8 255.0 DFES_OneToOne 0.00 255.0 FORMAT "%5.1" /end CHARACTERISTIC
/begin CHARACTERISTIC DFC_DisblMsk2.DFC_Com_ABSInfo_DLC_C "disable mask / Disable masks of check DFC_Com_ABSInfo_DLC" VALUE 0x9080D6A Val_Wu8 255.0 DFES_OneToOne 0.00 255.0 FORMAT "%5.1" /end CHARACTERISTIC
/begin CHARACTERISTIC DFC_DisblMsk2.DFC_Com_ABSInfo_TO_C "disable mask / Disable masks of check DFC_Com_ABSInfo_TO" VALUE 0x9080D6B Val_Wu8 255.0 DFES_OneToOne 0.00 255.0 FORMAT "%5.1" /end CHARACTERISTIC
/begin CHARACTERISTIC DFC_DisblMsk2.DFC_EV1max_C "disable mask / Disable masks of check DFC_EV1max" VALUE 0x9080D77 Val_Wu8 255.0 DFES_OneToOne 0.00 255.0 FORMAT "%5.1" /end CHARACTERISTIC
/begin CHARACTERISTIC DFC_DisblMsk2.DFC_EV1min_C "disable mask / Disable masks of check DFC_EV1min" VALUE 0x9080D78 Val_Wu8 255.0 DFES_OneToOne 0.00 255.0 FORMAT "%5.1" /end CHARACTERISTIC
/begin CHARACTERISTIC DFC_DisblMsk2.DFC_EV1sig_C "disable mask / Disable masks of check DFC_EV1sig" VALUE 0x9080D79 Val_Wu8 255.0 DFES_OneToOne 0.00 255.0 FORMAT "%5.1" /end CHARACTERISTIC
/begin CHARACTERISTIC DFC_DisblMsk2.DFC_EVX_C "disable mask / Disable masks of check DFC_EVX" VALUE 0x9080D7C Val_Wu8 255.0 DFES_OneToOne 0.00 255.0 FORMAT "%5.1" /end CHARACTERISTIC
/begin CHARACTERISTIC DFC_DisblMsk2.DFC_CAN_E_TIMEOUT_C "disable mask / Disable masks of check DFC_CAN_E_TIMEOUT" VALUE 0x9080D8F Val_Wu8 255.0 DFES_OneToOne 0.00 255.0 FORMAT "%5.1" /end CHARACTERISTIC
/begin CHARACTERISTIC DFC_DisblMsk2.DFC_BypAirActrOcCoil1_C "disable mask / Disable masks of check DFC_BypAirActrOcCoil1" VALUE 0x9080DA1 Val_Wu8 255.0 DFES_OneToOne 0.00 255.0 FORMAT "%5.1" /end CHARACTERISTIC
/begin CHARACTERISTIC DFC_DisblMsk2.DFC_BypAirActrOcCoil2_C "disable mask / Disable masks of check DFC_BypAirActrOcCoil2" VALUE 0x9080DA2 Val_Wu8 255.0 DFES_OneToOne 0.00 255.0 FORMAT "%5.1" /end CHARACTERISTIC
/begin CHARACTERISTIC DFC_DisblMsk2.DFC_BypAirActrOlCoil1_C "disable mask / Disable masks of check DFC_BypAirActrOlCoil1" VALUE 0x9080DA3 Val_Wu8 255.0 DFES_OneToOne 0.00 255.0 FORMAT "%5.1" /end CHARACTERISTIC
/begin CHARACTERISTIC DFC_DisblMsk2.DFC_BypAirActrOlCoil2_C "disable mask / Disable masks of check DFC_BypAirActrOlCoil2" VALUE 0x9080DA4 Val_Wu8 255.0 DFES_OneToOne 0.00 255.0 FORMAT "%5.1" /end CHARACTERISTIC
/begin CHARACTERISTIC DFC_DisblMsk2.DFC_BypAirActrOt_C "disable mask / Disable masks of check DFC_BypAirActrOt" VALUE 0x9080DA5 Val_Wu8 255.0 DFES_OneToOne 0.00 255.0 FORMAT "%5.1" /end CHARACTERISTIC
/begin CHARACTERISTIC DFC_DisblMsk2.DFC_BypAirActrScbCoil1_C "disable mask / Disable masks of check DFC_BypAirActrScbCoil1" VALUE 0x9080DA6 Val_Wu8 255.0 DFES_OneToOne 0.00 255.0 FORMAT "%5.1" /end CHARACTERISTIC
/begin CHARACTERISTIC DFC_DisblMsk2.DFC_BypAirActrScbCoil2_C "disable mask / Disable masks of check DFC_BypAirActrScbCoil2" VALUE 0x9080DA7 Val_Wu8 255.0 DFES_OneToOne 0.00 255.0 FORMAT "%5.1" /end CHARACTERISTIC
/begin CHARACTERISTIC DFC_DisblMsk2.DFC_BypAirActrScgCoil1_C "disable mask / Disable masks of check DFC_BypAirActrScgCoil1" VALUE 0x9080DA8 Val_Wu8 255.0 DFES_OneToOne 0.00 255.0 FORMAT "%5.1" /end CHARACTERISTIC
/begin CHARACTERISTIC DFC_DisblMsk2.DFC_BypAirActrScgCoil2_C "disable mask / Disable masks of check DFC_BypAirActrScgCoil2" VALUE 0x9080DA9 Val_Wu8 255.0 DFES_OneToOne 0.00 255.0 FORMAT "%5.1" /end CHARACTERISTIC
/begin CHARACTERISTIC DNLRNSTPADP "Minimum engine speed threshold for activation of step loss correction" VALUE 0x9084EB6 KwWU16 16383.75 nmot_uw_q0p25 0.00 16383.75 FORMAT "%8.2" /end CHARACTERISTIC
/begin CHARACTERISTIC EROTAN "Exhaust Regulation or Type Approval Number" ASCII 0x90814F1 ValA_Wu8 255.0 defaultAscii 0.00 255.0 NUMBER 17 /end CHARACTERISTIC
/begin CHARACTERISTIC FKRLSTPADP "factor difference of modelled air charge value with reference to measured air charge to enable step loss correction" VALUE 0x9084EB8 KwWU16 1.999969 fak_uw_b2 0.00 1.999969 FORMAT "%8.6" /end CHARACTERISTIC
/begin CHARACTERISTIC FRQLOWERLIMIT "Control speed for the open direction of stepper motor" VALUE 0x9084EBA KwWU16 65535.00 pps_uw_q1 0.00 65535.00 FORMAT "%8.2" /end CHARACTERISTIC
/begin CHARACTERISTIC FRQMECHLIMIT "Control speed once stepper reaches towards the lower mechanical limit" VALUE 0x9084EBC KwWU16 65535.00 pps_uw_q1 0.00 65535.00 FORMAT "%8.2" /end CHARACTERISTIC
/begin CHARACTERISTIC FRQSTPMECHLRN "Control speed for the mechanical limit learning of stepper motor" VALUE 0x9084EBE KwWU16 65535.00 pps_uw_q1 0.00 65535.00 FORMAT "%8.2" /end CHARACTERISTIC
/begin CHARACTERISTIC FRQSTPRESLIM "Control speed during the resonance speed of stepper motor operation" VALUE 0x9084EC0 KwWU16 65535.00 pps_uw_q1 0.00 65535.00 FORMAT "%8.2" /end CHARACTERISTIC
/begin CHARACTERISTIC FRQSTPRESMAXLIM "Max limit for the control speed at which resonance occur for the stepper motor" VALUE 0x9084EC2 KwWU16 65535.00 pps_uw_q1 0.00 65535.00 FORMAT "%8.2" /end CHARACTERISTIC
/begin CHARACTERISTIC FRQSTPRESMINLIM "Min limit for the control speed at which resonance starts for stepper motor" VALUE 0x9084EC4 KwWU16 65535.00 pps_uw_q1 0.00 65535.00 FORMAT "%8.2" /end CHARACTERISTIC
/begin CHARACTERISTIC FRQUPPERLIMIT "Control speed for the open direction of stepper motor" VALUE 0x9084EC6 KwWU16 65535.00 pps_uw_q1 0.00 65535.00 FORMAT "%8.2" /end CHARACTERISTIC
/begin CHARACTERISTIC HEXPRGFILE_CA "Hex program filename calibration array" ASCII 0x9081503 ValA_Wu8 255.0 defaultAscii 0.00 255.0 NUMBER 14 /end CHARACTERISTIC
/begin CHARACTERISTIC KLPSSTPADAPFG "Min pressure value for the disable of step loss correction method once step reaches mechanical limit" CURVE 0x9084EC8 KlAxU8SstxU16WU16 2559.961 p_uw_q0p039 0.00 2559.961 FORMAT "%8.3"
 /begin AXIS_DESCR STD_AXIS nmot_w nmot_uw_q0p25 5 0.00 16383.75 FORMAT "%8.2" DEPOSIT ABSOLUTE /end AXIS_DESCR
/end CHARACTERISTIC
/begin CHARACTERISTIC KTMPARTNUM_CA "KTM part number calibration" ASCII 0x9081512 ValA_Wu8 255.0 defaultAscii 0.00 255.0 NUMBER 14 /end CHARACTERISTIC
/begin CHARACTERISTIC MAXSTEP "Upper mechanical stop (Stepper)" VALUE 0x9084EDE KwWU16 65535.00 dez 0.00 65535.00 FORMAT "%8.2" /end CHARACTERISTIC
/begin CHARACTERISTIC MAXSTEPLOWFRQEN "stepper reaches towards the upper mechanical limit where lower control speed operation is required" VALUE 0x9084EE0 KwWU16 65535.00 dez 0.00 65535.00 FORMAT "%8.2" /end CHARACTERISTIC
/begin CHARACTERISTIC medc_datasetid "Text with the dataset identification" ASCII 0x9089ED2 ValA_Wu8 255.0 defaultAscii 0.00 255.0 NUMBER 99 /end CHARACTERISTIC
/begin CHARACTERISTIC MINSTEP "Step at which valve is completely closed" VALUE 0x9084EE2 KwWU16 65535.00 dez 0.00 65535.00 FORMAT "%8.2" /end CHARACTERISTIC
/begin CHARACTERISTIC MINSTEPLOWFRQEN "stepper reaches towards the lower mechanical limit where lower control speed operation is required" VALUE 0x9084EE4 KwWU16 65535.00 dez 0.00 65535.00 FORMAT "%8.2" /end CHARACTERISTIC
/begin CHARACTERISTIC NDECJ "Engine speed threshold for power stage diagnosis" VALUE 0x9084EFC KwWU8 10200. EngN_LRes 0.00 10200. FORMAT "%5.0" /end CHARACTERISTIC
/begin CHARACTERISTIC OVERVOLTAGE_THRESHOLD_C "over voltage threshold to be compared with battery voltage" VALUE 0x9081368 KwWU8 17.95 spg_ubatt 0.00 17.95 FORMAT "%5.2" /end CHARACTERISTIC
/begin CHARACTERISTIC POSTDRVDLY "Maximum delay time of post drive for activation of stepper control" VALUE 0x9084EE6 KwWU16 65535.00 dez 0.00 65535.00 FORMAT "%8.2" /end CHARACTERISTIC
/begin CHARACTERISTIC SDSTCNTR_RPM_C "RPM calibration for sidestand counter" VALUE 0x908136A KwWU16 32767.50 EngN 0.00 32767.50 FORMAT "%8.2" /end CHARACTERISTIC
/begin CHARACTERISTIC SSECUSN_CA "Bosch ECU software number calibration array" ASCII 0x9081521 ValA_Wu8 255.0 defaultAscii 0.00 255.0 NUMBER 10 /end CHARACTERISTIC
/begin CHARACTERISTIC STEPPATN "Trigger pattern for stepper motor to activate" VAL_BLK 0x9084EE8 KwbWU8 255.0 dez 0.00 255.0 FORMAT "%5.1" NUMBER 4 /end CHARACTERISTIC
/begin CHARACTERISTIC STEPPATRNCOILOFF "Trigger pattern for stepper motor for the power save counter" VAL_BLK 0x9084EEC KwbWU8 255.0 dez 0.00 255.0 FORMAT "%5.1" NUMBER 4 /end CHARACTERISTIC
/begin CHARACTERISTIC STPADPDISCTR "time counter to disable the step loss correction method after start" VALUE 0x9084EF0 KwWU16 65535.00 dez 0.00 65535.00 FORMAT "%8.2" /end CHARACTERISTIC
/begin CHARACTERISTIC STPPOWOFF "waiting time before stepper powersave becomes active" VALUE 0x9084EF2 KwWU16 65.53500 t_q0p001 0.00 65.53500 FORMAT "%8.5" /end CHARACTERISTIC
/begin CHARACTERISTIC STPRVPSAP "Application parameter for setpoint Stepper valve position" VALUE 0x9084EF4 KwWU16 99.99847 rel_uw_b100 0.00 99.99847 FORMAT "%8.5" /end CHARACTERISTIC
/begin CHARACTERISTIC TDSTPADAP "delay time to activate step loss correction method" VALUE 0x9084EF6 KwWU8 2.550 t_q0p01 0.00 2.550 FORMAT "%5.3" /end CHARACTERISTIC
/begin CHARACTERISTIC TDSTPRLYFB "delay time to activate stepper feedback for starter engagement in case of failure" VALUE 0x9084EF8 KwWU16 655.3500 t_q0p01 0.00 655.3500 FORMAT "%8.4" /end CHARACTERISTIC
/begin CHARACTERISTIC TLTCNTR_RPM_C "RPM Calibration for tilt counter to increment" VALUE 0x908136C KwWU16 32767.50 EngN 0.00 32767.50 FORMAT "%8.2" /end CHARACTERISTIC
/begin CHARACTERISTIC UBCJMN "Min. Ubat-threshold for release of the power stage diagnosis" VALUE 0x9084EFE KwWU16 15000.00 Volt_Batt 0.00 15000.00 FORMAT "%8.2" EXTENDED_LIMITS 0.00 1310700. /end CHARACTERISTIC
/begin CHARACTERISTIC UBCJMX "Max. Ubat-threshold f. release of the BSP 752 R-power stage diagnosis" VALUE 0x9084F00 KwWU16 25500.00 Volt_Batt 0.00 25500.00 FORMAT "%8.2" EXTENDED_LIMITS 0.00 1310700. /end CHARACTERISTIC
/begin CHARACTERISTIC UBSTPSTMN "Minimal voltage threshold for stepper motor at start" VALUE 0x9084EFA KwWU8 25.50 spg_q0p1 0.00 25.50 FORMAT "%5.2" /end CHARACTERISTIC
/begin CHARACTERISTIC UBSTPSTMX "Maximum voltage threshold for stepper motor at start" VALUE 0x9084EFB KwWU8 25.50 spg_q0p1 0.00 25.50 FORMAT "%5.2" /end CHARACTERISTIC
/begin CHARACTERISTIC vmlg_max_C "Max. possible mileage range" VALUE 0x908136E KwWU16 6553.500 fak_q0p1 0.00 6553.500 FORMAT "%8.3" /end CHARACTERISTIC
/begin MEASUREMENT avgmlg "Average mileage (in kmpl)" UWORD fak_q0p1 1 100 0.00 6553.500 FORMAT "%8.3" ECU_ADDRESS 0x4000C6AA
 /begin IF_DATA XCPplus 0x0102
  /begin DAQ_EVENT VARIABLE /begin AVAILABLE_EVENT_LIST EVENT 0 EVENT 1 EVENT 2 EVENT 3 /end AVAILABLE_EVENT_LIST /begin DEFAULT_EVENT_LIST EVENT 3 /end DEFAULT_EVENT_LIST /end DAQ_EVENT
 /end IF_DATA
/end MEASUREMENT
/begin MEASUREMENT avgvmlg "Array to store average fuel consumption (km/l) in last five driving cycles." UWORD fak_q0p1 1 100 0.00 6553.500 FORMAT "%8.3" ARRAY_SIZE 5 ECU_ADDRESS 0x4000C6A0
 /begin IF_DATA XCPplus 0x0102
  /begin DAQ_EVENT VARIABLE /begin AVAILABLE_EVENT_LIST EVENT 0 EVENT 1 EVENT 2 EVENT 3 /end AVAILABLE_EVENT_LIST /begin DEFAULT_EVENT_LIST EVENT 3 /end DEFAULT_EVENT_LIST /end DAQ_EVENT
 /end IF_DATA
/end MEASUREMENT
/begin MEASUREMENT BypAirActr_cntrOcErrCoil1 "Over currrent error counter coil 1" UBYTE OneToOne 1 100 0.00 255.0 FORMAT "%5.1" ECU_ADDRESS 0x40008833
 /begin IF_DATA XCPplus 0x0102
  /begin DAQ_EVENT VARIABLE /begin AVAILABLE_EVENT_LIST EVENT 0 EVENT 1 EVENT 2 EVENT 3 /end AVAILABLE_EVENT_LIST /begin DEFAULT_EVENT_LIST EVENT 2 /end DEFAULT_EVENT_LIST /end DAQ_EVENT
 /end IF_DATA
/end MEASUREMENT
/begin MEASUREMENT BypAirActr_cntrOcErrCoil2 "Over currrent error counter coil 2" UBYTE OneToOne 1 100 0.00 255.0 FORMAT "%5.1" ECU_ADDRESS 0x40008840
 /begin IF_DATA XCPplus 0x0102
  /begin DAQ_EVENT VARIABLE /begin AVAILABLE_EVENT_LIST EVENT 0 EVENT 1 EVENT 2 EVENT 3 /end AVAILABLE_EVENT_LIST /begin DEFAULT_EVENT_LIST EVENT 2 /end DEFAULT_EVENT_LIST /end DAQ_EVENT
 /end IF_DATA
/end MEASUREMENT
/begin MEASUREMENT BypAirActr_cntrOcHealCoil1 "Over currrent heal counter coil 1" UBYTE OneToOne 1 100 0.00 255.0 FORMAT "%5.1" ECU_ADDRESS 0x40008834
 /begin IF_DATA XCPplus 0x0102
  /begin DAQ_EVENT VARIABLE /begin AVAILABLE_EVENT_LIST EVENT 0 EVENT 1 EVENT 2 EVENT 3 /end AVAILABLE_EVENT_LIST /begin DEFAULT_EVENT_LIST EVENT 2 /end DEFAULT_EVENT_LIST /end DAQ_EVENT
 /end IF_DATA
/end MEASUREMENT
/begin MEASUREMENT BypAirActr_cntrOcHealCoil2 "Over currrent heal counter coil 2" UBYTE OneToOne 1 100 0.00 255.0 FORMAT "%5.1" ECU_ADDRESS 0x40008841
 /begin IF_DATA XCPplus 0x0102
  /begin DAQ_EVENT VARIABLE /begin AVAILABLE_EVENT_LIST EVENT 0 EVENT 1 EVENT 2 EVENT 3 /end AVAILABLE_EVENT_LIST /begin DEFAULT_EVENT_LIST EVENT 2 /end DEFAULT_EVENT_LIST /end DAQ_EVENT
 /end IF_DATA
/end MEASUREMENT
/begin MEASUREMENT BypAirActr_cntrOlErrCoil1 "Open load error counter coil 1" UBYTE OneToOne 1 100 0.00 255.0 FORMAT "%5.1" ECU_ADDRESS 0x4000883F
 /begin IF_DATA XCPplus 0x0102
  /begin DAQ_EVENT VARIABLE /begin AVAILABLE_EVENT_LIST EVENT 0 EVENT 1 EVENT 2 EVENT 3 /end AVAILABLE_EVENT_LIST /begin DEFAULT_EVENT_LIST EVENT 2 /end DEFAULT_EVENT_LIST /end DAQ_EVENT
 /end IF_DATA
/end MEASUREMENT
/begin MEASUREMENT BypAirActr_cntrOlErrCoil2 "Open load error counter coil 2" UBYTE OneToOne 1 100 0.00 255.0 FORMAT "%5.1" ECU_ADDRESS 0x4000884C
 /begin IF_DATA XCPplus 0x0102
  /begin DAQ_EVENT VARIABLE /begin AVAILABLE_EVENT_LIST EVENT 0 EVENT 1 EVENT 2 EVENT 3 /end AVAILABLE_EVENT_LIST /begin DEFAULT_EVENT_LIST EVENT 2 /end DEFAULT_EVENT_LIST /end DAQ_EVENT
 /end IF_DATA
/end MEASUREMENT
/begin MEASUREMENT BypAirActr_cntrOlHealCoil1 "Open load heal counter coil 1" UBYTE OneToOne 1 100 0.00 255.0 FORMAT "%5.1" ECU_ADDRESS 0x4000883E
 /begin IF_DATA XCPplus 0x0102
  /begin DAQ_EVENT VARIABLE /begin AVAILABLE_EVENT_LIST EVENT 0 EVENT 1 EVENT 2 EVENT 3 /end AVAILABLE_EVENT_LIST /begin DEFAULT_EVENT_LIST EVENT 2 /end DEFAULT_EVENT_LIST /end DAQ_EVENT
 /end IF_DATA
/end MEASUREMENT
/begin MEASUREMENT BypAirActr_cntrOlHealCoil2 "Open load heal counter coil 2" UBYTE OneToOne 1 100 0.00 255.0 FORMAT "%5.1" ECU_ADDRESS 0x4000884B
 /begin IF_DATA XCPplus 0x0102
  /begin DAQ_EVENT VARIABLE /begin AVAILABLE_EVENT_LIST EVENT 0 EVENT 1 EVENT 2 EVENT 3 /end AVAILABLE_EVENT_LIST /begin DEFAULT_EVENT_LIST EVENT 2 /end DEFAULT_EVENT_LIST /end DAQ_EVENT
 /end IF_DATA
/end MEASUREMENT
/begin MEASUREMENT BypAirActr_cntrOtErr "Over temperature error counter" UBYTE OneToOne 1 100 0.00 255.0 FORMAT "%5.1" ECU_ADDRESS 0x4000884E
 /begin IF_DATA XCPplus 0x0102
  /begin DAQ_EVENT VARIABLE /begin AVAILABLE_EVENT_LIST EVENT 0 EVENT 1 EVENT 2 EVENT 3 /end AVAILABLE_EVENT_LIST /begin DEFAULT_EVENT_LIST EVENT 2 /end DEFAULT_EVENT_LIST /end DAQ_EVENT
 /end IF_DATA
/end MEASUREMENT
/begin MEASUREMENT BypAirActr_cntrOtHeal "Over temperature heal counter" UBYTE OneToOne 1 100 0.00 255.0 FORMAT "%5.1" ECU_ADDRESS 0x4000884D
 /begin IF_DATA XCPplus 0x0102
  /begin DAQ_EVENT VARIABLE /begin AVAILABLE_EVENT_LIST EVENT 0 EVENT 1 EVENT 2 EVENT 3 /end AVAILABLE_EVENT_LIST /begin DEFAULT_EVENT_LIST EVENT 2 /end DEFAULT_EVENT_LIST /end DAQ_EVENT
 /end IF_DATA
/end MEASUREMENT
/begin MEASUREMENT BypAirActr_cntrScbErrCoil1 "Short circuit to battery error counter, coil 1" UBYTE OneToOne 1 100 0.00 255.0 FORMAT "%5.1" ECU_ADDRESS 0x4000883A
 /begin IF_DATA XCPplus 0x0102
  /begin DAQ_EVENT VARIABLE /begin AVAILABLE_EVENT_LIST EVENT 0 EVENT 1 EVENT 2 EVENT 3 /end AVAILABLE_EVENT_LIST /begin DEFAULT_EVENT_LIST EVENT 2 /end DEFAULT_EVENT_LIST /end DAQ_EVENT
 /end IF_DATA
/end MEASUREMENT
/begin MEASUREMENT BypAirActr_cntrScbErrCoil2 "Short circuit to battery error counter, coil 2" UBYTE OneToOne 1 100 0.00 255.0 FORMAT "%5.1" ECU_ADDRESS 0x40008847
 /begin IF_DATA XCPplus 0x0102
  /begin DAQ_EVENT VARIABLE /begin AVAILABLE_EVENT_LIST EVENT 0 EVENT 1 EVENT 2 EVENT 3 /end AVAILABLE_EVENT_LIST /begin DEFAULT_EVENT_LIST EVENT 2 /end DEFAULT_EVENT_LIST /end DAQ_EVENT
 /end IF_DATA
/end MEASUREMENT
/begin MEASUREMENT BypAirActr_cntrScbHealCoil1 "Short circuit to battery heal counter, coil 1" UBYTE OneToOne 1 100 0.00 255.0 FORMAT "%5.1" ECU_ADDRESS 0x40008839
 /begin IF_DATA XCPplus 0x0102
  /begin DAQ_EVENT VARIABLE /begin AVAILABLE_EVENT_LIST EVENT 0 EVENT 1 EVENT 2 EVENT 3 /end AVAILABLE_EVENT_LIST /begin DEFAULT_EVENT_LIST EVENT 2 /end DEFAULT_EVENT_LIST /end DAQ_EVENT
 /end IF_DATA
/end MEASUREMENT
/begin MEASUREMENT BypAirActr_cntrScbHealCoil2 "Short circuit to battery heal counter, coil 2" UBYTE OneToOne 1 100 0.00 255.0 FORMAT "%5.1" ECU_ADDRESS 0x40008846
 /begin IF_DATA XCPplus 0x0102
  /begin DAQ_EVENT VARIABLE /begin AVAILABLE_EVENT_LIST EVENT 0 EVENT 1 EVENT 2 EVENT 3 /end AVAILABLE_EVENT_LIST /begin DEFAULT_EVENT_LIST EVENT 2 /end DEFAULT_EVENT_LIST /end DAQ_EVENT
 /end IF_DATA
/end MEASUREMENT
/begin MEASUREMENT BypAirActr_cntrScgErrCoil1 "Short circuit to ground error counter, coil 1" UBYTE OneToOne 1 100 0.00 255.0 FORMAT "%5.1" ECU_ADDRESS 0x40008836
 /begin IF_DATA XCPplus 0x0102
  /begin DAQ_EVENT VARIABLE /begin AVAILABLE_EVENT_LIST EVENT 0 EVENT 1 EVENT 2 EVENT 3 /end AVAILABLE_EVENT_LIST /begin DEFAULT_EVENT_LIST EVENT 2 /end DEFAULT_EVENT_LIST /end DAQ_EVENT
 /end IF_DATA
/end MEASUREMENT
/begin MEASUREMENT BypAirActr_cntrScgErrCoil2 "Short circuit to ground error counter, coil 2" UBYTE OneToOne 1 100 0.00 255.0 FORMAT "%5.1" ECU_ADDRESS 0x40008843
 /begin IF_DATA XCPplus 0x0102
  /begin DAQ_EVENT VARIABLE /begin AVAILABLE_EVENT_LIST EVENT 0 EVENT 1 EVENT 2 EVENT 3 /end AVAILABLE_EVENT_LIST /begin DEFAULT_EVENT_LIST EVENT 2 /end DEFAULT_EVENT_LIST /end DAQ_EVENT
 /end IF_DATA
/end MEASUREMENT
/begin MEASUREMENT BypAirActr_cntrScgHealCoil1 "Short circuit to ground heal counter, coil 1" UBYTE OneToOne 1 100 0.00 255.0 FORMAT "%5.1" ECU_ADDRESS 0x40008835
 /begin IF_DATA XCPplus 0x0102
  /begin DAQ_EVENT VARIABLE /begin AVAILABLE_EVENT_LIST EVENT 0 EVENT 1 EVENT 2 EVENT 3 /end AVAILABLE_EVENT_LIST /begin DEFAULT_EVENT_LIST EVENT 2 /end DEFAULT_EVENT_LIST /end DAQ_EVENT
 /end IF_DATA
/end MEASUREMENT
/begin MEASUREMENT BypAirActr_cntrScgHealCoil2 "Short circuit to ground heal counter, coil 2" UBYTE OneToOne 1 100 0.00 255.0 FORMAT "%5.1" ECU_ADDRESS 0x40008842
 /begin IF_DATA XCPplus 0x0102
  /begin DAQ_EVENT VARIABLE /begin AVAILABLE_EVENT_LIST EVENT 0 EVENT 1 EVENT 2 EVENT 3 /end AVAILABLE_EVENT_LIST /begin DEFAULT_EVENT_LIST EVENT 2 /end DEFAULT_EVENT_LIST /end DAQ_EVENT
 /end IF_DATA
/end MEASUREMENT
/begin MEASUREMENT BypAirActr_CoilNrDiag "By-Pass Air Actuator Coil number used for Diagnosis" UBYTE dez 1 100 0.00 255.0 FORMAT "%5.1" ECU_ADDRESS 0x40008857
 /begin IF_DATA XCPplus 0x0102
  /begin DAQ_EVENT VARIABLE /begin AVAILABLE_EVENT_LIST EVENT 0 EVENT 1 EVENT 2 EVENT 3 /end AVAILABLE_EVENT_LIST /begin DEFAULT_EVENT_LIST EVENT 2 /end DEFAULT_EVENT_LIST /end DAQ_EVENT
 /end IF_DATA
/end MEASUREMENT
/begin MEASUREMENT BypAirActr_DiagInfo_a "Array: Bypass Air Actuator Diagnosis Information" ULONG dez 1 100 0.00 4294967295.00 FORMAT "%13.2" ARRAY_SIZE 2 ECU_ADDRESS 0x40008E40 /end MEASUREMENT
/begin MEASUREMENT BypAirActr_flgActrCls "Condition: By-Pass air actuator Close request" UBYTE B_TRUE 1 100 0.00 1.00000000000 BIT_MASK 0x1 FORMAT "%13.11" ECU_ADDRESS 0x40008852
 /begin IF_DATA XCPplus 0x0102
  /begin DAQ_EVENT VARIABLE /begin AVAILABLE_EVENT_LIST EVENT 0 EVENT 1 EVENT 2 EVENT 3 /end AVAILABLE_EVENT_LIST /begin DEFAULT_EVENT_LIST EVENT 1 /end DEFAULT_EVENT_LIST /end DAQ_EVENT
 /end IF_DATA
/end MEASUREMENT
/begin MEASUREMENT BypAirActr_flgActrOpen "Condition: By-Pass air actuator open request" UBYTE B_TRUE 1 100 0.00 1.00000000000 BIT_MASK 0x1 FORMAT "%13.11" ECU_ADDRESS 0x40008851
 /begin IF_DATA XCPplus 0x0102
  /begin DAQ_EVENT VARIABLE /begin AVAILABLE_EVENT_LIST EVENT 0 EVENT 1 EVENT 2 EVENT 3 /end AVAILABLE_EVENT_LIST /begin DEFAULT_EVENT_LIST EVENT 1 /end DEFAULT_EVENT_LIST /end DAQ_EVENT
 /end IF_DATA
/end MEASUREMENT
/begin MEASUREMENT BypAirActr_flgCoilOn "Condition: By-Pass Air Actuator coil ON state" UBYTE B_TRUE 1 100 0.00 1.00000000000 BIT_MASK 0x1 FORMAT "%13.11" ECU_ADDRESS 0x40008850
 /begin IF_DATA XCPplus 0x0102
  /begin DAQ_EVENT VARIABLE /begin AVAILABLE_EVENT_LIST EVENT 0 EVENT 1 EVENT 2 EVENT 3 /end AVAILABLE_EVENT_LIST /begin DEFAULT_EVENT_LIST EVENT 1 /end DEFAULT_EVENT_LIST /end DAQ_EVENT
 /end IF_DATA
/end MEASUREMENT
/begin MEASUREMENT BypAirActr_flgCoilSwtOffScDiag1 "Flag : Coil switch off request for short circuit diagnosis; coil 1" UBYTE B_TRUE 1 100 0.00 1.00000000000 BIT_MASK 0x1 FORMAT "%13.11" ECU_ADDRESS 0x40008832
 /begin IF_DATA XCPplus 0x0102
  /begin DAQ_EVENT VARIABLE /begin AVAILABLE_EVENT_LIST EVENT 0 EVENT 1 EVENT 2 EVENT 3 /end AVAILABLE_EVENT_LIST /begin DEFAULT_EVENT_LIST EVENT 2 /end DEFAULT_EVENT_LIST /end DAQ_EVENT
 /end IF_DATA
/end MEASUREMENT
/begin MEASUREMENT BypAirActr_flgCoilSwtOffScDiag2 "Flag : Coil switch off request for short circuit diagnosis; coil 2" UBYTE B_TRUE 1 100 0.00 1.00000000000 BIT_MASK 0x1 FORMAT "%13.11" ECU_ADDRESS 0x40008831
 /begin IF_DATA XCPplus 0x0102
  /begin DAQ_EVENT VARIABLE /begin AVAILABLE_EVENT_LIST EVENT 0 EVENT 1 EVENT 2 EVENT 3 /end AVAILABLE_EVENT_LIST /begin DEFAULT_EVENT_LIST EVENT 2 /end DEFAULT_EVENT_LIST /end DAQ_EVENT
 /end IF_DATA
/end MEASUREMENT
/begin MEASUREMENT BypAirActr_flgDiagComErr "Condition: By-Pass Air Actuator comunication error" UBYTE B_TRUE 1 100 0.00 1.00000000000 BIT_MASK 0x1 FORMAT "%13.11" ECU_ADDRESS 0x40008859
 /begin IF_DATA XCPplus 0x0102
  /begin DAQ_EVENT VARIABLE /begin AVAILABLE_EVENT_LIST EVENT 0 EVENT 1 EVENT 2 EVENT 3 /end AVAILABLE_EVENT_LIST /begin DEFAULT_EVENT_LIST EVENT 2 /end DEFAULT_EVENT_LIST /end DAQ_EVENT
 /end IF_DATA
/end MEASUREMENT
/begin MEASUREMENT BypAirActr_flgDiagEna "Condition: By-Pass Air Actuator Diagnosis enabling" UBYTE B_TRUE 1 100 0.00 1.00000000000 BIT_MASK 0x1 FORMAT "%13.11" ECU_ADDRESS 0x4000884F
 /begin IF_DATA XCPplus 0x0102
  /begin DAQ_EVENT VARIABLE /begin AVAILABLE_EVENT_LIST EVENT 0 EVENT 1 EVENT 2 EVENT 3 /end AVAILABLE_EVENT_LIST /begin DEFAULT_EVENT_LIST EVENT 2 /end DEFAULT_EVENT_LIST /end DAQ_EVENT
 /end IF_DATA
/end MEASUREMENT
/begin MEASUREMENT BypAirActr_flgDiagUpdinfo "Condition: By-Pass Air Actuator Diagnosis updated information" UBYTE B_TRUE 1 100 0.00 1.00000000000 BIT_MASK 0x1 FORMAT "%13.11" ECU_ADDRESS 0x40008858
 /begin IF_DATA XCPplus 0x0102
  /begin DAQ_EVENT VARIABLE /begin AVAILABLE_EVENT_LIST EVENT 0 EVENT 1 EVENT 2 EVENT 3 /end AVAILABLE_EVENT_LIST /begin DEFAULT_EVENT_LIST EVENT 2 /end DEFAULT_EVENT_LIST /end DAQ_EVENT
 /end IF_DATA
/end MEASUREMENT
/begin MEASUREMENT BypAirActr_flgOcErrCoil1 "Condition: Stepper coil over current error; coil 1" UBYTE B_TRUE 1 100 0.00 1.00000000000 BIT_MASK 0x1 FORMAT "%13.11" ECU_ADDRESS 0x40008830
 /begin IF_DATA XCPplus 0x0102
  /begin DAQ_EVENT VARIABLE /begin AVAILABLE_EVENT_LIST EVENT 0 EVENT 1 EVENT 2 EVENT 3 /end AVAILABLE_EVENT_LIST /begin DEFAULT_EVENT_LIST EVENT 2 /end DEFAULT_EVENT_LIST /end DAQ_EVENT
 /end IF_DATA
/end MEASUREMENT
/begin MEASUREMENT BypAirActr_flgOcErrCoil2 "Condition: Stepper coil over current error; coil 2" UBYTE B_TRUE 1 100 0.00 1.00000000000 BIT_MASK 0x1 FORMAT "%13.11" ECU_ADDRESS 0x4000882F
 /begin IF_DATA XCPplus 0x0102
  /begin DAQ_EVENT VARIABLE /begin AVAILABLE_EVENT_LIST EVENT 0 EVENT 1 EVENT 2 EVENT 3 /end AVAILABLE_EVENT_LIST /begin DEFAULT_EVENT_LIST EVENT 2 /end DEFAULT_EVENT_LIST /end DAQ_EVENT
 /end IF_DATA
/end MEASUREMENT
/begin MEASUREMENT BypAirActr_flgOcHealCfmdCoil1 "Condition: Over current confirmed heal for coil 1" UBYTE B_TRUE 1 100 0.00 1.00000000000 BIT_MASK 0x1 FORMAT "%13.11" ECU_ADDRESS 0x4000883D
 /begin IF_DATA XCPplus 0x0102
  /begin DAQ_EVENT VARIABLE /begin AVAILABLE_EVENT_LIST EVENT 0 EVENT 1 EVENT 2 EVENT 3 /end AVAILABLE_EVENT_LIST /begin DEFAULT_EVENT_LIST EVENT 2 /end DEFAULT_EVENT_LIST /end DAQ_EVENT
 /end IF_DATA
/end MEASUREMENT
/begin MEASUREMENT BypAirActr_flgOcHealCfmdCoil2 "Condition: Over current confirmed heal for coil 2" UBYTE B_TRUE 1 100 0.00 1.00000000000 BIT_MASK 0x1 FORMAT "%13.11" ECU_ADDRESS 0x4000884A
 /begin IF_DATA XCPplus 0x0102
  /begin DAQ_EVENT VARIABLE /begin AVAILABLE_EVENT_LIST EVENT 0 EVENT 1 EVENT 2 EVENT 3 /end AVAILABLE_EVENT_LIST /begin DEFAULT_EVENT_LIST EVENT 2 /end DEFAULT_EVENT_LIST /end DAQ_EVENT
 /end IF_DATA
/end MEASUREMENT
/begin MEASUREMENT BypAirActr_flgOcHealCoil1 "Condition: Stepper over current heal for coil 1" UBYTE B_TRUE 1 100 0.00 1.00000000000 BIT_MASK 0x1 FORMAT "%13.11" ECU_ADDRESS 0x4000882E
 /begin IF_DATA XCPplus 0x0102
  /begin DAQ_EVENT VARIABLE /begin AVAILABLE_EVENT_LIST EVENT 0 EVENT 1 EVENT 2 EVENT 3 /end AVAILABLE_EVENT_LIST /begin DEFAULT_EVENT_LIST EVENT 2 /end DEFAULT_EVENT_LIST /end DAQ_EVENT
 /end IF_DATA
/end MEASUREMENT
/begin MEASUREMENT BypAirActr_flgOcHealCoil2 "Condition: Stepper over current heal for coil 2" UBYTE B_TRUE 1 100 0.00 1.00000000000 BIT_MASK 0x1 FORMAT "%13.11" ECU_ADDRESS 0x4000882D
 /begin IF_DATA XCPplus 0x0102
  /begin DAQ_EVENT VARIABLE /begin AVAILABLE_EVENT_LIST EVENT 0 EVENT 1 EVENT 2 EVENT 3 /end AVAILABLE_EVENT_LIST /begin DEFAULT_EVENT_LIST EVENT 2 /end DEFAULT_EVENT_LIST /end DAQ_EVENT
 /end IF_DATA
/end MEASUREMENT
/begin MEASUREMENT BypAirActr_flgOlErrCoil1 "Condition: Stepper coil open load error; coil 1" UBYTE B_TRUE 1 100 0.00 1.00000000000 BIT_MASK 0x1 FORMAT "%13.11" ECU_ADDRESS 0x4000882C
 /begin IF_DATA XCPplus 0x0102
  /begin DAQ_EVENT VARIABLE /begin AVAILABLE_EVENT_LIST EVENT 0 EVENT 1 EVENT 2 EVENT 3 /end AVAILABLE_EVENT_LIST /begin DEFAULT_EVENT_LIST EVENT 2 /end DEFAULT_EVENT_LIST /end DAQ_EVENT
 /end IF_DATA
/end MEASUREMENT
/begin MEASUREMENT BypAirActr_flgOlErrCoil2 "Condition: Stepper coil open load error; coil 2" UBYTE B_TRUE 1 100 0.00 1.00000000000 BIT_MASK 0x1 FORMAT "%13.11" ECU_ADDRESS 0x4000882B
 /begin IF_DATA XCPplus 0x0102
  /begin DAQ_EVENT VARIABLE /begin AVAILABLE_EVENT_LIST EVENT 0 EVENT 1 EVENT 2 EVENT 3 /end AVAILABLE_EVENT_LIST /begin DEFAULT_EVENT_LIST EVENT 2 /end DEFAULT_EVENT_LIST /end DAQ_EVENT
 /end IF_DATA
/end MEASUREMENT
/begin MEASUREMENT BypAirActr_flgOlHealCoil1 "Condition: Stepper coil open load heal; coil 1" UBYTE B_TRUE 1 100 0.00 1.00000000000 BIT_MASK 0x1 FORMAT "%13.11" ECU_ADDRESS 0x4000882A
 /begin IF_DATA XCPplus 0x0102
  /begin DAQ_EVENT VARIABLE /begin AVAILABLE_EVENT_LIST EVENT 0 EVENT 1 EVENT 2 EVENT 3 /end AVAILABLE_EVENT_LIST /begin DEFAULT_EVENT_LIST EVENT 2 /end DEFAULT_EVENT_LIST /end DAQ_EVENT
 /end IF_DATA
/end MEASUREMENT
/begin MEASUREMENT BypAirActr_flgOlHealCoil2 "Condition: Stepper coil open load heal; coil 2" UBYTE B_TRUE 1 100 0.00 1.00000000000 BIT_MASK 0x1 FORMAT "%13.11" ECU_ADDRESS 0x40008829
 /begin IF_DATA XCPplus 0x0102
  /begin DAQ_EVENT VARIABLE /begin AVAILABLE_EVENT_LIST EVENT 0 EVENT 1 EVENT 2 EVENT 3 /end AVAILABLE_EVENT_LIST /begin DEFAULT_EVENT_LIST EVENT 2 /end DEFAULT_EVENT_LIST /end DAQ_EVENT
 /end IF_DATA
/end MEASUREMENT
/begin MEASUREMENT BypAirActr_flgOnStOLDiagAbort "Condition: By-Pass Air Actuator ON state diagnosis abort for open load error check" UBYTE B_TRUE 1 100 0.00 1.00000000000 BIT_MASK 0x1 FORMAT "%13.11" ECU_ADDRESS 0x40008861
 /begin IF_DATA XCPplus 0x0102
  /begin DAQ_EVENT VARIABLE /begin AVAILABLE_EVENT_LIST EVENT 0 EVENT 1 EVENT 2 EVENT 3 /end AVAILABLE_EVENT_LIST /begin DEFAULT_EVENT_LIST EVENT 2 /end DEFAULT_EVENT_LIST /end DAQ_EVENT
 /end IF_DATA
/end MEASUREMENT
/begin MEASUREMENT BypAirActr_flgOnStOLDiagRunng "Condition: By-Pass Air Actuator ON state diagnosis running for open load error check" UBYTE B_TRUE 1 100 0.00 1.00000000000 BIT_MASK 0x1 FORMAT "%13.11" ECU_ADDRESS 0x40008860
 /begin IF_DATA XCPplus 0x0102
  /begin DAQ_EVENT VARIABLE /begin AVAILABLE_EVENT_LIST EVENT 0 EVENT 1 EVENT 2 EVENT 3 /end AVAILABLE_EVENT_LIST /begin DEFAULT_EVENT_LIST EVENT 2 /end DEFAULT_EVENT_LIST /end DAQ_EVENT
 /end IF_DATA
/end MEASUREMENT
/begin MEASUREMENT BypAirActr_flgOtErr "Condition: Over temperature error" UBYTE B_TRUE 1 100 0.00 1.00000000000 BIT_MASK 0x1 FORMAT "%13.11" ECU_ADDRESS 0x40008828
 /begin IF_DATA XCPplus 0x0102
  /begin DAQ_EVENT VARIABLE /begin AVAILABLE_EVENT_LIST EVENT 0 EVENT 1 EVENT 2 EVENT 3 /end AVAILABLE_EVENT_LIST /begin DEFAULT_EVENT_LIST EVENT 2 /end DEFAULT_EVENT_LIST /end DAQ_EVENT
 /end IF_DATA
/end MEASUREMENT
/begin MEASUREMENT BypAirActr_flgOtHeal "Condition: Over temperature error healed" UBYTE B_TRUE 1 100 0.00 1.00000000000 BIT_MASK 0x1 FORMAT "%13.11" ECU_ADDRESS 0x40008827
 /begin IF_DATA XCPplus 0x0102
  /begin DAQ_EVENT VARIABLE /begin AVAILABLE_EVENT_LIST EVENT 0 EVENT 1 EVENT 2 EVENT 3 /end AVAILABLE_EVENT_LIST /begin DEFAULT_EVENT_LIST EVENT 2 /end DEFAULT_EVENT_LIST /end DAQ_EVENT
 /end IF_DATA
/end MEASUREMENT
/begin MEASUREMENT BypAirActr_flgPsElecErr "Condition: Stepper power stage electric error" UBYTE B_TRUE 1 100 0.00 1.00000000000 BIT_MASK 0x1 FORMAT "%13.11" ECU_ADDRESS 0x40008826
 /begin IF_DATA XCPplus 0x0102
  /begin DAQ_EVENT VARIABLE /begin AVAILABLE_EVENT_LIST EVENT 0 EVENT 1 EVENT 2 EVENT 3 /end AVAILABLE_EVENT_LIST /begin DEFAULT_EVENT_LIST EVENT 2 /end DEFAULT_EVENT_LIST /end DAQ_EVENT
 /end IF_DATA
/end MEASUREMENT
/begin MEASUREMENT BypAirActr_flgScbErrCfmdCoil1 "Condition: short circuit to battery confirmed error for coil 1" UBYTE B_TRUE 1 100 0.00 1.00000000000 BIT_MASK 0x1 FORMAT "%13.11" ECU_ADDRESS 0x4000883C
 /begin IF_DATA XCPplus 0x0102
  /begin DAQ_EVENT VARIABLE /begin AVAILABLE_EVENT_LIST EVENT 0 EVENT 1 EVENT 2 EVENT 3 /end AVAILABLE_EVENT_LIST /begin DEFAULT_EVENT_LIST EVENT 2 /end DEFAULT_EVENT_LIST /end DAQ_EVENT
 /end IF_DATA
/end MEASUREMENT
/begin MEASUREMENT BypAirActr_flgScbErrCfmdCoil2 "Condition: short circuit to battery confirmed error for coil 2" UBYTE B_TRUE 1 100 0.00 1.00000000000 BIT_MASK 0x1 FORMAT "%13.11" ECU_ADDRESS 0x40008849
 /begin IF_DATA XCPplus 0x0102
  /begin DAQ_EVENT VARIABLE /begin AVAILABLE_EVENT_LIST EVENT 0 EVENT 1 EVENT 2 EVENT 3 /end AVAILABLE_EVENT_LIST /begin DEFAULT_EVENT_LIST EVENT 2 /end DEFAULT_EVENT_LIST /end DAQ_EVENT
 /end IF_DATA
/end MEASUREMENT
/begin MEASUREMENT BypAirActr_flgScbErrCoil1 "Condition: Stepper coil short circuit to battery error; coil 1" UBYTE B_TRUE 1 100 0.00 1.00000000000 BIT_MASK 0x1 FORMAT "%13.11" ECU_ADDRESS 0x40008825
 /begin IF_DATA XCPplus 0x0102
  /begin DAQ_EVENT VARIABLE /begin AVAILABLE_EVENT_LIST EVENT 0 EVENT 1 EVENT 2 EVENT 3 /end AVAILABLE_EVENT_LIST /begin DEFAULT_EVENT_LIST EVENT 2 /end DEFAULT_EVENT_LIST /end DAQ_EVENT
 /end IF_DATA
/end MEASUREMENT
/begin MEASUREMENT BypAirActr_flgScbErrCoil2 "Condition: Stepper coil short circuit to battery error; coil 2" UBYTE B_TRUE 1 100 0.00 1.00000000000 BIT_MASK 0x1 FORMAT "%13.11" ECU_ADDRESS 0x40008824
 /begin IF_DATA XCPplus 0x0102
  /begin DAQ_EVENT VARIABLE /begin AVAILABLE_EVENT_LIST EVENT 0 EVENT 1 EVENT 2 EVENT 3 /end AVAILABLE_EVENT_LIST /begin DEFAULT_EVENT_LIST EVENT 2 /end DEFAULT_EVENT_LIST /end DAQ_EVENT
 /end IF_DATA
/end MEASUREMENT
/begin MEASUREMENT BypAirActr_flgScbHealCfmdCoil1 "Condition: short circuit to battery confirmed heal for coil 1" UBYTE B_TRUE 1 100 0.00 1.00000000000 BIT_MASK 0x1 FORMAT "%13.11" ECU_ADDRESS 0x4000883B
 /begin IF_DATA XCPplus 0x0102
  /begin DAQ_EVENT VARIABLE /begin AVAILABLE_EVENT_LIST EVENT 0 EVENT 1 EVENT 2 EVENT 3 /end AVAILABLE_EVENT_LIST /begin DEFAULT_EVENT_LIST EVENT 2 /end DEFAULT_EVENT_LIST /end DAQ_EVENT
 /end IF_DATA
/end MEASUREMENT
/begin MEASUREMENT BypAirActr_flgScbHealCfmdCoil2 "Condition: short circuit to battery confirmed heal for coil 2" UBYTE B_TRUE 1 100 0.00 1.00000000000 BIT_MASK 0x1 FORMAT "%13.11" ECU_ADDRESS 0x40008848
 /begin IF_DATA XCPplus 0x0102
  /begin DAQ_EVENT VARIABLE /begin AVAILABLE_EVENT_LIST EVENT 0 EVENT 1 EVENT 2 EVENT 3 /end AVAILABLE_EVENT_LIST /begin DEFAULT_EVENT_LIST EVENT 2 /end DEFAULT_EVENT_LIST /end DAQ_EVENT
 /end IF_DATA
/end MEASUREMENT
/begin MEASUREMENT BypAirActr_flgScbHealCoil1 "Condition: Stepper short to battery heal for coil 1" UBYTE B_TRUE 1 100 0.00 1.00000000000 BIT_MASK 0x1 FORMAT "%13.11" ECU_ADDRESS 0x40008823
 /begin IF_DATA XCPplus 0x0102
  /begin DAQ_EVENT VARIABLE /begin AVAILABLE_EVENT_LIST EVENT 0 EVENT 1 EVENT 2 EVENT 3 /end AVAILABLE_EVENT_LIST /begin DEFAULT_EVENT_LIST EVENT 2 /end DEFAULT_EVENT_LIST /end DAQ_EVENT
 /end IF_DATA
/end MEASUREMENT
/begin MEASUREMENT BypAirActr_flgScbHealCoil2 "Condition: Stepper short to battery heal for coil 2" UBYTE B_TRUE 1 100 0.00 1.00000000000 BIT_MASK 0x1 FORMAT "%13.11" ECU_ADDRESS 0x40008822
 /begin IF_DATA XCPplus 0x0102
  /begin DAQ_EVENT VARIABLE /begin AVAILABLE_EVENT_LIST EVENT 0 EVENT 1 EVENT 2 EVENT 3 /end AVAILABLE_EVENT_LIST /begin DEFAULT_EVENT_LIST EVENT 2 /end DEFAULT_EVENT_LIST /end DAQ_EVENT
 /end IF_DATA
/end MEASUREMENT
/begin MEASUREMENT BypAirActr_flgScgErrCfmdCoil1 "Condition: short circuit to ground confirmed error for coil 1" UBYTE B_TRUE 1 100 0.00 1.00000000000 BIT_MASK 0x1 FORMAT "%13.11" ECU_ADDRESS 0x40008838
 /begin IF_DATA XCPplus 0x0102
  /begin DAQ_EVENT VARIABLE /begin AVAILABLE_EVENT_LIST EVENT 0 EVENT 1 EVENT 2 EVENT 3 /end AVAILABLE_EVENT_LIST /begin DEFAULT_EVENT_LIST EVENT 2 /end DEFAULT_EVENT_LIST /end DAQ_EVENT
 /end IF_DATA
/end MEASUREMENT
/begin MEASUREMENT BypAirActr_flgScgErrCfmdCoil2 "Condition: short circuit to ground confirmed error for coil 2" UBYTE B_TRUE 1 100 0.00 1.00000000000 BIT_MASK 0x1 FORMAT "%13.11" ECU_ADDRESS 0x40008845
 /begin IF_DATA XCPplus 0x0102
  /begin DAQ_EVENT VARIABLE /begin AVAILABLE_EVENT_LIST EVENT 0 EVENT 1 EVENT 2 EVENT 3 /end AVAILABLE_EVENT_LIST /begin DEFAULT_EVENT_LIST EVENT 2 /end DEFAULT_EVENT_LIST /end DAQ_EVENT
 /end IF_DATA
/end MEASUREMENT
/begin MEASUREMENT BypAirActr_flgScgErrCoil1 "Condition: Stepper coil short circuit to ground error; coil 1" UBYTE B_TRUE 1 100 0.00 1.00000000000 BIT_MASK 0x1 FORMAT "%13.11" ECU_ADDRESS 0x40008821
 /begin IF_DATA XCPplus 0x0102
  /begin DAQ_EVENT VARIABLE /begin AVAILABLE_EVENT_LIST EVENT 0 EVENT 1 EVENT 2 EVENT 3 /end AVAILABLE_EVENT_LIST /begin DEFAULT_EVENT_LIST EVENT 2 /end DEFAULT_EVENT_LIST /end DAQ_EVENT
 /end IF_DATA
/end MEASUREMENT
/begin MEASUREMENT BypAirActr_flgScgErrCoil2 "Condition: Stepper coil short circuit to ground error; coil 2" UBYTE B_TRUE 1 100 0.00 1.00000000000 BIT_MASK 0x1 FORMAT "%13.11" ECU_ADDRESS 0x40008820
 /begin IF_DATA XCPplus 0x0102
  /begin DAQ_EVENT VARIABLE /begin AVAILABLE_EVENT_LIST EVENT 0 EVENT 1 EVENT 2 EVENT 3 /end AVAILABLE_EVENT_LIST /begin DEFAULT_EVENT_LIST EVENT 2 /end DEFAULT_EVENT_LIST /end DAQ_EVENT
 /end IF_DATA
/end MEASUREMENT
/begin MEASUREMENT BypAirActr_flgScgHealCfmdCoil1 "Condition: short circuit to ground confirmed heal for coil 1" UBYTE B_TRUE 1 100 0.00 1.00000000000 BIT_MASK 0x1 FORMAT "%13.11" ECU_ADDRESS 0x40008837
 /begin IF_DATA XCPplus 0x0102
  /begin DAQ_EVENT VARIABLE /begin AVAILABLE_EVENT_LIST EVENT 0 EVENT 1 EVENT 2 EVENT 3 /end AVAILABLE_EVENT_LIST /begin DEFAULT_EVENT_LIST EVENT 2 /end DEFAULT_EVENT_LIST /end DAQ_EVENT
 /end IF_DATA
/end MEASUREMENT
/begin MEASUREMENT BypAirActr_flgScgHealCfmdCoil2 "Condition: short circuit to ground confirmed heal for coil 2" UBYTE B_TRUE 1 100 0.00 1.00000000000 BIT_MASK 0x1 FORMAT "%13.11" ECU_ADDRESS 0x40008844
 /begin IF_DATA XCPplus 0x0102
  /begin DAQ_EVENT VARIABLE /begin AVAILABLE_EVENT_LIST EVENT 0 EVENT 1 EVENT 2 EVENT 3 /end AVAILABLE_EVENT_LIST /begin DEFAULT_EVENT_LIST EVENT 2 /end DEFAULT_EVENT_LIST /end DAQ_EVENT
 /end IF_DATA
/end MEASUREMENT
/begin MEASUREMENT BypAirActr_flgScgHealCoil1 "Condition: Stepper short to ground heal for coil 1" UBYTE B_TRUE 1 100 0.00 1.00000000000 BIT_MASK 0x1 FORMAT "%13.11" ECU_ADDRESS 0x4000881F
 /begin IF_DATA XCPplus 0x0102
  /begin DAQ_EVENT VARIABLE /begin AVAILABLE_EVENT_LIST EVENT 0 EVENT 1 EVENT 2 EVENT 3 /end AVAILABLE_EVENT_LIST /begin DEFAULT_EVENT_LIST EVENT 2 /end DEFAULT_EVENT_LIST /end DAQ_EVENT
 /end IF_DATA
/end MEASUREMENT
/begin MEASUREMENT BypAirActr_flgScgHealCoil2 "Condition: Stepper short to ground heal for coil 2" UBYTE B_TRUE 1 100 0.00 1.00000000000 BIT_MASK 0x1 FORMAT "%13.11" ECU_ADDRESS 0x4000881E
 /begin IF_DATA XCPplus 0x0102
  /begin DAQ_EVENT VARIABLE /begin AVAILABLE_EVENT_LIST EVENT 0 EVENT 1 EVENT 2 EVENT 3 /end AVAILABLE_EVENT_LIST /begin DEFAULT_EVENT_LIST EVENT 2 /end DEFAULT_EVENT_LIST /end DAQ_EVENT
 /end IF_DATA
/end MEASUREMENT
/begin MEASUREMENT BypAirActr_Step "bypass air actuator steps for actuation" SWORD dez 1 100 -32768.00 32767.00 FORMAT "%8.2" ECU_ADDRESS 0x40008496
 /begin IF_DATA XCPplus 0x0102
  /begin DAQ_EVENT VARIABLE /begin AVAILABLE_EVENT_LIST EVENT 0 EVENT 1 EVENT 2 EVENT 3 /end AVAILABLE_EVENT_LIST /begin DEFAULT_EVENT_LIST EVENT 1 /end DEFAULT_EVENT_LIST /end DAQ_EVENT
 /end IF_DATA
/end MEASUREMENT
/begin MEASUREMENT BypAirActr_stErrObsCoil1 "By-Pass Air Actuator error status observer for coil1" UBYTE dez 1 100 0.00 255.0 FORMAT "%5.1" ECU_ADDRESS 0x40008856
 /begin IF_DATA XCPplus 0x0102
  /begin DAQ_EVENT VARIABLE /begin AVAILABLE_EVENT_LIST EVENT 0 EVENT 1 EVENT 2 EVENT 3 /end AVAILABLE_EVENT_LIST /begin DEFAULT_EVENT_LIST EVENT 2 /end DEFAULT_EVENT_LIST /end DAQ_EVENT
 /end IF_DATA
/end MEASUREMENT
/begin MEASUREMENT BypAirActr_stErrObsCoil2 "By-Pass Air Actuator error status observer for coil2" UBYTE dez 1 100 0.00 255.0 FORMAT "%5.1" ECU_ADDRESS 0x40008855
 /begin IF_DATA XCPplus 0x0102
  /begin DAQ_EVENT VARIABLE /begin AVAILABLE_EVENT_LIST EVENT 0 EVENT 1 EVENT 2 EVENT 3 /end AVAILABLE_EVENT_LIST /begin DEFAULT_EVENT_LIST EVENT 2 /end DEFAULT_EVENT_LIST /end DAQ_EVENT
 /end IF_DATA
/end MEASUREMENT
/begin MEASUREMENT BypAirActr_stTstSucCoil1 "By-Pass Air Actuator status test success coil1" UBYTE dez 1 100 0.00 255.0 FORMAT "%5.1" ECU_ADDRESS 0x40008854
 /begin IF_DATA XCPplus 0x0102
  /begin DAQ_EVENT VARIABLE /begin AVAILABLE_EVENT_LIST EVENT 0 EVENT 1 EVENT 2 EVENT 3 /end AVAILABLE_EVENT_LIST /begin DEFAULT_EVENT_LIST EVENT 2 /end DEFAULT_EVENT_LIST /end DAQ_EVENT
 /end IF_DATA
/end MEASUREMENT
/begin MEASUREMENT BypAirActr_stTstSucCoil2 "By-Pass Air Actuator status test success coil2" UBYTE dez 1 100 0.00 255.0 FORMAT "%5.1" ECU_ADDRESS 0x40008853
 /begin IF_DATA XCPplus 0x0102
  /begin DAQ_EVENT VARIABLE /begin AVAILABLE_EVENT_LIST EVENT 0 EVENT 1 EVENT 2 EVENT 3 /end AVAILABLE_EVENT_LIST /begin DEFAULT_EVENT_LIST EVENT 2 /end DEFAULT_EVENT_LIST /end DAQ_EVENT
 /end IF_DATA
/end MEASUREMENT
/begin MEASUREMENT B_closestp "Condition stepper close" UBYTE B_TRUE 1 100 0.00 1.00000000000 BIT_MASK 0x1 FORMAT "%13.11" ECU_ADDRESS 0x40008877
 /begin IF_DATA XCPplus 0x0102
  /begin DAQ_EVENT VARIABLE /begin AVAILABLE_EVENT_LIST EVENT 0 EVENT 1 EVENT 2 EVENT 3 /end AVAILABLE_EVENT_LIST /begin DEFAULT_EVENT_LIST EVENT 1 /end DEFAULT_EVENT_LIST /end DAQ_EVENT
 /end IF_DATA
/end MEASUREMENT
/begin MEASUREMENT B_deseehr_msg "Diagnosis power stage after the main Relay: entry conditions fulfilled" UBYTE B_TRUE 1 100 0.00 1.00000000000 BIT_MASK 0x1 FORMAT "%13.11" ECU_ADDRESS 0x40006390
 /begin IF_DATA XCPplus 0x0102
  /begin DAQ_EVENT VARIABLE /begin AVAILABLE_EVENT_LIST EVENT 0 EVENT 1 EVENT 2 EVENT 3 /end AVAILABLE_EVENT_LIST /begin DEFAULT_EVENT_LIST EVENT 2 /end DEFAULT_EVENT_LIST /end DAQ_EVENT
 /end IF_DATA
/end MEASUREMENT
/begin MEASUREMENT B_desee_msg "Diagnosis power stages, entry conditions fulfilled" UBYTE B_TRUE 1 100 0.00 1.00000000000 BIT_MASK 0x1 FORMAT "%13.11" ECU_ADDRESS 0x40006391
 /begin IF_DATA XCPplus 0x0102
  /begin DAQ_EVENT VARIABLE /begin AVAILABLE_EVENT_LIST EVENT 0 EVENT 1 EVENT 2 EVENT 3 /end AVAILABLE_EVENT_LIST /begin DEFAULT_EVENT_LIST EVENT 2 /end DEFAULT_EVENT_LIST /end DAQ_EVENT
 /end IF_DATA
/end MEASUREMENT
/begin MEASUREMENT B_eev "condition injector fault (power stage)" UBYTE B_TRUE 1 100 0.00 1.00000000000 BIT_MASK 0x1 FORMAT "%13.11" ECU_ADDRESS 0x4000645B
 /begin IF_DATA XCPplus 0x0102
  /begin DAQ_EVENT VARIABLE /begin AVAILABLE_EVENT_LIST EVENT 0 EVENT 1 EVENT 2 EVENT 3 /end AVAILABLE_EVENT_LIST /begin DEFAULT_EVENT_LIST EVENT 2 /end DEFAULT_EVENT_LIST /end DAQ_EVENT
 /end IF_DATA
/end MEASUREMENT
/begin MEASUREMENT B_ellr "Condition: error report from functional diag" UBYTE B_TRUE 1 100 0.00 1.00000000000 BIT_MASK 0x1 FORMAT "%13.11" ECU_ADDRESS 0x40008872
 /begin IF_DATA XCPplus 0x0102
  /begin DAQ_EVENT VARIABLE /begin AVAILABLE_EVENT_LIST EVENT 0 EVENT 1 EVENT 2 EVENT 3 /end AVAILABLE_EVENT_LIST /begin DEFAULT_EVENT_LIST EVENT 1 /end DEFAULT_EVENT_LIST /end DAQ_EVENT
 /end IF_DATA
/end MEASUREMENT
/begin MEASUREMENT B_ellse "Condition: electrical error idle speed actuator" UBYTE B_TRUE 1 100 0.00 1.00000000000 BIT_MASK 0x1 FORMAT "%13.11" ECU_ADDRESS 0x4000881D
 /begin IF_DATA XCPplus 0x0102
  /begin DAQ_EVENT VARIABLE /begin AVAILABLE_EVENT_LIST EVENT 0 EVENT 1 EVENT 2 EVENT 3 /end AVAILABLE_EVENT_LIST /begin DEFAULT_EVENT_LIST EVENT 2 /end DEFAULT_EVENT_LIST /end DAQ_EVENT
 /end IF_DATA
/end MEASUREMENT
/begin MEASUREMENT B_enghrste "Bit to indicate the engine hours" UBYTE B_TRUE 1 100 0.00 1.00000000000 BIT_MASK 0x1 FORMAT "%13.11" ECU_ADDRESS 0x40008723
 /begin IF_DATA XCPplus 0x0102
  /begin DAQ_EVENT VARIABLE /begin AVAILABLE_EVENT_LIST EVENT 0 EVENT 1 EVENT 2 EVENT 3 /end AVAILABLE_EVENT_LIST /begin DEFAULT_EVENT_LIST EVENT 1 /end DEFAULT_EVENT_LIST /end DAQ_EVENT
 /end IF_DATA
/end MEASUREMENT
/begin MEASUREMENT B_frqincr "condition : trigger for stepper motor activation frequency counter" UBYTE B_TRUE 1 100 0.00 1.00000000000 BIT_MASK 0x1 FORMAT "%13.11" ECU_ADDRESS 0x4000887B
 /begin IF_DATA XCPplus 0x0102
  /begin DAQ_EVENT VARIABLE /begin AVAILABLE_EVENT_LIST EVENT 0 EVENT 1 EVENT 2 EVENT 3 /end AVAILABLE_EVENT_LIST /begin DEFAULT_EVENT_LIST EVENT 1 /end DEFAULT_EVENT_LIST /end DAQ_EVENT
 /end IF_DATA
/end MEASUREMENT
/begin MEASUREMENT B_lelshbb "Error lambda sensor downstream main-catalyst, resetting operational readiness" UBYTE B_TRUE 1 100 0.00 1.00000000000 BIT_MASK 0x1 FORMAT "%13.11" ECU_ADDRESS 0x40008882
 /begin IF_DATA XCPplus 0x0102
  /begin DAQ_EVENT VARIABLE /begin AVAILABLE_EVENT_LIST EVENT 0 EVENT 1 EVENT 2 EVENT 3 /end AVAILABLE_EVENT_LIST /begin DEFAULT_EVENT_LIST EVENT 2 /end DEFAULT_EVENT_LIST /end DAQ_EVENT
 /end IF_DATA
/end MEASUREMENT
/begin MEASUREMENT B_lelsxbb "Error first LS resetting operational readiness (local)" UBYTE B_TRUE 1 100 0.00 1.00000000000 BIT_MASK 0x2 FORMAT "%13.11" ECU_ADDRESS 0x40008882
 /begin IF_DATA XCPplus 0x0102
  /begin DAQ_EVENT VARIABLE /begin AVAILABLE_EVENT_LIST EVENT 0 EVENT 1 EVENT 2 EVENT 3 /end AVAILABLE_EVENT_LIST /begin DEFAULT_EVENT_LIST EVENT 2 /end DEFAULT_EVENT_LIST /end DAQ_EVENT
 /end IF_DATA
/end MEASUREMENT
/begin MEASUREMENT B_lelsxnb "Error first lambda sensor, not resetting operational readiness" UBYTE B_TRUE 1 100 0.00 1.00000000000 BIT_MASK 0x4 FORMAT "%13.11" ECU_ADDRESS 0x40008882
 /begin IF_DATA XCPplus 0x0102
  /begin DAQ_EVENT VARIABLE /begin AVAILABLE_EVENT_LIST EVENT 0 EVENT 1 EVENT 2 EVENT 3 /end AVAILABLE_EVENT_LIST /begin DEFAULT_EVENT_LIST EVENT 2 /end DEFAULT_EVENT_LIST /end DAQ_EVENT
 /end IF_DATA
/end MEASUREMENT
/begin MEASUREMENT B_lrnfgstp "Condition: IAC learning complete" UBYTE B_TRUE 1 100 0.00 1.00000000000 BIT_MASK 0x1 FORMAT "%13.11" ECU_ADDRESS 0x40008871
 /begin IF_DATA XCPplus 0x0102
  /begin DAQ_EVENT VARIABLE /begin AVAILABLE_EVENT_LIST EVENT 0 EVENT 1 EVENT 2 EVENT 3 /end AVAILABLE_EVENT_LIST /begin DEFAULT_EVENT_LIST EVENT 1 /end DEFAULT_EVENT_LIST /end DAQ_EVENT
 /end IF_DATA
/end MEASUREMENT
/begin MEASUREMENT B_lrnpost "Condition : Stepper learning completion" UBYTE B_TRUE 1 100 0.00 1.00000000000 BIT_MASK 0x1 FORMAT "%13.11" ECU_ADDRESS 0x4000C70D
 /begin IF_DATA XCPplus 0x0102
  /begin DAQ_EVENT VARIABLE /begin AVAILABLE_EVENT_LIST EVENT 0 EVENT 1 EVENT 2 EVENT 3 /end AVAILABLE_EVENT_LIST /begin DEFAULT_EVENT_LIST EVENT 1 /end DEFAULT_EVENT_LIST /end DAQ_EVENT
 /end IF_DATA
/end MEASUREMENT
/begin MEASUREMENT B_lrnstperf "Desired position of stepper motor(steps)" UBYTE B_TRUE 1 100 0.00 1.00000000000 BIT_MASK 0x1 FORMAT "%13.11" ECU_ADDRESS 0x4000C70C
 /begin IF_DATA XCPplus 0x0102
  /begin DAQ_EVENT VARIABLE /begin AVAILABLE_EVENT_LIST EVENT 0 EVENT 1 EVENT 2 EVENT 3 /end AVAILABLE_EVENT_LIST /begin DEFAULT_EVENT_LIST EVENT 1 /end DEFAULT_EVENT_LIST /end DAQ_EVENT
 /end IF_DATA
/end MEASUREMENT
/begin MEASUREMENT B_lrnstpfgrly "condition: stepper feedback for starter engagement" UBYTE B_TRUE 1 100 0.00 1.00000000000 BIT_MASK 0x1 FORMAT "%13.11" ECU_ADDRESS 0x40008870
 /begin IF_DATA XCPplus 0x0102
  /begin DAQ_EVENT VARIABLE /begin AVAILABLE_EVENT_LIST EVENT 0 EVENT 1 EVENT 2 EVENT 3 /end AVAILABLE_EVENT_LIST /begin DEFAULT_EVENT_LIST EVENT 1 /end DEFAULT_EVENT_LIST /end DAQ_EVENT
 /end IF_DATA
/end MEASUREMENT
/begin MEASUREMENT B_openstp "Condition stepper open" UBYTE B_TRUE 1 100 0.00 1.00000000000 BIT_MASK 0x1 FORMAT "%13.11" ECU_ADDRESS 0x40008876
 /begin IF_DATA XCPplus 0x0102
  /begin DAQ_EVENT VARIABLE /begin AVAILABLE_EVENT_LIST EVENT 0 EVENT 1 EVENT 2 EVENT 3 /end AVAILABLE_EVENT_LIST /begin DEFAULT_EVENT_LIST EVENT 1 /end DEFAULT_EVENT_LIST /end DAQ_EVENT
 /end IF_DATA
/end MEASUREMENT
/begin MEASUREMENT B_PmdInit_msg "Reset of standard powerstage diagnosis required" UBYTE B_TRUE 1 100 0.00 1.00000000000 BIT_MASK 0x1 FORMAT "%13.11" ECU_ADDRESS 0x40006392
 /begin IF_DATA XCPplus 0x0102
  /begin DAQ_EVENT VARIABLE /begin AVAILABLE_EVENT_LIST EVENT 0 EVENT 1 EVENT 2 EVENT 3 /end AVAILABLE_EVENT_LIST /begin DEFAULT_EVENT_LIST EVENT 2 /end DEFAULT_EVENT_LIST /end DAQ_EVENT
 /end IF_DATA
/end MEASUREMENT
/begin MEASUREMENT B_pos_ok "status bit: actual position of stepper is same as set value" UBYTE B_TRUE 1 100 0.00 1.00000000000 BIT_MASK 0x1 FORMAT "%13.11" ECU_ADDRESS 0x4000886F
 /begin IF_DATA XCPplus 0x0102
  /begin DAQ_EVENT VARIABLE /begin AVAILABLE_EVENT_LIST EVENT 0 EVENT 1 EVENT 2 EVENT 3 /end AVAILABLE_EVENT_LIST /begin DEFAULT_EVENT_LIST EVENT 1 /end DEFAULT_EVENT_LIST /end DAQ_EVENT
 /end IF_DATA
/end MEASUREMENT
/begin MEASUREMENT B_pslrnstp "condition for post drive mechanical limit learning activation" UBYTE B_TRUE 1 100 0.00 1.00000000000 BIT_MASK 0x1 FORMAT "%13.11" ECU_ADDRESS 0x4000886E
 /begin IF_DATA XCPplus 0x0102
  /begin DAQ_EVENT VARIABLE /begin AVAILABLE_EVENT_LIST EVENT 0 EVENT 1 EVENT 2 EVENT 3 /end AVAILABLE_EVENT_LIST /begin DEFAULT_EVENT_LIST EVENT 1 /end DEFAULT_EVENT_LIST /end DAQ_EVENT
 /end IF_DATA
/end MEASUREMENT
/begin MEASUREMENT B_resfrq "Condition: resonance frequency operation active for stepper control" UBYTE B_TRUE 1 100 0.00 1.00000000000 BIT_MASK 0x1 FORMAT "%13.11" ECU_ADDRESS 0x4000887C
 /begin IF_DATA XCPplus 0x0102
  /begin DAQ_EVENT VARIABLE /begin AVAILABLE_EVENT_LIST EVENT 0 EVENT 1 EVENT 2 EVENT 3 /end AVAILABLE_EVENT_LIST /begin DEFAULT_EVENT_LIST EVENT 1 /end DEFAULT_EVENT_LIST /end DAQ_EVENT
 /end IF_DATA
/end MEASUREMENT
/begin MEASUREMENT B_stepcmdactv "Condition : trigger signal for activation of stepper motor coil" UBYTE B_TRUE 1 100 0.00 1.00000000000 BIT_MASK 0x1 FORMAT "%13.11" ECU_ADDRESS 0x4000886D
 /begin IF_DATA XCPplus 0x0102
  /begin DAQ_EVENT VARIABLE /begin AVAILABLE_EVENT_LIST EVENT 0 EVENT 1 EVENT 2 EVENT 3 /end AVAILABLE_EVENT_LIST /begin DEFAULT_EVENT_LIST EVENT 1 /end DEFAULT_EVENT_LIST /end DAQ_EVENT
 /end IF_DATA
/end MEASUREMENT
/begin MEASUREMENT B_stpadap "status bit: request for step loss adaptation" UBYTE B_TRUE 1 100 0.00 1.00000000000 BIT_MASK 0x1 FORMAT "%13.11" ECU_ADDRESS 0x4000886C
 /begin IF_DATA XCPplus 0x0102
  /begin DAQ_EVENT VARIABLE /begin AVAILABLE_EVENT_LIST EVENT 0 EVENT 1 EVENT 2 EVENT 3 /end AVAILABLE_EVENT_LIST /begin DEFAULT_EVENT_LIST EVENT 1 /end DEFAULT_EVENT_LIST /end DAQ_EVENT
 /end IF_DATA
/end MEASUREMENT
/begin MEASUREMENT B_stpadapen "Condition : trigger signal for activation of step loss adaptation" UBYTE B_TRUE 1 100 0.00 1.00000000000 BIT_MASK 0x1 FORMAT "%13.11" ECU_ADDRESS 0x4000886B
 /begin IF_DATA XCPplus 0x0102
  /begin DAQ_EVENT VARIABLE /begin AVAILABLE_EVENT_LIST EVENT 0 EVENT 1 EVENT 2 EVENT 3 /end AVAILABLE_EVENT_LIST /begin DEFAULT_EVENT_LIST EVENT 1 /end DEFAULT_EVENT_LIST /end DAQ_EVENT
 /end IF_DATA
/end MEASUREMENT
/begin MEASUREMENT B_stpadapfg "status bit: completion of step loss adaptation" UBYTE B_TRUE 1 100 0.00 1.00000000000 BIT_MASK 0x1 FORMAT "%13.11" ECU_ADDRESS 0x4000886A
 /begin IF_DATA XCPplus 0x0102
  /begin DAQ_EVENT VARIABLE /begin AVAILABLE_EVENT_LIST EVENT 0 EVENT 1 EVENT 2 EVENT 3 /end AVAILABLE_EVENT_LIST /begin DEFAULT_EVENT_LIST EVENT 1 /end DEFAULT_EVENT_LIST /end DAQ_EVENT
 /end IF_DATA
/end MEASUREMENT
/begin MEASUREMENT B_stpclose "status bit: request for stepper to move in close direction" UBYTE B_TRUE 1 100 0.00 1.00000000000 BIT_MASK 0x1 FORMAT "%13.11" ECU_ADDRESS 0x40008878
 /begin IF_DATA XCPplus 0x0102
  /begin DAQ_EVENT VARIABLE /begin AVAILABLE_EVENT_LIST EVENT 0 EVENT 1 EVENT 2 EVENT 3 /end AVAILABLE_EVENT_LIST /begin DEFAULT_EVENT_LIST EVENT 1 /end DEFAULT_EVENT_LIST /end DAQ_EVENT
 /end IF_DATA
/end MEASUREMENT
/begin MEASUREMENT B_stpclsreq "status bit: request for the stepper to move in close direction" UBYTE B_TRUE 1 100 0.00 1.00000000000 BIT_MASK 0x1 FORMAT "%13.11" ECU_ADDRESS 0x40008869
 /begin IF_DATA XCPplus 0x0102
  /begin DAQ_EVENT VARIABLE /begin AVAILABLE_EVENT_LIST EVENT 0 EVENT 1 EVENT 2 EVENT 3 /end AVAILABLE_EVENT_LIST /begin DEFAULT_EVENT_LIST EVENT 1 /end DEFAULT_EVENT_LIST /end DAQ_EVENT
 /end IF_DATA
/end MEASUREMENT
/begin MEASUREMENT B_stpcoiloff "status bit: request for stepper for power save active" UBYTE B_TRUE 1 100 0.00 1.00000000000 BIT_MASK 0x1 FORMAT "%13.11" ECU_ADDRESS 0x40008868
 /begin IF_DATA XCPplus 0x0102
  /begin DAQ_EVENT VARIABLE /begin AVAILABLE_EVENT_LIST EVENT 0 EVENT 1 EVENT 2 EVENT 3 /end AVAILABLE_EVENT_LIST /begin DEFAULT_EVENT_LIST EVENT 1 /end DEFAULT_EVENT_LIST /end DAQ_EVENT
 /end IF_DATA
/end MEASUREMENT
/begin MEASUREMENT B_stplossadp "status bit: step loss correction mode active" UBYTE B_TRUE 1 100 0.00 1.00000000000 BIT_MASK 0x1 FORMAT "%13.11" ECU_ADDRESS 0x40008867
 /begin IF_DATA XCPplus 0x0102
  /begin DAQ_EVENT VARIABLE /begin AVAILABLE_EVENT_LIST EVENT 0 EVENT 1 EVENT 2 EVENT 3 /end AVAILABLE_EVENT_LIST /begin DEFAULT_EVENT_LIST EVENT 1 /end DEFAULT_EVENT_LIST /end DAQ_EVENT
 /end IF_DATA
/end MEASUREMENT
/begin MEASUREMENT B_stpmechlim "status bit: request for the operation with mechanical limit frequency for stepper" UBYTE B_TRUE 1 100 0.00 1.00000000000 BIT_MASK 0x1 FORMAT "%13.11" ECU_ADDRESS 0x4000887A
 /begin IF_DATA XCPplus 0x0102
  /begin DAQ_EVENT VARIABLE /begin AVAILABLE_EVENT_LIST EVENT 0 EVENT 1 EVENT 2 EVENT 3 /end AVAILABLE_EVENT_LIST /begin DEFAULT_EVENT_LIST EVENT 1 /end DEFAULT_EVENT_LIST /end DAQ_EVENT
 /end IF_DATA
/end MEASUREMENT
/begin MEASUREMENT B_stpopen "status bit: request for stepper to move in open direction" UBYTE B_TRUE 1 100 0.00 1.00000000000 BIT_MASK 0x1 FORMAT "%13.11" ECU_ADDRESS 0x40008879
 /begin IF_DATA XCPplus 0x0102
  /begin DAQ_EVENT VARIABLE /begin AVAILABLE_EVENT_LIST EVENT 0 EVENT 1 EVENT 2 EVENT 3 /end AVAILABLE_EVENT_LIST /begin DEFAULT_EVENT_LIST EVENT 1 /end DEFAULT_EVENT_LIST /end DAQ_EVENT
 /end IF_DATA
/end MEASUREMENT
/begin MEASUREMENT B_stpopenreq "status bit: request for the stepper to move in open direction" UBYTE B_TRUE 1 100 0.00 1.00000000000 BIT_MASK 0x1 FORMAT "%13.11" ECU_ADDRESS 0x40008866
 /begin IF_DATA XCPplus 0x0102
  /begin DAQ_EVENT VARIABLE /begin AVAILABLE_EVENT_LIST EVENT 0 EVENT 1 EVENT 2 EVENT 3 /end AVAILABLE_EVENT_LIST /begin DEFAULT_EVENT_LIST EVENT 1 /end DEFAULT_EVENT_LIST /end DAQ_EVENT
 /end IF_DATA
/end MEASUREMENT
/begin MEASUREMENT B_stppostfg "status bit: stepper movement completion in post drive" UBYTE B_TRUE 1 100 0.00 1.00000000000 BIT_MASK 0x1 FORMAT "%13.11" ECU_ADDRESS 0x40008865
 /begin IF_DATA XCPplus 0x0102
  /begin DAQ_EVENT VARIABLE /begin AVAILABLE_EVENT_LIST EVENT 0 EVENT 1 EVENT 2 EVENT 3 /end AVAILABLE_EVENT_LIST /begin DEFAULT_EVENT_LIST EVENT 1 /end DEFAULT_EVENT_LIST /end DAQ_EVENT
 /end IF_DATA
/end MEASUREMENT
/begin MEASUREMENT B_stpren "Condition: IAC learning complete" UBYTE B_TRUE 1 100 0.00 1.00000000000 BIT_MASK 0x1 FORMAT "%13.11" ECU_ADDRESS 0x40008864
 /begin IF_DATA XCPplus 0x0102
  /begin DAQ_EVENT VARIABLE /begin AVAILABLE_EVENT_LIST EVENT 0 EVENT 1 EVENT 2 EVENT 3 /end AVAILABLE_EVENT_LIST /begin DEFAULT_EVENT_LIST EVENT 1 /end DEFAULT_EVENT_LIST /end DAQ_EVENT
 /end IF_DATA
/end MEASUREMENT
/begin MEASUREMENT B_stpsap "Condition application stepper function" UBYTE B_TRUE 1 100 0.00 1.00000000000 BIT_MASK 0x1 FORMAT "%13.11" ECU_ADDRESS 0x40008863
 /begin IF_DATA XCPplus 0x0102
  /begin DAQ_EVENT VARIABLE /begin AVAILABLE_EVENT_LIST EVENT 0 EVENT 1 EVENT 2 EVENT 3 /end AVAILABLE_EVENT_LIST /begin DEFAULT_EVENT_LIST EVENT 1 /end DEFAULT_EVENT_LIST /end DAQ_EVENT
 /end IF_DATA
/end MEASUREMENT
/begin MEASUREMENT B_stpuboff "control indicating battery voltage below or above threshold voltage range." UBYTE B_TRUE 1 100 0.00 1.00000000000 BIT_MASK 0x1 FORMAT "%13.11" ECU_ADDRESS 0x40008862
 /begin IF_DATA XCPplus 0x0102
  /begin DAQ_EVENT VARIABLE /begin AVAILABLE_EVENT_LIST EVENT 0 EVENT 1 EVENT 2 EVENT 3 /end AVAILABLE_EVENT_LIST /begin DEFAULT_EVENT_LIST EVENT 1 /end DEFAULT_EVENT_LIST /end DAQ_EVENT
 /end IF_DATA
/end MEASUREMENT
/begin MEASUREMENT B_ubsqmn "Condition battery voltage is lower than thershold for stepper activation" UBYTE B_TRUE 1 100 0.00 1.00000000000 BIT_MASK 0x1 FORMAT "%13.11" ECU_ADDRESS 0x40008875
 /begin IF_DATA XCPplus 0x0102
  /begin DAQ_EVENT VARIABLE /begin AVAILABLE_EVENT_LIST EVENT 0 EVENT 1 EVENT 2 EVENT 3 /end AVAILABLE_EVENT_LIST /begin DEFAULT_EVENT_LIST EVENT 1 /end DEFAULT_EVENT_LIST /end DAQ_EVENT
 /end IF_DATA
/end MEASUREMENT
/begin MEASUREMENT B_ubsqmx "Condition battery voltage is above than thershold for stepper activation" UBYTE B_TRUE 1 100 0.00 1.00000000000 BIT_MASK 0x1 FORMAT "%13.11" ECU_ADDRESS 0x40008874
 /begin IF_DATA XCPplus 0x0102
  /begin DAQ_EVENT VARIABLE /begin AVAILABLE_EVENT_LIST EVENT 0 EVENT 1 EVENT 2 EVENT 3 /end AVAILABLE_EVENT_LIST /begin DEFAULT_EVENT_LIST EVENT 1 /end DEFAULT_EVENT_LIST /end DAQ_EVENT
 /end IF_DATA
/end MEASUREMENT
/begin MEASUREMENT CALDATAVN_r "calibration version ECUId" UBYTE dez 1 100 0.00 255.0 FORMAT "%5.1" ARRAY_SIZE 16 ECU_ADDRESS 0x40008750
 /begin IF_DATA XCPplus 0x0102
  /begin DAQ_EVENT VARIABLE /begin AVAILABLE_EVENT_LIST EVENT 0 EVENT 1 EVENT 2 EVENT 3 /end AVAILABLE_EVENT_LIST /begin DEFAULT_EVENT_LIST EVENT 1 /end DEFAULT_EVENT_LIST /end DAQ_EVENT
 /end IF_DATA
/end MEASUREMENT
/begin MEASUREMENT CoEng_bObdTmrInctg "On Board Diagnostic timer is incrementing" UBYTE OneToOne 1 100 0.00 1.000 BIT_MASK 0x1 FORMAT "%5.3" ECU_ADDRESS 0x40006415
 /begin IF_DATA XCPplus 0x0102
  /begin DAQ_EVENT VARIABLE /begin AVAILABLE_EVENT_LIST EVENT 0 EVENT 1 EVENT 2 EVENT 3 /end AVAILABLE_EVENT_LIST /begin DEFAULT_EVENT_LIST EVENT 1 /end DEFAULT_EVENT_LIST /end DAQ_EVENT
 /end IF_DATA
/end MEASUREMENT
/begin MEASUREMENT CoEng_st "Engine operation status" UBYTE CoEng_st_COMPU_VERB 1 100 0.00 5.00000000000 FORMAT "%13.11" ECU_ADDRESS 0x400063E1
 /begin IF_DATA XCPplus 0x0102
  /begin DAQ_EVENT VARIABLE /begin AVAILABLE_EVENT_LIST EVENT 0 EVENT 1 EVENT 2 EVENT 3 /end AVAILABLE_EVENT_LIST /begin DEFAULT_EVENT_LIST EVENT 1 /end DEFAULT_EVENT_LIST /end DAQ_EVENT
 /end IF_DATA
/end MEASUREMENT
/begin MEASUREMENT CoEng_stOld "engine state before current state was reached" UBYTE CoEng_st_COMPU_VERB 1 100 0.00 5.00000000000 FORMAT "%13.11" ECU_ADDRESS 0x400063E0
 /begin IF_DATA XCPplus 0x0102
  /begin DAQ_EVENT VARIABLE /begin AVAILABLE_EVENT_LIST EVENT 0 EVENT 1 EVENT 2 EVENT 3 /end AVAILABLE_EVENT_LIST /begin DEFAULT_EVENT_LIST EVENT 1 /end DEFAULT_EVENT_LIST /end DAQ_EVENT
 /end IF_DATA
/end MEASUREMENT
/begin MEASUREMENT CoEng_tiNormalOBD "Engine running time - for OBD requirement" ULONG Time_sec_q1_COMPU 1 100 0.00 65535.0000000 FORMAT "%13.7" ECU_ADDRESS 0x400048C8
 /begin IF_DATA XCPplus 0x0102
  /begin DAQ_EVENT VARIABLE /begin AVAILABLE_EVENT_LIST EVENT 0 EVENT 1 EVENT 2 EVENT 3 /end AVAILABLE_EVENT_LIST /begin DEFAULT_EVENT_LIST EVENT 1 /end DEFAULT_EVENT_LIST /end DAQ_EVENT
 /end IF_DATA
/end MEASUREMENT
/begin MEASUREMENT coilnum "Temporary variable used to identify the coil number" UBYTE dez 1 100 0.00 255.0 FORMAT "%5.1" ECU_ADDRESS 0x4000887D
 /begin IF_DATA XCPplus 0x0102
  /begin DAQ_EVENT VARIABLE /begin AVAILABLE_EVENT_LIST EVENT 0 EVENT 1 EVENT 2 EVENT 3 /end AVAILABLE_EVENT_LIST /begin DEFAULT_EVENT_LIST EVENT 1 /end DEFAULT_EVENT_LIST /end DAQ_EVENT
 /end IF_DATA
/end MEASUREMENT
/begin MEASUREMENT ComDia_flgTPSLrnEnbl "Flag to indicate Tester request for Restarting TPS learning" UBYTE B_TRUE 1 100 0.00 1.00000000000 BIT_MASK 0x1 FORMAT "%13.11" ECU_ADDRESS 0x40006414
 /begin IF_DATA XCPplus 0x0102
  /begin DAQ_EVENT VARIABLE /begin AVAILABLE_EVENT_LIST EVENT 0 EVENT 1 EVENT 2 EVENT 3 /end AVAILABLE_EVENT_LIST /begin DEFAULT_EVENT_LIST EVENT 1 /end DEFAULT_EVENT_LIST /end DAQ_EVENT
 /end IF_DATA
/end MEASUREMENT
/begin MEASUREMENT Com_flgABSFrntwhlSpdVld "ABS Front Wheel Speed Validity" UBYTE B_TRUE 1 100 0.00 1.00000000000 BIT_MASK 0x1 FORMAT "%13.11" ECU_ADDRESS 0x4000639A
 /begin IF_DATA XCPplus 0x0102
  /begin DAQ_EVENT VARIABLE /begin AVAILABLE_EVENT_LIST EVENT 0 EVENT 1 EVENT 2 EVENT 3 /end AVAILABLE_EVENT_LIST /begin DEFAULT_EVENT_LIST EVENT 1 /end DEFAULT_EVENT_LIST /end DAQ_EVENT
 /end IF_DATA
/end MEASUREMENT
/begin MEASUREMENT Com_flgABSRewhlSpdVld "ABS Rear Wheel Speed Validity" UBYTE B_TRUE 1 100 0.00 1.00000000000 BIT_MASK 0x1 FORMAT "%13.11" ECU_ADDRESS 0x40006399
 /begin IF_DATA XCPplus 0x0102
  /begin DAQ_EVENT VARIABLE /begin AVAILABLE_EVENT_LIST EVENT 0 EVENT 1 EVENT 2 EVENT 3 /end AVAILABLE_EVENT_LIST /begin DEFAULT_EVENT_LIST EVENT 1 /end DEFAULT_EVENT_LIST /end DAQ_EVENT
 /end IF_DATA
/end MEASUREMENT
/begin MEASUREMENT Com_stABSEvntAct "ABS activationde-activation status" UBYTE B_TRUE 1 100 0.00 1.00000000000 BIT_MASK 0x1 FORMAT "%13.11" ECU_ADDRESS 0x400063B0
 /begin IF_DATA XCPplus 0x0102
  /begin DAQ_EVENT VARIABLE /begin AVAILABLE_EVENT_LIST EVENT 0 EVENT 1 EVENT 2 EVENT 3 /end AVAILABLE_EVENT_LIST /begin DEFAULT_EVENT_LIST EVENT 1 /end DEFAULT_EVENT_LIST /end DAQ_EVENT
 /end IF_DATA
/end MEASUREMENT
/begin MEASUREMENT Com_stABSWarnLmp "ABS warning lamp state" UBYTE OneToOne 1 100 0.00 255.0 FORMAT "%5.1" ECU_ADDRESS 0x400063A0
 /begin IF_DATA XCPplus 0x0102
  /begin DAQ_EVENT VARIABLE /begin AVAILABLE_EVENT_LIST EVENT 0 EVENT 1 EVENT 2 EVENT 3 /end AVAILABLE_EVENT_LIST /begin DEFAULT_EVENT_LIST EVENT 1 /end DEFAULT_EVENT_LIST /end DAQ_EVENT
 /end IF_DATA
/end MEASUREMENT
/begin MEASUREMENT Com_vABSFrntWhlSpd "ABS Front Wheel Speed" UWORD RBPtCel_v_0p05625_1 1 100 0.00 3686.344 FORMAT "%8.3" ECU_ADDRESS 0x40005D7E
 /begin IF_DATA XCPplus 0x0102
  /begin DAQ_EVENT VARIABLE /begin AVAILABLE_EVENT_LIST EVENT 0 EVENT 1 EVENT 2 EVENT 3 /end AVAILABLE_EVENT_LIST /begin DEFAULT_EVENT_LIST EVENT 1 /end DEFAULT_EVENT_LIST /end DAQ_EVENT
 /end IF_DATA
/end MEASUREMENT
/begin MEASUREMENT Com_vABSReWhlSpd "ABS Rear Wheel Speed" UWORD RBPtCel_v_0p05625_1 1 100 0.00 3686.344 FORMAT "%8.3" ECU_ADDRESS 0x40005D7C
 /begin IF_DATA XCPplus 0x0102
  /begin DAQ_EVENT VARIABLE /begin AVAILABLE_EVENT_LIST EVENT 0 EVENT 1 EVENT 2 EVENT 3 /end AVAILABLE_EVENT_LIST /begin DEFAULT_EVENT_LIST EVENT 1 /end DEFAULT_EVENT_LIST /end DAQ_EVENT
 /end IF_DATA
/end MEASUREMENT
/begin MEASUREMENT Dcm_stCallWr "Call state of writing information into EEPROM" UBYTE OneToOne 1 100 0.00 255.0 FORMAT "%5.1" ECU_ADDRESS 0x4000639F /end MEASUREMENT
/begin MEASUREMENT Dcm_stEepOrder "EEPROM order state of writing information into EEPROM" UBYTE OneToOne 1 100 0.00 255.0 FORMAT "%5.1" ECU_ADDRESS 0x4000639E /end MEASUREMENT
/begin MEASUREMENT Dcm_stMSR "Status of MSR functionality whether it is enabled or disabled" UBYTE dez 1 100 0.00 255.0 FORMAT "%5.1" ECU_ADDRESS 0x4000639D
 /begin IF_DATA XCPplus 0x0102
  /begin DAQ_EVENT VARIABLE /begin AVAILABLE_EVENT_LIST EVENT 0 EVENT 1 EVENT 2 EVENT 3 /end AVAILABLE_EVENT_LIST /begin DEFAULT_EVENT_LIST EVENT 1 /end DEFAULT_EVENT_LIST /end DAQ_EVENT
 /end IF_DATA
/end MEASUREMENT
/begin MEASUREMENT Dcm_stVarcode "variant coding information" UBYTE dez 1 100 0.00 255.0 FORMAT "%5.1" ECU_ADDRESS 0x4000639B
 /begin IF_DATA XCPplus 0x0102
  /begin DAQ_EVENT VARIABLE /begin AVAILABLE_EVENT_LIST EVENT 0 EVENT 1 EVENT 2 EVENT 3 /end AVAILABLE_EVENT_LIST /begin DEFAULT_EVENT_LIST EVENT 1 /end DEFAULT_EVENT_LIST /end DAQ_EVENT
 /end IF_DATA
/end MEASUREMENT
/begin MEASUREMENT Dcm_stVarcode2 "variant coding information 2" UBYTE dez 1 100 0.00 255.0 FORMAT "%5.1" ECU_ADDRESS 0x4000639C
 /begin IF_DATA XCPplus 0x0102
  /begin DAQ_EVENT VARIABLE /begin AVAILABLE_EVENT_LIST EVENT 0 EVENT 1 EVENT 2 EVENT 3 /end AVAILABLE_EVENT_LIST /begin DEFAULT_EVENT_LIST EVENT 1 /end DEFAULT_EVENT_LIST /end DAQ_EVENT
 /end IF_DATA
/end MEASUREMENT
/begin MEASUREMENT DDRC_ctArDebLvl.DFC_SSpMon1 "Debouncing counters / Debounce Timer or Event counter for check DFC_SSpMon1" SWORD DFC_OneToOne 1 100 -32768.00 32767.00 FORMAT "%8.2" ECU_ADDRESS 0x40005E9E /end MEASUREMENT
/begin MEASUREMENT DDRC_ctArDebLvl.DFC_SSpMon1OT "Debouncing counters / Debounce Timer or Event counter for check DFC_SSpMon1OT" SWORD DFC_OneToOne 1 100 -32768.00 32767.00 FORMAT "%8.2" ECU_ADDRESS 0x40005EA0 /end MEASUREMENT
/begin MEASUREMENT DDRC_ctArDebLvl.DFC_SSpMon1OV "Debouncing counters / Debounce Timer or Event counter for check DFC_SSpMon1OV" SWORD DFC_OneToOne 1 100 -32768.00 32767.00 FORMAT "%8.2" ECU_ADDRESS 0x40005EA2 /end MEASUREMENT
/begin MEASUREMENT DDRC_ctArDebLvl.DFC_SSpMon1SCG "Debouncing counters / Debounce Timer or Event counter for check DFC_SSpMon1SCG" SWORD DFC_OneToOne 1 100 -32768.00 32767.00 FORMAT "%8.2" ECU_ADDRESS 0x40005EA4 /end MEASUREMENT
/begin MEASUREMENT DDRC_ctArDebLvl.DFC_SSpMon1UV "Debouncing counters / Debounce Timer or Event counter for check DFC_SSpMon1UV" SWORD DFC_OneToOne 1 100 -32768.00 32767.00 FORMAT "%8.2" ECU_ADDRESS 0x40005EA6 /end MEASUREMENT
/begin MEASUREMENT DDRC_ctArDebLvl.DFC_SSpMon2 "Debouncing counters / Debounce Timer or Event counter for check DFC_SSpMon2" SWORD DFC_OneToOne 1 100 -32768.00 32767.00 FORMAT "%8.2" ECU_ADDRESS 0x40005EA8 /end MEASUREMENT
/begin MEASUREMENT DDRC_ctArDebLvl.DFC_SSpMon2OT "Debouncing counters / Debounce Timer or Event counter for check DFC_SSpMon2OT" SWORD DFC_OneToOne 1 100 -32768.00 32767.00 FORMAT "%8.2" ECU_ADDRESS 0x40005EAA /end MEASUREMENT
/begin MEASUREMENT DDRC_ctArDebLvl.DFC_SSpMon2OV "Debouncing counters / Debounce Timer or Event counter for check DFC_SSpMon2OV" SWORD DFC_OneToOne 1 100 -32768.00 32767.00 FORMAT "%8.2" ECU_ADDRESS 0x40005EAC /end MEASUREMENT
/begin MEASUREMENT DDRC_ctArDebLvl.DFC_SSpMon2SCG "Debouncing counters / Debounce Timer or Event counter for check DFC_SSpMon2SCG" SWORD DFC_OneToOne 1 100 -32768.00 32767.00 FORMAT "%8.2" ECU_ADDRESS 0x40005EAE /end MEASUREMENT
/begin MEASUREMENT DDRC_ctArDebLvl.DFC_SSpMon2UV "Debouncing counters / Debounce Timer or Event counter for check DFC_SSpMon2UV" SWORD DFC_OneToOne 1 100 -32768.00 32767.00 FORMAT "%8.2" ECU_ADDRESS 0x40005EB0 /end MEASUREMENT
/begin MEASUREMENT DDRC_ctArDebLvl.DFC_CANIF_E_CTRL_NOT_SLEEP_ERROR_VALUE "Debouncing counters / Debounce Timer or Event counter for check DFC_CANIF_E_CTRL_NOT_SLEEP_ERROR_VALUE" SWORD DFC_OneToOne 1 100 -32768.00 32767.00 FORMAT "%8.2" ECU_ADDRESS 0x40005EB2 /end MEASUREMENT
/begin MEASUREMENT DDRC_ctArDebLvl.DFC_CANIF_E_CTRL_STOPPED_ERROR_VALUE "Debouncing counters / Debounce Timer or Event counter for check DFC_CANIF_E_CTRL_STOPPED_ERROR_VALUE" SWORD DFC_OneToOne 1 100 -32768.00 32767.00 FORMAT "%8.2" ECU_ADDRESS 0x40005EB4 /end MEASUREMENT
/begin MEASUREMENT DDRC_ctArDebLvl.DFC_CANIF_E_INVALID_DLC_ERROR "Debouncing counters / Debounce Timer or Event counter for check DFC_CANIF_E_INVALID_DLC_ERROR" SWORD DFC_OneToOne 1 100 -32768.00 32767.00 FORMAT "%8.2" ECU_ADDRESS 0x40005EB6 /end MEASUREMENT
/begin MEASUREMENT DDRC_ctArDebLvl.DFC_CANNM_E_CANIF_TRANSMIT_ERROR "Debouncing counters / Debounce Timer or Event counter for check DFC_CANNM_E_CANIF_TRANSMIT_ERROR" SWORD DFC_OneToOne 1 100 -32768.00 32767.00 FORMAT "%8.2" ECU_ADDRESS 0x40005EB8 /end MEASUREMENT
/begin MEASUREMENT DDRC_ctArDebLvl.DFC_CANNM_E_INIT_FAILED "Debouncing counters / Debounce Timer or Event counter for check DFC_CANNM_E_INIT_FAILED" SWORD DFC_OneToOne 1 100 -32768.00 32767.00 FORMAT "%8.2" ECU_ADDRESS 0x40005EBA /end MEASUREMENT
/begin MEASUREMENT DDRC_ctArDebLvl.DFC_CANNM_E_NETWORK_TIMEOUT "Debouncing counters / Debounce Timer or Event counter for check DFC_CANNM_E_NETWORK_TIMEOUT" SWORD DFC_OneToOne 1 100 -32768.00 32767.00 FORMAT "%8.2" ECU_ADDRESS 0x40005EBC /end MEASUREMENT
/begin MEASUREMENT DDRC_ctArDebLvl.DFC_CAN_E_TIMEOUT "Debouncing counters / Debounce Timer or Event counter for check DFC_CAN_E_TIMEOUT" SWORD DFC_OneToOne 1 100 -32768.00 32767.00 FORMAT "%8.2" ECU_ADDRESS 0x40005EBE /end MEASUREMENT
/begin MEASUREMENT DDRC_ctArDebLvl.DFC_COMM_E_NET_START_IND_CHANNEL_0 "Debouncing counters / Debounce Timer or Event counter for check DFC_COMM_E_NET_START_IND_CHANNEL_0" SWORD DFC_OneToOne 1 100 -32768.00 32767.00 FORMAT "%8.2" ECU_ADDRESS 0x40005EC0 /end MEASUREMENT
/begin MEASUREMENT DDRC_ctArDebLvl.DFC_COMM_E_NET_START_IND_CHANNEL_1 "Debouncing counters / Debounce Timer or Event counter for check DFC_COMM_E_NET_START_IND_CHANNEL_1" SWORD DFC_OneToOne 1 100 -32768.00 32767.00 FORMAT "%8.2" ECU_ADDRESS 0x40005EC2 /end MEASUREMENT
/begin MEASUREMENT DDRC_ctArDebLvl.DFC_COMM_E_NET_START_IND_CHANNEL_2 "Debouncing counters / Debounce Timer or Event counter for check DFC_COMM_E_NET_START_IND_CHANNEL_2" SWORD DFC_OneToOne 1 100 -32768.00 32767.00 FORMAT "%8.2" ECU_ADDRESS 0x40005EC4 /end MEASUREMENT
/begin MEASUREMENT DDRC_ctArDebLvl.DFC_COMM_E_NET_START_IND_CHANNEL_3 "Debouncing counters / Debounce Timer or Event counter for check DFC_COMM_E_NET_START_IND_CHANNEL_3" SWORD DFC_OneToOne 1 100 -32768.00 32767.00 FORMAT "%8.2" ECU_ADDRESS 0x40005EC6 /end MEASUREMENT
/begin MEASUREMENT DDRC_ctArDebLvl.DFC_COMM_E_NET_START_IND_CHANNEL_4 "Debouncing counters / Debounce Timer or Event counter for check DFC_COMM_E_NET_START_IND_CHANNEL_4" SWORD DFC_OneToOne 1 100 -32768.00 32767.00 FORMAT "%8.2" ECU_ADDRESS 0x40005EC8 /end MEASUREMENT
/begin MEASUREMENT DDRC_ctArDebLvl.DFC_COMM_E_NET_START_IND_CHANNEL_5 "Debouncing counters / Debounce Timer or Event counter for check DFC_COMM_E_NET_START_IND_CHANNEL_5" SWORD DFC_OneToOne 1 100 -32768.00 32767.00 FORMAT "%8.2" ECU_ADDRESS 0x40005ECA /end MEASUREMENT
/begin MEASUREMENT DDRC_ctArDebLvl.DFC_PDUR_E_INIT_FAILED "Debouncing counters / Debounce Timer or Event counter for check DFC_PDUR_E_INIT_FAILED" SWORD DFC_OneToOne 1 100 -32768.00 32767.00 FORMAT "%8.2" ECU_ADDRESS 0x40005ECC /end MEASUREMENT
/begin MEASUREMENT DDRC_ctArDebLvl.DFC_PDUR_E_PDU_INSTANCE_LOST "Debouncing counters / Debounce Timer or Event counter for check DFC_PDUR_E_PDU_INSTANCE_LOST" SWORD DFC_OneToOne 1 100 -32768.00 32767.00 FORMAT "%8.2" ECU_ADDRESS 0x40005ECE /end MEASUREMENT
/begin MEASUREMENT DDRC_ctArDebLvl.DFC_RBA_IOEXTLIB_KEEPALIVE_DRV "Debouncing counters / Debounce Timer or Event counter for check DFC_RBA_IOEXTLIB_KEEPALIVE_DRV" SWORD DFC_OneToOne 1 100 -32768.00 32767.00 FORMAT "%8.2" ECU_ADDRESS 0x40005ED0 /end MEASUREMENT
/begin MEASUREMENT DDRC_ctArDebLvl.DFC_RBA_IOEXTLIB_KEEPALIVE_INI "Debouncing counters / Debounce Timer or Event counter for check DFC_RBA_IOEXTLIB_KEEPALIVE_INI" SWORD DFC_OneToOne 1 100 -32768.00 32767.00 FORMAT "%8.2" ECU_ADDRESS 0x40005ED2 /end MEASUREMENT
/begin MEASUREMENT DDRC_ctArDebLvl.DFC_rba_IoSigRtc_StopCounter "Debouncing counters / Debounce Timer or Event counter for check DFC_rba_IoSigRtc_StopCounter" SWORD DFC_OneToOne 1 100 -32768.00 32767.00 FORMAT "%8.2" ECU_ADDRESS 0x40005ED4 /end MEASUREMENT
/begin MEASUREMENT DDRC_ctArDebLvl.DFC_rba_MultiStackTrace_Threshold "Debouncing counters / Debounce Timer or Event counter for check DFC_rba_MultiStackTrace_Threshold" SWORD DFC_OneToOne 1 100 -32768.00 32767.00 FORMAT "%8.2" ECU_ADDRESS 0x40005ED6 /end MEASUREMENT
/begin MEASUREMENT DDRC_St.DFC_BusDiagOpenLoad_Can0 "Debouncing counters / Debounce Timer or Event counter for check DFC_BusDiagOpenLoad_Can0" ULONG DFC_OneToOne 1 100 0.00 536870911.000 BIT_MASK 0x1fffffff FORMAT "%13.3" ECU_ADDRESS 0x40004FBC /end MEASUREMENT
/begin MEASUREMENT DDRC_St.DFC_Com_ABSInfo_DLC "Debouncing counters / Debounce Timer or Event counter for check DFC_Com_ABSInfo_DLC" ULONG DFC_OneToOne 1 100 0.00 536870911.000 BIT_MASK 0x1fffffff FORMAT "%13.3" ECU_ADDRESS 0x40004FC0 /end MEASUREMENT
/begin MEASUREMENT DDRC_St.DFC_Com_ABSInfo_TO "Debouncing counters / Debounce Timer or Event counter for check DFC_Com_ABSInfo_TO" ULONG DFC_OneToOne 1 100 0.00 536870911.000 BIT_MASK 0x1fffffff FORMAT "%13.3" ECU_ADDRESS 0x40004FC4 /end MEASUREMENT
/begin MEASUREMENT DDRC_St.DFC_BusDiagBusOff_Can0 "Debouncing counters / Debounce Timer or Event counter for check DFC_BusDiagBusOff_Can0" ULONG DFC_OneToOne 1 100 0.00 536870911.000 BIT_MASK 0x1fffffff FORMAT "%13.3" ECU_ADDRESS 0x40004FC8 /end MEASUREMENT
/begin MEASUREMENT DDRC_St.DFC_DevLibBattUHi "Debouncing counters / Debounce Timer or Event counter for check DFC_DevLibBattUHi" ULONG DFC_OneToOne 1 100 0.00 536870911.000 BIT_MASK 0x1fffffff FORMAT "%13.3" ECU_ADDRESS 0x40004FCC /end MEASUREMENT
/begin MEASUREMENT DDRC_St.DFC_DevLibBattULo "Debouncing counters / Debounce Timer or Event counter for check DFC_DevLibBattULo" ULONG DFC_OneToOne 1 100 0.00 536870911.000 BIT_MASK 0x1fffffff FORMAT "%13.3" ECU_ADDRESS 0x40004FD0 /end MEASUREMENT
/begin MEASUREMENT DDRC_St.DFC_StrtOL "Debouncing counters / Debounce Timer or Event counter for check DFC_StrtOL" ULONG DFC_OneToOne 1 100 0.00 536870911.000 BIT_MASK 0x1fffffff FORMAT "%13.3" ECU_ADDRESS 0x40004FD4 /end MEASUREMENT
/begin MEASUREMENT DDRC_St.DFC_StrtOvrTemp "Debouncing counters / Debounce Timer or Event counter for check DFC_StrtOvrTemp" ULONG DFC_OneToOne 1 100 0.00 536870911.000 BIT_MASK 0x1fffffff FORMAT "%13.3" ECU_ADDRESS 0x40004FD8 /end MEASUREMENT
/begin MEASUREMENT DDRC_St.DFC_StrtSCB "Debouncing counters / Debounce Timer or Event counter for check DFC_StrtSCB" ULONG DFC_OneToOne 1 100 0.00 536870911.000 BIT_MASK 0x1fffffff FORMAT "%13.3" ECU_ADDRESS 0x40004FDC /end MEASUREMENT
/begin MEASUREMENT DDRC_St.DFC_StrtSCG "Debouncing counters / Debounce Timer or Event counter for check DFC_StrtSCG" ULONG DFC_OneToOne 1 100 0.00 536870911.000 BIT_MASK 0x1fffffff FORMAT "%13.3" ECU_ADDRESS 0x40004FE0 /end MEASUREMENT
/begin MEASUREMENT DDRC_St.DFC_MILLmpOL "Debouncing counters / Debounce Timer or Event counter for check DFC_MILLmpOL" UWORD DFC_OneToOne 1 100 0.00 8191.000 BIT_MASK 0x1fff FORMAT "%8.3" ECU_ADDRESS 0x40005E8E /end MEASUREMENT
/begin MEASUREMENT DDRC_St.DFC_MILLmpOT "Debouncing counters / Debounce Timer or Event counter for check DFC_MILLmpOT" UWORD DFC_OneToOne 1 100 0.00 8191.000 BIT_MASK 0x1fff FORMAT "%8.3" ECU_ADDRESS 0x40005E90 /end MEASUREMENT
/begin MEASUREMENT DDRC_St.DFC_MILLmpSCB "Debouncing counters / Debounce Timer or Event counter for check DFC_MILLmpSCB" UWORD DFC_OneToOne 1 100 0.00 8191.000 BIT_MASK 0x1fff FORMAT "%8.3" ECU_ADDRESS 0x40005E92 /end MEASUREMENT
/begin MEASUREMENT DDRC_St.DFC_MILLmpSCG "Debouncing counters / Debounce Timer or Event counter for check DFC_MILLmpSCG" UWORD DFC_OneToOne 1 100 0.00 8191.000 BIT_MASK 0x1fff FORMAT "%8.3" ECU_ADDRESS 0x40005E94 /end MEASUREMENT
/begin MEASUREMENT DDRC_St.DFC_EV1max "Debouncing counters / Debounce Timer or Event counter for check DFC_EV1max" UWORD DFC_OneToOne 1 100 0.00 8191.000 BIT_MASK 0x1fff FORMAT "%8.3" ECU_ADDRESS 0x40005E96 /end MEASUREMENT
/begin MEASUREMENT DDRC_St.DFC_EV1min "Debouncing counters / Debounce Timer or Event counter for check DFC_EV1min" UWORD DFC_OneToOne 1 100 0.00 8191.000 BIT_MASK 0x1fff FORMAT "%8.3" ECU_ADDRESS 0x40005E98 /end MEASUREMENT
/begin MEASUREMENT DDRC_St.DFC_EV1sig "Debouncing counters / Debounce Timer or Event counter for check DFC_EV1sig" UWORD DFC_OneToOne 1 100 0.00 8191.000 BIT_MASK 0x1fff FORMAT "%8.3" ECU_ADDRESS 0x40005E9A /end MEASUREMENT
/begin MEASUREMENT DDRC_stLstRprtEve.DFC_SSpMon1 "Monitoring state / Monitoring state of DFC_SSpMon1" UBYTE DDRC_LstRprtEve_VERB 1 100 0.00 255.000000000 FORMAT "%13.9" ECU_ADDRESS 0x40004FE8 /end MEASUREMENT
/begin MEASUREMENT DDRC_stLstRprtEve.DFC_SSpMon1OT "Monitoring state / Monitoring state of DFC_SSpMon1OT" UBYTE DDRC_LstRprtEve_VERB 1 100 0.00 255.000000000 FORMAT "%13.9" ECU_ADDRESS 0x40004FE9 /end MEASUREMENT
/begin MEASUREMENT DDRC_stLstRprtEve.DFC_SSpMon1OV "Monitoring state / Monitoring state of DFC_SSpMon1OV" UBYTE DDRC_LstRprtEve_VERB 1 100 0.00 255.000000000 FORMAT "%13.9" ECU_ADDRESS 0x40004FEA /end MEASUREMENT
/begin MEASUREMENT DDRC_stLstRprtEve.DFC_SSpMon1SCG "Monitoring state / Monitoring state of DFC_SSpMon1SCG" UBYTE DDRC_LstRprtEve_VERB 1 100 0.00 255.000000000 FORMAT "%13.9" ECU_ADDRESS 0x40004FEB /end MEASUREMENT
/begin MEASUREMENT DDRC_stLstRprtEve.DFC_SSpMon1UV "Monitoring state / Monitoring state of DFC_SSpMon1UV" UBYTE DDRC_LstRprtEve_VERB 1 100 0.00 255.000000000 FORMAT "%13.9" ECU_ADDRESS 0x40004FEC /end MEASUREMENT
/begin MEASUREMENT DDRC_stLstRprtEve.DFC_SSpMon2 "Monitoring state / Monitoring state of DFC_SSpMon2" UBYTE DDRC_LstRprtEve_VERB 1 100 0.00 255.000000000 FORMAT "%13.9" ECU_ADDRESS 0x40004FED /end MEASUREMENT
/begin MEASUREMENT DDRC_stLstRprtEve.DFC_SSpMon2OT "Monitoring state / Monitoring state of DFC_SSpMon2OT" UBYTE DDRC_LstRprtEve_VERB 1 100 0.00 255.000000000 FORMAT "%13.9" ECU_ADDRESS 0x40004FEE /end MEASUREMENT
/begin MEASUREMENT DDRC_stLstRprtEve.DFC_SSpMon2OV "Monitoring state / Monitoring state of DFC_SSpMon2OV" UBYTE DDRC_LstRprtEve_VERB 1 100 0.00 255.000000000 FORMAT "%13.9" ECU_ADDRESS 0x40004FEF /end MEASUREMENT
/begin MEASUREMENT DDRC_stLstRprtEve.DFC_SSpMon2SCG "Monitoring state / Monitoring state of DFC_SSpMon2SCG" UBYTE DDRC_LstRprtEve_VERB 1 100 0.00 255.000000000 FORMAT "%13.9" ECU_ADDRESS 0x40004FF0 /end MEASUREMENT
/begin MEASUREMENT DDRC_stLstRprtEve.DFC_SSpMon2UV "Monitoring state / Monitoring state of DFC_SSpMon2UV" UBYTE DDRC_LstRprtEve_VERB 1 100 0.00 255.000000000 FORMAT "%13.9" ECU_ADDRESS 0x40004FF1 /end MEASUREMENT
/begin MEASUREMENT DDRC_stLstRprtEve.DFC_CANIF_E_CTRL_NOT_SLEEP_ERROR_VALUE "Monitoring state / Monitoring state of DFC_CANIF_E_CTRL_NOT_SLEEP_ERROR_VALUE" UBYTE DDRC_LstRprtEve_VERB 1 100 0.00 255.000000000 FORMAT "%13.9" ECU_ADDRESS 0x40004FF2 /end MEASUREMENT
/begin MEASUREMENT DDRC_stLstRprtEve.DFC_CANIF_E_CTRL_STOPPED_ERROR_VALUE "Monitoring state / Monitoring state of DFC_CANIF_E_CTRL_STOPPED_ERROR_VALUE" UBYTE DDRC_LstRprtEve_VERB 1 100 0.00 255.000000000 FORMAT "%13.9" ECU_ADDRESS 0x40004FF3 /end MEASUREMENT
/begin MEASUREMENT DDRC_stLstRprtEve.DFC_CANIF_E_INVALID_DLC_ERROR "Monitoring state / Monitoring state of DFC_CANIF_E_INVALID_DLC_ERROR" UBYTE DDRC_LstRprtEve_VERB 1 100 0.00 255.000000000 FORMAT "%13.9" ECU_ADDRESS 0x40004FF4 /end MEASUREMENT
/begin MEASUREMENT DDRC_stLstRprtEve.DFC_CANNM_E_CANIF_TRANSMIT_ERROR "Monitoring state / Monitoring state of DFC_CANNM_E_CANIF_TRANSMIT_ERROR" UBYTE DDRC_LstRprtEve_VERB 1 100 0.00 255.000000000 FORMAT "%13.9" ECU_ADDRESS 0x40004FF5 /end MEASUREMENT
/begin MEASUREMENT DDRC_stLstRprtEve.DFC_CANNM_E_INIT_FAILED "Monitoring state / Monitoring state of DFC_CANNM_E_INIT_FAILED" UBYTE DDRC_LstRprtEve_VERB 1 100 0.00 255.000000000 FORMAT "%13.9" ECU_ADDRESS 0x40004FF6 /end MEASUREMENT
/begin MEASUREMENT DDRC_stLstRprtEve.DFC_CANNM_E_NETWORK_TIMEOUT "Monitoring state / Monitoring state of DFC_CANNM_E_NETWORK_TIMEOUT" UBYTE DDRC_LstRprtEve_VERB 1 100 0.00 255.000000000 FORMAT "%13.9" ECU_ADDRESS 0x40004FF7 /end MEASUREMENT
/begin MEASUREMENT DDRC_stLstRprtEve.DFC_CAN_E_TIMEOUT "Monitoring state / Monitoring state of DFC_CAN_E_TIMEOUT" UBYTE DDRC_LstRprtEve_VERB 1 100 0.00 255.000000000 FORMAT "%13.9" ECU_ADDRESS 0x40004FF8 /end MEASUREMENT
/begin MEASUREMENT DDRC_stLstRprtEve.DFC_COMM_E_NET_START_IND_CHANNEL_0 "Monitoring state / Monitoring state of DFC_COMM_E_NET_START_IND_CHANNEL_0" UBYTE DDRC_LstRprtEve_VERB 1 100 0.00 255.000000000 FORMAT "%13.9" ECU_ADDRESS 0x40004FF9 /end MEASUREMENT
/begin MEASUREMENT DDRC_stLstRprtEve.DFC_COMM_E_NET_START_IND_CHANNEL_1 "Monitoring state / Monitoring state of DFC_COMM_E_NET_START_IND_CHANNEL_1" UBYTE DDRC_LstRprtEve_VERB 1 100 0.00 255.000000000 FORMAT "%13.9" ECU_ADDRESS 0x40004FFA /end MEASUREMENT
/begin MEASUREMENT DDRC_stLstRprtEve.DFC_COMM_E_NET_START_IND_CHANNEL_2 "Monitoring state / Monitoring state of DFC_COMM_E_NET_START_IND_CHANNEL_2" UBYTE DDRC_LstRprtEve_VERB 1 100 0.00 255.000000000 FORMAT "%13.9" ECU_ADDRESS 0x40004FFB /end MEASUREMENT
/begin MEASUREMENT DDRC_stLstRprtEve.DFC_COMM_E_NET_START_IND_CHANNEL_3 "Monitoring state / Monitoring state of DFC_COMM_E_NET_START_IND_CHANNEL_3" UBYTE DDRC_LstRprtEve_VERB 1 100 0.00 255.000000000 FORMAT "%13.9" ECU_ADDRESS 0x40004FFC /end MEASUREMENT
/begin MEASUREMENT DDRC_stLstRprtEve.DFC_COMM_E_NET_START_IND_CHANNEL_4 "Monitoring state / Monitoring state of DFC_COMM_E_NET_START_IND_CHANNEL_4" UBYTE DDRC_LstRprtEve_VERB 1 100 0.00 255.000000000 FORMAT "%13.9" ECU_ADDRESS 0x40004FFD /end MEASUREMENT
/begin MEASUREMENT DDRC_stLstRprtEve.DFC_COMM_E_NET_START_IND_CHANNEL_5 "Monitoring state / Monitoring state of DFC_COMM_E_NET_START_IND_CHANNEL_5" UBYTE DDRC_LstRprtEve_VERB 1 100 0.00 255.000000000 FORMAT "%13.9" ECU_ADDRESS 0x40004FFE /end MEASUREMENT
/begin MEASUREMENT DDRC_stLstRprtEve.DFC_PDUR_E_INIT_FAILED "Monitoring state / Monitoring state of DFC_PDUR_E_INIT_FAILED" UBYTE DDRC_LstRprtEve_VERB 1 100 0.00 255.000000000 FORMAT "%13.9" ECU_ADDRESS 0x40004FFF /end MEASUREMENT
/begin MEASUREMENT DDRC_stLstRprtEve.DFC_PDUR_E_PDU_INSTANCE_LOST "Monitoring state / Monitoring state of DFC_PDUR_E_PDU_INSTANCE_LOST" UBYTE DDRC_LstRprtEve_VERB 1 100 0.00 255.000000000 FORMAT "%13.9" ECU_ADDRESS 0x40005000 /end MEASUREMENT
/begin MEASUREMENT DDRC_stLstRprtEve.DFC_RBA_IOEXTLIB_KEEPALIVE_DRV "Monitoring state / Monitoring state of DFC_RBA_IOEXTLIB_KEEPALIVE_DRV" UBYTE DDRC_LstRprtEve_VERB 1 100 0.00 255.000000000 FORMAT "%13.9" ECU_ADDRESS 0x40005001 /end MEASUREMENT
/begin MEASUREMENT DDRC_stLstRprtEve.DFC_RBA_IOEXTLIB_KEEPALIVE_INI "Monitoring state / Monitoring state of DFC_RBA_IOEXTLIB_KEEPALIVE_INI" UBYTE DDRC_LstRprtEve_VERB 1 100 0.00 255.000000000 FORMAT "%13.9" ECU_ADDRESS 0x40005002 /end MEASUREMENT
/begin MEASUREMENT DDRC_stLstRprtEve.DFC_rba_IoSigRtc_StopCounter "Monitoring state / Monitoring state of DFC_rba_IoSigRtc_StopCounter" UBYTE DDRC_LstRprtEve_VERB 1 100 0.00 255.000000000 FORMAT "%13.9" ECU_ADDRESS 0x40005003 /end MEASUREMENT
/begin MEASUREMENT DDRC_stLstRprtEve.DFC_rba_MultiStackTrace_Threshold "Monitoring state / Monitoring state of DFC_rba_MultiStackTrace_Threshold" UBYTE DDRC_LstRprtEve_VERB 1 100 0.00 255.000000000 FORMAT "%13.9" ECU_ADDRESS 0x40005004 /end MEASUREMENT
/begin MEASUREMENT Dem_disableEventStatusUpdateGroup "Bit encoded DTCGroups disabled for EventStatusUpdate" UBYTE OneToOne 1 100 0.00 255.0 FORMAT "%5.1" ECU_ADDRESS 0x40003E74 /end MEASUREMENT
/begin MEASUREMENT Dem_DTCFltForFDC "FilterForFaultDetectionCounter parameter of current Dem_SetDTCFilter()" UBYTE OneToOne 1 100 0.00 255.0 FORMAT "%5.1" ECU_ADDRESS 0x40003E77 /end MEASUREMENT
/begin MEASUREMENT Dem_DTCFltFormat "DTCFormat parameter of current Dem_SetDTCFilter() request" UBYTE OneToOne 1 100 0.00 255.0 FORMAT "%5.1" ECU_ADDRESS 0x40003E7B /end MEASUREMENT
/begin MEASUREMENT Dem_DTCFltKind "DTCKind parameter of current Dem_SetDTCFilter() request" UBYTE OneToOne 1 100 0.00 255.0 FORMAT "%5.1" ECU_ADDRESS 0x40003E7C /end MEASUREMENT
/begin MEASUREMENT Dem_DTCFltOrigin "DTCOrigin parameter of current Dem_SetDTCFilter() request" UBYTE OneToOne 1 100 0.00 255.0 FORMAT "%5.1" ECU_ADDRESS 0x40003E7A /end MEASUREMENT
/begin MEASUREMENT Dem_DTCFltProcCnt "Number of DTCs found to current Dem_SetDTCFilter() request" UWORD OneToOne 1 100 0.00 65535.00 FORMAT "%8.2" ECU_ADDRESS 0x40002CFA /end MEASUREMENT
/begin MEASUREMENT Dem_DTCFltProcIdx "Loop index for asynchron Dem_SetDTCFilter() processing" UWORD OneToOne 1 100 0.00 65535.00 FORMAT "%8.2" ECU_ADDRESS 0x40002CFC /end MEASUREMENT
/begin MEASUREMENT Dem_DTCFltRecFormat "DTCFormat parameter of current Dem_SetFreezeFrameRecordFilter() request" UBYTE OneToOne 1 100 0.00 255.0 FORMAT "%5.1" ECU_ADDRESS 0x40003E76 /end MEASUREMENT
/begin MEASUREMENT Dem_DTCFltRecRsltIdx "Index variable for incremental GetNextFilteredRecord output" UWORD OneToOne 1 100 0.00 65535.00 FORMAT "%8.2" ECU_ADDRESS 0x40002CF6 /end MEASUREMENT
/begin MEASUREMENT Dem_DTCFltRsltIdx "Index variable for incremental GetNextFilteredDTCxxx output" UWORD OneToOne 1 100 0.00 65535.00 FORMAT "%8.2" ECU_ADDRESS 0x40002CF8 /end MEASUREMENT
/begin MEASUREMENT Dem_DTCFltSeverity "DTCSeverity parameter of current Dem_SetDTCFilter() request" UBYTE OneToOne 1 100 0.00 255.0 FORMAT "%5.1" ECU_ADDRESS 0x40003E78 /end MEASUREMENT
/begin MEASUREMENT Dem_DTCFltSt "Current state of Dem_SetDTCFilter() processing" UBYTE Dem_DTCFltSt_Verb 1 100 0.00 5.00000000000 FORMAT "%13.11" ECU_ADDRESS 0x40003E75 /end MEASUREMENT
/begin MEASUREMENT Dem_DTCFltStatusMask "DTCStatusMask parameter of current Dem_SetDTCFilter() request" UBYTE OneToOne 1 100 0.00 255.0 FORMAT "%5.1" ECU_ADDRESS 0x40003E7D /end MEASUREMENT
/begin MEASUREMENT Dem_DTCFltWithSeverity "FilterWithSeverity parameter of current Dem_SetDTCFilter() request" UBYTE OneToOne 1 100 0.00 255.0 FORMAT "%5.1" ECU_ADDRESS 0x40003E79 /end MEASUREMENT
/begin MEASUREMENT deve_DiagInfo "deve-diagnosis info" ULONG dez 1 100 0.00 4294967295.00 FORMAT "%13.2" ARRAY_SIZE 1 ECU_ADDRESS 0x40005024 /end MEASUREMENT
/begin MEASUREMENT deve_PSDiagInfo "Powerstage Diag information" ULONG dez 1 100 0.00 4294967295.00 FORMAT "%13.2" ARRAY_SIZE 1 ECU_ADDRESS 0x40005020 /end MEASUREMENT
/begin MEASUREMENT DSM_xTabVersion "DSM version indentification signature" UWORD DFC_OneToOne 1 100 0.00 65535.00 FORMAT "%8.2" ECU_ADDRESS 0x400061BA /end MEASUREMENT
/begin MEASUREMENT dstpstep_w "deviation between set point and actual position of stepper position" SWORD dez 1 100 -32768.00 32767.00 FORMAT "%8.2" ECU_ADDRESS 0x400084AE
 /begin IF_DATA XCPplus 0x0102
  /begin DAQ_EVENT VARIABLE /begin AVAILABLE_EVENT_LIST EVENT 0 EVENT 1 EVENT 2 EVENT 3 /end AVAILABLE_EVENT_LIST /begin DEFAULT_EVENT_LIST EVENT 1 /end DEFAULT_EVENT_LIST /end DAQ_EVENT
 /end IF_DATA
/end MEASUREMENT
/begin MEASUREMENT eevbz "Error in Power stage injection valve" UBYTE dez 1 100 0.00 255.0 FORMAT "%5.1" ECU_ADDRESS 0x4000645D
 /begin IF_DATA XCPplus 0x0102
  /begin DAQ_EVENT VARIABLE /begin AVAILABLE_EVENT_LIST EVENT 0 EVENT 1 EVENT 2 EVENT 3 /end AVAILABLE_EVENT_LIST /begin DEFAULT_EVENT_LIST EVENT 2 /end DEFAULT_EVENT_LIST /end DAQ_EVENT
 /end IF_DATA
/end MEASUREMENT
/begin MEASUREMENT eevd "Injection valve Errorbyte from DEVE 6.70.1" UBYTE dez 1 100 0.00 255.0 FORMAT "%5.1" ECU_ADDRESS 0x4000645C
 /begin IF_DATA XCPplus 0x0102
  /begin DAQ_EVENT VARIABLE /begin AVAILABLE_EVENT_LIST EVENT 0 EVENT 1 EVENT 2 EVENT 3 /end AVAILABLE_EVENT_LIST /begin DEFAULT_EVENT_LIST EVENT 2 /end DEFAULT_EVENT_LIST /end DAQ_EVENT
 /end IF_DATA
/end MEASUREMENT
/begin MEASUREMENT eevd_bz_ng "." UBYTE dez 1 100 0.00 255.0 FORMAT "%5.1" ECU_ADDRESS 0x4000645E
 /begin IF_DATA XCPplus 0x0102
  /begin DAQ_EVENT VARIABLE /begin AVAILABLE_EVENT_LIST EVENT 0 EVENT 1 EVENT 2 EVENT 3 /end AVAILABLE_EVENT_LIST /begin DEFAULT_EVENT_LIST EVENT 2 /end DEFAULT_EVENT_LIST /end DAQ_EVENT
 /end IF_DATA
/end MEASUREMENT
/begin MEASUREMENT engRunHrs_tmpU32 "total engine run hours" ULONG dez 1 100 0.00 4294967295.00 FORMAT "%13.2" ECU_ADDRESS 0x400048A4
 /begin IF_DATA XCPplus 0x0102
  /begin DAQ_EVENT VARIABLE /begin AVAILABLE_EVENT_LIST EVENT 0 EVENT 1 EVENT 2 EVENT 3 /end AVAILABLE_EVENT_LIST /begin DEFAULT_EVENT_LIST EVENT 1 /end DEFAULT_EVENT_LIST /end DAQ_EVENT
 /end IF_DATA
/end MEASUREMENT
/begin MEASUREMENT engRunHrs_tmpU8 "total engine run hours" UBYTE dez 1 100 0.00 255.0 FORMAT "%5.1" ARRAY_SIZE 4 ECU_ADDRESS 0x400048A0
 /begin IF_DATA XCPplus 0x0102
  /begin DAQ_EVENT VARIABLE /begin AVAILABLE_EVENT_LIST EVENT 0 EVENT 1 EVENT 2 EVENT 3 /end AVAILABLE_EVENT_LIST /begin DEFAULT_EVENT_LIST EVENT 1 /end DEFAULT_EVENT_LIST /end DAQ_EVENT
 /end IF_DATA
/end MEASUREMENT
/begin MEASUREMENT engRunHrs_UpdateFail "counter for writing total engine run hours" UWORD dez 1 100 0.00 65535.00 FORMAT "%8.2" ECU_ADDRESS 0x40005D78
 /begin IF_DATA XCPplus 0x0102
  /begin DAQ_EVENT VARIABLE /begin AVAILABLE_EVENT_LIST EVENT 0 EVENT 1 EVENT 2 EVENT 3 /end AVAILABLE_EVENT_LIST /begin DEFAULT_EVENT_LIST EVENT 1 /end DEFAULT_EVENT_LIST /end DAQ_EVENT
 /end IF_DATA
/end MEASUREMENT
/begin MEASUREMENT flglrs "CARB FREEZE FRAME byte, bank 1, for lambda control" UBYTE dez 1 100 0.00 255.0 FORMAT "%5.1" ECU_ADDRESS 0x40008881
 /begin IF_DATA XCPplus 0x0102
  /begin DAQ_EVENT VARIABLE /begin AVAILABLE_EVENT_LIST EVENT 0 EVENT 1 EVENT 2 EVENT 3 /end AVAILABLE_EVENT_LIST /begin DEFAULT_EVENT_LIST EVENT 2 /end DEFAULT_EVENT_LIST /end DAQ_EVENT
 /end IF_DATA
/end MEASUREMENT
/begin MEASUREMENT frqtimeconv_w "time counter converted from frequency value" UWORD dez 1 100 0.00 65535.00 FORMAT "%8.2" ECU_ADDRESS 0x400084B2
 /begin IF_DATA XCPplus 0x0102
  /begin DAQ_EVENT VARIABLE /begin AVAILABLE_EVENT_LIST EVENT 0 EVENT 1 EVENT 2 EVENT 3 /end AVAILABLE_EVENT_LIST /begin DEFAULT_EVENT_LIST EVENT 1 /end DEFAULT_EVENT_LIST /end DAQ_EVENT
 /end IF_DATA
/end MEASUREMENT
/begin MEASUREMENT HEXPRGFILE_r "Hex program file name" UBYTE dez 1 100 0.00 255.0 FORMAT "%5.1" ARRAY_SIZE 14 ECU_ADDRESS 0x40008740
 /begin IF_DATA XCPplus 0x0102
  /begin DAQ_EVENT VARIABLE /begin AVAILABLE_EVENT_LIST EVENT 0 EVENT 1 EVENT 2 EVENT 3 /end AVAILABLE_EVENT_LIST /begin DEFAULT_EVENT_LIST EVENT 1 /end DEFAULT_EVENT_LIST /end DAQ_EVENT
 /end IF_DATA
/end MEASUREMENT
/begin MEASUREMENT KTMPARTNUM_r "KTM part number" UBYTE dez 1 100 0.00 255.0 FORMAT "%5.1" ARRAY_SIZE 14 ECU_ADDRESS 0x40008730
 /begin IF_DATA XCPplus 0x0102
  /begin DAQ_EVENT VARIABLE /begin AVAILABLE_EVENT_LIST EVENT 0 EVENT 1 EVENT 2 EVENT 3 /end AVAILABLE_EVENT_LIST /begin DEFAULT_EVENT_LIST EVENT 1 /end DEFAULT_EVENT_LIST /end DAQ_EVENT
 /end IF_DATA
/end MEASUREMENT
/begin MEASUREMENT navg "Number of drivecycles for mileage calculation" UWORD OneToOne 1 100 0.00 65535.00 FORMAT "%8.2" ECU_ADDRESS 0x4000C6AE
 /begin IF_DATA XCPplus 0x0102
  /begin DAQ_EVENT VARIABLE /begin AVAILABLE_EVENT_LIST EVENT 0 EVENT 1 EVENT 2 EVENT 3 /end AVAILABLE_EVENT_LIST /begin DEFAULT_EVENT_LIST EVENT 3 /end DEFAULT_EVENT_LIST /end DAQ_EVENT
 /end IF_DATA
/end MEASUREMENT
/begin MEASUREMENT navg_init "Driving cycle counter for calculating first n driving cycles for mielage calculation" UWORD OneToOne 1 100 0.00 65535.00 FORMAT "%8.2" ECU_ADDRESS 0x4000C6AC
 /begin IF_DATA XCPplus 0x0102
  /begin DAQ_EVENT VARIABLE /begin AVAILABLE_EVENT_LIST EVENT 0 EVENT 1 EVENT 2 EVENT 3 /end AVAILABLE_EVENT_LIST /begin DEFAULT_EVENT_LIST EVENT 3 /end DEFAULT_EVENT_LIST /end DAQ_EVENT
 /end IF_DATA
/end MEASUREMENT
/begin MEASUREMENT olls "duty cycle for idle speed actuator" UBYTE rel_ub_b100 1 100 0.00 99.61 FORMAT "%5.2" ECU_ADDRESS 0x40008873
 /begin IF_DATA XCPplus 0x0102
  /begin DAQ_EVENT VARIABLE /begin AVAILABLE_EVENT_LIST EVENT 0 EVENT 1 EVENT 2 EVENT 3 /end AVAILABLE_EVENT_LIST /begin DEFAULT_EVENT_LIST EVENT 1 /end DEFAULT_EVENT_LIST /end DAQ_EVENT
 /end IF_DATA
/end MEASUREMENT
/begin MEASUREMENT olls_w "ISA position with respect to lower mechanical stop" UWORD rel_uw_b100 1 100 0.00 99.99847 FORMAT "%8.5" ECU_ADDRESS 0x400084A8
 /begin IF_DATA XCPplus 0x0102
  /begin DAQ_EVENT VARIABLE /begin AVAILABLE_EVENT_LIST EVENT 0 EVENT 1 EVENT 2 EVENT 3 /end AVAILABLE_EVENT_LIST /begin DEFAULT_EVENT_LIST EVENT 1 /end DEFAULT_EVENT_LIST /end DAQ_EVENT
 /end IF_DATA
/end MEASUREMENT
/begin MEASUREMENT posdly_w "Counter to activate stepper operation during post drive mode" UWORD dez 1 100 0.00 65535.00 FORMAT "%8.2" ECU_ADDRESS 0x400084AC
 /begin IF_DATA XCPplus 0x0102
  /begin DAQ_EVENT VARIABLE /begin AVAILABLE_EVENT_LIST EVENT 0 EVENT 1 EVENT 2 EVENT 3 /end AVAILABLE_EVENT_LIST /begin DEFAULT_EVENT_LIST EVENT 1 /end DEFAULT_EVENT_LIST /end DAQ_EVENT
 /end IF_DATA
/end MEASUREMENT
/begin MEASUREMENT psstpfrz_w "final freeze manifold pressure with altitude correction value during step loss adaptation" UWORD p_uw_q0p039 1 100 0.00 2559.961 FORMAT "%8.3" ECU_ADDRESS 0x400084A6
 /begin IF_DATA XCPplus 0x0102
  /begin DAQ_EVENT VARIABLE /begin AVAILABLE_EVENT_LIST EVENT 0 EVENT 1 EVENT 2 EVENT 3 /end AVAILABLE_EVENT_LIST /begin DEFAULT_EVENT_LIST EVENT 1 /end DEFAULT_EVENT_LIST /end DAQ_EVENT
 /end IF_DATA
/end MEASUREMENT
/begin MEASUREMENT sdstactcntr_l "sidestand counter" ULONG dez 1 100 0.00 4294967295.00 FORMAT "%13.2" ECU_ADDRESS 0x4000C678
 /begin IF_DATA XCPplus 0x0102
  /begin DAQ_EVENT VARIABLE /begin AVAILABLE_EVENT_LIST EVENT 0 EVENT 1 EVENT 2 EVENT 3 /end AVAILABLE_EVENT_LIST /begin DEFAULT_EVENT_LIST EVENT 1 /end DEFAULT_EVENT_LIST /end DAQ_EVENT
 /end IF_DATA
/end MEASUREMENT
/begin MEASUREMENT SSECUSN_r "Bosch ECU software number" UBYTE dez 1 100 0.00 255.0 FORMAT "%5.1" ARRAY_SIZE 10 ECU_ADDRESS 0x40008724
 /begin IF_DATA XCPplus 0x0102
  /begin DAQ_EVENT VARIABLE /begin AVAILABLE_EVENT_LIST EVENT 0 EVENT 1 EVENT 2 EVENT 3 /end AVAILABLE_EVENT_LIST /begin DEFAULT_EVENT_LIST EVENT 1 /end DEFAULT_EVENT_LIST /end DAQ_EVENT
 /end IF_DATA
/end MEASUREMENT
/begin MEASUREMENT stepfrqcnt "the activation counter based on the stepper is not moved" UWORD dez 1 100 0.00 65535.00 FORMAT "%8.2" ECU_ADDRESS 0x400084B4
 /begin IF_DATA XCPplus 0x0102
  /begin DAQ_EVENT VARIABLE /begin AVAILABLE_EVENT_LIST EVENT 0 EVENT 1 EVENT 2 EVENT 3 /end AVAILABLE_EVENT_LIST /begin DEFAULT_EVENT_LIST EVENT 1 /end DEFAULT_EVENT_LIST /end DAQ_EVENT
 /end IF_DATA
/end MEASUREMENT
/begin MEASUREMENT stpcount_w "delay counter during directional (close to open or open to close) change for stepper operation" UWORD t_q0p001 1 100 0.00 65.53500 FORMAT "%8.5" ECU_ADDRESS 0x400084B6 /end MEASUREMENT
/begin MEASUREMENT stpdiacnt "Counter to count the number of activations of stepper to start diagnosis" UBYTE dez 1 100 0.00 255.0 FORMAT "%5.1" ECU_ADDRESS 0x4000887F /end MEASUREMENT
/begin MEASUREMENT stpfreqt_w "current control speed of stepper operation" UWORD pps_uw_q1 1 100 0.00 65535.00 FORMAT "%8.2" ECU_ADDRESS 0x400084B0
 /begin IF_DATA XCPplus 0x0102
  /begin DAQ_EVENT VARIABLE /begin AVAILABLE_EVENT_LIST EVENT 0 EVENT 1 EVENT 2 EVENT 3 /end AVAILABLE_EVENT_LIST /begin DEFAULT_EVENT_LIST EVENT 1 /end DEFAULT_EVENT_LIST /end DAQ_EVENT
 /end IF_DATA
/end MEASUREMENT
/begin MEASUREMENT stpfrqrampinit_w "initialisation of ramp frequency value for stepper motor operation" UWORD pps_uw_q1 1 100 0.00 65535.00 FORMAT "%8.2" ECU_ADDRESS 0x400084A4
 /begin IF_DATA XCPplus 0x0102
  /begin DAQ_EVENT VARIABLE /begin AVAILABLE_EVENT_LIST EVENT 0 EVENT 1 EVENT 2 EVENT 3 /end AVAILABLE_EVENT_LIST /begin DEFAULT_EVENT_LIST EVENT 1 /end DEFAULT_EVENT_LIST /end DAQ_EVENT
 /end IF_DATA
/end MEASUREMENT
/begin MEASUREMENT stpfrqramp_w "ramp frequency value for stepper motor operation" UWORD pps_uw_q1 1 100 0.00 65535.00 FORMAT "%8.2" ECU_ADDRESS 0x400084A2
 /begin IF_DATA XCPplus 0x0102
  /begin DAQ_EVENT VARIABLE /begin AVAILABLE_EVENT_LIST EVENT 0 EVENT 1 EVENT 2 EVENT 3 /end AVAILABLE_EVENT_LIST /begin DEFAULT_EVENT_LIST EVENT 1 /end DEFAULT_EVENT_LIST /end DAQ_EVENT
 /end IF_DATA
/end MEASUREMENT
/begin MEASUREMENT stpfrq_w "current frequency of stepper motor operation" UWORD pps_uw_q1 1 100 0.00 65535.00 FORMAT "%8.2" ECU_ADDRESS 0x400084A0
 /begin IF_DATA XCPplus 0x0102
  /begin DAQ_EVENT VARIABLE /begin AVAILABLE_EVENT_LIST EVENT 0 EVENT 1 EVENT 2 EVENT 3 /end AVAILABLE_EVENT_LIST /begin DEFAULT_EVENT_LIST EVENT 1 /end DEFAULT_EVENT_LIST /end DAQ_EVENT
 /end IF_DATA
/end MEASUREMENT
/begin MEASUREMENT stplrnadp_w "desired position of stepper motor during step loss correction mode active" UWORD dez 1 100 0.00 65535.00 FORMAT "%8.2" ECU_ADDRESS 0x4000849E
 /begin IF_DATA XCPplus 0x0102
  /begin DAQ_EVENT VARIABLE /begin AVAILABLE_EVENT_LIST EVENT 0 EVENT 1 EVENT 2 EVENT 3 /end AVAILABLE_EVENT_LIST /begin DEFAULT_EVENT_LIST EVENT 1 /end DEFAULT_EVENT_LIST /end DAQ_EVENT
 /end IF_DATA
/end MEASUREMENT
/begin MEASUREMENT stplrnsol_w "Desired position of stepper motor for mech limit learning (steps)" UWORD dez 1 100 0.00 65535.00 FORMAT "%8.2" ECU_ADDRESS 0x4000849C
 /begin IF_DATA XCPplus 0x0102
  /begin DAQ_EVENT VARIABLE /begin AVAILABLE_EVENT_LIST EVENT 0 EVENT 1 EVENT 2 EVENT 3 /end AVAILABLE_EVENT_LIST /begin DEFAULT_EVENT_LIST EVENT 1 /end DEFAULT_EVENT_LIST /end DAQ_EVENT
 /end IF_DATA
/end MEASUREMENT
/begin MEASUREMENT stpstepcnt_w "actual position of stepper motor(steps)" UWORD dez 1 100 0.00 65535.00 FORMAT "%8.2" ECU_ADDRESS 0x4000C6C0
 /begin IF_DATA XCPplus 0x0102
  /begin DAQ_EVENT VARIABLE /begin AVAILABLE_EVENT_LIST EVENT 0 EVENT 1 EVENT 2 EVENT 3 /end AVAILABLE_EVENT_LIST /begin DEFAULT_EVENT_LIST EVENT 1 /end DEFAULT_EVENT_LIST /end DAQ_EVENT
 /end IF_DATA
/end MEASUREMENT
/begin MEASUREMENT stpstepi_w "actual position of stepper motor(steps)" UWORD dez 1 100 0.00 65535.00 FORMAT "%8.2" ECU_ADDRESS 0x4000C6BE
 /begin IF_DATA XCPplus 0x0102
  /begin DAQ_EVENT VARIABLE /begin AVAILABLE_EVENT_LIST EVENT 0 EVENT 1 EVENT 2 EVENT 3 /end AVAILABLE_EVENT_LIST /begin DEFAULT_EVENT_LIST EVENT 1 /end DEFAULT_EVENT_LIST /end DAQ_EVENT
 /end IF_DATA
/end MEASUREMENT
/begin MEASUREMENT stpstepsol_w "Coordinated desired position of stepper motor (steps) based on application layer function" UWORD dez 1 100 0.00 65535.00 FORMAT "%8.2" ECU_ADDRESS 0x400084AA
 /begin IF_DATA XCPplus 0x0102
  /begin DAQ_EVENT VARIABLE /begin AVAILABLE_EVENT_LIST EVENT 0 EVENT 1 EVENT 2 EVENT 3 /end AVAILABLE_EVENT_LIST /begin DEFAULT_EVENT_LIST EVENT 1 /end DEFAULT_EVENT_LIST /end DAQ_EVENT
 /end IF_DATA
/end MEASUREMENT
/begin MEASUREMENT stpsteps_w "Desired position of stepper motor(steps)" UWORD dez 1 100 0.00 65535.00 FORMAT "%8.2" ECU_ADDRESS 0x4000849A
 /begin IF_DATA XCPplus 0x0102
  /begin DAQ_EVENT VARIABLE /begin AVAILABLE_EVENT_LIST EVENT 0 EVENT 1 EVENT 2 EVENT 3 /end AVAILABLE_EVENT_LIST /begin DEFAULT_EVENT_LIST EVENT 1 /end DEFAULT_EVENT_LIST /end DAQ_EVENT
 /end IF_DATA
/end MEASUREMENT
/begin MEASUREMENT stpvpsol_w "Nominal value of STP valve position" UWORD dez 1 100 0.00 65535.00 FORMAT "%8.2" ECU_ADDRESS 0x40008498
 /begin IF_DATA XCPplus 0x0102
  /begin DAQ_EVENT VARIABLE /begin AVAILABLE_EVENT_LIST EVENT 0 EVENT 1 EVENT 2 EVENT 3 /end AVAILABLE_EVENT_LIST /begin DEFAULT_EVENT_LIST EVENT 1 /end DEFAULT_EVENT_LIST /end DAQ_EVENT
 /end IF_DATA
/end MEASUREMENT
/begin MEASUREMENT temp_pos "Temporary variable used for storing the stepper's command word" UBYTE dez 1 100 0.00 255.0 FORMAT "%5.1" ECU_ADDRESS 0x4000887E
 /begin IF_DATA XCPplus 0x0102
  /begin DAQ_EVENT VARIABLE /begin AVAILABLE_EVENT_LIST EVENT 0 EVENT 1 EVENT 2 EVENT 3 /end AVAILABLE_EVENT_LIST /begin DEFAULT_EVENT_LIST EVENT 1 /end DEFAULT_EVENT_LIST /end DAQ_EVENT
 /end IF_DATA
/end MEASUREMENT
/begin MEASUREMENT tltcntr_l "tilt counter" ULONG dez 1 100 0.00 4294967295.00 FORMAT "%13.2" ECU_ADDRESS 0x4000C674
 /begin IF_DATA XCPplus 0x0102
  /begin DAQ_EVENT VARIABLE /begin AVAILABLE_EVENT_LIST EVENT 0 EVENT 1 EVENT 2 EVENT 3 /end AVAILABLE_EVENT_LIST /begin DEFAULT_EVENT_LIST EVENT 1 /end DEFAULT_EVENT_LIST /end DAQ_EVENT
 /end IF_DATA
/end MEASUREMENT
/begin MEASUREMENT vmlg "Fuel consumption in terms of mileage" UWORD fak_q0p1 1 100 0.00 6553.500 FORMAT "%8.3" ECU_ADDRESS 0x40008202
 /begin IF_DATA XCPplus 0x0102
  /begin DAQ_EVENT VARIABLE /begin AVAILABLE_EVENT_LIST EVENT 0 EVENT 1 EVENT 2 EVENT 3 /end AVAILABLE_EVENT_LIST /begin DEFAULT_EVENT_LIST EVENT 3 /end DEFAULT_EVENT_LIST /end DAQ_EVENT
 /end IF_DATA
/end MEASUREMENT
/begin MEASUREMENT vmlg_nonavg "Instantaneous mileage calculated every second" UWORD fak_q0p1 1 100 0.00 6553.500 FORMAT "%8.3" ECU_ADDRESS 0x40008200
 /begin IF_DATA XCPplus 0x0102
  /begin DAQ_EVENT VARIABLE /begin AVAILABLE_EVENT_LIST EVENT 0 EVENT 1 EVENT 2 EVENT 3 /end AVAILABLE_EVENT_LIST /begin DEFAULT_EVENT_LIST EVENT 3 /end DEFAULT_EVENT_LIST /end DAQ_EVENT
 /end IF_DATA
/end MEASUREMENT
/begin MEASUREMENT vmlg_sum "Mileage accumulated over a driving cycle" ULONG fak_q0p1 1 100 0.00 429496729.500 FORMAT "%13.3" ECU_ADDRESS 0x40008DF8
 /begin IF_DATA XCPplus 0x0102
  /begin DAQ_EVENT VARIABLE /begin AVAILABLE_EVENT_LIST EVENT 0 EVENT 1 EVENT 2 EVENT 3 /end AVAILABLE_EVENT_LIST /begin DEFAULT_EVENT_LIST EVENT 3 /end DEFAULT_EVENT_LIST /end DAQ_EVENT
 /end IF_DATA
/end MEASUREMENT
/begin MEASUREMENT wubcntr_l "over voltage counter" ULONG dez 1 100 0.00 4294967295.00 FORMAT "%13.2" ECU_ADDRESS 0x4000C670
 /begin IF_DATA XCPplus 0x0102
  /begin DAQ_EVENT VARIABLE /begin AVAILABLE_EVENT_LIST EVENT 0 EVENT 1 EVENT 2 EVENT 3 /end AVAILABLE_EVENT_LIST /begin DEFAULT_EVENT_LIST EVENT 1 /end DEFAULT_EVENT_LIST /end DAQ_EVENT
 /end IF_DATA
/end MEASUREMENT
/begin FUNCTION BypAirActr_Mon "9500.6.0  Bypass Air Actuator Monitoring"
 /begin DEF_CHARACTERISTIC BypAirActr_cntrOcErrThd_C BypAirActr_cntrOcHealThd_C BypAirActr_cntrOlErrThd_C BypAirActr_cntrOlHealThd_C BypAirActr_cntrOtErrThd_C BypAirActr_cntrOtHealThd_C BypAirActr_cntrScbErrThd_C BypAirActr_cntrScbHealThd_C BypAirActr_cntrScgErrThd_C BypAirActr_cntrScgHealThd_C DFC_CtlMsk2.DFC_BypAirActrOcCoil1_C DFC_CtlMsk2.DFC_BypAirActrOcCoil2_C DFC_CtlMsk2.DFC_BypAirActrOlCoil1_C DFC_CtlMsk2.DFC_BypAirActrOlCoil2_C DFC_CtlMsk2.DFC_BypAirActrOt_C DFC_CtlMsk2.DFC_BypAirActrScbCoil1_C DFC_CtlMsk2.DFC_BypAirActrScbCoil2_C DFC_CtlMsk2.DFC_BypAirActrScgCoil1_C DFC_CtlMsk2.DFC_BypAirActrScgCoil2_C DFC_DisblMsk2.DFC_BypAirActrOcCoil1_C DFC_DisblMsk2.DFC_BypAirActrOcCoil2_C DFC_DisblMsk2.DFC_BypAirActrOlCoil1_C DFC_DisblMsk2.DFC_BypAirActrOlCoil2_C DFC_DisblMsk2.DFC_BypAirActrOt_C DFC_DisblMsk2.DFC_BypAirActrScbCoil1_C DFC_DisblMsk2.DFC_BypAirActrScbCoil2_C DFC_DisblMsk2.DFC_BypAirActrScgCoil1_C DFC_DisblMsk2.DFC_BypAirActrScgCoil2_C /end DEF_CHARACTERISTIC
 /begin IN_MEASUREMENT BypAirActr_flgCoilOn BypAirActr_flgDiagEna BypAirActr_stErrObsCoil1 BypAirActr_stErrObsCoil2 BypAirActr_stTstSucCoil1 BypAirActr_stTstSucCoil2 B_stpcoiloff SyC_stSub /end IN_MEASUREMENT
 /begin OUT_MEASUREMENT BypAirActr_flgCoilSwtOffScDiag1 BypAirActr_flgCoilSwtOffScDiag2 BypAirActr_flgOcErrCoil1 BypAirActr_flgOcErrCoil2 BypAirActr_flgOcHealCoil1 BypAirActr_flgOcHealCoil2 BypAirActr_flgOlErrCoil1 BypAirActr_flgOlErrCoil2 BypAirActr_flgOlHealCoil1 BypAirActr_flgOlHealCoil2 BypAirActr_flgOtErr BypAirActr_flgOtHeal BypAirActr_flgPsElecErr BypAirActr_flgScbErrCoil1 BypAirActr_flgScbErrCoil2 BypAirActr_flgScbHealCoil1 BypAirActr_flgScbHealCoil2 BypAirActr_flgScgErrCoil1 BypAirActr_flgScgErrCoil2 BypAirActr_flgScgHealCoil1 BypAirActr_flgScgHealCoil2 B_ellse /end OUT_MEASUREMENT
 /begin LOC_MEASUREMENT BypAirActr_cntrOcErrCoil1 BypAirActr_cntrOcErrCoil2 BypAirActr_cntrOcHealCoil1 BypAirActr_cntrOcHealCoil2 BypAirActr_cntrOlErrCoil1 BypAirActr_cntrOlErrCoil2 BypAirActr_cntrOlHealCoil1 BypAirActr_cntrOlHealCoil2 BypAirActr_cntrOtErr BypAirActr_cntrOtHeal BypAirActr_cntrScbErrCoil1 BypAirActr_cntrScbErrCoil2 BypAirActr_cntrScbHealCoil1 BypAirActr_cntrScbHealCoil2 BypAirActr_cntrScgErrCoil1 BypAirActr_cntrScgErrCoil2 BypAirActr_cntrScgHealCoil1 BypAirActr_cntrScgHealCoil2 BypAirActr_flgOcHealCfmdCoil1 BypAirActr_flgOcHealCfmdCoil2 BypAirActr_flgScbErrCfmdCoil1 BypAirActr_flgScbErrCfmdCoil2 BypAirActr_flgScbHealCfmdCoil1 BypAirActr_flgScbHealCfmdCoil2 BypAirActr_flgScgErrCfmdCoil1 BypAirActr_flgScgErrCfmdCoil2 BypAirActr_flgScgHealCfmdCoil1 BypAirActr_flgScgHealCfmdCoil2 /end LOC_MEASUREMENT
 FUNCTION_VERSION "9500.6.0" /end FUNCTION
/begin FUNCTION BypAirActr_PsIf "9500.5.0  Bypass Air Actuator Power stage Interface"
 /begin IN_MEASUREMENT BypAirActr_flgCoilSwtOffScDiag1 BypAirActr_flgCoilSwtOffScDiag2 B_pokayoke B_stepcmdactv B_stpclsreq B_stpopenreq B_stpuboff SyC_stSub /end IN_MEASUREMENT
 /begin OUT_MEASUREMENT BypAirActr_flgActrCls BypAirActr_flgActrOpen BypAirActr_flgCoilOn BypAirActr_flgDiagEna BypAirActr_Step BypAirActr_stErrObsCoil1 BypAirActr_stErrObsCoil2 BypAirActr_stTstSucCoil1 BypAirActr_stTstSucCoil2 /end OUT_MEASUREMENT
 /begin LOC_MEASUREMENT BypAirActr_CoilNrDiag BypAirActr_DiagInfo_a BypAirActr_flgDiagComErr BypAirActr_flgDiagUpdinfo BypAirActr_flgOnStOLDiagAbort BypAirActr_flgOnStOLDiagRunng /end LOC_MEASUREMENT
 FUNCTION_VERSION "9500.5.0" /end FUNCTION
/begin FUNCTION BypAirActr_SteprMotPosnCtrl "9500.6.0  Stepper motor position control"
 /begin DEF_CHARACTERISTIC CWSTPR DELTASTPLRN DELTFRQRAMP DNLRNSTPADP FKRLSTPADP FRQLOWERLIMIT FRQMECHLIMIT FRQSTPMECHLRN FRQSTPRESLIM FRQSTPRESMAXLIM FRQSTPRESMINLIM FRQUPPERLIMIT KLPSSTPADAPFG MAXSTEP MAXSTEPLOWFRQEN MINSTEP MINSTEPLOWFRQEN POSTDRVDLY STEPPATN STEPPATRNCOILOFF STPADPDISCTR STPPOWOFF STPRVPSAP TDSTPADAP TDSTPRLYFB UBSTPSTMN UBSTPSTMX /end DEF_CHARACTERISTIC
 /begin IN_MEASUREMENT B_edk B_edss B_ellse B_ll B_llrein B_nmin B_pokayoke Eep_EnvRamHist Eep_EnvRamInvld fho_w fkmsdk_w nmot_w nstat ollsst_w ollss_w psxzs_w pu_w rldkfil_w rlfgsb_w SyC_stSub ubsq /end IN_MEASUREMENT
 /begin OUT_MEASUREMENT B_ellr B_lrnfgstp B_lrnpost B_lrnstperf B_lrnstpfgrly B_pos_ok B_pslrnstp B_stepcmdactv B_stpadap B_stpadapen B_stpadapfg B_stpclsreq B_stpcoiloff B_stplossadp B_stpopenreq B_stppostfg B_stpren B_stpsap B_stpuboff olls olls_w psstpfrz_w stpfrqrampinit_w stpfrqramp_w stpfrq_w stplrnadp_w stplrnsol_w stpstepi_w stpsteps_w stpvpsol_w /end OUT_MEASUREMENT
 /begin LOC_MEASUREMENT B_closestp B_frqincr B_openstp B_resfrq B_stpclose B_stpmechlim B_stpopen B_ubsqmn B_ubsqmx coilnum dstpstep_w frqtimeconv_w posdly_w stepfrqcnt stpcount_w stpdiacnt stpfreqt_w stpstepcnt_w stpstepsol_w temp_pos /end LOC_MEASUREMENT
 FUNCTION_VERSION "9500.6.0" /end FUNCTION
/begin FUNCTION CanDrv ""
 /begin DEF_CHARACTERISTIC DDRC_DebArCounter.DFC_CAN_E_TIMEOUT.isJmpUpActv_C DDRC_DebArCounter.DFC_CAN_E_TIMEOUT.isJmpDwnActv_C DDRC_DebArCounter.DFC_CAN_E_TIMEOUT.limPassd_C DDRC_DebArCounter.DFC_CAN_E_TIMEOUT.limFaild_C DDRC_DebArCounter.DFC_CAN_E_TIMEOUT.stepUp_C DDRC_DebArCounter.DFC_CAN_E_TIMEOUT.stepDwn_C DDRC_DebArCounter.DFC_CAN_E_TIMEOUT.jmpUpVal_C DDRC_DebArCounter.DFC_CAN_E_TIMEOUT.jmpDwnVal_C DFC_CtlMsk2.DFC_CAN_E_TIMEOUT_C DFC_DisblMsk2.DFC_CAN_E_TIMEOUT_C /end DEF_CHARACTERISTIC
/end FUNCTION
/begin FUNCTION CDrv_Shared "330.0.0   Complex Driver Shared Definitions Gasoline" /begin IN_MEASUREMENT EpmSyn_phiOffs Epm_numCyl /end IN_MEASUREMENT FUNCTION_VERSION "330.0.0" /end FUNCTION
/begin FUNCTION CEL_Compu "1.235.0   Arithemetic computation methods and physical units in MSR language" FUNCTION_VERSION "1.235.0" /end FUNCTION
/begin FUNCTION CEL_CompuLcy "1.0.0     Computation methods and SW Units with old DGS naming convention" FUNCTION_VERSION "1.0.0" /end FUNCTION
/begin FUNCTION CEL_Const "1.16.0    DGS central System Constants of the category FIXED" /begin DEF_CHARACTERISTIC medc_datasetid /end DEF_CHARACTERISTIC FUNCTION_VERSION "1.16.0" /end FUNCTION
/begin FUNCTION CodeGen "2.14.1    ASCET Automotive System Library Interface" FUNCTION_VERSION "2.14.1" /end FUNCTION
/begin FUNCTION CoEng_StEng "9000.0.0  Coordinator Engine - Engine States" /begin DEF_CHARACTERISTIC CoEng_nThresCranking_C /end DEF_CHARACTERISTIC /begin IN_MEASUREMENT B_stendes Epm_nEng SyC_stSub tnse_w /end IN_MEASUREMENT /begin OUT_MEASUREMENT CoEng_bObdTmrInctg CoEng_st CoEng_stOld CoEng_tiNormalOBD /end OUT_MEASUREMENT FUNCTION_VERSION "9000.0.0" /end FUNCTION
/begin FUNCTION Common "3.2.0     central header file" FUNCTION_VERSION "3.2.0" /end FUNCTION
/begin FUNCTION Common_Prj "9000.3.0  project specific parts of Common" FUNCTION_VERSION "9000.3.0" /end FUNCTION
/begin FUNCTION ComScl_Appl "6.4.0_386.9.0_MTBApplication of ComScl Layer"
 /begin DEF_CHARACTERISTIC DDRC_DurDeb.Com_tiDFC_Com_ABSInfo_DLCDebOk_C DDRC_DurDeb.Com_tiDFC_Com_ABSInfo_DLCDebDef_C DDRC_DurDeb.Com_tiDFC_Com_ABSInfo_TODebOk_C DDRC_DurDeb.Com_tiDFC_Com_ABSInfo_TODebDef_C DFC_CtlMsk2.DFC_Com_ABSInfo_DLC_C DFC_CtlMsk2.DFC_Com_ABSInfo_TO_C DFC_DisblMsk2.DFC_Com_ABSInfo_DLC_C DFC_DisblMsk2.DFC_Com_ABSInfo_TO_C /end DEF_CHARACTERISTIC
 /begin IN_MEASUREMENT anztib_w APP_r avgmlg B_atmtpa B_bevab B_hsve B_kh B_khn B_kl15 B_kuppl B_leanvk B_ll B_lr B_lra B_mdene B_neutgear B_nozwe B_sa B_slv B_stendes B_syn B_temin B_tltsig B_uk1 B_zwlwf Com_avgvfzg_0 Com_avgvfzg_1 Com_avgvmlg_0 Com_avgvmlg_1 Com_BIDev_flgSidstSt Com_B_etmot Com_B_OvHLamp Com_DFES_numDFC Com_DFES_numDFC0 Com_DFES_numDFC1 Com_DFES_numDFC2 Com_DFES_numDFC3 Com_DFES_numDFC4 Com_DFES_stChk Com_DFES_stChk0 Com_DFES_stChk1 Com_DFES_stChk2 Com_DFES_stChk3 Com_DFES_stChk4 Com_DIUMPR_ctGenDenom Com_stgwhs Com_stlf1s Com_stllri Com_stmaxlatp Com_stOvHEngShDwn Com_stOvHEngSpdLimr Com_stte Com_vfzg_w dmllri_w dmvad_w DSMDur_ctPID21h DSMDur_ctPID31h fkmsdk_w fra_w fr_w fwfb_w gangi igndglck InjSys_volFuFlowmL lamsol miist_w milbo_w milbu_w MILLmp_stPs miopt_w MisfDet_stDet MisfDet_stDnDet mizbo_w mizbu_w ml msleak_w nmot nsol_w nstat ofmsdkq_w olls_w phlsnvxf psdss_w pu redsol rinv_w rka_w rkukg_w rk_w rl Rollovr_stRollovrDiagcErr SidstSwt_stSidstDiagcErr taikrm tans tateout_w tieff_w tmot top06m_w tvlr ubsq usvkl wdkba wdkba_w zwopt zwout zwout1 zwspae /end IN_MEASUREMENT
 /begin OUT_MEASUREMENT Com_flgABSFrntwhlSpdVld Com_flgABSRewhlSpdVld Com_stABSEvntAct Com_stABSWarnLmp Com_vABSFrntWhlSpd Com_vABSReWhlSpd /end OUT_MEASUREMENT
 FUNCTION_VERSION "6.4.0_386.9.0_MTB" /end FUNCTION
/begin FUNCTION Conversion_CELPrj "35000.1.0 Conversion Formulas, which are migrated from GS classic" FUNCTION_VERSION "35000.1.0" /end FUNCTION
/begin FUNCTION DCFFLR "9000.2.0  Output situation Oxygen sensor control for mode$01, mode$02, Carb Freeze Frame"
 /begin IN_MEASUREMENT B_eobdlr B_lr B_sbbvk nmot_w PrjCon_stLamSensRrCat_b SyC_stSub /end IN_MEASUREMENT
 /begin OUT_MEASUREMENT flglrs /end OUT_MEASUREMENT
 /begin LOC_MEASUREMENT B_lelshbb B_lelsxbb B_lelsxnb /end LOC_MEASUREMENT
 FUNCTION_VERSION "9000.2.0" /end FUNCTION
/begin FUNCTION DcmCore_If "1.8.0     MSR Interface generator for Autosar DCM" FUNCTION_VERSION "1.8.0" /end FUNCTION
/begin FUNCTION DcmDspUDS_DID "9000.2.0_386.2.0Configuration and Implementation of the DIDs for the DCM UDS Services (RDBI, WDBI, IOCBI)"
 /begin DEF_CHARACTERISTIC CALDATAVN_CA CALIBID DCM_ACTRTMR_C EROTAN HEXPRGFILE_CA KTMPARTNUM_CA OVERVOLTAGE_THRESHOLD_C SDSTCNTR_RPM_C SSECUSN_CA TLTCNTR_RPM_C vmlg_max_C /end DEF_CHARACTERISTIC
 /begin REF_CHARACTERISTIC ATS_numIgnImp_C ATS_numInjPfiImp_C /end REF_CHARACTERISTIC
 /begin IN_MEASUREMENT avgvfzg B_atmtpa B_bm B_kl15 B_ll B_sa B_sdstact B_st B_tltsig B_vllr engcmbstevnt_l EngDa_tEng engrevcntr_l EpmCrS_stSigMode Epm_nEng fra_w frm_w fr_w gangi kmstand_l MILLmp_stMIL ml_w ofmsdkq_w olls_w psdss_w rka_w rl szout_w T15_st tans tateout_w tieff_w topre1m_l ubsq udss_w urovs_w usdst_w usvkl uwdk_w VehV_v vfzg vsks_w wdkba wtans wub zwout zwout1 /end IN_MEASUREMENT
 /begin OUT_MEASUREMENT avgmlg avgvmlg B_enghrste Dcm_stMSR Dcm_stVarcode Dcm_stVarcode2 sdstactcntr_l tltcntr_l vmlg vmlg_nonavg wubcntr_l /end OUT_MEASUREMENT
 /begin LOC_MEASUREMENT CALDATAVN_r Dcm_stCallWr Dcm_stEepOrder engRunHrs_tmpU32 engRunHrs_tmpU8 engRunHrs_UpdateFail HEXPRGFILE_r KTMPARTNUM_r navg navg_init SSECUSN_r vmlg_sum /end LOC_MEASUREMENT
 FUNCTION_VERSION "9000.2.0_386.2.0" /end FUNCTION
/begin FUNCTION DcmDspUDS_RC "7.14.0_386.1.0DCM UDS Routine Control" /begin DEF_CHARACTERISTIC ComDia_uThrRelearnThd_C /end DEF_CHARACTERISTIC /begin IN_MEASUREMENT B_kuppl B_ll Epm_nEng ThrVlv_stLrngTstrTrig uwdk_w /end IN_MEASUREMENT /begin OUT_MEASUREMENT ComDia_flgTPSLrnEnbl /end OUT_MEASUREMENT FUNCTION_VERSION "7.14.0_386.1.0" /end FUNCTION
/begin FUNCTION DDRC "30000.13.0Diagnostic Debounce and Report of Check"
 /begin REF_CHARACTERISTIC DDRC_DurDeb.DevLib_tiBattUHiDebOk_C DDRC_DurDeb.DevLib_tiBattUHiDebDef_C DDRC_DurDeb.DevLib_tiBattULoDebOk_C DDRC_DurDeb.DevLib_tiBattULoDebDef_C DDRC_DurDeb.Strt_tiOLDebOk_C DDRC_DurDeb.Strt_tiOLDebDef_C DDRC_DurDeb.Strt_tiOvrTempDebOk_C DDRC_DurDeb.Strt_tiOvrTempDebDef_C DDRC_DurDeb.Strt_tiSCBDebOk_C DDRC_DurDeb.Strt_tiSCBDebDef_C DDRC_DurDeb.Strt_tiSCGDebOk_C DDRC_DurDeb.Strt_tiSCGDebDef_C DDRC_DurDeb.MILLmp_tiOLDebOk_C DDRC_DurDeb.MILLmp_tiOLDebDef_C DDRC_DurDeb.MILLmp_tiOTDebOk_C DDRC_DurDeb.MILLmp_tiOTDebDef_C DDRC_DurDeb.MILLmp_tiSCBDebOk_C DDRC_DurDeb.MILLmp_tiSCBDebDef_C DDRC_DurDeb.MILLmp_tiSCGDebOk_C DDRC_DurDeb.MILLmp_tiSCGDebDef_C DDRC_DurDeb.InjVvG_numOLDebOk_C DDRC_DurDeb.InjVvG_numOLDebDef_C DDRC_DurDeb.InjVvG_numSCBDebOk_C DDRC_DurDeb.InjVvG_numSCBDebDef_C DDRC_DurDeb.InjVvG_numSCGDebOk_C DDRC_DurDeb.InjVvG_numSCGDebDef_C DDRC_DurDeb.BusDiag_tiBusOffOL_Can0DebOk_C DDRC_DurDeb.BusDiag_tiBusOffOL_Can0DebDef_C DDRC_DurDeb.Com_tiDFC_Com_ABSInfo_DLCDebOk_C DDRC_DurDeb.Com_tiDFC_Com_ABSInfo_DLCDebDef_C DDRC_DurDeb.Com_tiDFC_Com_ABSInfo_TODebOk_C DDRC_DurDeb.Com_tiDFC_Com_ABSInfo_TODebDef_C DDRC_DurDeb.BusDiag_numBusOff_Can0DebOk_C DDRC_DurDeb.BusDiag_numBusOff_Can0DebDef_C DDRC_RatDeb.DevLib_tiBattUHiUDRat_C DDRC_RatDeb.DevLib_tiBattULoUDRat_C DDRC_RatDeb.Strt_tiOLUDRat_C DDRC_RatDeb.Strt_tiOvrTempUDRat_C DDRC_RatDeb.Strt_tiSCBUDRat_C DDRC_RatDeb.Strt_tiSCGUDRat_C DDRC_RatDeb.MILLmp_tiOLUDRat_C DDRC_RatDeb.MILLmp_tiOTUDRat_C DDRC_RatDeb.MILLmp_tiSCBUDRat_C DDRC_RatDeb.MILLmp_tiSCGUDRat_C DDRC_RatDeb.InjVvG_numOLUDRat_C DDRC_RatDeb.InjVvG_numSCBUDRat_C DDRC_RatDeb.InjVvG_numSCGUDRat_C /end REF_CHARACTERISTIC
 /begin LOC_MEASUREMENT DDRC_St.DFC_BusDiagOpenLoad_Can0 DDRC_St.DFC_Com_ABSInfo_DLC DDRC_St.DFC_Com_ABSInfo_TO DDRC_St.DFC_BusDiagBusOff_Can0 DDRC_St.DFC_DevLibBattUHi DDRC_St.DFC_DevLibBattULo DDRC_St.DFC_StrtOL DDRC_St.DFC_StrtOvrTemp DDRC_St.DFC_StrtSCB DDRC_St.DFC_StrtSCG DDRC_St.DFC_MILLmpOL DDRC_St.DFC_MILLmpOT DDRC_St.DFC_MILLmpSCB DDRC_St.DFC_MILLmpSCG DDRC_St.DFC_EV1max DDRC_St.DFC_EV1min DDRC_St.DFC_EV1sig DSM_xTabVersion /end LOC_MEASUREMENT
 FUNCTION_VERSION "30000.13.0" /end FUNCTION
/begin FUNCTION DDRC_DemDeb ""
 /begin DEF_CHARACTERISTIC DDRC_DebArCounter.DFC_CANIF_E_CTRL_STOPPED_ERROR_VALUE.isJmpUpActv_C DDRC_DebArCounter.DFC_CANIF_E_CTRL_STOPPED_ERROR_VALUE.isJmpDwnActv_C DDRC_DebArCounter.DFC_CANIF_E_CTRL_STOPPED_ERROR_VALUE.limPassd_C DDRC_DebArCounter.DFC_CANIF_E_CTRL_STOPPED_ERROR_VALUE.limFaild_C DDRC_DebArCounter.DFC_CANIF_E_CTRL_STOPPED_ERROR_VALUE.stepUp_C DDRC_DebArCounter.DFC_CANIF_E_CTRL_STOPPED_ERROR_VALUE.stepDwn_C DDRC_DebArCounter.DFC_CANIF_E_CTRL_STOPPED_ERROR_VALUE.jmpUpVal_C DDRC_DebArCounter.DFC_CANIF_E_CTRL_STOPPED_ERROR_VALUE.jmpDwnVal_C DDRC_DebArCounter.DFC_CANIF_E_INVALID_DLC_ERROR.isJmpUpActv_C DDRC_DebArCounter.DFC_CANIF_E_INVALID_DLC_ERROR.isJmpDwnActv_C DDRC_DebArCounter.DFC_CANIF_E_INVALID_DLC_ERROR.limPassd_C DDRC_DebArCounter.DFC_CANIF_E_INVALID_DLC_ERROR.limFaild_C DDRC_DebArCounter.DFC_CANIF_E_INVALID_DLC_ERROR.stepUp_C DDRC_DebArCounter.DFC_CANIF_E_INVALID_DLC_ERROR.stepDwn_C DDRC_DebArCounter.DFC_CANIF_E_INVALID_DLC_ERROR.jmpUpVal_C DDRC_DebArCounter.DFC_CANIF_E_INVALID_DLC_ERROR.jmpDwnVal_C DDRC_DebArCounter.DFC_CANNM_E_CANIF_TRANSMIT_ERROR.isJmpUpActv_C DDRC_DebArCounter.DFC_CANNM_E_CANIF_TRANSMIT_ERROR.isJmpDwnActv_C DDRC_DebArCounter.DFC_CANNM_E_CANIF_TRANSMIT_ERROR.limPassd_C DDRC_DebArCounter.DFC_CANNM_E_CANIF_TRANSMIT_ERROR.limFaild_C DDRC_DebArCounter.DFC_CANNM_E_CANIF_TRANSMIT_ERROR.stepUp_C DDRC_DebArCounter.DFC_CANNM_E_CANIF_TRANSMIT_ERROR.stepDwn_C DDRC_DebArCounter.DFC_CANNM_E_CANIF_TRANSMIT_ERROR.jmpUpVal_C DDRC_DebArCounter.DFC_CANNM_E_CANIF_TRANSMIT_ERROR.jmpDwnVal_C DDRC_DebArCounter.DFC_CANNM_E_INIT_FAILED.isJmpUpActv_C DDRC_DebArCounter.DFC_CANNM_E_INIT_FAILED.isJmpDwnActv_C DDRC_DebArCounter.DFC_CANNM_E_INIT_FAILED.limPassd_C DDRC_DebArCounter.DFC_CANNM_E_INIT_FAILED.limFaild_C DDRC_DebArCounter.DFC_CANNM_E_INIT_FAILED.stepUp_C DDRC_DebArCounter.DFC_CANNM_E_INIT_FAILED.stepDwn_C DDRC_DebArCounter.DFC_CANNM_E_INIT_FAILED.jmpUpVal_C DDRC_DebArCounter.DFC_CANNM_E_INIT_FAILED.jmpDwnVal_C DDRC_DebArCounter.DFC_CANNM_E_NETWORK_TIMEOUT.isJmpUpActv_C DDRC_DebArCounter.DFC_CANNM_E_NETWORK_TIMEOUT.isJmpDwnActv_C DDRC_DebArCounter.DFC_CANNM_E_NETWORK_TIMEOUT.limPassd_C DDRC_DebArCounter.DFC_CANNM_E_NETWORK_TIMEOUT.limFaild_C DDRC_DebArCounter.DFC_CANNM_E_NETWORK_TIMEOUT.stepUp_C DDRC_DebArCounter.DFC_CANNM_E_NETWORK_TIMEOUT.stepDwn_C DDRC_DebArCounter.DFC_CANNM_E_NETWORK_TIMEOUT.jmpUpVal_C DDRC_DebArCounter.DFC_CANNM_E_NETWORK_TIMEOUT.jmpDwnVal_C DDRC_DebArCounter.DFC_COMM_E_NET_START_IND_CHANNEL_0.isJmpUpActv_C DDRC_DebArCounter.DFC_COMM_E_NET_START_IND_CHANNEL_0.isJmpDwnActv_C DDRC_DebArCounter.DFC_COMM_E_NET_START_IND_CHANNEL_0.limPassd_C DDRC_DebArCounter.DFC_COMM_E_NET_START_IND_CHANNEL_0.limFaild_C DDRC_DebArCounter.DFC_COMM_E_NET_START_IND_CHANNEL_0.stepUp_C DDRC_DebArCounter.DFC_COMM_E_NET_START_IND_CHANNEL_0.stepDwn_C DDRC_DebArCounter.DFC_COMM_E_NET_START_IND_CHANNEL_0.jmpUpVal_C DDRC_DebArCounter.DFC_COMM_E_NET_START_IND_CHANNEL_0.jmpDwnVal_C DDRC_DebArCounter.DFC_COMM_E_NET_START_IND_CHANNEL_1.isJmpUpActv_C DDRC_DebArCounter.DFC_COMM_E_NET_START_IND_CHANNEL_1.isJmpDwnActv_C DDRC_DebArCounter.DFC_COMM_E_NET_START_IND_CHANNEL_1.limPassd_C DDRC_DebArCounter.DFC_COMM_E_NET_START_IND_CHANNEL_1.limFaild_C DDRC_DebArCounter.DFC_COMM_E_NET_START_IND_CHANNEL_1.stepUp_C DDRC_DebArCounter.DFC_COMM_E_NET_START_IND_CHANNEL_1.stepDwn_C DDRC_DebArCounter.DFC_COMM_E_NET_START_IND_CHANNEL_1.jmpUpVal_C DDRC_DebArCounter.DFC_COMM_E_NET_START_IND_CHANNEL_1.jmpDwnVal_C DDRC_DebArCounter.DFC_COMM_E_NET_START_IND_CHANNEL_2.isJmpUpActv_C DDRC_DebArCounter.DFC_COMM_E_NET_START_IND_CHANNEL_2.isJmpDwnActv_C DDRC_DebArCounter.DFC_COMM_E_NET_START_IND_CHANNEL_2.limPassd_C DDRC_DebArCounter.DFC_COMM_E_NET_START_IND_CHANNEL_2.limFaild_C DDRC_DebArCounter.DFC_COMM_E_NET_START_IND_CHANNEL_2.stepUp_C DDRC_DebArCounter.DFC_COMM_E_NET_START_IND_CHANNEL_2.stepDwn_C DDRC_DebArCounter.DFC_COMM_E_NET_START_IND_CHANNEL_2.jmpUpVal_C DDRC_DebArCounter.DFC_COMM_E_NET_START_IND_CHANNEL_2.jmpDwnVal_C DDRC_DebArCounter.DFC_COMM_E_NET_START_IND_CHANNEL_3.isJmpUpActv_C DDRC_DebArCounter.DFC_COMM_E_NET_START_IND_CHANNEL_3.isJmpDwnActv_C DDRC_DebArCounter.DFC_COMM_E_NET_START_IND_CHANNEL_3.limPassd_C DDRC_DebArCounter.DFC_COMM_E_NET_START_IND_CHANNEL_3.limFaild_C DDRC_DebArCounter.DFC_COMM_E_NET_START_IND_CHANNEL_3.stepUp_C DDRC_DebArCounter.DFC_COMM_E_NET_START_IND_CHANNEL_3.stepDwn_C DDRC_DebArCounter.DFC_COMM_E_NET_START_IND_CHANNEL_3.jmpUpVal_C DDRC_DebArCounter.DFC_COMM_E_NET_START_IND_CHANNEL_3.jmpDwnVal_C DDRC_DebArCounter.DFC_COMM_E_NET_START_IND_CHANNEL_4.isJmpUpActv_C DDRC_DebArCounter.DFC_COMM_E_NET_START_IND_CHANNEL_4.isJmpDwnActv_C DDRC_DebArCounter.DFC_COMM_E_NET_START_IND_CHANNEL_4.limPassd_C DDRC_DebArCounter.DFC_COMM_E_NET_START_IND_CHANNEL_4.limFaild_C DDRC_DebArCounter.DFC_COMM_E_NET_START_IND_CHANNEL_4.stepUp_C DDRC_DebArCounter.DFC_COMM_E_NET_START_IND_CHANNEL_4.stepDwn_C DDRC_DebArCounter.DFC_COMM_E_NET_START_IND_CHANNEL_4.jmpUpVal_C DDRC_DebArCounter.DFC_COMM_E_NET_START_IND_CHANNEL_4.jmpDwnVal_C DDRC_DebArCounter.DFC_COMM_E_NET_START_IND_CHANNEL_5.isJmpUpActv_C DDRC_DebArCounter.DFC_COMM_E_NET_START_IND_CHANNEL_5.isJmpDwnActv_C DDRC_DebArCounter.DFC_COMM_E_NET_START_IND_CHANNEL_5.limPassd_C DDRC_DebArCounter.DFC_COMM_E_NET_START_IND_CHANNEL_5.limFaild_C DDRC_DebArCounter.DFC_COMM_E_NET_START_IND_CHANNEL_5.stepUp_C DDRC_DebArCounter.DFC_COMM_E_NET_START_IND_CHANNEL_5.stepDwn_C DDRC_DebArCounter.DFC_COMM_E_NET_START_IND_CHANNEL_5.jmpUpVal_C DDRC_DebArCounter.DFC_COMM_E_NET_START_IND_CHANNEL_5.jmpDwnVal_C DDRC_DebArCounter.DFC_PDUR_E_INIT_FAILED.isJmpUpActv_C DDRC_DebArCounter.DFC_PDUR_E_INIT_FAILED.isJmpDwnActv_C DDRC_DebArCounter.DFC_PDUR_E_INIT_FAILED.limPassd_C DDRC_DebArCounter.DFC_PDUR_E_INIT_FAILED.limFaild_C DDRC_DebArCounter.DFC_PDUR_E_INIT_FAILED.stepUp_C DDRC_DebArCounter.DFC_PDUR_E_INIT_FAILED.stepDwn_C DDRC_DebArCounter.DFC_PDUR_E_INIT_FAILED.jmpUpVal_C DDRC_DebArCounter.DFC_PDUR_E_INIT_FAILED.jmpDwnVal_C DDRC_DebArCounter.DFC_PDUR_E_PDU_INSTANCE_LOST.isJmpUpActv_C DDRC_DebArCounter.DFC_PDUR_E_PDU_INSTANCE_LOST.isJmpDwnActv_C DDRC_DebArCounter.DFC_PDUR_E_PDU_INSTANCE_LOST.limPassd_C DDRC_DebArCounter.DFC_PDUR_E_PDU_INSTANCE_LOST.limFaild_C DDRC_DebArCounter.DFC_PDUR_E_PDU_INSTANCE_LOST.stepUp_C DDRC_DebArCounter.DFC_PDUR_E_PDU_INSTANCE_LOST.stepDwn_C DDRC_DebArCounter.DFC_PDUR_E_PDU_INSTANCE_LOST.jmpUpVal_C DDRC_DebArCounter.DFC_PDUR_E_PDU_INSTANCE_LOST.jmpDwnVal_C /end DEF_CHARACTERISTIC
 /begin REF_CHARACTERISTIC DDRC_DebArCounter.DFC_CANIF_E_CTRL_NOT_SLEEP_ERROR_VALUE.isJmpUpActv_C DDRC_DebArCounter.DFC_CANIF_E_CTRL_NOT_SLEEP_ERROR_VALUE.isJmpDwnActv_C DDRC_DebArCounter.DFC_CANIF_E_CTRL_NOT_SLEEP_ERROR_VALUE.limPassd_C DDRC_DebArCounter.DFC_CANIF_E_CTRL_NOT_SLEEP_ERROR_VALUE.limFaild_C DDRC_DebArCounter.DFC_CANIF_E_CTRL_NOT_SLEEP_ERROR_VALUE.stepUp_C DDRC_DebArCounter.DFC_CANIF_E_CTRL_NOT_SLEEP_ERROR_VALUE.stepDwn_C DDRC_DebArCounter.DFC_CANIF_E_CTRL_NOT_SLEEP_ERROR_VALUE.jmpUpVal_C DDRC_DebArCounter.DFC_CANIF_E_CTRL_NOT_SLEEP_ERROR_VALUE.jmpDwnVal_C DDRC_DebArCounter.DFC_CAN_E_TIMEOUT.isJmpUpActv_C DDRC_DebArCounter.DFC_CAN_E_TIMEOUT.isJmpDwnActv_C DDRC_DebArCounter.DFC_CAN_E_TIMEOUT.limPassd_C DDRC_DebArCounter.DFC_CAN_E_TIMEOUT.limFaild_C DDRC_DebArCounter.DFC_CAN_E_TIMEOUT.stepUp_C DDRC_DebArCounter.DFC_CAN_E_TIMEOUT.stepDwn_C DDRC_DebArCounter.DFC_CAN_E_TIMEOUT.jmpUpVal_C DDRC_DebArCounter.DFC_CAN_E_TIMEOUT.jmpDwnVal_C DDRC_DebArCounter.DFC_RBA_IOEXTLIB_KEEPALIVE_DRV.isJmpUpActv_C DDRC_DebArCounter.DFC_RBA_IOEXTLIB_KEEPALIVE_DRV.isJmpDwnActv_C DDRC_DebArCounter.DFC_RBA_IOEXTLIB_KEEPALIVE_DRV.limPassd_C DDRC_DebArCounter.DFC_RBA_IOEXTLIB_KEEPALIVE_DRV.limFaild_C DDRC_DebArCounter.DFC_RBA_IOEXTLIB_KEEPALIVE_DRV.stepUp_C DDRC_DebArCounter.DFC_RBA_IOEXTLIB_KEEPALIVE_DRV.stepDwn_C DDRC_DebArCounter.DFC_RBA_IOEXTLIB_KEEPALIVE_DRV.jmpUpVal_C DDRC_DebArCounter.DFC_RBA_IOEXTLIB_KEEPALIVE_DRV.jmpDwnVal_C DDRC_DebArCounter.DFC_RBA_IOEXTLIB_KEEPALIVE_INI.isJmpUpActv_C DDRC_DebArCounter.DFC_RBA_IOEXTLIB_KEEPALIVE_INI.isJmpDwnActv_C DDRC_DebArCounter.DFC_RBA_IOEXTLIB_KEEPALIVE_INI.limPassd_C DDRC_DebArCounter.DFC_RBA_IOEXTLIB_KEEPALIVE_INI.limFaild_C DDRC_DebArCounter.DFC_RBA_IOEXTLIB_KEEPALIVE_INI.stepUp_C DDRC_DebArCounter.DFC_RBA_IOEXTLIB_KEEPALIVE_INI.stepDwn_C DDRC_DebArCounter.DFC_RBA_IOEXTLIB_KEEPALIVE_INI.jmpUpVal_C DDRC_DebArCounter.DFC_RBA_IOEXTLIB_KEEPALIVE_INI.jmpDwnVal_C DDRC_DebArCounter.DFC_rba_IoSigRtc_StopCounter.isJmpUpActv_C DDRC_DebArCounter.DFC_rba_IoSigRtc_StopCounter.isJmpDwnActv_C DDRC_DebArCounter.DFC_rba_IoSigRtc_StopCounter.limPassd_C DDRC_DebArCounter.DFC_rba_IoSigRtc_StopCounter.limFaild_C DDRC_DebArCounter.DFC_rba_IoSigRtc_StopCounter.stepUp_C DDRC_DebArCounter.DFC_rba_IoSigRtc_StopCounter.stepDwn_C DDRC_DebArCounter.DFC_rba_IoSigRtc_StopCounter.jmpUpVal_C DDRC_DebArCounter.DFC_rba_IoSigRtc_StopCounter.jmpDwnVal_C DDRC_DebArCounter.DFC_rba_MultiStackTrace_Threshold.isJmpUpActv_C DDRC_DebArCounter.DFC_rba_MultiStackTrace_Threshold.isJmpDwnActv_C DDRC_DebArCounter.DFC_rba_MultiStackTrace_Threshold.limPassd_C DDRC_DebArCounter.DFC_rba_MultiStackTrace_Threshold.limFaild_C DDRC_DebArCounter.DFC_rba_MultiStackTrace_Threshold.stepUp_C DDRC_DebArCounter.DFC_rba_MultiStackTrace_Threshold.stepDwn_C DDRC_DebArCounter.DFC_rba_MultiStackTrace_Threshold.jmpUpVal_C DDRC_DebArCounter.DFC_rba_MultiStackTrace_Threshold.jmpDwnVal_C DDRC_DebArTime.DFC_SSpMon1.tiLimFaild_C DDRC_DebArTime.DFC_SSpMon1.tiLimPassd_C DDRC_DebArTime.DFC_SSpMon1OT.tiLimFaild_C DDRC_DebArTime.DFC_SSpMon1OT.tiLimPassd_C DDRC_DebArTime.DFC_SSpMon1OV.tiLimFaild_C DDRC_DebArTime.DFC_SSpMon1OV.tiLimPassd_C DDRC_DebArTime.DFC_SSpMon1SCG.tiLimFaild_C DDRC_DebArTime.DFC_SSpMon1SCG.tiLimPassd_C DDRC_DebArTime.DFC_SSpMon1UV.tiLimFaild_C DDRC_DebArTime.DFC_SSpMon1UV.tiLimPassd_C DDRC_DebArTime.DFC_SSpMon2.tiLimFaild_C DDRC_DebArTime.DFC_SSpMon2.tiLimPassd_C DDRC_DebArTime.DFC_SSpMon2OT.tiLimFaild_C DDRC_DebArTime.DFC_SSpMon2OT.tiLimPassd_C DDRC_DebArTime.DFC_SSpMon2OV.tiLimFaild_C DDRC_DebArTime.DFC_SSpMon2OV.tiLimPassd_C DDRC_DebArTime.DFC_SSpMon2SCG.tiLimFaild_C DDRC_DebArTime.DFC_SSpMon2SCG.tiLimPassd_C DDRC_DebArTime.DFC_SSpMon2UV.tiLimFaild_C DDRC_DebArTime.DFC_SSpMon2UV.tiLimPassd_C /end REF_CHARACTERISTIC
 /begin LOC_MEASUREMENT DDRC_ctArDebLvl.DFC_SSpMon1 DDRC_ctArDebLvl.DFC_SSpMon1OT DDRC_ctArDebLvl.DFC_SSpMon1OV DDRC_ctArDebLvl.DFC_SSpMon1SCG DDRC_ctArDebLvl.DFC_SSpMon1UV DDRC_ctArDebLvl.DFC_SSpMon2 DDRC_ctArDebLvl.DFC_SSpMon2OT DDRC_ctArDebLvl.DFC_SSpMon2OV DDRC_ctArDebLvl.DFC_SSpMon2SCG DDRC_ctArDebLvl.DFC_SSpMon2UV DDRC_ctArDebLvl.DFC_CANIF_E_CTRL_NOT_SLEEP_ERROR_VALUE DDRC_ctArDebLvl.DFC_CANIF_E_CTRL_STOPPED_ERROR_VALUE DDRC_ctArDebLvl.DFC_CANIF_E_INVALID_DLC_ERROR DDRC_ctArDebLvl.DFC_CANNM_E_CANIF_TRANSMIT_ERROR DDRC_ctArDebLvl.DFC_CANNM_E_INIT_FAILED DDRC_ctArDebLvl.DFC_CANNM_E_NETWORK_TIMEOUT DDRC_ctArDebLvl.DFC_CAN_E_TIMEOUT DDRC_ctArDebLvl.DFC_COMM_E_NET_START_IND_CHANNEL_0 DDRC_ctArDebLvl.DFC_COMM_E_NET_START_IND_CHANNEL_1 DDRC_ctArDebLvl.DFC_COMM_E_NET_START_IND_CHANNEL_2 DDRC_ctArDebLvl.DFC_COMM_E_NET_START_IND_CHANNEL_3 DDRC_ctArDebLvl.DFC_COMM_E_NET_START_IND_CHANNEL_4 DDRC_ctArDebLvl.DFC_COMM_E_NET_START_IND_CHANNEL_5 DDRC_ctArDebLvl.DFC_PDUR_E_INIT_FAILED DDRC_ctArDebLvl.DFC_PDUR_E_PDU_INSTANCE_LOST DDRC_ctArDebLvl.DFC_RBA_IOEXTLIB_KEEPALIVE_DRV DDRC_ctArDebLvl.DFC_RBA_IOEXTLIB_KEEPALIVE_INI DDRC_ctArDebLvl.DFC_rba_IoSigRtc_StopCounter DDRC_ctArDebLvl.DFC_rba_MultiStackTrace_Threshold DDRC_stLstRprtEve.DFC_SSpMon1 DDRC_stLstRprtEve.DFC_SSpMon1OT DDRC_stLstRprtEve.DFC_SSpMon1OV DDRC_stLstRprtEve.DFC_SSpMon1SCG DDRC_stLstRprtEve.DFC_SSpMon1UV DDRC_stLstRprtEve.DFC_SSpMon2 DDRC_stLstRprtEve.DFC_SSpMon2OT DDRC_stLstRprtEve.DFC_SSpMon2OV DDRC_stLstRprtEve.DFC_SSpMon2SCG DDRC_stLstRprtEve.DFC_SSpMon2UV DDRC_stLstRprtEve.DFC_CANIF_E_CTRL_NOT_SLEEP_ERROR_VALUE DDRC_stLstRprtEve.DFC_CANIF_E_CTRL_STOPPED_ERROR_VALUE DDRC_stLstRprtEve.DFC_CANIF_E_INVALID_DLC_ERROR DDRC_stLstRprtEve.DFC_CANNM_E_CANIF_TRANSMIT_ERROR DDRC_stLstRprtEve.DFC_CANNM_E_INIT_FAILED DDRC_stLstRprtEve.DFC_CANNM_E_NETWORK_TIMEOUT DDRC_stLstRprtEve.DFC_CAN_E_TIMEOUT DDRC_stLstRprtEve.DFC_COMM_E_NET_START_IND_CHANNEL_0 DDRC_stLstRprtEve.DFC_COMM_E_NET_START_IND_CHANNEL_1 DDRC_stLstRprtEve.DFC_COMM_E_NET_START_IND_CHANNEL_2 DDRC_stLstRprtEve.DFC_COMM_E_NET_START_IND_CHANNEL_3 DDRC_stLstRprtEve.DFC_COMM_E_NET_START_IND_CHANNEL_4 DDRC_stLstRprtEve.DFC_COMM_E_NET_START_IND_CHANNEL_5 DDRC_stLstRprtEve.DFC_PDUR_E_INIT_FAILED DDRC_stLstRprtEve.DFC_PDUR_E_PDU_INSTANCE_LOST DDRC_stLstRprtEve.DFC_RBA_IOEXTLIB_KEEPALIVE_DRV DDRC_stLstRprtEve.DFC_RBA_IOEXTLIB_KEEPALIVE_INI DDRC_stLstRprtEve.DFC_rba_IoSigRtc_StopCounter DDRC_stLstRprtEve.DFC_rba_MultiStackTrace_Threshold /end LOC_MEASUREMENT
/end FUNCTION
/begin FUNCTION DECJ "100.3.0   standard powerstage diagnosis enabling" /begin DEF_CHARACTERISTIC NDECJ UBCJMN UBCJMX /end DEF_CHARACTERISTIC /begin IN_MEASUREMENT BattU_u Epm_nEngLRes SyC_stSub /end IN_MEASUREMENT /begin OUT_MEASUREMENT B_deseehr_msg B_desee_msg B_PmdInit_msg /end OUT_MEASUREMENT FUNCTION_VERSION "100.3.0" /end FUNCTION
/begin FUNCTION DemDcmIf "30000.1.0 Dem-Dcm Interfaces" /begin IN_MEASUREMENT DFES_stOutstate DSMAUX_ctWUC DSMRdy_xPId1 /end IN_MEASUREMENT
 /begin LOC_MEASUREMENT Dem_disableEventStatusUpdateGroup Dem_DTCFltForFDC Dem_DTCFltFormat Dem_DTCFltKind Dem_DTCFltOrigin Dem_DTCFltProcCnt Dem_DTCFltProcIdx Dem_DTCFltRecFormat Dem_DTCFltRecRsltIdx Dem_DTCFltRsltIdx Dem_DTCFltSeverity Dem_DTCFltSt Dem_DTCFltStatusMask Dem_DTCFltWithSeverity /end LOC_MEASUREMENT
 FUNCTION_VERSION "30000.1.0" /end FUNCTION
/begin FUNCTION DEVE "1000.9.0_2.1.0Diagnosis of Output Stage Electromagnetic Injector Gasoline PFI"
 /begin DEF_CHARACTERISTIC CWPSEVE DDRC_DurDeb.InjVvG_numOLDebOk_C DDRC_DurDeb.InjVvG_numOLDebDef_C DDRC_DurDeb.InjVvG_numSCBDebOk_C DDRC_DurDeb.InjVvG_numSCBDebDef_C DDRC_DurDeb.InjVvG_numSCGDebOk_C DDRC_DurDeb.InjVvG_numSCGDebDef_C DDRC_RatDeb.InjVvG_numOLUDRat_C DDRC_RatDeb.InjVvG_numSCBUDRat_C DDRC_RatDeb.InjVvG_numSCGUDRat_C DFC_CtlMsk2.DFC_EV1max_C DFC_CtlMsk2.DFC_EV1min_C DFC_CtlMsk2.DFC_EV1sig_C DFC_CtlMsk2.DFC_EVX_C DFC_DisblMsk2.DFC_EV1max_C DFC_DisblMsk2.DFC_EV1min_C DFC_DisblMsk2.DFC_EV1sig_C DFC_DisblMsk2.DFC_EVX_C /end DEF_CHARACTERISTIC
 /begin REF_CHARACTERISTIC TVP /end REF_CHARACTERISTIC
 /begin IN_MEASUREMENT B_desee B_kl15 B_sa B_stend evz_austot /end IN_MEASUREMENT
 /begin OUT_MEASUREMENT B_eev eevbz eevd /end OUT_MEASUREMENT
 /begin LOC_MEASUREMENT deve_DiagInfo deve_PSDiagInfo eevd_bz_ng /end LOC_MEASUREMENT
 FUNCTION_VERSION "1000.9.0_2.1.0" /end FUNCTION
/begin COMPU_METHOD B_TRUE "" TAB_VERB "%6.3" "" COMPU_TAB_REF B_TRUE /end COMPU_METHOD
/begin COMPU_VTAB B_TRUE "" TAB_VERB 2 0 "FALSE" 1 "TRUE" /end COMPU_VTAB
/begin COMPU_METHOD CoEng_st_COMPU_VERB "" TAB_VERB "%6.3" "" COMPU_TAB_REF CoEng_st_COMPU_VERB /end COMPU_METHOD
/begin COMPU_VTAB CoEng_st_COMPU_VERB "" TAB_VERB 6 0 "COENG_STANDBY" 1 "COENG_READY" 2 "COENG_CRANKING" 3 "COENG_RUNNING" 4 "COENG_STOPPING" 5 "COENG_FINISH" /end COMPU_VTAB
/begin COMPU_METHOD CRS_BACKUP_DYN_SY_Compu "" TAB_VERB "%6.3" "" COMPU_TAB_REF CRS_BACKUP_DYN_SY_Compu /end COMPU_METHOD
/begin COMPU_VTAB CRS_BACKUP_DYN_SY_Compu "" TAB_VERB 2 0 "CAL_DYNCOR" 1 "ADAP_DYNCAOR" /end COMPU_VTAB
/begin COMPU_METHOD CRS_BACKUP_SY_Compu "" TAB_VERB "%6.3" "" COMPU_TAB_REF CRS_BACKUP_SY_Compu /end COMPU_METHOD
/begin COMPU_VTAB CRS_BACKUP_SY_Compu "" TAB_VERB 4 0 "NO_BCR" 1 "BCR" 2 "BCR_DYNCOR_START" 3 "BCR_DYNCOR_ALWAYS" /end COMPU_VTAB
/begin COMPU_METHOD CRS_CY30CONF_SY_Compu "" TAB_VERB "%6.3" "" COMPU_TAB_REF CRS_CY30CONF_SY_Compu /end COMPU_METHOD
/begin COMPU_VTAB CRS_CY30CONF_SY_Compu "" TAB_VERB 4 0 "HARD_WIRED" 1 "CONF_TH_VIA_SW" 2 "CONF_K_VIA_SW" 3 "CONF_TH_K_VIA_SW" /end COMPU_VTAB
/begin COMPU_METHOD CRS_DIAG_DETAIL_SY_Compu "" TAB_VERB "%6.3" "" COMPU_TAB_REF CRS_DIAG_DETAIL_SY_Compu /end COMPU_METHOD
/begin COMPU_VTAB CRS_DIAG_DETAIL_SY_Compu "" TAB_VERB 3 0 "NO_DETAIL" 1 "DETAIL_ERRSIG" 2 "DETAIL_ERRSIG_GLITCH" /end COMPU_VTAB
/begin COMPU_METHOD CRS_DIAG_SYNCINJLOST_SY_Compu "" TAB_VERB "%6.3" "" COMPU_TAB_REF CRS_DIAG_SYNCINJLOST_SY_Compu /end COMPU_METHOD
/begin COMPU_VTAB CRS_DIAG_SYNCINJLOST_SY_Compu "" TAB_VERB 3 0 "NO_ADD_DIAG" 1 "ACTIVATED" 2 "ACTIVATED_ALL" /end COMPU_VTAB
/begin COMPU_METHOD CRS_MIAP_SY_Compu "" TAB_VERB "%6.3" "" COMPU_TAB_REF CRS_MIAP_SY_Compu /end COMPU_METHOD
/begin COMPU_VTAB CRS_MIAP_SY_Compu "" TAB_VERB 2 0 "NO_COR" 1 "MIAP" /end COMPU_VTAB
/begin COMPU_METHOD CRS_SSP_SY_Compu "" TAB_VERB "%6.3" "" COMPU_TAB_REF CRS_SSP_SY_Compu /end COMPU_METHOD
/begin COMPU_VTAB CRS_SSP_SY_Compu "" TAB_VERB 4 0 "NO_CRS_SSPMON" 1 "CRS_SSPMON1" 2 "CRS_SSPMON2" 3 "CRS_SSPMON3" /end COMPU_VTAB
/begin COMPU_METHOD CRS_TAA_SY_Compu "" TAB_VERB "%6.3" "" COMPU_TAB_REF CRS_TAA_SY_Compu /end COMPU_METHOD
/begin COMPU_VTAB CRS_TAA_SY_Compu "" TAB_VERB 3 0 "NO_COR" 1 "TAA" 2 "TAA_ChkCor" /end COMPU_VTAB
/begin COMPU_METHOD CRS_TOOTHAVRG_SY_Compu "" TAB_VERB "%6.3" "" COMPU_TAB_REF CRS_TOOTHAVRG_SY_Compu /end COMPU_METHOD
/begin COMPU_VTAB CRS_TOOTHAVRG_SY_Compu "" TAB_VERB 2 0 "NO_AVRG" 1 "TOOTH_AVERAGE" /end COMPU_VTAB
/begin COMPU_METHOD CRYPTOLIB_SC_Compu "" TAB_VERB "%6.3" "" COMPU_TAB_REF CRYPTOLIB_SC_Compu /end COMPU_METHOD
/begin COMPU_VTAB CRYPTOLIB_SC_Compu "" TAB_VERB 2 0 "CRYPTOLIB_RB" 1 "CRYPTOLIB_BMW" /end COMPU_VTAB
/begin COMPU_METHOD CubMtrPerHr "" RAT_FUNC "%6.3" "m^3/h" COEFFS 0 10 0 0 0 1 /end COMPU_METHOD
/begin COMPU_METHOD Curr "" RAT_FUNC "%6.2" "mA" COEFFS 0 1 0 0 0 1 /end COMPU_METHOD
/begin COMPU_METHOD Curr_A "" RAT_FUNC "%6.4" "A" COEFFS 0 100 0 0 0 1 /end COMPU_METHOD
/begin COMPU_METHOD CVOCFG_SC_Compu "" TAB_VERB "%6.3" "" COMPU_TAB_REF CVOCFG_SC_Compu /end COMPU_METHOD
/begin COMPU_VTAB CVOCFG_SC_Compu "" TAB_VERB 4 0 "NO_CVO" 1 "BASC_CVO" 2 "STEP2_CVO" 3 "STEP3_CVO" /end COMPU_VTAB
/begin COMPU_METHOD CY150_SC_Compu "" TAB_VERB "%6.3" "" COMPU_TAB_REF CY150_SC_Compu /end COMPU_METHOD
/begin COMPU_VTAB CY150_SC_Compu "" TAB_VERB 2 0 "CY150_NONE" 1 "CY150_STRTR" /end COMPU_VTAB
/begin COMPU_METHOD CY320_SY_Compu "" TAB_VERB "%6.3" "" COMPU_TAB_REF CY320_SY_Compu /end COMPU_METHOD
/begin COMPU_VTAB CY320_SY_Compu "" TAB_VERB 2 0 "0" 1 "1" /end COMPU_VTAB
/begin COMPU_METHOD CY327_SY_Compu "" TAB_VERB "%6.3" "" COMPU_TAB_REF CY327_SY_Compu /end COMPU_METHOD
/begin COMPU_VTAB CY327_SY_Compu "" TAB_VERB 3 0 "No CY327" 1 "One CY327" 2 "Two CY327" /end COMPU_VTAB
/begin COMPU_METHOD CylHtRls "" RAT_FUNC "%6.3" "J" COEFFS 0 4 0 0 0 1 /end COMPU_METHOD
/begin COMPU_METHOD CylHtRlsRate "" RAT_FUNC "%6.4" "J/AgCA" COEFFS 0 64 0 0 0 1 /end COMPU_METHOD
/begin COMPU_METHOD CylinderVolumeCpp "" RAT_FUNC "%9.8" "m^3" COEFFS 0 1000000 0 0 0 1 /end COMPU_METHOD
/begin COMPU_METHOD CYLINDINJ_SY_Compu "" RAT_FUNC "%6.2" "" COEFFS 0 1 0 0 0 1 /end COMPU_METHOD
/begin COMPU_METHOD CylK1 "" RAT_FUNC "%6.4" "10^-5m^3/AgCA" COEFFS 0 128 0 0 0 1 /end COMPU_METHOD
/begin COMPU_METHOD CylK2 "" RAT_FUNC "%7.6" "-" COEFFS 0 16384 0 0 0 1 /end COMPU_METHOD
/begin COMPU_METHOD CylPres "" RAT_FUNC "%6.4" "bar" COEFFS 0 128 0 0 0 1 /end COMPU_METHOD
/begin COMPU_METHOD DDRCTime_ms "" RAT_FUNC "%6.1" "ms" COEFFS 0 1 0 0 0 10 /end COMPU_METHOD
/begin COMPU_METHOD DDRC_DTRFRZINFHEALDEB_SY_Compu "" TAB_VERB "%6.3" "" COMPU_TAB_REF DDRC_DTRFRZINFHEALDEB_SY_Compu /end COMPU_METHOD
/begin COMPU_VTAB DDRC_DTRFRZINFHEALDEB_SY_Compu "" TAB_VERB 2 0 "False" 1 "True" /end COMPU_VTAB
/begin COMPU_METHOD DDRC_DTRUPDSUP_SY_Compu "" TAB_VERB "%6.3" "" COMPU_TAB_REF DDRC_DTRUPDSUP_SY_Compu /end COMPU_METHOD
/begin COMPU_VTAB DDRC_DTRUPDSUP_SY_Compu "" TAB_VERB 2 0 "False" 1 "True" /end COMPU_VTAB
/begin COMPU_METHOD DDRC_LstRprtEve_VERB "" TAB_VERB "%6.3" "" COMPU_TAB_REF DDRC_LstRprtEve_VERB /end COMPU_METHOD
/begin COMPU_VTAB DDRC_LstRprtEve_VERB "" TAB_VERB 5 0 "PASSED" 1 "FAILED" 2 "PREPASSED" 3 "PREFAILED" 255 "INVALID" /end COMPU_VTAB
/begin COMPU_METHOD DDRC_Ratio "" TAB_VERB "%6.3" "-" COMPU_TAB_REF DDRC_Ratio /end COMPU_METHOD
/begin COMPU_VTAB DDRC_Ratio "" TAB_VERB 4 1 "Ratio1" 2 "Ratio2" 3 "Ratio3" 4 "Ratio4" /end COMPU_VTAB
/begin COMPU_METHOD DEDIA_VRNTCONF_SY_Compu "" TAB_VERB "%6.3" "" COMPU_TAB_REF DEDIA_VRNTCONF_SY_Compu /end COMPU_METHOD
/begin COMPU_VTAB DEDIA_VRNTCONF_SY_Compu "" TAB_VERB 3 0 "DEDIA_VRNTCONF_ALL" 1 "DEDIA_VRNTCONF_DS" 2 "DEDIA_VRNTCONF_GS" /end COMPU_VTAB
/begin COMPU_METHOD DEFDSTRTTMNGFORDIGSENS_SY_Compu "" TAB_VERB "%6.3" "" COMPU_TAB_REF DEFDSTRTTMNGFORDIGSENS_SY_Compu /end COMPU_METHOD
/begin COMPU_VTAB DEFDSTRTTMNGFORDIGSENS_SY_Compu "" TAB_VERB 2 0 "False" 1 "True" /end COMPU_VTAB
/begin COMPU_METHOD Dem_DTCFltSt_Verb "" TAB_VERB "%6.3" "-" COMPU_TAB_REF Dem_DTCFltSt_Verb /end COMPU_METHOD
/begin COMPU_VTAB Dem_DTCFltSt_Verb "" TAB_VERB 6 0 "IDLE" 1 "UDS_ENTRIES_PENDING" 2 "UDS_DTCS_PENDING" 3 "UDS_ENTRIES_RSLT" 4 "OBD_ENTRIES_RSLT" 5 "UDS_DTCS_RSLT" /end COMPU_VTAB
/begin COMPU_METHOD DEM_SC_Compu "" TAB_VERB "%6.3" "" COMPU_TAB_REF DEM_SC_Compu /end COMPU_METHOD
/begin COMPU_VTAB DEM_SC_Compu "" TAB_VERB 2 0 "False" 1 "True" /end COMPU_VTAB
/begin COMPU_METHOD Dens "" RAT_FUNC "%6.3" "Kg/m^3" COEFFS 0 10 0 0 0 1 /end COMPU_METHOD
/begin COMPU_METHOD DensFine "" RAT_FUNC "%6.4" "Kg/m^3" COEFFS 0 500 0 0 0 1 /end COMPU_METHOD
/begin COMPU_METHOD DerPresRl_COMPU "" RAT_FUNC "%6.0" "hPa/s" COEFFS 0 0.01 0 0 0 1 /end COMPU_METHOD
/begin COMPU_METHOD DEVLIB_4WINDIACMPNENA_SY_Compu "" TAB_VERB "%6.3" "" COMPU_TAB_REF DEVLIB_4WINDIACMPNENA_SY_Compu /end COMPU_METHOD
/begin COMPU_VTAB DEVLIB_4WINDIACMPNENA_SY_Compu "" TAB_VERB 2 0 "False" 1 "True" /end COMPU_VTAB
/begin COMPU_METHOD DEVLIB_ACTRPRTAIRHTRCHK_SY_Compu "" TAB_VERB "%6.3" "" COMPU_TAB_REF DEVLIB_ACTRPRTAIRHTRCHK_SY_Compu /end COMPU_METHOD
/begin COMPU_VTAB DEVLIB_ACTRPRTAIRHTRCHK_SY_Compu "" TAB_VERB 2 0 "False" 1 "True" /end COMPU_VTAB
/begin COMPU_METHOD DEVLIB_ACTRPRTCMPNENA_SY_Compu "" TAB_VERB "%6.3" "" COMPU_TAB_REF DEVLIB_ACTRPRTCMPNENA_SY_Compu /end COMPU_METHOD
/begin COMPU_VTAB DEVLIB_ACTRPRTCMPNENA_SY_Compu "" TAB_VERB 2 0 "False" 1 "True" /end COMPU_VTAB
/begin COMPU_METHOD DEVLIB_ACTRPRTGLWCTLCHK_SY_Compu "" TAB_VERB "%6.3" "" COMPU_TAB_REF DEVLIB_ACTRPRTGLWCTLCHK_SY_Compu /end COMPU_METHOD
/begin COMPU_VTAB DEVLIB_ACTRPRTGLWCTLCHK_SY_Compu "" TAB_VERB 2 0 "False" 1 "True" /end COMPU_VTAB
/begin COMPU_METHOD DEVLIB_DBG_SY_Compu "" TAB_VERB "%6.3" "" COMPU_TAB_REF DEVLIB_DBG_SY_Compu /end COMPU_METHOD
/begin COMPU_VTAB DEVLIB_DBG_SY_Compu "" TAB_VERB 2 0 "False" 1 "True" /end COMPU_VTAB
/begin COMPU_METHOD DEVLIB_DIACTLLINECMPNENA_SY_Compu "" TAB_VERB "%6.3" "" COMPU_TAB_REF DEVLIB_DIACTLLINECMPNENA_SY_Compu /end COMPU_METHOD
/begin COMPU_VTAB DEVLIB_DIACTLLINECMPNENA_SY_Compu "" TAB_VERB 2 0 "False" 1 "True" /end COMPU_VTAB
/begin COMPU_METHOD DEVLIB_HBRGADVHWSEL_SY_Compu "" TAB_VERB "%6.3" "" COMPU_TAB_REF DEVLIB_HBRGADVHWSEL_SY_Compu /end COMPU_METHOD
/begin COMPU_VTAB DEVLIB_HBRGADVHWSEL_SY_Compu "" TAB_VERB 4 0 "NOFUNC" 1 "TLE7209" 2 "CY146" 3 "BOTH" /end COMPU_VTAB
/begin COMPU_METHOD DEVLIB_HBRGENA_SY_Compu "" TAB_VERB "%6.3" "" COMPU_TAB_REF DEVLIB_HBRGENA_SY_Compu /end COMPU_METHOD
/begin COMPU_VTAB DEVLIB_HBRGENA_SY_Compu "" TAB_VERB 2 0 "0" 1 "1" /end COMPU_VTAB
/begin COMPU_METHOD DEVLIB_PHYSRNGCHK_SY_Compu "" TAB_VERB "%6.3" "" COMPU_TAB_REF DEVLIB_PHYSRNGCHK_SY_Compu /end COMPU_METHOD
/begin COMPU_VTAB DEVLIB_PHYSRNGCHK_SY_Compu "" TAB_VERB 2 0 "FALSE" 1 "TRUE" /end COMPU_VTAB
/begin COMPU_METHOD DEVLIB_PSOFFOPNLD_SY_Compu "" TAB_VERB "%6.3" "" COMPU_TAB_REF DEVLIB_PSOFFOPNLD_SY_Compu /end COMPU_METHOD
/begin COMPU_VTAB DEVLIB_PSOFFOPNLD_SY_Compu "" TAB_VERB 2 0 "FALSE" 1 "TRUE" /end COMPU_VTAB
/begin COMPU_METHOD DEVLIB_PSSTATEMOCSOPINI_SY_Compu "" TAB_VERB "%6.3" "" COMPU_TAB_REF DEVLIB_PSSTATEMOCSOPINI_SY_Compu /end COMPU_METHOD
/begin COMPU_VTAB DEVLIB_PSSTATEMOCSOPINI_SY_Compu "" TAB_VERB 2 0 "False" 1 "True" /end COMPU_VTAB
/begin COMPU_METHOD DEVLIB_PWRSTGSTATEMOCSOPCHK_SY_Compu "" TAB_VERB "%6.3" "" COMPU_TAB_REF DEVLIB_PWRSTGSTATEMOCSOPCHK_SY_Compu /end COMPU_METHOD
/begin COMPU_VTAB DEVLIB_PWRSTGSTATEMOCSOPCHK_SY_Compu "" TAB_VERB 2 0 "False" 1 "True" /end COMPU_VTAB
/begin COMPU_METHOD dez "" RAT_FUNC "%6.2" "" COEFFS 0 1 0 0 0 1 /end COMPU_METHOD
/begin COMPU_METHOD DFC_CALPRMSTATDISBLMSK_SC_Compu "" TAB_VERB "%6.3" "" COMPU_TAB_REF DFC_CALPRMSTATDISBLMSK_SC_Compu /end COMPU_METHOD
/begin COMPU_VTAB DFC_CALPRMSTATDISBLMSK_SC_Compu "" TAB_VERB 2 0 "Disabled" 1 "Enabled" /end COMPU_VTAB
/begin COMPU_METHOD DFC_CTLDISBLLAYOUT_SY_Compu "" RAT_FUNC "%6.2" "" COEFFS 0 1 0 0 0 1 /end COMPU_METHOD
/begin COMPU_METHOD DFC_CTLMSKBYTES_SY_Compu "" TAB_VERB "%6.3" "" COMPU_TAB_REF DFC_CTLMSKBYTES_SY_Compu /end COMPU_METHOD
/begin COMPU_VTAB DFC_CTLMSKBYTES_SY_Compu "" TAB_VERB 2 1 "SIZE_1_BYTE" 2 "SIZE_2_BYTES" /end COMPU_VTAB
/begin COMPU_METHOD DFC_DISBLMSKBYTES_SY_Compu "" TAB_VERB "%6.3" "" COMPU_TAB_REF DFC_DISBLMSKBYTES_SY_Compu /end COMPU_METHOD
/begin COMPU_VTAB DFC_DISBLMSKBYTES_SY_Compu "" TAB_VERB 3 1 "SIZE_1_BYTE" 2 "SIZE_2_BYTES" 4 "SIZE_4_BYTES" /end COMPU_VTAB
/begin COMPU_METHOD DFC_OneToOne "" RAT_FUNC "%6.2" "-" COEFFS 0 1 0 0 0 1 /end COMPU_METHOD
/begin COMPU_METHOD DFES_ACTVENHMTSIMCONDPID9F_SC_Compu "" TAB_VERB "%6.3" "" COMPU_TAB_REF DFES_ACTVENHMTSIMCONDPID9F_SC_Compu /end COMPU_METHOD
/begin COMPU_VTAB DFES_ACTVENHMTSIMCONDPID9F_SC_Compu "" TAB_VERB 2 0 "False" 1 "True" /end COMPU_VTAB
/begin COMPU_METHOD DFES_ACTVSIMRCDNPID03_SC_Compu "" TAB_VERB "%6.3" "" COMPU_TAB_REF DFES_ACTVSIMRCDNPID03_SC_Compu /end COMPU_METHOD
/begin COMPU_VTAB DFES_ACTVSIMRCDNPID03_SC_Compu "" TAB_VERB 2 0 "False" 1 "True" /end COMPU_VTAB
/begin COMPU_METHOD DFES_ADDLMILMOD_SC_Compu "" TAB_VERB "%6.3" "" COMPU_TAB_REF DFES_ADDLMILMOD_SC_Compu /end COMPU_METHOD
/begin COMPU_VTAB DFES_ADDLMILMOD_SC_Compu "" TAB_VERB 2 0 "NO_ADDLMILMOD" 1 "ADDLMILMOD_SET1" /end COMPU_VTAB
/begin COMPU_METHOD DFES_BLINKPATENA_SC_Compu "" TAB_VERB "%6.3" "" COMPU_TAB_REF DFES_BLINKPATENA_SC_Compu /end COMPU_METHOD
/begin COMPU_VTAB DFES_BLINKPATENA_SC_Compu "" TAB_VERB 2 0 "False" 1 "True" /end COMPU_VTAB
/begin COMPU_METHOD DFES_BLKENTRY_SY_Compu "" TAB_VERB "%6.3" "" COMPU_TAB_REF DFES_BLKENTRY_SY_Compu /end COMPU_METHOD
/begin COMPU_VTAB DFES_BLKENTRY_SY_Compu "" TAB_VERB 2 0 "False" 1 "True" /end COMPU_VTAB
/begin COMPU_METHOD DFES_COMMILDEB_SY_Compu "" TAB_VERB "%6.3" "" COMPU_TAB_REF DFES_COMMILDEB_SY_Compu /end COMPU_METHOD
/begin COMPU_VTAB DFES_COMMILDEB_SY_Compu "" TAB_VERB 2 0 "DISABLED" 1 "ENABLED" /end COMPU_VTAB
/begin COMPU_METHOD DFES_DTC_TSTFAIL_SY_Compu "" TAB_VERB "%6.3" "" COMPU_TAB_REF DFES_DTC_TSTFAIL_SY_Compu /end COMPU_METHOD
/begin COMPU_VTAB DFES_DTC_TSTFAIL_SY_Compu "" TAB_VERB 2 0 "0" 1 "1" /end COMPU_VTAB
/begin COMPU_METHOD DFES_EOLCLR_SY_Compu "" TAB_VERB "%6.3" "" COMPU_TAB_REF DFES_EOLCLR_SY_Compu /end COMPU_METHOD
/begin COMPU_VTAB DFES_EOLCLR_SY_Compu "" TAB_VERB 2 0 "False" 1 "True" /end COMPU_VTAB
/begin COMPU_METHOD DFES_EXTDFLT_SY_Compu "" TAB_VERB "%6.3" "" COMPU_TAB_REF DFES_EXTDFLT_SY_Compu /end COMPU_METHOD
/begin COMPU_VTAB DFES_EXTDFLT_SY_Compu "" TAB_VERB 2 0 "DISABLED" 1 "ENABLED" /end COMPU_VTAB
/begin COMPU_METHOD DFES_IRV_SY_Compu "" TAB_VERB "%6.3" "" COMPU_TAB_REF DFES_IRV_SY_Compu /end COMPU_METHOD
/begin COMPU_VTAB DFES_IRV_SY_Compu "" TAB_VERB 2 0 "DFES_IRV_DISBL" 1 "DFES_IRV_ENA" /end COMPU_VTAB
/begin COMPU_METHOD DFES_OneToOne "" RAT_FUNC "%6.2" "-" COEFFS 0 1 0 0 0 1 /end COMPU_METHOD
/begin COMPU_METHOD DFES_PDTC_SY_Compu "" TAB_VERB "%6.3" "" COMPU_TAB_REF DFES_PDTC_SY_Compu /end COMPU_METHOD
/begin COMPU_VTAB DFES_PDTC_SY_Compu "" TAB_VERB 2 0 "False" 1 "True" /end COMPU_VTAB
/begin COMPU_METHOD DFES_PRVTSTRDLT_SY_Compu "" TAB_VERB "%6.3" "" COMPU_TAB_REF DFES_PRVTSTRDLT_SY_Compu /end COMPU_METHOD
/begin COMPU_VTAB DFES_PRVTSTRDLT_SY_Compu "" TAB_VERB 2 0 "False" 1 "True" /end COMPU_VTAB
/begin COMPU_METHOD DFES_SIMCOND_SY_Compu "" TAB_VERB "%6.3" "" COMPU_TAB_REF DFES_SIMCOND_SY_Compu /end COMPU_METHOD
/begin COMPU_VTAB DFES_SIMCOND_SY_Compu "" TAB_VERB 2 0 "DISABLED" 1 "ENABLED" /end COMPU_VTAB
/begin COMPU_METHOD DFES_VIS_BUF_SY_Compu "" TAB_VERB "%6.3" "" COMPU_TAB_REF DFES_VIS_BUF_SY_Compu /end COMPU_METHOD
/begin COMPU_VTAB DFES_VIS_BUF_SY_Compu "" TAB_VERB 2 0 "0" 1 "1" /end COMPU_VTAB
/begin COMPU_METHOD dFlConsum "" RAT_FUNC "%6.4" "l/h/s" COEFFS 0 100 0 0 0 1 /end COMPU_METHOD
/begin COMPU_METHOD DIAACTR_ELECCTRLLINEDIAGCPTENA_SC_Compu "" TAB_VERB "%6.3" "" COMPU_TAB_REF DIAACTR_ELECCTRLLINEDIAGCPTENA_SC_Compu /end COMPU_METHOD
/begin COMPU_VTAB DIAACTR_ELECCTRLLINEDIAGCPTENA_SC_Compu "" TAB_VERB 2 0 "False" 1 "True" /end COMPU_VTAB
/begin COMPU_METHOD DIAACTR_ELECHBRDGDIAGENA_SC_Compu "" TAB_VERB "%6.3" "" COMPU_TAB_REF DIAACTR_ELECHBRDGDIAGENA_SC_Compu /end COMPU_METHOD
/begin COMPU_VTAB DIAACTR_ELECHBRDGDIAGENA_SC_Compu "" TAB_VERB 2 0 "False" 1 "True" /end COMPU_VTAB
/begin COMPU_METHOD DIAACTR_ELECPSDIAGCMPNENA_SC_Compu "" TAB_VERB "%6.3" "" COMPU_TAB_REF DIAACTR_ELECPSDIAGCMPNENA_SC_Compu /end COMPU_METHOD
/begin COMPU_VTAB DIAACTR_ELECPSDIAGCMPNENA_SC_Compu "" TAB_VERB 2 0 "False" 1 "True" /end COMPU_VTAB
/begin COMPU_METHOD DIAACTR_ELECPSDIAGERRINFO_SC_Compu "" TAB_VERB "%6.3" "" COMPU_TAB_REF DIAACTR_ELECPSDIAGERRINFO_SC_Compu /end COMPU_METHOD
/begin COMPU_VTAB DIAACTR_ELECPSDIAGERRINFO_SC_Compu "" TAB_VERB 2 0 "LSTRAWINFO" 1 "LSTTESTRSLT" /end COMPU_VTAB
/begin COMPU_METHOD DIABAS_ATSLRGIDSUPRT_SC_Compu "" TAB_VERB "%6.3" "" COMPU_TAB_REF DIABAS_ATSLRGIDSUPRT_SC_Compu /end COMPU_METHOD
/begin COMPU_VTAB DIABAS_ATSLRGIDSUPRT_SC_Compu "" TAB_VERB 2 0 "DISABLE" 1 "ENABLE" /end COMPU_VTAB
/begin COMPU_METHOD DIABAS_ATSSUSP_SC_Compu "" TAB_VERB "%6.3" "" COMPU_TAB_REF DIABAS_ATSSUSP_SC_Compu /end COMPU_METHOD
/begin COMPU_VTAB DIABAS_ATSSUSP_SC_Compu "" TAB_VERB 2 1 "Temporary" 2 "Permanent" /end COMPU_VTAB
/begin COMPU_METHOD DIABAS_ATS_SC_Compu "" TAB_VERB "%6.3" "" COMPU_TAB_REF DIABAS_ATS_SC_Compu /end COMPU_METHOD
/begin COMPU_VTAB DIABAS_ATS_SC_Compu "" TAB_VERB 2 0 "ATS inactive" 1 "ATS active" /end COMPU_VTAB
/begin COMPU_METHOD DIABAS_AVS_SY_Compu "" TAB_VERB "%6.3" "" COMPU_TAB_REF DIABAS_AVS_SY_Compu /end COMPU_METHOD
/begin COMPU_VTAB DIABAS_AVS_SY_Compu "" TAB_VERB 2 0 "False" 1 "True" /end COMPU_VTAB
/begin COMPU_METHOD EngN "" RAT_FUNC "%6.3" "rpm" COEFFS 0 2 0 0 0 1 /end COMPU_METHOD
/begin COMPU_METHOD EngN_LRes "" RAT_FUNC "%6.1" "rpm" COEFFS 0 0.025 0 0 0 1 /end COMPU_METHOD
/begin COMPU_METHOD fak_q0p1 "" RAT_FUNC "%6.3" "-" COEFFS 0 1 0 0 0 0.1 /end COMPU_METHOD
/begin COMPU_METHOD fak_uw_b2 "" RAT_FUNC "%7.6" "-" COEFFS 0 65536 0 0 0 2 /end COMPU_METHOD
/begin COMPU_METHOD nmot_uw_q0p25 "" RAT_FUNC "%6.3" "1/min" COEFFS 0 1 0 0 0 0.25 /end COMPU_METHOD
/begin COMPU_METHOD OneToOne "" RAT_FUNC "%6.2" "-" COEFFS 0 1 0 0 0 1 /end COMPU_METHOD
/begin COMPU_METHOD pps_uw_q1 "" RAT_FUNC "%6.2" "pps" COEFFS 0 1 0 0 0 1 /end COMPU_METHOD
/begin COMPU_METHOD p_uw_q0p039 "" RAT_FUNC "%6.4" "hPa" COEFFS 0 256 0 0 0 10 /end COMPU_METHOD
/begin COMPU_METHOD RBPtCel_v_0p05625_1 "" RAT_FUNC "%6.4" "km/h" COEFFS 0 640 0 0 0 36 /end COMPU_METHOD
/begin COMPU_METHOD rel_ub_b100 "" RAT_FUNC "%6.3" "%" COEFFS 0 256 0 0 0 100 /end COMPU_METHOD
/begin COMPU_METHOD rel_uw_b100 "" RAT_FUNC "%6.4" "%" COEFFS 0 65536 0 0 0 100 /end COMPU_METHOD
/begin COMPU_METHOD spg_q0p1 "" RAT_FUNC "%6.3" "V" COEFFS 0 1 0 0 0 0.1 /end COMPU_METHOD
/begin COMPU_METHOD spg_ubatt "" RAT_FUNC "%6.4" "V" COEFFS 0 14.2045454545455 0 0 0 1 /end COMPU_METHOD
/begin COMPU_METHOD spg_uw_q0p001222 "" RAT_FUNC "%6.4" "V" COEFFS 0 65536 0 0 0 80 /end COMPU_METHOD
/begin COMPU_METHOD Time_sec_q1_COMPU "" RAT_FUNC "%6.2" "s" COEFFS 0 1 0 0 0 1 /end COMPU_METHOD
/begin COMPU_METHOD t_q0p001 "" RAT_FUNC "%6.5" "s" COEFFS 0 1000 0 0 0 1 /end COMPU_METHOD
/begin COMPU_METHOD t_q0p01 "" RAT_FUNC "%6.4" "s" COEFFS 0 100 0 0 0 1 /end COMPU_METHOD
/begin COMPU_METHOD Volt_Batt "" RAT_FUNC "%6.1" "mV" COEFFS 0 0.05 0 0 0 1 /end COMPU_METHOD
/begin COMPU_METHOD defaultAscii "" RAT_FUNC "%6.2" "" COEFFS 0 1 0 0 0 1 /end COMPU_METHOD
/begin RECORD_LAYOUT KlAxU8SstxU16WU16 NO_AXIS_PTS_X 1 UWORD AXIS_PTS_X 2 UWORD INDEX_INCR DIRECT FNC_VALUES 3 UWORD COLUMN_DIR DIRECT /end RECORD_LAYOUT
/begin RECORD_LAYOUT KwbUb FNC_VALUES 1 UBYTE COLUMN_DIR DIRECT /end RECORD_LAYOUT
/begin RECORD_LAYOUT KwbWU8 FNC_VALUES 1 UBYTE COLUMN_DIR DIRECT /end RECORD_LAYOUT
/begin RECORD_LAYOUT KwWU16 FNC_VALUES 1 UWORD COLUMN_DIR DIRECT /end RECORD_LAYOUT
/begin RECORD_LAYOUT KwWU8 FNC_VALUES 1 UBYTE COLUMN_DIR DIRECT /end RECORD_LAYOUT
/begin RECORD_LAYOUT RB_Val_Ws16 FNC_VALUES 1 SWORD COLUMN_DIR DIRECT /end RECORD_LAYOUT
/begin RECORD_LAYOUT RB_Val_Wu8 FNC_VALUES 1 UBYTE COLUMN_DIR DIRECT /end RECORD_LAYOUT
/begin RECORD_LAYOUT ValA_Wu8 FNC_VALUES 1 UBYTE COLUMN_DIR DIRECT /end RECORD_LAYOUT
/begin RECORD_LAYOUT Val_Ws16 FNC_VALUES 1 SWORD COLUMN_DIR DIRECT /end RECORD_LAYOUT
/begin RECORD_LAYOUT Val_Wu16 FNC_VALUES 1 UWORD COLUMN_DIR DIRECT /end RECORD_LAYOUT
/begin RECORD_LAYOUT Val_Wu8 FNC_VALUES 1 UBYTE COLUMN_DIR DIRECT /end RECORD_LAYOUT
/end MODULE
/end PROJECT
